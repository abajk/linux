## Documentation/devicetree/bindings/remoteproc/qcom,ipq8074-wcss-pil.yaml
```yaml
# SPDX-License-Identifier: (GPL-2.0-only OR BSD-2-Clause)
%YAML 1.2
---
$id: http://devicetree.org/schemas/remoteproc/qcom,ipq8074-wcss-pil.yaml#
$schema: http://devicetree.org/meta-schemas/core.yaml#

title: Qualcomm Hexagon Peripheral Image Loader

maintainers:
  - Avaneesh Kumar Dwivedi <quic_akdwived@quicinc.com>
  - Bjorn Andersson <andersson@kernel.org>
  - Govind Singh <govinds@codeaurora.org>
  - Jeffrey Hugo <jeffrey.l.hugo@gmail.com>
  - Krzysztof Kozlowski <krzysztof.kozlowski@linaro.org>
  - Luca Weiss <luca@lucaweiss.eu>
  - Sibi Sankar <quic_sibis@quicinc.com>
  - Slark Xiao <slark_xiao@163.com>
  - Sricharan Ramabadhran <quic_srichara@quicinc.com>
  - Stephan Gerhold <stephan.gerhold@kernkonzept.com>
  - Stephan Gerhold <stephan@gerhold.net>

description: |
  Qualcomm Hexagon Peripheral Image Loader

  This document defines the binding for a component that loads and boots firmware
  on the Qualcomm Hexagon core.

  The Hexagon node may also have a subnode named either "smd-edge" or
  "glink-edge" that describes the communication edge, channels and devices
  related to the Hexagon. See ../soc/qcom/qcom,smd.yaml and
  ../soc/qcom/qcom,glink.txt for details on how to describe these.

properties:
  compatible:
    items:
      - enum:
          - qcom,ipq8074-wcss-pil
          - qcom,qcs404-wcss-pil
    description: Identifies this node as a Qualcomm Hexagon PIL.

  reg:
    items:
      - description: Base address and size of the QDSP6 register block.
      - description: Base address and size of the RMB register block.
    description: Register ranges for the QDSP6 and RMB blocks.

  reg-names:
    items:
      - const: q6dsp
      - const: rmb
    description: Names corresponding to the register ranges.

  interrupts-extended:
    items:
      - description: Phandle and specifier for the watchdog interrupt.
      - description: Phandle and specifier for the fatal interrupt.
      - description: Phandle and specifier for the ready interrupt.
      - description: Phandle and specifier for the handover interrupt.
      - description: Phandle and specifier for the stop-ack interrupt.
    description: References to interrupts matching interrupt-names.

  interrupt-names:
    items:
      - const: wdog
      - const: fatal
      - const: ready
      - const: handover
      - const: stop-ack
    description: Names of the interrupts for the Hexagon core.

  clocks:
    items:
      - description: Phandle to the clock required by the Hexagon core.
    description: Reference to the clocks matching clock-names.

  clock-names:
    items:
      - const: xo
      - const: gcc_abhs_cbcr
      - const: gcc_abhs_cbcr
      - const: gcc_axim_cbcr
      - const: lcc_ahbfabric_cbc
      - const: tcsr_lcc_cbc
      - const: lcc_abhs_cbc
      - const: lcc_tcm_slave_cbc
      - const: lcc_abhm_cbc
      - const: lcc_axim_cbc
      - const: lcc_bcr_sleep
    description: Names of clocks required by qcom,qcs404-wcss-pil.

  resets:
    items:
      - description: Reset controller for the WCSS AON domain.
      - description: Reset controller for the WCSS core.
      - description: Reset controller for the WCSS Q6 core.
    description: Reset controllers for the WCSS sub-system.

  reset-names:
    items:
      - const: wcss_aon_reset
      - const: wcss_reset
      - const: wcss_q6_reset
    description: Names corresponding to the reset controllers.

  memory-region:
    description: Reference to the reserved-memory region for the WCSS subsystem.

  cx-supply:
    description: Reference to regulators held during Hexagon core boot.

  qcom,smem-states:
    description: Reference to the SMEM state for requesting Hexagon shutdown.
    $ref: /schemas/types.yaml#/definitions/phandle-array

  qcom,smem-state-names:
    items:
      - const: stop
    description: Name of the SMEM state for shutdown requests.

  qcom,halt-regs:
    items:
      - description: Phandle to TCSR syscon.
      - description: Offset for Q6 halt register.
      - description: Offset for WCSS halt register.
      - description: Offset for NC halt register.
    description: Halt register locations within the TCSR syscon.

allOf:
  - if:
      properties:
        compatible:
          contains:
            const: qcom,qcs404-wcss-pil
    then:
      required:
        - cx-supply
        - qcom,smem-states
        - qcom,smem-state-names
        - qcom,halt-regs
    else:
      properties:
        cx-supply: false
        qcom,smem-states: false
        qcom,smem-state-names: false
        qcom,halt-regs: false

required:
  - compatible
  - reg
  - reg-names
  - interrupts-extended
  - interrupt-names
  - clocks
  - clock-names
  - resets
  - reset-names
  - memory-region

additionalProperties: false

examples:
  - |
    remoteproc@0x100000 {
      compatible = "qcom,qcs404-wcss-pil";
      reg = <0x12340000 0x1000>, <0x12341000 0x1000>;
      reg-names = "q6dsp", "rmb";
      interrupts-extended = <&intc 1>, <&intc 2>, <&intc 3>, <&intc 4>, <&intc 5>;
      interrupt-names = "wdog", "fatal", "ready", "handover", "stop-ack";
      clocks = <&xo_clk>;
      clock-names = "xo";
      resets = <&wcss_aon_reset>, <&wcss_reset>, <&wcss_q6_reset>;
      reset-names = "wcss_aon_reset", "wcss_reset", "wcss_q6_reset";
      memory-region = <&wcss_mem>;
      cx-supply = <&vdd_rcc>;
      qcom,smem-states = <&smem_state>;
      qcom,smem-state-names = "stop";
      qcom,halt-regs = <&tcsr 0x4 0x8 0xC>;
    };
```

## Documentation/devicetree/bindings/remoteproc/st,st231-rproc.yaml
```yaml
# SPDX-License-Identifier: (GPL-2.0-only OR BSD-2-Clause)
%YAML 1.2
---
$id: http://devicetree.org/schemas/remoteproc/st,st231-rproc.yaml#
$schema: http://devicetree.org/meta-schemas/core.yaml#

title: STMicroelectronics Co-Processor

maintainers:
  - Lee Jones <lee@kernel.org>

description: |
  This binding provides support for adjunct processors found on ST SoCs.

  Co-processors can be controlled from the bootloader or the primary OS. If
  the bootloader starts a co-processor, the primary OS must detect its state
  and act accordingly.

properties:
  compatible:
    description: Co-processor compatible string.
    items:
      - enum:
          - st,st231-rproc
          - st,st40-rproc

  memory-region:
    description: Reserved memory region for the co-processor.
    $ref: /schemas/types.yaml#/definitions/phandle

  resets:
    description: Reset lines for the co-processor.
    items:
      - description: sw_reset reset phandle and specifier.
      - description: pwr_reset reset phandle and specifier.

  reset-names:
    description: Names for each reset line.
    items:
      - const: sw_reset
      - const: pwr_reset

  clocks:
    maxItems: 1
    description: Clock for the co-processor.

  clock-frequency:
    description: Clock frequency to set the co-processor if the bootloader hasn't already done so.

  "st,syscfg":
    description: System configuration register which holds the boot vector for the co-processor.
    items:
      - description: Phandle to syscon block.
      - description: Boot vector register offset.

required:
  - compatible
  - memory-region
  - resets
  - reset-names
  - clocks
  - clock-frequency
  - "st,syscfg"

additionalProperties: false

examples:
  - |
    audio_reserved: rproc@42000000 {
        compatible = "shared-dma-pool";
        reg = <0x42000000 0x01000000>;
        no-map;
    };

  - |
    st231-audio {
        compatible = "st,st231-rproc";
        memory-region = <&audio_reserved>;
        resets = <&softreset STIH407_ST231_AUD_SOFTRESET>;
        reset-names = "sw_reset";
        clocks = <&clk_s_c0_flexgen CLK_ST231_AUD_0>;
        clock-frequency = <600000000>;
        st,syscfg = <&syscfg_core 0x228>;
    };
```

## Documentation/devicetree/bindings/remoteproc/ti,am3352-wkup-m3.yaml
```yaml
# SPDX-License-Identifier: (GPL-2.0-only OR BSD-2-Clause)
%YAML 1.2
---
$id: http://devicetree.org/schemas/remoteproc/ti,am3352-wkup-m3.yaml#
$schema: http://devicetree.org/meta-schemas/core.yaml#

title: TI Wakeup M3 Remoteproc Driver

maintainers:
  - Dave Gerlach <d-gerlach@ti.com>

description: |
  TI Wakeup M3 Remoteproc Driver

  The TI AM33xx and AM43xx family of devices use a small Cortex M3
  co-processor (commonly referred to as Wakeup M3 or CM3) to help
  with various low power tasks that cannot be controlled from the MPU.
  This CM3 processor requires a firmware binary to accomplish this.
  The wkup_m3 remoteproc driver handles the loading of the firmware
  and booting of the CM3.

  Wkup M3 Device Node:

  A wkup_m3 device node is used to represent the Wakeup M3 processor
  instance within the SoC. It is added as a child node of the parent
  interconnect bus (l4_wkup) through which it is accessible to the MPU.

properties:
  compatible:
    description: Hardware compatibility string for Wakeup M3 co-processor.
    oneOf:
      - items:
          - enum:
              - ti,am3352-wkup-m3
              - ti,am4372-wkup-m3

  reg:
    description: Internal memory address ranges for the Wakeup M3 firmware.
    items:
      - description: Address and size of UMEM region
      - description: Address and size of DMEM region

  reg-names:
    description: Names of the two memory regions.
    items:
      - const: umem
      - const: dmem

  ti,hwmods:
    description: Name of the hardware module associated with the wkup M3 device.
    $ref: /schemas/types.yaml#/definitions/string

  ti,pm-firmware:
    description: Name of the firmware file to load and boot the wkup M3.
    $ref: /schemas/types.yaml#/definitions/string

required:
  - compatible
  - reg
  - reg-names
  - ti,hwmods
  - ti,pm-firmware

additionalProperties: false

examples:
  - |
    /* AM33xx */
    ocp {
        l4_wkup: l4_wkup@44c00000 {
            compatible = "am335-l4-wkup", "simple-bus";
            ranges = <0 0x44c00000 0x400000>;
            #address-cells = <1>;
            #size-cells = <1>;

            wkup_m3: wkup_m3@100000 {
                compatible = "ti,am3352-wkup-m3";
                reg = <0x100000 0x4000>,
                      <0x180000 0x2000>;
                reg-names = "umem", "dmem";
                ti,hwmods = "wkup_m3";
                ti,pm-firmware = "am335x-pm-firmware.elf";
            };
        };

        ...
    };
```

## Documentation/devicetree/bindings/remoteproc/ti,da850-dsp.yaml
```yaml
# SPDX-License-Identifier: (GPL-2.0-only OR BSD-2-Clause)
%YAML 1.2
---
$id: http://devicetree.org/schemas/remoteproc/ti,da850-dsp.yaml#
$schema: http://devicetree.org/meta-schemas/core.yaml#

title: TI Davinci DSP devices

maintainers:
  - Krzysztof Kozlowski <krzysztof.kozlowski@linaro.org>
  - Rob Herring <robh@kernel.org>
  - Suman Anna <s-anna@ti.com>

description: |
  The TI Davinci family of SoCs usually contains a TI DSP Core sub-system that
  is used to offload some of the processor-intensive tasks or algorithms, for
  achieving various system level goals.

  The processor cores in the sub-system usually contain additional sub-modules
  like L1 and/or L2 caches/SRAMs, an Interrupt Controller, an external memory
  controller, a dedicated local power/sleep controller etc. The DSP processor
  core used in Davinci SoCs is usually a C674x DSP CPU.

  DSP Device Node:
  Each DSP Core sub-system is represented as a single DT node.

properties:
  compatible:
    items:
      - enum: [ti, da850-dsp]
  reg:
    items:
      - description: L2 SRAM memory region
      - description: L1 PRAM memory region
      - description: L1 DRAM memory region
      - description: HOST1CFG register space
      - description: CHIPSIG_BASE register space
  reg-names:
    items:
      - const: l2sram
      - const: l1pram
      - const: l1dram
      - const: host1cfg
      - const: chipsig_base
  interrupts:
    items:
      - description: DSP interrupt line
  memory-region:
    $ref: /schemas/types.yaml#/definitions/phandle

required:
  - compatible
  - reg
  - reg-names
  - interrupts
  - memory-region

additionalProperties: false

examples:
  - |
    reserved-memory {
      #address-cells = <1>;
      #size-cells = <1>;
      ranges;

      dsp_memory_region: dsp-memory@c3000000 {
        compatible = "shared-dma-pool";
        reg = <0xc3000000 0x1000000>;
        reusable;
      };
    };

    dsp: dsp@11800000 {
      compatible = "ti,da850-dsp";
      reg = <0x11800000 0x40000>,
            <0x11e00000 0x8000>,
            <0x11f00000 0x8000>,
            <0x01c14044 0x4>,
            <0x01c14174 0x8>;
      reg-names = "l2sram", "l1pram", "l1dram", "host1cfg", "chipsig_base";
      interrupts = <28>;
      memory-region = <&dsp_memory_region>;
    };
```
