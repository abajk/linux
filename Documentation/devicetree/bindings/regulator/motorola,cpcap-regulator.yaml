## Documentation/devicetree/bindings/regulator/motorola,cpcap-regulator.yaml
```yaml
# SPDX-License-Identifier: (GPL-2.0-only OR BSD-2-Clause)
# Copyright 2025 Linaro Ltd.
%YAML 1.2
---
$id: http://devicetree.org/schemas/regulator/motorola,cpcap-regulator.yaml#
$schema: http://devicetree.org/meta-schemas/core.yaml#

title: Motorola CPCAP PMIC regulator

maintainers:
  - Peter Geis <pgwipeout@gmail.com>
  - Tony Lindgren <tony@atomide.com>

description: |
  Motorola CPCAP PMIC voltage regulators
  ------------------------------------

  Requires node properties:

  See Documentation/devicetree/bindings/regulator/regulator.txt
  for more details about the regulator properties.

properties:
  compatible:
    description: >
      Device compatible string.
    items:
      - enum:
          - "motorola,cpcap-regulator"
          - "motorola,mapphone-cpcap-regulator"
          - "motorola,xoom-cpcap-regulator"

  regulator-name:
    description: Name of the regulator.
    $ref: /schemas/types.yaml#/definitions/string

  regulator-min-microvolt:
    description: Minimum output voltage in microvolts.

  regulator-max-microvolt:
    description: Maximum output voltage in microvolts.

  regulator-enable-ramp-delay:
    description: Ramp delay on regulator enable in microseconds.
    $ref: /schemas/types.yaml#/definitions/uint32

  regulator-boot-on:
    description: Enable regulator at boot.
    type: boolean

required:
  - compatible
  - regulator-name
  - regulator-min-microvolt
  - regulator-max-microvolt
  - regulator-enable-ramp-delay

additionalProperties: false

examples:
  - |
    cpcap_regulator: regulator {
        compatible = "motorola,cpcap-regulator";
        regulator-name = "sw5";
        regulator-min-microvolt = <5050000>;
        regulator-max-microvolt = <5050000>;
        regulator-enable-ramp-delay = <50000>;
        regulator-boot-on;
    };
```

## Documentation/devicetree/bindings/regulator/mps,mp8859.yaml
```yaml
# SPDX-License-Identifier: (GPL-2.0-only OR BSD-2-Clause)
%YAML 1.2
---
$id: http://devicetree.org/schemas/regulator/mps,mp8859.yaml#
$schema: http://devicetree.org/meta-schemas/core.yaml#

title: Monolithic Power Systems MP8859 voltage regulator

maintainers:
  - Markus Reichl <m.reichl@fivetechno.de>

properties:
  compatible:
    items:
      - const: mps,mp8859

  reg:
    maxItems: 1

  mp8859_dcdc:
    description: Optional subnode for regulator
    $ref: /schemas/regulator/regulator.yaml
    unevaluatedProperties: false

required:
  - compatible
  - reg

additionalProperties: false

examples:
  - |
    regulator@66 {
        compatible = "mps,mp8859";
        reg = <0x66>;
        mp8859_dcdc {
            regulator-name = "dc_12v";
            regulator-min-microvolt = <12000000>;
            regulator-max-microvolt = <12000000>;
            regulator-boot-on;
            regulator-always-on;
        };
    };
```

## Documentation/devicetree/bindings/regulator/pvs,pv88080.yaml
```yaml
# SPDX-License-Identifier: (GPL-2.0-only OR BSD-2-Clause)
# Copyright 2025 Diasemi
---
$id: http://devicetree.org/schemas/regulator/pvs,pv88080.yaml#
$schema: http://devicetree.org/meta-schemas/core.yaml#

title: Powerventure Semiconductor PV88080 Voltage Regulator

maintainers:
  - Eric Jeong <eric.jeong.opensource@diasemi.com>
  - James Ban <James.Ban.opensource@diasemi.com>

description: |
  * Powerventure Semiconductor PV88080 Voltage Regulator

properties:
  compatible:
    enum:
      - pvs,pv88080-aa
      - pvs,pv88080-ba
      - pvs,pv88080
  reg:
    description: I2C slave address (usually 0x49)
    maxItems: 1

  interrupts:
    description: The interrupt outputs of the controller.
    items:
      - description: interrupt output 1
      - description: interrupt output 2
      
  regulators:
    description: A node that houses a sub-node for each regulator within the device.
      Each sub-node is identified using the node's name, with valid values listed below.
      The content of each sub-node is defined by the standard binding for regulators;
      see regulator.yaml.
    type: object
    additionalProperties: false
    properties:
      BUCK1:
        $ref: /schemas/regulator/regulator.yaml#
        unevaluatedProperties: false

      BUCK2:
        $ref: /schemas/regulator/regulator.yaml#
        unevaluatedProperties: false

      BUCK3:
        $ref: /schemas/regulator/regulator.yaml#
        unevaluatedProperties: false

      HVBUCK:
        $ref: /schemas/regulator/regulator.yaml#
        unevaluatedProperties: false

    required:
      - BUCK1
      - BUCK2
      - BUCK3
      - HVBUCK

required:
  - compatible
  - reg
  - interrupts
  - regulators

additionalProperties: false

examples:
  - |
    pmic: pv88080@49 {
        compatible = "pvs,pv88080-ba";
        reg = <0x49>;
        interrupts = <24 24>;
        regulators {
            BUCK1 {
                regulator-name = "buck1";
                regulator-min-microvolt = <600000>;
                regulator-max-microvolt = <1393750>;
                regulator-min-microamp = <220000>;
                regulator-max-microamp = <7040000>;
            };
            BUCK2 {
                regulator-name = "buck2";
                regulator-min-microvolt = <600000>;
                regulator-max-microvolt = <1393750>;
                regulator-min-microamp = <1496000>;
                regulator-max-microamp = <4189000>;
            };
            BUCK3 {
                regulator-name = "buck3";
                regulator-min-microvolt = <1400000>;
                regulator-max-microvolt = <2193750>;
                regulator-min-microamp = <1496000>;
                regulator-max-microamp = <4189000>;
            };
            HVBUCK {
                regulator-name = "hvbuck";
                regulator-min-microvolt = <5000>;
                regulator-max-microvolt = <1275000>;
            };
        };
    };
```

## Documentation/devicetree/bindings/regulator/pvs-pv88060.yaml
```yaml
# SPDX-License-Identifier: (GPL-2.0-only OR BSD-2-Clause)
%YAML 1.2
---
$id: http://devicetree.org/schemas/regulator/pvs-pv88060.yaml#
$schema: http://devicetree.org/meta-schemas/core.yaml#

title: Powerventure Semiconductor PV88060 Voltage Regulator

maintainers:
  - Geert Uytterhoeven <geert+renesas@glider.be>
  - James Ban <James.Ban.opensource@diasemi.com>

properties:
  compatible:
    enum:
      - pvs,pv88060

  reg:
    maxItems: 1
    description: I2C slave address, usually 0x49

  interrupts:
    description: the interrupt outputs of the controller
    items:
      - description: primary interrupt output
      - description: secondary interrupt output

  regulators:
    description: Node containing sub-nodes for each voltage regulator
    type: object
    additionalProperties: false
    properties:
      BUCK1:
        $ref: /schemas/regulator/regulator.yaml#
        unevaluatedProperties: false

      LDO1:
        $ref: /schemas/regulator/regulator.yaml#
        unevaluatedProperties: false

      LDO2:
        $ref: /schemas/regulator/regulator.yaml#
        unevaluatedProperties: false

      LDO3:
        $ref: /schemas/regulator/regulator.yaml#
        unevaluatedProperties: false

      LDO4:
        $ref: /schemas/regulator/regulator.yaml#
        unevaluatedProperties: false

      LDO5:
        $ref: /schemas/regulator/regulator.yaml#
        unevaluatedProperties: false

      LDO6:
        $ref: /schemas/regulator/regulator.yaml#
        unevaluatedProperties: false

      LDO7:
        $ref: /schemas/regulator/regulator.yaml#
        unevaluatedProperties: false

      SW1:
        $ref: /schemas/regulator/regulator.yaml#
        unevaluatedProperties: false

      SW2:
        $ref: /schemas/regulator/regulator.yaml#
        unevaluatedProperties: false

      SW3:
        $ref: /schemas/regulator/regulator.yaml#
        unevaluatedProperties: false

      SW4:
        $ref: /schemas/regulator/regulator.yaml#
        unevaluatedProperties: false

      SW5:
        $ref: /schemas/regulator/regulator.yaml#
        unevaluatedProperties: false

      SW6:
        $ref: /schemas/regulator/regulator.yaml#
        unevaluatedProperties: false


required:
  - compatible
  - reg
  - interrupts
  - regulators

additionalProperties: false

examples:
  - |
    pv88060@49 {
      compatible = "pvs,pv88060";
      reg = <0x49>;
      interrupts = <24 24>;
      regulators {
        BUCK1 {
          regulator-name = "buck1";
          regulator-min-microvolt = <2800000>;
          regulator-max-microvolt = <4387500>;
          regulator-min-microamp = <1496000>;
          regulator-max-microamp = <4189000>;
          regulator-boot-on;
        };
        LDO1 {
          regulator-name = "ldo1";
          regulator-min-microvolt = <1200000>;
          regulator-max-microvolt = <3350000>;
          regulator-boot-on;
        };
        LDO2 {
          regulator-name = "ldo2";
          regulator-min-microvolt = <1200000>;
          regulator-max-microvolt = <3350000>;
          regulator-boot-on;
        };
        LDO3 {
          regulator-name = "ldo3";
          regulator-min-microvolt = <1200000>;
          regulator-max-microvolt = <3350000>;
          regulator-boot-on;
        };
        LDO4 {
          regulator-name = "ldo4";
          regulator-min-microvolt = <1200000>;
          regulator-max-microvolt = <3350000>;
          regulator-boot-on;
        };
        LDO5 {
          regulator-name = "ldo5";
          regulator-min-microvolt = <1200000>;
          regulator-max-microvolt = <3350000>;
          regulator-boot-on;
        };
        LDO6 {
          regulator-name = "ldo6";
          regulator-min-microvolt = <1200000>;
          regulator-max-microvolt = <3350000>;
          regulator-boot-on;
        };
        LDO7 {
          regulator-name = "ldo7";
          regulator-min-microvolt = <1200000>;
          regulator-max-microvolt = <3350000>;
          regulator-boot-on;
        };
        SW1 {
          regulator-name = "sw1";
          regulator-min-microvolt = <5000000>;
          regulator-max-microvolt = <5000000>;
        };
        SW2 {
          regulator-name = "sw2";
          regulator-min-microvolt = <5000000>;
          regulator-max-microvolt = <5000000>;
          regulator-boot-on;
        };
        SW3 {
          regulator-name = "sw3";
          regulator-min-microvolt = <5000000>;
          regulator-max-microvolt = <5000000>;
          regulator-boot-on;
        };
        SW4 {
          regulator-name = "sw4";
          regulator-min-microvolt = <5000000>;
          regulator-max-microvolt = <5000000>;
          regulator-boot-on;
        };
        SW5 {
          regulator-name = "sw5";
          regulator-min-microvolt = <5000000>;
          regulator-max-microvolt = <5000000>;
          regulator-boot-on;
        };
        SW6 {
          regulator-name = "sw6";
          regulator-min-microvolt = <5000000>;
          regulator-max-microvolt = <5000000>;
        };
      };
    };
```

## Documentation/devicetree/bindings/regulator/pvs-pv88090.yaml
```yaml
# SPDX-License-Identifier: (GPL-2.0-only OR BSD-2-Clause)
%YAML 1.2
---
$id: http://devicetree.org/schemas/regulator/pvs-pv88090.yaml#
$schema: http://devicetree.org/meta-schemas/core.yaml#

title: Powerventure Semiconductor PV88090 Voltage Regulator

maintainers:
  - James Ban <James.Ban.opensource@diasemi.com>

description: |
  * Powerventure Semiconductor PV88090 Voltage Regulator

  Required properties:
  - compatible: "pvs,pv88090".
  - reg: I2C slave address, usually 0x48.
  - interrupts: the interrupt outputs of the controller
  - regulators: A node that houses a sub-node for each regulator within the
    device. Each sub-node is identified using the node's name, with valid
    values listed below. The content of each sub-node is defined by the
    standard binding for regulators; see regulator.txt.

  Optional properties:
  - Any optional property defined in regulator.txt

properties:

  compatible:
    items:
      - const: pvs,pv88090

  reg:
    maxItems: 1

  interrupts:
    maxItems: 1

  regulators:
    description: A node that contains subnodes for each regulator in the device
    type: object
    additionalProperties: false

    properties:
      BUCK1:
        $ref: /schemas/regulator/regulator.yaml#
      BUCK2:
        $ref: /schemas/regulator/regulator.yaml#
      BUCK3:
        $ref: /schemas/regulator/regulator.yaml#
      LDO1:
        $ref: /schemas/regulator/regulator.yaml#
      LDO2:
        $ref: /schemas/regulator/regulator.yaml#

required:
  - compatible
  - reg
  - interrupts
  - regulators

additionalProperties: false

examples:
  - |
    pmic@48 {
        compatible = "pvs,pv88090";
        reg = <0x48>;
        interrupts = <24 24>;

        regulators {
            BUCK1 {
                regulator-name = "buck1";
                regulator-min-microvolt = < 600000>;
                regulator-max-microvolt = <1393750>;
                regulator-min-microamp = < 220000>;
                regulator-max-microamp = <7040000>;
                regulator-boot-on;
            };

            BUCK2 {
                regulator-name = "buck2";
                regulator-min-microvolt = < 600000>;
                regulator-max-microvolt = <1393750>;
                regulator-min-microamp = <1496000>;
                regulator-max-microamp = <4189000>;
            };

            BUCK3 {
                regulator-name = "buck3";
                regulator-min-microvolt = <600000>;
                regulator-max-microvolt = <1393750>;
                regulator-min-microamp = <1496000>;
                regulator-max-microamp = <4189000>;
                regulator-boot-on;
            };

            LDO1 {
                regulator-name = "ldo1";
                regulator-min-microvolt = <1200000>;
                regulator-max-microvolt = <4350000>;
                regulator-boot-on;
            };

            LDO2 {
                regulator-name = "ldo2";
                regulator-min-microvolt = < 650000>;
                regulator-max-microvolt = <2225000>;
                regulator-boot-on;
            };
        };
    };
```
