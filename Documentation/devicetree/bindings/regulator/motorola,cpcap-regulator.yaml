## Documentation/devicetree/bindings/regulator/ti,lm363x-regulator.yaml
```yaml
# SPDX-License-Identifier: (GPL-2.0-only OR BSD-2-Clause)
%YAML 1.2
---
$id: http://devicetree.org/schemas/regulator/ti,lm363x-regulator.yaml#
$schema: http://devicetree.org/meta-schemas/core.yaml#

title: TI LM363x regulator
maintainers:
  - Milo Kim <milo.kim@ti.com>

description: |
  TI LMU LM363x regulator device tree bindings

  LM363x regulator driver supports LM3631 and LM3632.
  LM3631 has five regulators and LM3632 supports three regulators.

properties:
  compatible:
    items:
      - const: ti,lm363x-regulator

  enable-gpios:
    description: Two GPIO specifiers for Vpos and Vneg control pins.
    maxItems: 2

  vboost:
    description: Boost regulator subnode.
    $ref: /schemas/regulator/regulator.yaml#
    unevaluatedProperties: false

    properties:
      regulator-name:
        const: lcd_boost
    required:
      - regulator-name

  vcont:
    description: Contrast voltage regulator subnode.
    $ref: /schemas/regulator/regulator.yaml#
    unevaluatedProperties: false

    properties:
      regulator-name:
        const: lcd_vcont
    required:
      - regulator-name

  voref:
    description: Reference voltage regulator subnode.
    $ref: /schemas/regulator/regulator.yaml#
    unevaluatedProperties: false

    properties:
      regulator-name:
        const: lcd_voref

    required:
      - regulator-name

  vpos:
    description: Positive output regulator subnode.
    $ref: /schemas/regulator/regulator.yaml#
    unevaluatedProperties: false

    properties:
      regulator-name:
        const: lcd_vpos

    required:
      - regulator-name

  vneg:
    description: Negative output regulator subnode.
    $ref: /schemas/regulator/regulator.yaml#
    unevaluatedProperties: false

    properties:
      regulator-name:
        const: lcd_vneg

    required:
      - regulator-name

additionalProperties: false

examples:
  - |
    lm3631@29 {
        compatible = "ti,lm3631";
        reg = <0x29>;
        regulators {
            compatible = "ti,lm363x-regulator";
            vboost {
                regulator-name = "lcd_boost";
                regulator-min-microvolt = <4500000>;
                regulator-max-microvolt = <6350000>;
                regulator-always-on;
            };
            vcont {
                regulator-name = "lcd_vcont";
                regulator-min-microvolt = <1800000>;
                regulator-max-microvolt = <3300000>;
            };
            voref {
                regulator-name = "lcd_voref";
                regulator-min-microvolt = <4000000>;
                regulator-max-microvolt = <6000000>;
            };
            vpos {
                regulator-name = "lcd_vpos";
                regulator-min-microvolt = <4000000>;
                regulator-max-microvolt = <6000000>;
                regulator-boot-on;
            };
            vneg {
                regulator-name = "lcd_vneg";
                regulator-min-microvolt = <4000000>;
                regulator-max-microvolt = <6000000>;
                regulator-boot-on;
            };
        };
    };
  - |
    lm3632@11 {
        compatible = "ti,lm3632";
        reg = <0x11>;
        regulators {
            compatible = "ti,lm363x-regulator";
            enable-gpios = <&gpio1 16 GPIO_ACTIVE_HIGH>,
                           <&gpio1 28 GPIO_ACTIVE_HIGH>;
            vboost {
                regulator-name = "lcd_boost";
                regulator-min-microvolt = <4500000>;
                regulator-max-microvolt = <6400000>;
                regulator-always-on;
            };
            vpos {
                regulator-name = "lcd_vpos";
                regulator-min-microvolt = <4000000>;
                regulator-max-microvolt = <6000000>;
            };
            vneg {
                regulator-name = "lcd_vneg";
                regulator-min-microvolt = <4000000>;
                regulator-max-microvolt = <6000000>;
            };
        };
    };
```

## Documentation/devicetree/bindings/regulator/ti,lp872x.yaml
```yaml
# SPDX-License-Identifier: (GPL-2.0-only OR BSD-2-Clause)
# Copyright 2025 TI/National Semiconductor
%YAML 1.2
---
$id: http://devicetree.org/schemas/regulator/ti,lp872x.yaml#
$schema: http://devicetree.org/meta-schemas/core.yaml#

title: TI/National Semiconductor LP872x Regulator Driver

maintainers:
  - Alexander A. Klimov <grandmaster@al2klimov.de>
  - Kim, Milo <Milo.Kim@ti.com>
  - Paul Kocialkowski <contact@paulk.fr>

description: |
  Binding for TI/National Semiconductor LP872x Driver.

  Sub nodes for regulator_init_data
    LP8720 has maximum 6 nodes. (child name: ldo1 ~ 5 and buck)
    LP8725 has maximum 9 nodes. (child name: ldo1 ~ 5, lilo1,2 and buck1,2)
    For more details, please see the following binding document:
    Documentation/devicetree/bindings/regulator/regulator.txt

  Datasheet:
    - LP8720: https://www.ti.com/lit/ds/symlink/lp8720.pdf
    - LP8725: https://www.ti.com/lit/ds/symlink/lp8725.pdf

properties:
  compatible:
    items:
      - enum:
          - ti,lp8720
          - ti,lp8725

  reg:
    description: I2C slave address (0x7d = LP8720, 0x7a = LP8725)
    items:
      - description: Slave address

  ti,general-config:
    description: |
      Value of LP872X_GENERAL_CFG register.

      (LP8720)
        bit[2]: BUCK output voltage control by external DVS pin or register
                1 = external pin, 0 = bit7 of register 08h
        bit[1]: sleep control by external DVS pin or register
                1 = external pin, 0 = bit6 of register 08h
        bit[0]: time step unit(usec). 1 = 25, 0 = 50

      (LP8725)
        bit[7:6]: time step unit(usec). 00 = 32, 01 = 64, 10 = 128, 11 = 256
        bit[4]:   BUCK2 enable control. 1 = enable, 0 = disable
        bit[3]:   BUCK2 output voltage register address. 1 = 0Ah, 0 = 0Bh
        bit[2]:   BUCK1 output voltage control by external DVS pin or register
                  1 = register 08h, 0 = DVS
        bit[1]:   LDO sleep control. 1 = sleep mode, 0 = normal
        bit[0]:   BUCK1 enable control, 1 = enable, 0 = disable
    $ref: /schemas/types.yaml#/definitions/uint8

  ti,update-config:
    description: Set the LP872X_GENERAL_CFG register at init
    type: boolean

  ti,dvs-gpio:
    description: GPIO specifier for external DVS pin control of LP872x devices
    $ref: /schemas/types.yaml#/definitions/phandle-array

  ti,dvs-vsel:
    description: DVS selector (0 = SEL_V1, 1 = SEL_V2)
    $ref: /schemas/types.yaml#/definitions/uint8

  ti,dvs-state:
    description: Initial DVS pin state (0 = DVS_LOW, 1 = DVS_HIGH)
    $ref: /schemas/types.yaml#/definitions/uint8

  enable-gpios:
    description: GPIO specifier for EN pin control of LP872x devices
    $ref: /schemas/types.yaml#/definitions/phandle-array

required:
  - compatible
  - reg

additionalProperties: false

examples:
  - |
    lp8720@7d {
        compatible = "ti,lp8720";
        reg = <0x7d>;
        ti,general-config = /bits/ 8 <0x03>;
        ti,update-config;
        ti,dvs-gpio = <&gpio5 6 0>;
        ti,dvs-vsel = /bits/ 8 <1>;
        ti,dvs-state = /bits/ 8 <1>;

        vaf: ldo1 {
            regulator-min-microvolt = <1200000>;
            regulator-max-microvolt = <3300000>;
        };

        vmmc: ldo2 {
            regulator-min-microvolt = <1200000>;
            regulator-max-microvolt = <3300000>;
        };

        vcam_io: ldo3 {
            regulator-min-microvolt = <1200000>;
            regulator-max-microvolt = <3300000>;
            regulator-boot-on;
        };

        vcam_core: ldo4 {
            regulator-min-microvolt = <800000>;
            regulator-max-microvolt = <2850000>;
            regulator-boot-on;
        };

        vcam: ldo5 {
            regulator-min-microvolt = <1200000>;
            regulator-max-microvolt = <3300000>;
        };

        vcc: buck {
            regulator-name = "VBUCK";
            regulator-min-microvolt = <800000>;
            regulator-max-microvolt = <2300000>;
        };
    };
  - |
    lp8725@7a {
        compatible = "ti,lp8725";
        reg = <0x7a>;
        ti,general-config = /bits/ 8 <0xdd>;
        ti,update-config;

        vcam_io: ldo1 {
            regulator-min-microvolt = <1200000>;
            regulator-max-microvolt = <3300000>;
        };

        vcam_core: ldo2 {
            regulator-min-microvolt = <1200000>;
            regulator-max-microvolt = <3300000>;
        };

        vcam: ldo3 {
            regulator-min-microvolt = <1200000>;
            regulator-max-microvolt = <3300000>;
        };

        vcmmb_io: ldo4 {
            regulator-min-microvolt = <1200000>;
            regulator-max-microvolt = <3300000>;
            regulator-boot-on;
        };

        vcmmb_core: ldo5 {
            regulator-min-microvolt = <1200000>;
            regulator-max-microvolt = <3300000>;
            regulator-boot-on;
        };

        vaux1: lilo1 {
            regulator-name = "VAUX1";
            regulator-min-microvolt = <800000>;
            regulator-max-microvolt = <3300000>;
        };

        vaux2: lilo2 {
            regulator-name = "VAUX2";
            regulator-min-microvolt = <800000>;
            regulator-max-microvolt = <3300000>;
        };

        vcc1: buck1 {
            regulator-name = "VBUCK1";
            regulator-min-microvolt = <800000>;
            regulator-max-microvolt = <3000000>;
            regulator-min-microamp = <460000>;
            regulator-max-microamp = <1370000>;
            regulator-boot-on;
        };

        vcc2: buck2 {
            regulator-name = "VBUCK2";
            regulator-min-microvolt = <800000>;
            regulator-max-microvolt = <3000000>;
            regulator-min-microamp = <460000>;
            regulator-max-microamp = <1370000>;
            regulator-boot-on;
        };
    };
```

## Documentation/devicetree/bindings/regulator/ti,palmas-pmic.yaml
```yaml
%YAML 1.2
---
$id: http://devicetree.org/schemas/ti,palmas-pmic.yaml#
$schema: http://devicetree.org/meta-schemas/core.yaml#

title: TI Palmas PMIC
maintainers:
  - Bill Huang <bilhuang@nvidia.com>
  - J Keerthy <j-keerthy@ti.com>
  - Keerthy <j-keerthy@ti.com>
  - Laxman Dewangan <ldewangan@nvidia.com>
  - Nishanth Menon <nm@ti.com>
  - Rob Herring <robh@kernel.org>
  - Schuyler Patton <spatton@ti.com>

description: |
  * palmas regulator IP block devicetree bindings

  The tps659038 for the AM57x class have OTP spins that
  have different part numbers but the same functionality. There
  is not a need to add the OTP spins to the palmas driver. The
  spin devices should use the tps659038 as its compatible value.
  This is the list of those devices:
  tps659037

properties:
  compatible:
    description: Device compatible value(s) for Palmas PMIC.
    $ref: /schemas/types.yaml#/definitions/string-array
    items:
      - enum:
          - ti,twl6035-pmic
          - ti,twl6036-pmic
          - ti,twl6037-pmic
          - ti,tps65913-pmic
          - ti,tps65914-pmic
          - ti,tps65917-pmic
          - ti,tps659038-pmic
          - ti,palmas-pmic
  interrupts:
    description: PMIC interrupt specifier.
    items:
      - description: Interrupt number.
      - description: Interrupt type from interrupt-controller.
  interrupts-name:
    description: Names of the individual interrupts.
    $ref: /schemas/types.yaml#/definitions/string-array
    items:
      - enum: [short-irq]
  ti,ldo6-vibrator:
    description: LDO6 operates in vibrator mode if present.
    type: boolean
  ti,system-power-controller:
    description: PMIC controls system power if present.
    type: boolean
  regulators:
    description: PMIC regulator subnodes.
    type: object
    patternProperties:
      '^[a-zA-Z0-9,_+-]+$':
        description: Individual regulator settings.
        type: object
        required:
          - regulator-name
          - regulator-min-microvolt
          - regulator-max-microvolt
        properties:
          regulator-name:
            description: Name of the regulator.
            $ref: /schemas/types.yaml#/definitions/string
          regulator-min-microvolt:
            description: Minimum voltage in microvolts.
          regulator-max-microvolt:
            description: Maximum voltage in microvolts.
          regulator-always-on:
            description: Keep regulator enabled at all times.
            type: boolean
          regulator-boot-on:
            description: Enable regulator at boot.
            type: boolean
          ti,warm-reset:
            description: Maintain voltage during warm reset.
            type: boolean
          ti,roof-floor:
            description: Control rail by external pin (1=ENABLE1, 2=ENABLE2, 3=NSLEEP).
            $ref: /schemas/types.yaml#/definitions/int32
            enum: [1, 2, 3]
          ti,mode-sleep:
            description: PMIC sleep mode (0=off,1=auto,2=eco,3=forced-pwm).
            $ref: /schemas/types.yaml#/definitions/int32
            enum: [0, 1, 2, 3]
          ti,smps-range:
            description: Override SMPS hardware range (0=low,1=high).
            $ref: /schemas/types.yaml#/definitions/int32
            enum: [0, 1]
        additionalProperties: false
    additionalProperties: false

required:
  - compatible
  - interrupts
  - interrupts-name

additionalProperties: false

examples:
  - |
    #include <dt-bindings/interrupt-controller/irq.h>
    pmic {
        compatible = "ti,twl6035-pmic", "ti,palmas-pmic";
        interrupts = <14 IRQ_TYPE_NONE>;
        interrupts-name = "short-irq";

        ti,ldo6-vibrator;

        ti,system-power-controller;

        regulators {
            smps12_reg: smps12 {
                regulator-name = "smps12";
                regulator-min-microvolt = <600000>;
                regulator-max-microvolt = <1500000>;
                regulator-always-on;
                regulator-boot-on;
                ti,warm-reset;
                ti,roof-floor = <1>; /* ENABLE1 control */
                ti,mode-sleep = <0>;
                ti,smps-range = <1>;
            };

            ldo1_reg: ldo1 {
                regulator-name = "ldo1";
                regulator-min-microvolt = <2800000>;
                regulator-max-microvolt = <2800000>;
            };
        };
    };
```
