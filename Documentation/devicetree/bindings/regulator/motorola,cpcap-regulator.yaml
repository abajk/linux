## Documentation/devicetree/bindings/remoteproc/ti,keystone-rproc.yaml
```yaml
# SPDX-License-Identifier: (GPL-2.0-only OR BSD-2-Clause)
# Copyright 2025 Linaro Ltd.
%YAML 1.2
---
$id: http://devicetree.org/schemas/remoteproc/ti,keystone-rproc.yaml#
$schema: http://devicetree.org/meta-schemas/core.yaml#

title: TI Keystone DSP remote processor

maintainers:
  - Mauro Carvalho Chehab <mchehab+huawei@kernel.org>
  - Rob Herring <robh@kernel.org>
  - Suman Anna <s-anna@ti.com>

description: |
  TI Keystone DSP devices

  The TI Keystone 2 family of SoCs usually have one or more (up to 8) TI DSP Core
  sub-systems that are used to offload some of the processor-intensive tasks or
  algorithms, for achieving various system level goals.

  These processor sub-systems usually contain additional sub-modules like L1
  and/or L2 caches/SRAMs, an Interrupt Controller, an external memory controller,
  a dedicated local power/sleep controller etc. The DSP processor core in
  Keystone 2 SoCs is usually a TMS320C66x CorePac processor.

properties:
  compatible:
    items:
      - enum: ["ti,k2hk-dsp", "ti,k2l-dsp", "ti,k2e-dsp", "ti,k2g-dsp"]

  reg:
    description: Regions for L2 SRAM, L1 PRAM and L1 DRAM
    items:
      - description: L2 SRAM region
      - description: L1 PRAM region
      - description: L1 DRAM region

  reg-names:
    description: Memory region names
    items:
      - const: l2sram
      - const: l1pram
      - const: l1dram

  clocks:
    maxItems: 1

  power-domains:
    description: Power domain phandle and device ID (Keystone 2 66AK2G)
    items:
      - description: PM domain phandle
      - description: DSP device ID

  ti,syscon-dev:
    description: Phandle and offset of the DSP boot address register
    items:
      - description: Keystone device‐state-control phandle
      - description: boot address register offset

  resets:
    maxItems: 1

  interrupts:
    maxItems: 2

  interrupt-names:
    description: Interrupt names
    items:
      - const: vring
      - const: exception

  kick-gpios:
    description: GPIO for virtio IPC kick
    maxItems: 1

  memory-region:
    description: Reserved memory region for remoteproc
    maxItems: 1

required:
  - compatible
  - reg
  - reg-names
  - ti,syscon-dev
  - resets
  - interrupts
  - interrupt-names
  - kick-gpios

additionalProperties: false

examples:
  - |
    dsp0: dsp@10800000 {
        compatible = "ti,k2hk-dsp";
        reg = <0x10800000 0x00100000>,
              <0x10e00000 0x00008000>,
              <0x10f00000 0x00008000>;
        reg-names = "l2sram", "l1pram", "l1dram";
        clocks = <&clkgem0>;
        ti,syscon-dev = <&devctrl 0x40>;
        resets = <&pscrst 0>;
        interrupts = <0 8>;
        interrupt-names = "vring", "exception";
        kick-gpios = <&dspgpio0 27 0>;
        memory-region = <&dsp_common_memory>;
    };

  - |
    dsp0: dsp@10800000 {
        compatible = "ti,k2g-dsp";
        reg = <0x10800000 0x00100000>,
              <0x10e00000 0x00008000>,
              <0x10f00000 0x00008000>;
        reg-names = "l2sram", "l1pram", "l1dram";
        power-domains = <&k2g_pds 0x0046>;
        ti,syscon-dev = <&devctrl 0x40>;
        resets = <&k2g_reset 0x0046 0x1>;
        interrupts = <0 8>;
        interrupt-names = "vring", "exception";
        kick-gpios = <&dspgpio0 27 0>;
        memory-region = <&dsp_common_memory>;
    };
```

## Documentation/devicetree/bindings/reserved-memory/xen,shared-memory-v1.yaml
```yaml
# SPDX-License-Identifier: (GPL-2.0-only OR BSD-2-Clause)
# Copyright 2025 Xilinx Ltd.
%YAML 1.2
---
$id: http://devicetree.org/schemas/reserved-memory/xen,shared-memory-v1.yaml#
$schema: http://devicetree.org/meta-schemas/core.yaml#

title: Xen hypervisor shared memory
maintainers:
  - Stefano Stabellini <stefanos@xilinx.com>

description: |
  * Xen hypervisor reserved-memory binding

  Expose one or more memory regions as reserved-memory to the guest
  virtual machine. Typically, a region is configured at VM creation time
  to be a shared memory area across multiple virtual machines for
  communication among them.

  For each of these pre-shared memory regions, a range is exposed under
  the /reserved-memory node as a child node. Each range sub-node is named
  xen-shmem@<address> and has the following properties:

properties:
  compatible:
    items:
      - enum:
          - xen,shared-memory-v1

  reg:
    items:
      - description: base guest physical address
      - description: size of the shared memory region

  xen,offset:
    description: 64 bit integer offset within the owner virtual machine's shared
      memory region used for the mapping in the borrower VM.
    $ref: /schemas/types.yaml#/definitions/uint64

  xen,id:
    description: A string that identifies the shared memory region as specified in the VM config file.
    $ref: /schemas/types.yaml#/definitions/string

required:
  - compatible
  - reg
  - xen,id

additionalProperties: false
```

## Documentation/devicetree/bindings/reset/brcm,bcm63138-pmb.yaml
```yaml
# SPDX-License-Identifier: (GPL-2.0-only OR BSD-2-Clause)
# Copyright 2025 Broadcom
%YAML 1.2
---
$id: http://devicetree.org/schemas/reset/brcm,bcm63138-pmb.yaml#
$schema: http://devicetree.org/meta-schemas/core.yaml#

title: Broadcom BCM63138 Processor Monitor Bus reset controller

maintainers:
  - Florian Fainelli <f.fainelli@gmail.com>

description: |
  Broadcom BCM63138 Processor Monitor Bus binding
  ===============================================

  Please also refer to reset.txt in this directory for common reset
  controller binding usage.

properties:
  compatible:
    description: Compatible string for this reset bus controller
    items:
      - const: brcm,bcm63138-pmb

  reg:
    description: Base register address and size for this bus controller
    items:
      - description: Register base address
      - description: Register size

  '#reset-cells':
    description: >
      First cell is the address within the bus instance designated by the phandle,
      second is the number of zones for this peripheral
    const: 2

required:
  - compatible
  - reg
  - '#reset-cells'

additionalProperties: false

examples:
  - |
    pmb0: reset-controller@4800c0 {
        compatible = "brcm,bcm63138-pmb";
        reg = <0x4800c0 0x10>;
        #reset-cells = <2>;
    };
```

## Documentation/devicetree/bindings/reset/img,pistachio-reset.yaml
```yaml
%YAML 1.2
---
$id: http://devicetree.org/schemas/reset/img,pistachio-reset.yaml#
$schema: http://devicetree.org/meta-schemas/core.yaml#

title: Pistachio Reset Controller

maintainers:
  - Damien Horsley <Damien.Horsley@imgtec.com>

description: |
  This binding describes a reset controller device that is used to enable and
  disable individual IP blocks within the Pistachio SoC using "soft reset"
  control bits found in the Pistachio SoC top level registers.

  The actual action taken when soft reset is asserted is hardware dependent.
  However, when asserted it may not be possible to access the hardware's
  registers, and following an assert/deassert sequence the hardware's previous
  state may no longer be valid.

  Please refer to Documentation/devicetree/bindings/reset/reset.txt
  for common reset controller binding usage.

properties:
  compatible:
    description: Identifies this node as a Pistachio reset controller.
    items:
      - enum: [img, pistachio-reset]

  '#reset-cells':
    description: Number of cells in a reset specifier.
    const: 1

  reset-controller: true

required:
  - compatible
  - '#reset-cells'

additionalProperties: false

examples:
  - |
    pistachio_reset: reset-controller {
      compatible = "img,pistachio-reset";
      #reset-cells = <1>;
    };
```

## Documentation/devicetree/bindings/reset/snps,hsdk-reset.yaml
```yaml
# SPDX-License-Identifier: (GPL-2.0-only OR BSD-2-Clause)
%YAML 1.2
---
$id: http://devicetree.org/schemas/reset/snps,hsdk-reset.yaml#
$schema: http://devicetree.org/meta-schemas/core.yaml#
title: Synopsys HSDK reset controller
maintainers:
  - Vineet Gupta <Vineet.Gupta1@synopsys.com>
description: |
  Binding for the Synopsys HSDK reset controller

  This binding uses the common reset binding[1].

  [1] Documentation/devicetree/bindings/reset/reset.txt

  The index could be found in <dt-bindings/reset/snps,hsdk-reset.h>
properties:
  compatible:
    items:
      - const: snps,hsdk-reset
  reg:
    description: |
      Register pairs where first is reset configuration register and second is
      software reset and status bits register
    items:
      - description: reset configuration register
      - description: software reset and status bits register
  '#reset-cells':
    const: 1
required:
  - compatible
  - reg
  - '#reset-cells'
additionalProperties: false
examples:
  - |
    reset: reset@880 {
        compatible = "snps,hsdk-reset";
        #reset-cells = <1>;
        reg = <0x8A0 0x4>, <0xFF0 0x4>;
    };
```
