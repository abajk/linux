## Documentation/devicetree/bindings/regulator/ti,tps65218.yaml
```yaml
# SPDX-License-Identifier: (GPL-2.0-only OR BSD-2-Clause)
# Copyright 2025 WAGO GmbH
%YAML 1.2
---
$id: http://devicetree.org/schemas/regulator/ti,tps65218.yaml#
$schema: http://devicetree.org/meta-schemas/core.yaml#

title: TI TPS65218 regulator controller

maintainers:
  - Christian Hohnstaedt <Christian.Hohnstaedt@wago.com>
  - Keerthy <j-keerthy@ti.com>

description: |
  TPS65218 family of regulators

  List of regulators provided by this controller, must be named
  after their hardware counterparts: dcdc[1-6] and ldo1
  This is the list of child nodes that specify the regulator
  initialization data for defined regulators. Not all regulators for the given
  device need to be present. The definition for each of these nodes is defined
  using the standard binding for regulators found at ./regulator.txt.

  The valid names for regulators are:
  tps65217: regulator-dcdc1, regulator-dcdc2, regulator-dcdc3, regulator-dcdc4,
  regulator-dcdc5, regulator-dcdc6, regulator-ldo1, regulator-ls3.
  Each regulator is defined using the standard binding for regulators.

properties:
  compatible:
    items:
      - const: ti,tps65218

  reg:
    items:
      - description: I2C slave address

  interrupts:
    items:
      - description: NMI interrupt
    description: NMI interrupt line

  interrupt-controller: true

  '#interrupt-cells':
    const: 2

patternProperties:
  '^regulator-(dcdc[1-6]|ldo1|ls3)$':
    $ref: /schemas/regulator/regulator.yaml
    unevaluatedProperties: false

additionalProperties: false

examples:
  - |
    tps65218: tps65218@24 {
        compatible = "ti,tps65218";
        reg = <0x24>;
        interrupts = <GIC_SPI 7 IRQ_TYPE_NONE>; /* NMIn */
        interrupt-controller;
        #interrupt-cells = <2>;
        dcdc1: regulator-dcdc1 {
            regulator-name = "vdd_core";
            regulator-min-microvolt = <912000>;
            regulator-max-microvolt = <1144000>;
            regulator-boot-on;
            regulator-always-on;
        };
        dcdc2: regulator-dcdc2 {
            regulator-name = "vdd_mpu";
            regulator-min-microvolt = <912000>;
            regulator-max-microvolt = <1378000>;
            regulator-boot-on;
            regulator-always-on;
        };
        dcdc3: regulator-dcdc3 {
            regulator-name = "vdcdc3";
            regulator-min-microvolt = <1500000>;
            regulator-max-microvolt = <1500000>;
            regulator-boot-on;
            regulator-always-on;
        };
        dcdc5: regulator-dcdc5 {
            regulator-name = "v1_0bat";
            regulator-min-microvolt = <1000000>;
            regulator-max-microvolt = <1000000>;
            regulator-boot-on;
            regulator-always-on;
        };
        dcdc6: regulator-dcdc6 {
            regulator-name = "v1_8bat";
            regulator-min-microvolt = <1800000>;
            regulator-max-microvolt = <1800000>;
            regulator-boot-on;
            regulator-always-on;
        };
        ldo1: regulator-ldo1 {
            regulator-min-microvolt = <1800000>;
            regulator-max-microvolt = <1800000>;
            regulator-boot-on;
            regulator-always-on;
        };
        ls2: regulator-ls2 {
            regulator-min-microamp = <100000>;
            regulator-max-microamp = <1000000>;
        };
        ls3: regulator-ls3 {
            regulator-min-microamp = <100000>;
            regulator-max-microamp = <1000000>;
        };
    };
```

## Documentation/devicetree/bindings/regulator/ti,tps6586x.yaml
```yaml
# SPDX-License-Identifier: (GPL-2.0-only OR BSD-2-Clause)
# Copyright 2018 Linaro Ltd.
%YAML 1.2
---
$id: http://devicetree.org/schemas/regulator/ti,tps6586x.yaml#
$schema: http://devicetree.org/meta-schemas/core.yaml#

title: TI TPS6586x PMIC

maintainers:
  - Bill Huang <bilhuang@nvidia.com>
  - Laxman Dewangan <ldewangan@nvidia.com>
  - Stephen Warren <swarren@nvidia.com>
  - Thierry Reding <thierry.reding@avionic-design.de>

description: |
  TPS6586x family of regulators

  Required properties:
  - compatible: "ti,tps6586x"
  - reg: I2C slave address
  - interrupts: the interrupt outputs of the controller
  - #gpio-cells: number of cells to describe a GPIO
  - gpio-controller: mark the device as a GPIO controller
  - regulators: A node that houses a sub-node for each regulator within the
    device. Each sub-node is identified using the node's name (or the deprecated
    regulator-compatible property if present), with valid values listed below.
    The content of each sub-node is defined by the standard binding for
    regulators; see regulator.txt.
  - sys-supply: The input supply for SYS.
  - vin-sm0-supply: The input supply for the SM0.
  - vin-sm1-supply: The input supply for the SM1.
  - vin-sm2-supply: The input supply for the SM2.
  - vinldo01-supply: The input supply for the LDO1 and LDO2
  - vinldo23-supply: The input supply for the LDO2 and LDO3
  - vinldo4-supply: The input supply for the LDO4
  - vinldo678-supply: The input supply for the LDO6, LDO7 and LDO8
  - vinldo9-supply: The input supply for the LDO9

  Optional properties:
  - ti,system-power-controller: Telling whether or not this pmic is controlling
    the system power.

  Note: LDO5 and LDO_RTC is supplied by SYS regulator internally and driver
        take care of making proper parent child relationship.

properties:
  compatible:
    items:
      - const: ti,tps6586x

  reg:
    items:
      - description: I2C slave address

  interrupts:
    description: interrupt outputs of the controller

  '#gpio-cells':
    const: 2

  gpio-controller: true

  ti,system-power-controller:
    type: boolean
    description: Telling whether or not this pmic is controlling the system power.

  sys-supply: true
  vin-sm0-supply: true
  vin-sm1-supply: true
  vin-sm2-supply: true
  vinldo01-supply: true
  vinldo23-supply: true
  vinldo4-supply: true
  vinldo678-supply: true
  vinldo9-supply: true

  regulators:
    description: A node that houses sub-nodes for each regulator within the
      device. Each sub-node is identified using the node's name (or the deprecated
      regulator-compatible property if present), with valid values listed below.
    type: object
    additionalProperties: false
    properties:
      sys:
        description: SYS regulator
        $ref: /schemas/regulator/regulator.yaml
      sm0:
        description: SM0 regulator
        $ref: /schemas/regulator/regulator.yaml
      sm1:
        description: SM1 regulator
        $ref: /schemas/regulator/regulator.yaml
      sm2:
        description: SM2 regulator
        $ref: /schemas/regulator/regulator.yaml
      ldo0:
        description: LDO0 regulator
        $ref: /schemas/regulator/regulator.yaml
      ldo1:
        description: LDO1 regulator
        $ref: /schemas/regulator/regulator.yaml
      ldo2:
        description: LDO2 regulator
        $ref: /schemas/regulator/regulator.yaml
      ldo3:
        description: LDO3 regulator
        $ref: /schemas/regulator/regulator.yaml
      ldo4:
        description: LDO4 regulator
        $ref: /schemas/regulator/regulator.yaml
      ldo5:
        description: LDO5 regulator
        $ref: /schemas/regulator/regulator.yaml
      ldo6:
        description: LDO6 regulator
        $ref: /schemas/regulator/regulator.yaml
      ldo7:
        description: LDO7 regulator
        $ref: /schemas/regulator/regulator.yaml
      ldo8:
        description: LDO8 regulator
        $ref: /schemas/regulator/regulator.yaml
      ldo9:
        description: LDO9 regulator
        $ref: /schemas/regulator/regulator.yaml
      ldo_rtc:
        description: LDO_RTC regulator
        $ref: /schemas/regulator/regulator.yaml

required:
  - compatible
  - reg
  - interrupts
  - '#gpio-cells'
  - gpio-controller
  - regulators
  - sys-supply
  - vin-sm0-supply
  - vin-sm1-supply
  - vin-sm2-supply
  - vinldo01-supply
  - vinldo23-supply
  - vinldo4-supply
  - vinldo678-supply
  - vinldo9-supply

additionalProperties: false
examples:
  - |
    pmu: tps6586x@34 {
        compatible = "ti,tps6586x";
        reg = <0x34>;
        interrupts = <0 88 0x4>;

        #gpio-cells = <2>;
        gpio-controller;

        ti,system-power-controller;

        sys-supply = <&some_reg>;
        vin-sm0-supply = <&some_reg>;
        vin-sm1-supply = <&some_reg>;
        vin-sm2-supply = <&some_reg>;
        vinldo01-supply = <...>;
        vinldo23-supply = <...>;
        vinldo4-supply = <...>;
        vinldo678-supply = <...>;
        vinldo9-supply = <...>;

        regulators {
            sys_reg: sys {
                regulator-name = "vdd_sys";
                regulator-boot-on;
                regulator-always-on;
            };

            sm0_reg: sm0 {
                regulator-min-microvolt = < 725000>;
                regulator-max-microvolt = <1500000>;
                regulator-boot-on;
                regulator-always-on;
            };

            sm1_reg: sm1 {
                regulator-min-microvolt = < 725000>;
                regulator-max-microvolt = <1500000>;
                regulator-boot-on;
                regulator-always-on;
            };

            sm2_reg: sm2 {
                regulator-min-microvolt = <3000000>;
                regulator-max-microvolt = <4550000>;
                regulator-boot-on;
                regulator-always-on;
            };

            ldo0_reg: ldo0 {
                regulator-name = "PCIE CLK";
                regulator-min-microvolt = <3300000>;
                regulator-max-microvolt = <3300000>;
            };

            ldo1_reg: ldo1 {
                regulator-min-microvolt = < 725000>;
                regulator-max-microvolt = <1500000>;
            };

            ldo2_reg: ldo2 {
                regulator-min-microvolt = < 725000>;
                regulator-max-microvolt = <1500000>;
            };

            ldo3_reg: ldo3 {
                regulator-min-microvolt = <1250000>;
                regulator-max-microvolt = <3300000>;
            };

            ldo4_reg: ldo4 {
                regulator-min-microvolt = <1700000>;
                regulator-max-microvolt = <2475000>;
            };

            ldo5_reg: ldo5 {
                regulator-min-microvolt = <1250000>;
                regulator-max-microvolt = <3300000>;
            };

            ldo6_reg: ldo6 {
                regulator-min-microvolt = <1250000>;
                regulator-max-microvolt = <3300000>;
            };

            ldo7_reg: ldo7 {
                regulator-min-microvolt = <1250000>;
                regulator-max-microvolt = <3300000>;
            };

            ldo8_reg: ldo8 {
                regulator-min-microvolt = <1250000>;
                regulator-max-microvolt = <3300000>;
            };

            ldo9_reg: ldo9 {
                regulator-min-microvolt = <1250000>;
                regulator-max-microvolt = <3300000>;
            };
        };
    };
```

## Documentation/devicetree/bindings/regulator/ti-abb-regulator.yaml
```yaml
# SPDX-License-Identifier: (GPL-2.0-only OR BSD-2-Clause)
# Copyright 2025 Texas Instruments
---
$id: http://devicetree.org/schemas/regulator/ti-abb-regulator.yaml#
$schema: http://devicetree.org/meta-schemas/core.yaml#

title: TI ABB regulator

maintainers:
  - Andrii.Tseglytskyi <andrii.tseglytskyi@ti.com>
  - Geert Uytterhoeven <geert+renesas@glider.be>
  - Masahiro Yamada <yamada.masahiro@socionext.com>
  - Nishanth Menon <nm@ti.com>

description: |
  Adaptive Body Bias(ABB) SoC internal LDO regulator for Texas Instruments SoCs

properties:
  compatible:
    description: Device compatible string selecting the ABB version
    items:
      - enum:
          - ti,abb-v1
          - ti,abb-v2
          - ti,abb-v3

  regulator-name:
    description: Unique name for the regulator instance
    $ref: /schemas/types.yaml#/definitions/string

  "#address-cells":
    description: Number of address cells, must be zero
    const: 0

  "#size-cells":
    description: Number of size cells, must be zero
    const: 0

  reg:
    maxItems: 1

  reg-names:
    description: Names of register regions in order matching 'reg'
    $ref: /schemas/types.yaml#/definitions/string-array
    items:
      - enum:
          - base-address
          - control-address
          - setup-address
          - int-address
          - efuse-address
          - ldo-address

  clocks:
    maxItems: 1

  ti,settling-time:
    description: Settling time (µs) to reach target for SR2_WTCNT_VALUE
    $ref: /schemas/types.yaml#/definitions/uint32

  ti,clock-cycles:
    description: Number of system clock cycles used for computing settling time
    $ref: /schemas/types.yaml#/definitions/uint32

  ti,tranxdone-status-mask:
    description: Write-to-clear mask indicating transaction completion in interrupt register
    $ref: /schemas/types.yaml#/definitions/uint32

  ti,abb_info:
    description: >
      Array of six-tuples of u32 providing ABB configuration per voltage:
      volt (uV), ABB mode (0=bypass,1=FBB,3=RBB), efuse register offset,
      RBB enable efuse mask, FBB enable efuse mask, Vset value efuse mask.
    $ref: /schemas/types.yaml#/definitions/uint32-array
    items:
      - description: Voltage in microvolts
      - description: ABB mode (0=bypass,1=FBB,3=RBB)
      - description: Efuse register offset (if 'efuse-address' defined)
      - description: RBB enable efuse mask (if 'efuse-address' defined)
      - description: FBB enable efuse mask (if 'efuse-address' defined)
      - description: Vset efuse mask (if 'ldo-address' defined)

  ti,ldovbb-override-mask:
    description: Mask to enable override VSET in LDO override register
    $ref: /schemas/types.yaml#/definitions/uint32

  ti,ldovbb-vset-mask:
    description: Mask to set VSET value in LDO override register
    $ref: /schemas/types.yaml#/definitions/uint32

required:
  - compatible
  - regulator-name
  - reg
  - reg-names
  - "#address-cells"
  - "#size-cells"
  - clocks
  - ti,settling-time
  - ti,clock-cycles
  - ti,tranxdone-status-mask
  - ti,abb_info

additionalProperties: false
examples:
  - |
    abb_x: regulator-abb-x {
      compatible = "ti,abb-v1";
      regulator-name = "abb_x";
      #address-cells = <0>;
      #size-cells = <0>;
      reg = <0x483072f0 0x8>, <0x48306818 0x4>;
      reg-names = "base-address", "int-address";
      ti,tranxdone-status-mask = <0x4000000>;
      clocks = <&sysclk>;
      ti,settling-time = <30>;
      ti,clock-cycles = <8>;
      ti,abb_info = <
        1012500 0 0 0 0 0
        1200000 3 0 0 0 0
        1320000 1 0 0 0 0
      >;
    };

  - |
    abb_y: regulator-abb-y {
      compatible = "ti,abb-v2";
      regulator-name = "abb_y";
      #address-cells = <0>;
      #size-cells = <0>;
      reg = <0x4a307bd0 0x8>, <0x4a306014 0x4>, <0x4A002268 0x8>;
      reg-names = "base-address", "int-address", "efuse-address";
      ti,tranxdone-status-mask = <0x4000000>;
      clocks = <&sysclk>;
      ti,settling-time = <50>;
      ti,clock-cycles = <16>;
      ti,abb_info = <
        975000 0 0 0 0 0
        1012500 0 0x40000 0 0 0
        1200000 0 0x4 0 0x40000 0
        1320000 1 0 0 0 0
      >;
    };

  - |
    abb_z: regulator-abb-z {
      compatible = "ti,abb-v3";
      regulator-name = "abb_z";
      #address-cells = <0>;
      #size-cells = <0>;
      reg = <0x4ae07ce4 0x8>, <0x4ae06010 0x4>, <0x4a002194 0x8>, <0x4ae0C314 0x4>;
      reg-names = "base-address", "control-address", "setup-address", "int-address";
      ti,tranxdone-status-mask = <0x8000000>;
      ti,ldovbb-override-mask = <0x400>;
      ti,ldovbb-vset-mask = <0x1F>;
      clocks = <&sysclk>;
      ti,settling-time = <50>;
      ti,clock-cycles = <16>;
      ti,abb_info = <
        975000 0 0 0 0 0
        1200000 0 0x4 0 0x40000 0x1f00
      >;
    };
```
