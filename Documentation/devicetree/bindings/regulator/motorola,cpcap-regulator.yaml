## Documentation/devicetree/bindings/regulator/ti,pbias-omap.yaml
```yaml
# SPDX-License-Identifier: (GPL-2.0-only OR BSD-2-Clause)
# Copyright 2025 Texas Instruments Inc.
%YAML 1.2
---
$id: http://devicetree.org/schemas/ti,pbias-omap.yaml#
$schema: http://devicetree.org/meta-schemas/core.yaml#

title: PBIAS internal regulator

maintainers:
  - Balaji T K <balajitk@ti.com>
  - Kishon Vijay Abraham I <kishon@kernel.org>

description: |
  PBIAS internal regulator for SD card dual voltage i/o pads on OMAP SoCs.

properties:
  compatible:
    description: Valid compatible strings for the PBIAS regulator.
    items:
      - enum:
          - ti,pbias-omap
          - ti,pbias-omap2
          - ti,pbias-omap3
          - ti,pbias-omap4
          - ti,pbias-omap5
          - ti,pbias-dra7

  reg:
    description: Register offset from syscon base and size of the pbias register.
    items:
      - description: Register offset from syscon base
      - description: Size of pbias register

  syscon:
    description: phandle of the system control module
    $ref: /schemas/types.yaml#/definitions/phandle

  regulator-name:
    description: Name of the regulator
    enum:
      - pbias_mmc_omap2430
      - pbias_sim_omap3
      - pbias_mmc_omap4
      - pbias_mmc_omap5

  regulator-min-microvolt:
    description: Minimum voltage in microvolts supported by the regulator.

  regulator-max-microvolt:
    description: Maximum voltage in microvolts supported by the regulator.

required:
  - compatible
  - reg
  - syscon
  - regulator-name

additionalProperties: true

examples:
  - |
    pbias_regulator: pbias_regulator {
        compatible = "ti,pbias-omap";
        reg = <0 0x4>;
        syscon = <&omap5_padconf_global>;
        pbias_mmc_reg: pbias_mmc_omap5 {
            regulator-name = "pbias_mmc_omap5";
            regulator-min-microvolt = <1800000>;
            regulator-max-microvolt = <3000000>;
        };
    };
```

## Documentation/devicetree/bindings/regulator/ti,tps51632.yaml
```yaml
# SPDX-License-Identifier: (GPL-2.0-only OR BSD-2-Clause)
# Copyright 2025 NVIDIA Corporation
%YAML 1.2
---
$id: http://devicetree.org/schemas/regulator/ti,tps51632.yaml#
$schema: http://devicetree.org/meta-schemas/core.yaml#

title: TI TPS51632 Voltage Regulator

maintainers:
  - Laxman Dewangan <ldewangan@nvidia.com>

description: |
  TPS51632 Voltage regulators

  Any property defined as part of the core regulator binding, defined in
  regulator.txt, can also be used.

properties:
  compatible:
    items:
      - const: ti,tps51632

  reg:
    items:
      - description: I2C slave address

  regulator-name:
    description: Name of the regulator output

  regulator-min-microvolt:
    description: Minimum output voltage in microvolts

  regulator-max-microvolt:
    description: Maximum output voltage in microvolts

  regulator-boot-on:
    type: boolean
    description: Enable regulator at boot

  ti,enable-pwm-dvfs:
    type: boolean
    description: Enable the DVFS voltage control through the PWM interface.

  ti,dvfs-step-20mV:
    description: The 20mV step voltage when PWM DVFS enabled. Missing this
      will set 10mV step voltage in PWM DVFS mode. In normal mode, the voltage
      step is 10mV as per datasheet.
    $ref: /schemas/types.yaml#/definitions/uint32

additionalProperties: true

examples:
  - |
    tps51632 {
        compatible = "ti,tps51632";
        reg = <0x43>;
        regulator-name = "tps51632-vout";
        regulator-min-microvolt = <500000>;
        regulator-max-microvolt = <1500000>;
        regulator-boot-on;
        ti,enable-pwm-dvfs;
        ti,dvfs-step-20mV;
    };
```

## Documentation/devicetree/bindings/regulator/ti,tps65023.yaml
```yaml
# SPDX-License-Identifier: (GPL-2.0-only OR BSD-2-Clause)
%YAML 1.2
---
$id: http://devicetree.org/schemas/regulator/ti,tps65023.yaml#
$schema: http://devicetree.org/meta-schemas/core.yaml#

title: TPS65023 family of regulators

maintainers:
  - Thomas Elste <thomas.elste@imms.de>

properties:
  compatible:
    items:
      - enum:
          - ti,tps65020
          - ti,tps65021
          - ti,tps65023
  reg:
    description: I2C slave address of the device.
    maxItems: 1
  regulators:
    description: >
      Child nodes specifying regulator initialization data for
      VDCDC[1-3] and LDO[1-2] regulators.
    type: object
    additionalProperties: false
    patternProperties:
      "^VDCDC[1-3]$|^LDO[1-2]$":
        $ref: /schemas/regulator/regulator.yaml
        
required:
  - compatible
  - reg
  - regulators
additionalProperties: false
examples:
  - |
    tps65023@48 {
        compatible = "ti,tps65023";
        reg = <0x48>;
        regulators {
            VDCDC1 {
                regulator-name = "vdd_mpu";
                regulator-always-on;
                regulator-min-microvolt = <1200000>;
                regulator-max-microvolt = <1200000>;
            };
            VDCDC2 {
                regulator-name = "vdd_core";
                regulator-always-on;
                regulator-min-microvolt = <3300000>;
                regulator-max-microvolt = <3300000>;
            };
            VDCDC3 {
                regulator-name = "vdd_io";
                regulator-always-on;
                regulator-min-microvolt = <1800000>;
                regulator-max-microvolt = <1800000>;
            };
            LDO1 {
                regulator-name = "vdd_usb18";
                regulator-always-on;
                regulator-min-microvolt = <1800000>;
                regulator-max-microvolt = <1800000>;
            };
            LDO2 {
                regulator-name = "vdd_usb33";
                regulator-always-on;
                regulator-min-microvolt = <3300000>;
                regulator-max-microvolt = <3300000>;
            };
        };
    };
```

## Documentation/devicetree/bindings/regulator/ti,tps65090.yaml
```yaml
# SPDX-License-Identifier: (GPL-2.0-only OR BSD-2-Clause)
%YAML 1.2
---
$id: http://devicetree.org/schemas/regulator/ti,tps65090.yaml#
$schema: http://devicetree.org/meta-schemas/core.yaml#

title: TI TPS65090 PMIC
maintainers:
  - Andreas Färber <afaerber@suse.de>
  - Doug Anderson <dianders@chromium.org>
  - Jonathan Neuschäfer <j.neuschaefer@gmx.net>
  - Laxman Dewangan <ldewangan@nvidia.com>

description: |
  TPS65090 regulators

  Each regulator is defined using the standard binding for regulators.

properties:
  compatible:
    items:
      - const: ti,tps65090

  reg:
    items:
      - description: I2C slave address of the PMIC

  interrupts:
    description: Interrupt outputs of the controller
    items:
      - description: interrupt output

  regulators:
    description: >-
      Node containing sub-nodes for each regulator within the device.
    type: object
    additionalProperties: false
    properties:
      dcdc1:
        $ref: /schemas/regulator/regulator.yaml#
      dcdc2:
        $ref: /schemas/regulator/regulator.yaml#
      dcdc3:
        $ref: /schemas/regulator/regulator.yaml#
      fet1:
        $ref: /schemas/regulator/regulator.yaml#
      fet2:
        $ref: /schemas/regulator/regulator.yaml#
      fet3:
        $ref: /schemas/regulator/regulator.yaml#
      fet4:
        $ref: /schemas/regulator/regulator.yaml#
      fet5:
        $ref: /schemas/regulator/regulator.yaml#
      fet6:
        $ref: /schemas/regulator/regulator.yaml#
      fet7:
        $ref: /schemas/regulator/regulator.yaml#
      ldo1:
        $ref: /schemas/regulator/regulator.yaml#
      ldo2:
        $ref: /schemas/regulator/regulator.yaml#
    required:
      - dcdc1
      - dcdc2
      - dcdc3
      - fet1
      - fet2
      - fet3
      - fet4
      - fet5
      - fet6
      - fet7
      - ldo1
      - ldo2

  vsys1-supply: true
  vsys2-supply: true
  vsys3-supply: true
  infet1-supply: true
  infet2-supply: true
  infet3-supply: true
  infet4-supply: true
  infet5-supply: true
  infet6-supply: true
  infet7-supply: true
  vsys-l1-supply: true
  vsys-l2-supply: true

  ti,enable-ext-control:
    description: Enable external control of DCDC1, DCDC2 and DCDC3
    type: boolean

  dcdc-ext-control-gpios:
    description: GPIOs for external control of DCDC rails
    maxItems: 1

  ti,overcurrent-wait:
    description: Overcurrent wait time for FET regulators
    $ref: /schemas/types.yaml#/definitions/uint32
    minimum: 0
    maximum: 3

required:
  - compatible
  - reg
  - interrupts
  - regulators

additionalProperties: false

examples:
  - |
    tps65090@48 {
      compatible = "ti,tps65090";
      reg = <0x48>;
      interrupts = <0 88 0x4>;
      vsys1-supply = <&some_reg>;
      vsys2-supply = <&some_reg>;
      vsys3-supply = <&some_reg>;
      infet1-supply = <&some_reg>;
      infet2-supply = <&some_reg>;
      infet3-supply = <&some_reg>;
      infet4-supply = <&some_reg>;
      infet5-supply = <&some_reg>;
      infet6-supply = <&some_reg>;
      infet7-supply = <&some_reg>;
      vsys-l1-supply = <&some_reg>;
      vsys-l2-supply = <&some_reg>;
      regulators {
        dcdc1 {
          regulator-name = "dcdc1";
          regulator-boot-on;
          regulator-always-on;
          ti,enable-ext-control;
          dcdc-ext-control-gpios = <&gpio 10 0>;
        };
        dcdc2 {
          regulator-name = "dcdc2";
          regulator-boot-on;
          regulator-always-on;
        };
        dcdc3 {
          regulator-name = "dcdc3";
          regulator-boot-on;
          regulator-always-on;
        };
        fet1 {
          regulator-name = "fet1";
          regulator-boot-on;
          regulator-always-on;
        };
        fet2 {
          regulator-name = "fet2";
          regulator-boot-on;
          regulator-always-on;
        };
        fet3 {
          regulator-name = "fet3";
          regulator-boot-on;
          regulator-always-on;
        };
        fet4 {
          regulator-name = "fet4";
          regulator-boot-on;
          regulator-always-on;
        };
        fet5 {
          regulator-name = "fet5";
          regulator-boot-on;
          regulator-always-on;
        };
        fet6 {
          regulator-name = "fet6";
          regulator-boot-on;
          regulator-always-on;
        };
        fet7 {
          regulator-name = "fet7";
          regulator-boot-on;
          regulator-always-on;
        };
        ldo1 {
          regulator-name = "ldo1";
          regulator-boot-on;
          regulator-always-on;
        };
        ldo2 {
          regulator-name = "ldo2";
          regulator-boot-on;
          regulator-always-on;
        };
      };
    };
```

## Documentation/devicetree/bindings/regulator/ti,tps65217.yaml
```yaml
%YAML 1.2
---
$id: http://devicetree.org/schemas/regulator/ti,tps65217.yaml#
$schema: http://devicetree.org/meta-schemas/core.yaml#

title: TPS65217 family of regulators

maintainers:
  - AnilKumar Ch <anilkumar@ti.com>
  - Colin Foe-Parker <colin.foeparker@logicpd.com>
  - Heiko Schocher <hs@denx.de>
  - Peter Ujfalusi <peter.ujfalusi@ti.com>
  - Stephen Warren <swarren@nvidia.com>

description: |
  TPS65217 family of regulators

  The valid names for regulators are:
  tps65217: dcdc1, dcdc2, dcdc3, ldo1, ldo2, ldo3 and ldo4

  Each regulator is defined using the standard binding for regulators found at
  Documentation/devicetree/bindings/regulator/regulator.txt.

properties:
  compatible:
    const: ti,tps65217

  reg:
    description: I2C slave address
    items:
      - description: I2C slave address

  ti,pmic-shutdown-controller:
    type: boolean
    description: Telling the PMIC to shutdown on PWR_EN toggle

  regulators:
    description: Child node containing regulator initialization data
    type: object
    additionalProperties: false
    patternProperties:
      "^(dcdc[1-3]|ldo[1-4])$":
        description: Initialization data for a regulator
        $ref: /schemas/regulator/regulator.yaml#

required:
  - compatible
  - reg
  - regulators

additionalProperties: false

examples:
  - |
    tps: tps@24 {
      compatible = "ti,tps65217";
      ti,pmic-shutdown-controller;

      regulators {
        dcdc1_reg: dcdc1 {
          regulator-min-microvolt = <900000>;
          regulator-max-microvolt = <1800000>;
          regulator-boot-on;
          regulator-always-on;
        };

        dcdc2_reg: dcdc2 {
          regulator-min-microvolt = <900000>;
          regulator-max-microvolt = <3300000>;
          regulator-boot-on;
          regulator-always-on;
        };

        dcdc3_reg: dcc3 {
          regulator-min-microvolt = <900000>;
          regulator-max-microvolt = <1500000>;
          regulator-boot-on;
          regulator-always-on;
        };

        ldo1_reg: ldo1 {
          regulator-min-microvolt = <1000000>;
          regulator-max-microvolt = <3300000>;
          regulator-boot-on;
          regulator-always-on;
        };

        ldo2_reg: ldo2 {
          regulator-min-microvolt = <900000>;
          regulator-max-microvolt = <3300000>;
          regulator-boot-on;
          regulator-always-on;
        };

        ldo3_reg: ldo3 {
          regulator-min-microvolt = <1800000>;
          regulator-max-microvolt = <3300000>;
          regulator-boot-on;
          regulator-always-on;
        };

        ldo4_reg: ldo4 {
          regulator-min-microvolt = <1800000>;
          regulator-max-microvolt = <3300000>;
          regulator-boot-on;
          regulator-always-on;
        };
      };
    };
```
