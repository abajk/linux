## Documentation/devicetree/bindings/reset/st,stih407-softreset.yaml
```yaml
# SPDX-License-Identifier: (GPL-2.0-only OR BSD-2-Clause)
%YAML 1.2
---
$id: http://devicetree.org/schemas/st,stih407-softreset.yaml#
$schema: http://devicetree.org/meta-schemas/core.yaml#

title: STMicroelectronics STi family Sysconfig Peripheral SoftReset Controller

maintainers:
  - Jonathan Neuschäfer <j.neuschaefer@gmx.net>
  - Peter Griffin <peter.griffin@linaro.org>
  - Philipp Zabel <p.zabel@pengutronix.de>
  - Srinivas Kandagatla <srinivas.kandagatla@st.com>

description: |
  STMicroelectronics STi family Sysconfig Peripheral SoftReset Controller

  This binding describes a reset controller device that is used to enable and
  disable on-chip peripheral controllers such as USB and SATA, using
  "softreset" control bits found in the STi family SoC system configuration
  registers.

  The actual action taken when softreset is asserted is hardware dependent.
  However, when asserted it may not be possible to access the hardware's
  registers and after an assert/deassert sequence the hardware's previous state
  may no longer be valid.

  Please refer to reset.txt in this directory for common reset
  controller binding usage.

properties:
  '#reset-cells':
    const: 1
    description: |
      Specifies that this controller uses a single reset specifier cell.
  compatible:
    const: "st,stih407-softreset"
    description: |
      Node is compatible with STi SoftReset controller.

additionalProperties: false

required:
  - '#reset-cells'
  - compatible

examples:
  - |
    softreset: softreset-controller {
        #reset-cells = <1>;
        compatible = "st,stih407-softreset";
    };
```

## Documentation/devicetree/bindings/reset/ti,syscon-reset.yaml
```yaml
%YAML 1.2
---
$id: http://devicetree.org/schemas/reset/ti,syscon-reset.yaml#
$schema: http://devicetree.org/meta-schemas/core.yaml#

title: TI SysCon Reset Controller

maintainers:
  - Andrew F. Davis <afd@ti.com>
  - Bjorn Helgaas <bhelgaas@google.com>
  - Marco Franchi <marco.franchi@nxp.com>
  - Suman Anna <s-anna@ti.com>

description: |
  Almost all SoCs have hardware modules that require reset control in addition
  to clock and power control for their functionality. The reset control is
  typically provided by means of memory-mapped I/O registers. These registers are
  sometimes a part of a larger register space region implementing various
  functionalities. This register range is best represented as a syscon node to
  allow multiple entities to access their relevant registers in the common
  register space.

  A SysCon Reset Controller node defines a device that uses a syscon node and
  provides reset management functionality for various hardware modules present
  on the SoC.

properties:
  compatible:
    description: Supported compatible strings.
    items:
      - enum:
          - ti,k2e-pscrst
          - ti,k2l-pscrst
          - ti,k2hk-pscrst
          - ti,syscon-reset

  '#reset-cells':
    description: Number of reset cells. Must be 1.
    const: 1

  ti,reset-bits:
    description: |
      Contains the reset control register information. Each reset specifier
      consists of seven 32-bit cells:
        * Cell 1: offset of the reset assert control register from the syscon base
        * Cell 2: bit position in the reset assert control register
        * Cell 3: offset of the reset deassert control register from the syscon base
        * Cell 4: bit position in the reset deassert control register
        * Cell 5: offset of the reset status register from the syscon base
        * Cell 6: bit position in the reset status register
        * Cell 7: flags controlling reset behavior (see dt-bindings/reset/ti-syscon.h)
    items:
      - description: offset of the reset assert control register
      - description: bit position in the reset assert control register
      - description: offset of the reset deassert control register
      - description: bit position in the reset deassert control register
      - description: offset of the reset status register
      - description: bit position in the reset status register
      - description: flags controlling reset behavior

required:
  - compatible
  - '#reset-cells'
  - ti,reset-bits

additionalProperties: false

examples:
  - |
    reset-controller@2350000 {
        compatible = "ti,k2e-pscrst", "ti,syscon-reset";
        #reset-cells = <1>;
        ti,reset-bits = <
            0xa3c 8 0xa3c 8 0x83c 8 (ASSERT_CLEAR | DEASSERT_SET | STATUS_CLEAR)
            0xa40 5 0xa44 3 0     0 (ASSERT_SET   | DEASSERT_CLEAR | STATUS_NONE)
        >;
    };
```

## Documentation/devicetree/bindings/reset/xlnx,zynq-reset.yaml
```yaml
# SPDX-License-Identifier: (GPL-2.0-only OR BSD-2-Clause)
%YAML 1.2
---
$id: http://devicetree.org/schemas/xlnx,zynq-reset.yaml#
$schema: http://devicetree.org/meta-schemas/core.yaml#

title: Xilinx Zynq Reset Manager

maintainers:
  - Moritz Fischer <moritz.fischer@ettus.com>

description: |
  Xilinx Zynq Reset Manager

  The Zynq AP-SoC has several different resets.

  See Chapter 26 of the Zynq TRM (UG585) for more information about Zynq resets.

properties:
  compatible:
    const: xlnx,zynq-reset

  reg:
    description: Reset manager SLCR offset and size
    items:
      - description: Reset manager register offset
      - description: Reset manager register size

  syscon:
    description: A phandle to the Zynq's SLCR registers

  '#reset-cells':
    const: 1

  reset-controller: true

required:
  - compatible
  - reg
  - syscon
  - '#reset-cells'
  - reset-controller

additionalProperties: false

examples:
  - |
    rstc: rstc@200 {
        compatible = "xlnx,zynq-reset";
        reg = <0x200 0x48>;
        #reset-cells = <1>;
        syscon = <&slcr>;
    };
```

## Documentation/devicetree/bindings/resource-names.yaml
```yaml
# SPDX-License-Identifier: (GPL-2.0-only OR BSD-2-Clause)
%YAML 1.2
---
$id: http://devicetree.org/schemas/resource-names.yaml#
$schema: http://devicetree.org/meta-schemas/core.yaml#

title: Supplemental resource-names properties

maintainers:
  - Benoit Cousson <b-cousson@ti.com>

description: |
  Some properties contain an ordered list of 1 or more datum which are
  normally accessed by index.  However, some devices will have multiple
  values which are more naturally accessed by name.  Device nodes can
  include a supplemental property for assigning names to each of the list
  items.  The names property consists of a list of strings in the same
  order as the data in the resource property.

  Usage:

  The ‑names property must be used in conjunction with the normal resource
  property. If not it will be ignored.

properties:
  reg: {}
  clocks: {}
  reg-names:
    $ref: /schemas/types.yaml#/definitions/string-array
    description: Names for each of the reg entries, in order.

  clock-names:
    $ref: /schemas/types.yaml#/definitions/string-array
    description: Names for each of the clocks entries, in order.

  interrupt-names:
    $ref: /schemas/types.yaml#/definitions/string-array
    description: Names for each of the interrupts entries, in order.

dependencies:
  reg-names: [ reg ]
  clock-names: [ clocks ]
  interrupt-names: [ interrupts ]

additionalProperties: false

examples:
  - |
    node@0 {
      reg-names = "core", "aux";
      clock-names = "bus";
      interrupt-names = "rx", "tx";
    };
```

## Documentation/devicetree/bindings/rng/hisilicon,hip04-rng.yaml
```yaml
# SPDX-License-Identifier: (GPL-2.0-only OR BSD-2-Clause)
%YAML 1.2
---
$id: http://devicetree.org/schemas/hisilicon,hip04-rng.yaml#
$schema: http://devicetree.org/meta-schemas/core.yaml#

title: Hisilicon Random Number Generator

maintainers:
  - Kefeng Wang <wangkefeng.wang@huawei.com>

properties:
  compatible:
    items:
      - enum:
          - hisilicon,hip04-rng
          - hisilicon,hip05-rng

  reg:
    description: Register block base address and size.
    items:
      - description: Base address of RNG registers
      - description: Size of RNG register region

required:
  - compatible
  - reg

additionalProperties: false

examples:
  - |
    rng@d1010000 {
        compatible = "hisilicon,hip05-rng";
        reg = <0xd1010000 0x100>;
    };
```

## Documentation/devicetree/bindings/rng/sunw,n2-rng.yaml
```yaml
%YAML 1.2
---
$id: http://devicetree.org/schemas/sunw,n2-rng.yaml#
$schema: http://devicetree.org/meta-schemas/core.yaml#

title: HWRNG support for the n2_rng driver

maintainers:
  - Rob Herring <robh@kernel.org>

description: |
  HWRNG support for the n2_rng driver

  PS: see as well prtconfs.git by DaveM

properties:
  compatible:
    items:
      - enum:
          - SUNW,n2-rng
          - SUNW,vf-rng
          - SUNW,kt-rng
          - ORCL,m4-rng
          - ORCL,m7-rng

  reg:
    items:
      - description: base address to sample from

  rng-#units:
    description: Number of random number generator units.
    $ref: /schemas/types.yaml#/definitions/uint32

  name:
    description: Human-readable name of the random number generator.
    $ref: /schemas/types.yaml#/definitions/string

required:
  - compatible
  - reg

additionalProperties: false

examples:
  - |
    node@f029a4f4 {
        compatible = "ORCL,m4-rng";
        reg = <0x0000000e>;
        rng-#units = <0x00000002>;
        name = "random-number-generator";
    };
  - |
    node@f028c08c {
        compatible = "ORCL,m7-rng";
        reg = <0x0000000e>;
        rng-#units = <0x00000003>;
        name = "random-number-generator";
    };
```

## Documentation/devicetree/bindings/rtc/apm,xgene-rtc.yaml
```yaml
# SPDX-License-Identifier: (GPL-2.0-only OR BSD-2-Clause)
%YAML 1.2
---
$id: http://devicetree.org/schemas/apm,xgene-rtc.yaml#
$schema: http://devicetree.org/meta-schemas/core.yaml#

title: APM X-Gene Real Time Clock

maintainers:
  - Loc Ho <lho@apm.com>

description: |
  * APM X-Gene Real Time Clock

  RTC controller for the APM X-Gene Real Time Clock

properties:
  compatible:
    description: Binding compatible string
    items:
      - const: apm,xgene-rtc

  reg:
    items:
      - description: Physical base address of the controller
      - description: Length of the memory mapped region

  interrupts:
    description: IRQ line for the RTC
    items:
      - description: Interrupt specifier for the RTC

  '#clock-cells':
    const: 1
    description: Number of cells in clocks specifier

  clocks:
    maxItems: 1
    description: Reference to the clock entry

required:
  - compatible
  - reg
  - interrupts
  - '#clock-cells'
  - clocks

additionalProperties: false

examples:
  - |
    rtcclk: rtcclk {
        compatible = "fixed-clock";
        #clock-cells = <1>;
        clock-frequency = <100000000>;
        clock-output-names = "rtcclk";
    };

    rtc: rtc@10510000 {
        compatible = "apm,xgene-rtc";
        reg = <0x0 0x10510000 0x0 0x400>;
        interrupts = <0x0 0x46 0x4>;
        #clock-cells = <1>;
        clocks = <&rtcclk 0>;
    };
```

## Documentation/devicetree/bindings/rtc/cdns,rtc-r109v3.yaml
```yaml
# SPDX-License-Identifier: (GPL-2.0-only OR BSD-2-Clause)
%YAML 1.2
---
$id: http://devicetree.org/schemas/rtc/cdns,rtc-r109v3.yaml#
$schema: http://devicetree.org/meta-schemas/core.yaml#

title: Cadence Real Time Clock

maintainers:
  - Jan Kotas <jank@cadence.com>

description: |
  Cadence Real Time Clock

  The Cadence RTC controller with date, time and alarm capabilities.
  The alarm may wake the system from low-power state.

properties:
  compatible:
    items:
      - const: cdns,rtc-r109v3

  reg:
    items:
      - description: Base physical address of the register area.
      - description: Size of the register area.

  clocks:
    description: >
      Two clocks: pclk for the APB registers clock and ref_clk for the reference
      1Hz or 100Hz clock, depending on IP configuration.
    items:
      - description: APB registers clock.
      - description: Reference clock, 1Hz or 100Hz, depending on IP configuration.

  clock-names:
    items:
      - const: pclk
      - const: ref_clk

  interrupts:
    description: A single interrupt specifier.
    items:
      - description: Interrupt specifier.

required:
  - compatible
  - reg
  - clocks
  - interrupts

additionalProperties: false

examples:
  - |
    rtc0: rtc@fd080000 {
        compatible = "cdns,rtc-r109v3";
        reg = <0xfd080000 0x1000>;
        clock-names = "pclk", "ref_clk";
        clocks = <&sysclock>, <&refclock>;
        interrupts = <0 6 IRQ_TYPE_LEVEL_HIGH>;
    };
```

## Documentation/devicetree/bindings/rtc/dallas,ds1390.yaml
```yaml
# SPDX-License-Identifier: (GPL-2.0-only OR BSD-2-Clause)
%YAML 1.2
---
$id: http://devicetree.org/schemas/dallas,ds1390.yaml#
$schema: http://devicetree.org/meta-schemas/core.yaml#

title: Dallas DS1390 SPI Serial Real-Time Clock

maintainers:
  - Fabio Estevam <fabio.estevam@nxp.com>
  - Ivan Grimaldi <grimaldi.ivan@gmail.com>

description: |
  Dallas DS1390 SPI Serial Real-Time Clock

properties:
  compatible:
    items:
      - const: dallas,ds1390

  reg:
    items:
      - description: SPI bus chip select specification

  trickle-resistor-ohms:
    description: |
      Selected resistor for trickle charger.
      Values usable for ds1390 are 250, 2000, 4000.
      Should be given if trickle charger should be enabled.
    enum: [250, 2000, 4000]

  trickle-diode-disable:
    description: |
      Do not use internal trickle charger diode.
      Should be given if internal trickle charger diode should be disabled.
    type: boolean

required:
  - compatible
  - reg

additionalProperties: false

examples:
  - |
    ds1390: rtc@0 {
        compatible = "dallas,ds1390";
        trickle-resistor-ohms = <250>;
        reg = <0>;
    };
```

## Documentation/devicetree/bindings/rtc/epson,rx6110.yaml
```yaml
# SPDX-License-Identifier: (GPL-2.0-only OR BSD-2-Clause)
# Copyright 2025 Steffen Trumtrar <s.trumtrar@pengutronix.de>
%YAML 1.2
---
$id: http://devicetree.org/schemas/epson,rx6110.yaml#
$schema: http://devicetree.org/meta-schemas/core.yaml#

title: Epson RX6110 Real Time Clock

maintainers:
  - Steffen Trumtrar <s.trumtrar@pengutronix.de>

description: |
  The Epson RX6110 can be used with SPI or I2C busses. The kind of
  bus depends on the SPISEL pin and can not be configured via software.

  I2C mode

  SPI mode

properties:
  compatible:
    items:
      - enum: ["epson,rx6110"]
  reg:
    description: "Address of the device: I2C slave address in I2C mode or chip select number in SPI mode."
    items:
      - description: Register cell.
  spi-cs-high:
    description: RX6110 needs chip-select active high in SPI mode.
    type: boolean
  spi-cpha:
    description: RX6110 works with shifted clock phase in SPI mode.
    type: boolean
  spi-cpol:
    description: RX6110 works with inverse clock polarity in SPI mode.
    type: boolean

required:
  - compatible
  - reg

additionalProperties: false

examples:
  - |
    rtc: rtc@32 {
      compatible = "epson,rx6110";
      reg = <0x32>;
    };
  - |
    rtc: rtc@3 {
      compatible = "epson,rx6110";
      reg = <3>;
      spi-cs-high;
      spi-cpha;
      spi-cpol;
    };
```
