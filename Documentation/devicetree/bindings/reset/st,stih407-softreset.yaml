## Documentation/devicetree/bindings/rtc/ibm,opal-rtc.yaml
```yaml
# SPDX-License-Identifier: (GPL-2.0-only OR BSD-2-Clause)
%YAML 1.2
---
$id: http://devicetree.org/schemas/rtc/ibm,opal-rtc.yaml#
$schema: http://devicetree.org/meta-schemas/core.yaml#

title: IBM OPAL real-time clock

maintainers:
  - Michael Ellerman <mpe@ellerman.id.au>
  - Neelesh Gupta <neelegup@linux.vnet.ibm.com>
  - Sudeep Holla <sudeep.holla@arm.com>

description: |
  IBM OPAL real-time clock
  ------------------------

  Required properties:
  - compatible: Should be "ibm,opal-rtc"

  Optional properties:
  - wakeup-source: Decides if the wakeup is supported or not
      (Legacy property supported: "has-tpo")

properties:
  compatible:
    items:
      - const: ibm,opal-rtc

  wakeup-source:
    description: Decides if the wakeup is supported
    type: boolean

  has-tpo:
    description: Legacy alias for wakeup-source
    type: boolean

required:
  - compatible

additionalProperties: false

examples:
  - |
    rtc {
        compatible = "ibm,opal-rtc";
        wakeup-source;
        phandle = <0x10000029>;
        linux,phandle = <0x10000029>;
    };
```

## Documentation/devicetree/bindings/rtc/isil,isl12026.yaml
```yaml
# SPDX-License-Identifier: (GPL-2.0-only OR BSD-2-Clause)
# Copyright 2025 Cavium, Inc.
%YAML 1.2
---
$id: http://devicetree.org/schemas/rtc/isil,isl12026.yaml#
$schema: http://devicetree.org/meta-schemas/core.yaml#

title: ISL12026 I2C RTC/EEPROM

maintainers:
  - David Daney <david.daney@cavium.com>

description: |
  ISL12026 is an I2C RTC/EEPROM combination device. The RTC and control
  registers respond at bus address 0x6f, and the EEPROM array responds
  at bus address 0x57. The canonical "reg" value will be for the RTC portion.

properties:
  compatible:
    description: Device compatible string.
    items:
      - const: isil,isl12026

  reg:
    items:
      - description: I2C slave address for RTC registers (always 0x6f)

  isil,pwr-bsw:
    description: PWR.BSW bit must be set to the specified value for proper operation.
    $ref: /schemas/types.yaml#/definitions/uint32
    enum: [0, 1]

  isil,pwr-sbib:
    description: PWR.SBIB bit must be set to the specified value for proper operation.
    $ref: /schemas/types.yaml#/definitions/uint32
    enum: [0, 1]

required:
  - compatible
  - reg

additionalProperties: false

examples:
  - |
    rtc@6f {
        compatible = "isil,isl12026";
        reg = <0x6f>;
        isil,pwr-bsw = <0>;
        isil,pwr-sbib = <1>;
    };
```

## Documentation/devicetree/bindings/rtc/isil,isl12057.yaml
```yaml
# SPDX-License-Identifier: (GPL-2.0-only OR BSD-2-Clause)
# Copyright 2025 Arnaud Ebalard <arno@natisbad.org>
# Copyright 2025 Heiner Kallweit <hkallweit1@gmail.com>
# Copyright 2025 Rob Herring <robh@kernel.org>
# Copyright 2025 Sudeep Holla <sudeep.holla@arm.com>
%YAML 1.2
---
$id: http://devicetree.org/schemas/rtc/isil,isl12057.yaml#
$schema: http://devicetree.org/meta-schemas/core.yaml#

title: Intersil ISL12057 I2C RTC/Alarm chip

maintainers:
  - Arnaud Ebalard <arno@natisbad.org>
  - Heiner Kallweit <hkallweit1@gmail.com>
  - Rob Herring <robh@kernel.org>
  - Sudeep Holla <sudeep.holla@arm.com>

description: |
  Intersil ISL12057 I2C RTC/Alarm chip

  ISL12057 is a trivial I2C device (it has simple device tree bindings,
  consisting of a compatible field, an address and possibly an interrupt
  line).

  Nonetheless, it also supports an option boolean property ("wakeup-source")
  to handle the specific use-case found on at least three in-tree users
  of the chip (NETGEAR ReadyNAS 102, 104 and 2120 ARM-based NAS); On those
  devices, the IRQ#2 pin of the chip (associated with the alarm supported
  by the driver) is not connected to the SoC but to a PMIC. It allows the
  device to be powered up when RTC alarm rings. In order to mark the device
  has a wakeup source and get access to the 'wakealarm' sysfs entry, this
  specific property can be set when the IRQ#2 pin of the chip is not
  connected to the SoC but can wake up the device.

properties:
  compatible:
    items:
      - const: isil,isl12057

  reg:
    items:
      - description: I2C bus address of the device

  interrupts:
    items:
      - description: IRQ number for alarm input
      - description: IRQ trigger type (IRQ_TYPE flags)

  wakeup-source:
    description: Mark the chip as a wakeup source when interrupt pin not connected to SoC
    type: boolean

  pinctrl-0:
    $ref: /schemas/types.yaml#/definitions/phandle-array
    description: Pin control state for alarm interrupt

  pinctrl-names:
    $ref: /schemas/types.yaml#/definitions/string-array
    items:
      - const: default

required:
  - compatible
  - reg

additionalProperties: false

examples:
  - |
    isl12057@68 {
        compatible = "isil,isl12057";
        reg = <0x68>;
    };

  - |
    pinctrl {
        rtc_alarm_pin: rtc_alarm_pin {
            marvell,pins = "mpp6";
            marvell,function = "gpio";
        };
    };

    isl12057@68 {
        compatible = "isil,isl12057";
        reg = <0x68>;
        pinctrl-0 = <&rtc_alarm_pin>;
        pinctrl-names = "default";
        interrupts = <6 IRQ_TYPE_EDGE_FALLING>;
    };

  - |
    isl12057@68 {
        compatible = "isil,isl12057";
        reg = <0x68>;
        wakeup-source;
    };
```

## Documentation/devicetree/bindings/rtc/maxim,ds1302.yaml
```yaml
# SPDX-License-Identifier: (GPL-2.0-only OR BSD-2-Clause)
# Copyright 2025 Sergey Yanovich <ynvich@gmail.com>
%YAML 1.2
---
$id: http://devicetree.org/schemas/rtc/maxim,ds1302.yaml#
$schema: http://devicetree.org/meta-schemas/core.yaml#

title: Maxim DS1302 RTC

maintainers:
  - Sergey Yanovich <ynvich@gmail.com>

description: |
  * Maxim/Dallas Semiconductor DS-1302 RTC

  Simple device which could be used to store date/time between reboots.

  The device uses the standard MicroWire half-duplex transfer timing.
  Master output is set on low clock and sensed by the RTC on the rising
  edge. Master input is set by the RTC on the trailing edge and is sensed
  by the master on low clock.

properties:
  compatible:
    items:
      - const: maxim,ds1302

  reg:
    items:
      - description: Chip select index within the controller

  spi-max-frequency:
    $ref: /schemas/types.yaml#/definitions/uint32
    description: Maximum SPI clock frequency (500 kHz at 2.2 V, 2 MHz at 5 V)

  spi-3wire:
    type: boolean
    description: Shared data in/out line

  spi-lsb-first:
    type: boolean
    description: Least significant bit first transfers

  spi-cs-high:
    type: boolean
    description: Active high chip select line

required:
  - compatible
  - reg
  - spi-max-frequency
  - spi-3wire
  - spi-lsb-first
  - spi-cs-high

additionalProperties: false

examples:
  - |
    spi@901c {
        #address-cells = <1>;
        #size-cells = <0>;
        compatible = "icpdas,lp8841-spi-rtc";
        reg = <0x901c 0x1>;

        rtc@0 {
            compatible = "maxim,ds1302";
            reg = <0>;
            spi-max-frequency = <500000>;
            spi-3wire;
            spi-lsb-first;
            spi-cs-high;
        };
    };
```

## Documentation/devicetree/bindings/rtc/microchip,pic32mzda-rtc.yaml
```yaml
# SPDX-License-Identifier: (GPL-2.0-only OR BSD-2-Clause)
# Copyright 2025 Microchip Technology Inc.
%YAML 1.2
---
$id: http://devicetree.org/schemas/microchip,pic32mzda-rtc.yaml#
$schema: http://devicetree.org/meta-schemas/core.yaml#

title: Microchip PIC32 Real Time Clock and Calendar

maintainers:
  - Joshua Henderson <joshua.henderson@microchip.com>

description: |
  The RTCC keeps time in hours, minutes, and seconds, and one half second.
  It provides a calendar in weekday, date, month, and year. It also provides a
  configurable alarm.

properties:
  compatible:
    items:
      - const: "microchip,pic32mzda-rtc"
    description: Device compatible with the Microchip PIC32 RTCC.

  reg:
    items:
      - description: Physical base address of the controller.
      - description: Length of memory mapped region.

  interrupts:
    items:
      - description: RTC alarm/event interrupt.

  clocks:
    maxItems: 1
    description: Clock source for the RTCC.

required:
  - compatible
  - reg
  - interrupts
  - clocks

additionalProperties: false

examples:
  - |
    rtc: rtc@1f8c0000 {
        compatible = "microchip,pic32mzda-rtc";
        reg = <0x1f8c0000 0x60>;
        interrupts = <166 IRQ_TYPE_EDGE_RISING>;
        clocks = <&PBCLK6>;
    };
```

## Documentation/devicetree/bindings/rtc/motorola,cpcap-rtc.yaml
```yaml
# SPDX-License-Identifier: (GPL-2.0-only OR BSD-2-Clause)
# Copyright 2025 Sebastian Reichel <sre@kernel.org>
%YAML 1.2
---
$id: http://devicetree.org/schemas/motorola,cpcap-rtc.yaml#
$schema: http://devicetree.org/meta-schemas/core.yaml#

title: Motorola CPCAP PMIC RTC

maintainers:
  - Sebastian Reichel <sre@kernel.org>

description: |
  Motorola CPCAP PMIC RTC

  This module is part of the CPCAP. For more details about the whole
  chip see Documentation/devicetree/bindings/mfd/motorola-cpcap.txt.

properties:
  compatible:
    contains:
      const: motorola,cpcap-rtc

  interrupts:
    description: Interrupt specifier for alarm and periodic 1 Hz tick
    items:
      - description: Alarm interrupt
      - description: Periodic 1 Hz interrupt

  interrupt-names:
    items:
      - const: alarm
      - const: 1hz

required:
  - compatible
  - interrupts

additionalProperties: false

examples:
  - |
    &cpcap {
        cpcap_rtc: rtc {
            compatible = "motorola,cpcap-rtc";
            interrupts = <39 IRQ_TYPE_NONE>, <26 IRQ_TYPE_NONE>;
        };
    };
```

## Documentation/devicetree/bindings/rtc/motorola,mc146818.yaml
```yaml
# SPDX-License-Identifier: (GPL-2.0-only OR BSD-2-Clause)
%YAML 1.2
---
$id: http://devicetree.org/schemas/rtc/motorola,mc146818.yaml#
$schema: http://devicetree.org/meta-schemas/core.yaml#

title: Motorola mc146818 compatible RTC

maintainers:
  - Bjorn Helgaas <bhelgaas@google.com>
  - Rob Herring <robh@kernel.org>
  - Sebastian Andrzej Siewior <bigeasy@linutronix.de>

description: |
  Motorola mc146818 compatible RTC

  "Register A" and "B" are usually initialized by the firmware (BIOS for
  instance). If this is not done, it can be performed by the driver.

properties:
  compatible:
    description: The device compatibility string.
    items:
      - const: motorola,mc146818

  reg:
    description: Register base address and size of the RTC.
    items:
      - description: Register base address.
      - description: Register size in bytes.

  interrupts:
    description: Interrupt configurations.
    items:
      - description: Interrupt number.
      - description: Interrupt flags.

  ctrl-reg:
    description: Initial control register value (Register B).
    $ref: /schemas/types.yaml#/definitions/uint32

  freq-reg:
    description: Initial frequency divider register value (Register A).
    $ref: /schemas/types.yaml#/definitions/uint32

required:
  - compatible
  - reg

additionalProperties: false

examples:
  - |
    rtc@70 {
        compatible = "motorola,mc146818";
        reg = <1 0x70 2>;
        interrupts = <8 3>;
        ctrl-reg = <2>;
        freq-reg = <0x26>;
    };
```

## Documentation/devicetree/bindings/rtc/moxa,moxart-rtc.yaml
```yaml
# SPDX-License-Identifier: (GPL-2.0-only OR BSD-2-Clause)
# Copyright 2025 Dmitry Torokhov <dmitry.torokhov@gmail.com>, Jonas Jensen <jonas.jensen@gmail.com>
%YAML 1.2
---
$id: http://devicetree.org/schemas/rtc/moxa,moxart-rtc.yaml#
# $schema is the meta-schema this schema should be validated with.
$schema: http://devicetree.org/meta-schemas/core.yaml#

title: MOXA ART real-time clock

maintainers:
  - Dmitry Torokhov <dmitry.torokhov@gmail.com>
  - Jonas Jensen <jonas.jensen@gmail.com>

description: |
  MOXA ART real-time clock

properties:
  compatible:
    items:
      - const: moxa,moxart-rtc
    description: Device is compatible with the MOXA ART real-time clock.
  rtc-sclk-gpios:
    maxItems: 1
    description: RTC serial clock GPIO line with zero flags.
  rtc-data-gpios:
    maxItems: 1
    description: RTC data GPIO line with zero flags.
  rtc-reset-gpios:
    maxItems: 1
    description: RTC reset GPIO line with zero flags.

required:
  - compatible
  - rtc-sclk-gpios
  - rtc-data-gpios
  - rtc-reset-gpios

additionalProperties: false

examples:
  - |
    rtc: rtc {
        compatible = "moxa,moxart-rtc";
        rtc-sclk-gpios = <&gpio 5 0>;
        rtc-data-gpios = <&gpio 6 0>;
        rtc-reset-gpios = <&gpio 7 0>;
    };
```

## Documentation/devicetree/bindings/rtc/realtek,rtd1295-rtc.yaml
```yaml
# SPDX-License-Identifier: (GPL-2.0-only OR BSD-2-Clause)
%YAML 1.2
---
$id: http://devicetree.org/schemas/rtc/realtek,rtd1295-rtc.yaml#
$schema: http://devicetree.org/meta-schemas/core.yaml#

title: Realtek RTD129x Real-Time Clock
maintainers:
  - Andreas Färber <afaerber@suse.de>

description: |
  Realtek RTD129x Real-Time Clock

properties:
  compatible:
    items:
      - const: "realtek,rtd1295-rtc"
    description: Device compatible string.
  reg:
    items:
      - description: Physical base address and size of the RTC registers.
    description: Register base address and size.
  clocks:
    maxItems: 1
    description: Specifies the clock gate.

required:
  - compatible
  - reg
  - clocks

additionalProperties: false

examples:
  - |
    rtc@9801b600 {
        compatible = "realtek,rtd1295-rtc";
        reg = <0x9801b600 0x100>;
        clocks = <&clkc RTD1295_CLK_EN_MISC_RTC>;
    };
```

## Documentation/devicetree/bindings/rtc/st,stih407-lpc.yaml
```yaml
# SPDX-License-Identifier: (GPL-2.0-only OR BSD-2-Clause)
%YAML 1.2
---
$id: http://devicetree.org/schemas/st,stih407-lpc.yaml#
$schema: http://devicetree.org/meta-schemas/core.yaml#

title: STMicroelectronics Low Power Controller (LPC) - RTC

maintainers:
  - Lee Jones <lee@kernel.org>

description: |
  STMicroelectronics Low Power Controller (LPC) - RTC

  LPC currently supports Watchdog OR Real Time Clock OR Clocksource functionality.

  See: ../watchdog/st_lpc_wdt.txt for Watchdog options
  See: ../timer/st,stih407-lpc for Clocksource options

properties:
  compatible:
    items:
      - const: st,stih407-lpc
  reg:
    description: LPC registers base address and size
    items:
      - description: LPC registers base address
      - description: LPC registers size
  clocks:
    maxItems: 1
    description: "Clock used by the LPC device. See: ../clock/clock-bindings.txt"
  interrupts:
    items:
      - description: LPC interrupt line number and associated flags
  st,lpc-mode:
    description: "The LPC mode: ST_LPC_MODE_RTC (0), ST_LPC_MODE_WDT (1) or ST_LPC_MODE_CLKSRC (2)"
    $ref: /schemas/types.yaml#/definitions/uint32
    enum: [0, 1, 2]

required:
  - compatible
  - reg
  - clocks
  - interrupts
  - st,lpc-mode

additionalProperties: false

examples:
  - |
    lpc@fde05000 {
      compatible = "st,stih407-lpc";
      reg = <0xfde05000 0x1000>;
      clocks = <&clk_s_d3_flexgen CLK_LPC_0>;
      interrupts = <10 0>;
      st,lpc-mode = <ST_LPC_MODE_RTC>;
    };
```
