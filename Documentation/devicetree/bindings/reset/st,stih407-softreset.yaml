## Documentation/devicetree/bindings/rtc/ti,da830-rtc.yaml
```yaml
# SPDX-License-Identifier: (GPL-2.0-only OR BSD-2-Clause)
%YAML 1.2
---
$id: http://devicetree.org/schemas/rtc/ti,da830-rtc.yaml#
$schema: http://devicetree.org/meta-schemas/core.yaml#

title: TI Real Time Clock

maintainers:
  - Afzal Mohammed <afzal@ti.com>
  - Hebbar Gururaja <gururaja.hebbar@ti.com>
  - Johan Hovold <johan@kernel.org>
  - Keerthy <j-keerthy@ti.com>
  - Marcin Niestroj <m.niestroj@grinn-global.com>
  - Rob Herring <robh@kernel.org>

description: |
  TI Real Time Clock

properties:
  compatible:
    enum:
      - ti,da830-rtc
      - ti,am3352-rtc
      - ti,am4372-rtc

  reg:
    maxItems: 1

  interrupts:
    items:
      - description: RTC timer interrupt
      - description: alarm interrupts

  system-power-controller:
    description: Whether the RTC controls system power via pmic_power_en
    type: boolean

  clocks:
    maxItems: 2

  clock-names:
    items:
      - const: ext-clk
      - const: int-clk

  ext-wakeup:
    description: Pin settings for external wakeup subnode
    type: object
    additionalProperties: false
    properties:
      pins:
        description: Names of external wakeup pins to configure
        $ref: /schemas/types.yaml#/definitions/string-array
      input-enable:
        description: Enables the external wakeup input
        type: boolean
      ti,active-high:
        description: Set input active high (default is active low)
        type: boolean
    required:
      - pins

additionalProperties: false

examples:
  - |
    rtc@1c23000 {
      compatible = "ti,da830-rtc";
      reg = <0x23000 0x1000>;
      interrupts = <19 19>;
      system-power-controller;
      clocks = <&clk_32k_rtc>, <&clk_32768_ck>;
      clock-names = "ext-clk", "int-clk";
      pinctrl-0 = <&ext_wakeup>;
      pinctrl-names = "default";

      ext_wakeup: ext-wakeup {
        pins = "ext_wakeup0";
        input-enable;
        ti,active-high;
      };
    };
```

## Documentation/devicetree/bindings/rtc/ti,palmas-rtc.yaml
```yaml
# SPDX-License-Identifier: (GPL-2.0-only OR BSD-2-Clause)
# Copyright 2025 Dr. H. Nikolaus Schaller
%YAML 1.2
---
$id: http://devicetree.org/schemas/ti,palmas-rtc.yaml#
$schema: http://devicetree.org/meta-schemas/core.yaml#

title: TI Palmas RTC controller

maintainers:
  - Dr. H. Nikolaus Schaller <hns@goldelico.com>
  - Laxman Dewangan <ldewangan@nvidia.com>
  - Rob Herring <robh@kernel.org>

description: |
  Palmas RTC controller bindings

properties:
  compatible:
    description: |
      Must be "ti,palmas-rtc" for all Palmas series RTC controllers.
    items:
      - const: ti,palmas-rtc

  interrupts:
    items:
      - description: Interrupt number of RTC submodule on device.

  ti,backup-battery-chargeable:
    description: |
      The Palmas series device like TPS65913 or TPS80036 supports the backup
      battery for powering the RTC when main battery is removed or in very low
      power state. This flag tells whether the battery is chargeable or not.
      If present, the driver can enable charging.
    type: boolean

  ti,backup-battery-charge-high-current:
    description: |
      Enable high current charging in backup battery. Device supports < 100uA
      and > 100uA charging. The high current will be > 100uA. Absence of this
      property will charge battery to lower current (< 100uA).
    type: boolean

required:
  - compatible
  - interrupts

additionalProperties: false

examples:
  - |
    palmas: tps65913@58 {
        ...
        palmas_rtc: rtc {
            compatible = "ti,palmas-rtc";
            interrupts = <8 0>;
            ti,backup-battery-chargeable;
            ti,backup-battery-charge-high-current;
        };
        ...
    };
```

## Documentation/devicetree/bindings/scsi/hisilicon,hip05-sas-v1.yaml
```yaml
# SPDX-License-Identifier: (GPL-2.0-only OR BSD-2-Clause)
%YAML 1.2
---
$id: http://devicetree.org/schemas/scsi/hisilicon,hip05-sas-v1.yaml#
$schema: http://devicetree.org/meta-schemas/core.yaml#

title: HiSilicon SAS controller

maintainers:
  - John Garry <john.g.garry@oracle.com>
  - Rob Herring <robh@kernel.org>
  - Xiaofei Tan <tanxiaofei@huawei.com>

description: |
  * HiSilicon SAS controller

  The HiSilicon SAS controller supports SAS/SATA.

properties:
  compatible:
    description: Device compatible string for HiSilicon SAS controller.
    items:
      - enum:
          - hisilicon,hip05-sas-v1
          - hisilicon,hip06-sas-v2
          - hisilicon,hip07-sas-v2

  sas-addr:
    description: SAS address, array of 8 bytes representing host SAS address.
    $ref: /schemas/types.yaml#/definitions/uint8-array
    minItems: 8
    maxItems: 8

  reg:
    minItems: 1
    items:
      - description: SAS registers
      - description: CPLD SGPIO control registers

  hisilicon,sas-syscon:
    description: Phandle of syscon used for SAS control.
    $ref: /schemas/types.yaml#/definitions/phandle

  ctrl-reset-reg:
    description: Offset to controller reset register in SAS register region.
    $ref: /schemas/types.yaml#/definitions/uint32

  ctrl-reset-sts-reg:
    description: Offset to controller reset status register in SAS register region.
    $ref: /schemas/types.yaml#/definitions/uint32

  ctrl-clock-ena-reg:
    description: Offset to controller clock enable register in SAS register region.
    $ref: /schemas/types.yaml#/definitions/uint32

  queue-count:
    description: Number of delivery and completion queues in the controller.
    $ref: /schemas/types.yaml#/definitions/uint32

  phy-count:
    description: Number of PHYs accessible by the controller.
    $ref: /schemas/types.yaml#/definitions/uint32

  dma-coherent: true

  interrupts:
    description: |
      Interrupt specifiers for PHY, SATA, and completion queues; ordering and
      number depend on controller version.

  hip06-sas-v2-quirk-amt:
    description: Indicates that the v2 controller has the "am-max-transmissions" limitation.
    type: boolean

  hisilicon,signal-attenuation:
    description: |
      De-emphasis, preshoot, and boost attenuation readings for the board,
      used to calculate signal attenuation (y = (x-10000)/10000).
    $ref: /schemas/types.yaml#/definitions/uint32-array
    minItems: 3
    maxItems: 3
    items:
      minimum: 7600
      maximum: 12400

required:
  - compatible
  - sas-addr
  - reg
  - hisilicon,sas-syscon
  - ctrl-reset-reg
  - ctrl-reset-sts-reg
  - ctrl-clock-ena-reg
  - queue-count
  - phy-count
  - interrupts

additionalProperties: false

examples:
  - |
    sas0: sas@c1000000 {
        compatible = "hisilicon,hip05-sas-v1";
        sas-addr = [50 01 88 20 16 00 00 0a];
        reg = <0x0 0xc1000000 0x0 0x10000>;
        hisilicon,sas-syscon = <&pcie_sas>;
        ctrl-reset-reg = <0xa60>;
        ctrl-reset-sts-reg = <0x5a30>;
        ctrl-clock-ena-reg = <0x338>;
        queue-count = <32>;
        phy-count = <8>;
        dma-coherent;
        interrupts = <259 4>, <263 4>, <264 4>,
                     <269 4>, <273 4>, <274 4>,
                     <279 4>, <283 4>, <284 4>,
                     <289 4>, <293 4>, <294 4>,
                     <299 4>, <303 4>, <304 4>,
                     <309 4>, <313 4>, <314 4>,
                     <319 4>, <323 4>, <324 4>,
                     <329 4>, <333 4>, <334 4>,
                     <339 1>, <340 1>, <341 1>,
                     <342 1>, <343 1>, <344 1>,
                     <345 1>, <346 1>, <347 1>,
                     <348 1>, <349 1>, <350 1>,
                     <351 1>, <352 1>, <353 1>,
                     <354 1>, <355 1>, <356 1>,
                     <357 1>, <358 1>, <359 1>,
                     <360 1>, <361 1>, <362 1>,
                     <363 1>, <364 1>, <365 1>,
                     <366 1>, <367 1>;
    };
```

## Documentation/devicetree/bindings/serio/altr,ps2-1.0.yaml
```yaml
# SPDX-License-Identifier: (GPL-2.0-only OR BSD-2-Clause)
%YAML 1.2
---
$id: http://devicetree.org/schemas/serio/altr,ps2-1.0.yaml#
$schema: http://devicetree.org/meta-schemas/core.yaml#

title: Altera UP PS/2 controller

maintainers:
  - Dinh Nguyen <dinguyen@altera.com>
  - Walter Goossens <waltergoossens@home.nl>

description: |
  Altera UP PS/2 controller

properties:
  compatible:
    description: Compatibility string for the Altera UP PS/2 controller.
    items:
      - enum:
          - ALTR,ps2-1.0
          - altr,ps2-1.0

required:
  - compatible

additionalProperties: false

examples:
  - |
    ps2 {
        compatible = "altr,ps2-1.0";
    };
```

## Documentation/devicetree/bindings/serio/olpc,ap-sp.yaml
```yaml
# SPDX-License-Identifier: (GPL-2.0-only OR BSD-2-Clause)
# Copyright 2025 Daniel Drake <dsd@laptop.org>
# Copyright 2025 Lubomir Rintel <lkundrak@v3.sk>
%YAML 1.2
---
$id: http://devicetree.org/schemas/serio/olpc,ap-sp.yaml#
$schema: http://devicetree.org/meta-schemas/core.yaml#

title: OLPC AP-SP serio interface

maintainers:
  - Daniel Drake <dsd@laptop.org>
  - Lubomir Rintel <lkundrak@v3.sk>

description: |
  OLPC AP-SP serio interface

properties:
  compatible:
    items:
      - const: olpc,ap-sp
    description: Must be set to "olpc,ap-sp".
  reg:
    items:
      - description: Base address of SoC's WTM registers
      - description: Length of the SoC's WTM registers
    description: Memory-mapped registers for the WTM interface.
  interrupts:
    items:
      - description: SP-AP interrupt
    description: Interrupt line for the SP-AP communication.

required:
  - compatible
  - reg
  - interrupts

additionalProperties: false

examples:
  - |
    ap-sp@d4290000 {
        compatible = "olpc,ap-sp";
        reg = <0xd4290000 0x1000>;
        interrupts = <40>;
    };
```
