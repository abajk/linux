## Documentation/devicetree/bindings/usb/cavium,octeon-7130-usb-uctl.yaml
```yaml
%YAML 1.2
---
$id: http://devicetree.org/schemas/usb/cavium,octeon-7130-usb-uctl.yaml#
$schema: http://devicetree.org/meta-schemas/core.yaml#

title: Cavium SuperSpeed DWC3 USB SoC controller

maintainers:
  - Felipe Balbi <felipe.balbi@linux.intel.com>
  - Krzysztof Kozlowski <krzk@kernel.org>

description: |
  Required properties:
  - compatible: Should contain "cavium,octeon-7130-usb-uctl"

  Required child node:
  A child node must exist to represent the core DWC3 IP block.
  The name of the node is not important. The content of the node
  is defined in dwc3.txt.

properties:
  compatible:
    description: Parent node compatible string
    items:
      - const: cavium,octeon-7130-usb-uctl

  reg:
    description: Controller register base address and size
    items:
      - description: Base address and size of the DWC3 controller

  ranges: true

  refclk-frequency:
    description: Reference clock frequency in Hz
    $ref: /schemas/types.yaml#/definitions/uint32

  refclk-type-ss:
    description: Reference clock type for SuperSpeed mode
    $ref: /schemas/types.yaml#/definitions/string

  refclk-type-hs:
    description: Reference clock type for HighSpeed mode
    $ref: /schemas/types.yaml#/definitions/string

  power:
    description: Power supply phandle and flags
    items:
      - $ref: /schemas/types.yaml#/definitions/phandle
      - description: Regulator identifier
        type: integer
      - description: Flags
        type: integer

patternProperties:
  ".*":
    description: Child node representing the DWC3 core IP
    $ref: /schemas/usb/snps,dwc3.yaml#

required:
  - compatible
  - reg
  - ranges
  - refclk-frequency
  - refclk-type-ss
  - refclk-type-hs
  - power

additionalProperties: false

examples:
  - |
    uctl@1180069000000 {
        compatible = "cavium,octeon-7130-usb-uctl";
        reg = <0x00011800 0x69000000 0x00000000 0x00000100>;
        ranges;
        #address-cells = <0x00000002>;
        #size-cells = <0x00000002>;
        refclk-frequency = <0x05f5e100>;
        refclk-type-ss = "dlmc_ref_clk0";
        refclk-type-hs = "dlmc_ref_clk0";
        power = <0x00000002 0x00000002 0x00000001>;
        xhci@1690000000000 {
            compatible = "cavium,octeon-7130-xhci", "snps,dwc3";
            reg = <0x00016900 0x00000000 0x00000010 0x00000000>;
            interrupts = <0x00000009 0x00000004>;
        };
    };
```

## Documentation/devicetree/bindings/usb/hisilicon,hi3798cv200-xhci.yaml
```yaml
# SPDX-License-Identifier: (GPL-2.0-only OR BSD-2-Clause)
# Copyright 2025 Jianguo Sun
%YAML 1.2
---
$id: http://devicetree.org/schemas/usb/hisilicon,hi3798cv200-xhci.yaml#
$schema: http://devicetree.org/meta-schemas/core.yaml#

title: HiSilicon STB xHCI

maintainers:
  - Jianguo Sun <sunjianguo1@huawei.com>

properties:
  compatible:
    items:
      - const: hisilicon,hi3798cv200-xhci

  reg:
    maxItems: 1

  interrupts:
    maxItems: 1

  clocks:
    items:
      - description: Bus clock.
      - description: UTMI clock.
      - description: PIPE clock.
      - description: Suspend clock.

  clock-names:
    items:
      - const: bus
      - const: utmi
      - const: pipe
      - const: suspend

  resets:
    maxItems: 1

  reset-names:
    items:
      - const: soft

  phys:
    items:
      - description: Inno USB2 PHY.
      - description: Combo USB3 PHY.

  phy-names:
    items:
      - const: inno
      - const: combo

  usb2-lpm-disable:
    type: boolean
    description: Disable USB2 hardware low-power mode.
  usb3-lpm-capable:
    type: boolean
    description: Platform USB3 link power management capability.
  imod-interval-ns:
    description: Interrupt moderation interval in nanoseconds.

required:
  - compatible
  - reg
  - interrupts
  - clocks
  - clock-names
  - resets
  - reset-names
  - phys
  - phy-names

additionalProperties: false

examples:
  - |
    xhci0: xchi@f98a0000 {
      compatible = "hisilicon,hi3798cv200-xhci";
      reg = <0xf98a0000 0x10000>;
      interrupts = <GIC_SPI 69 IRQ_TYPE_LEVEL_HIGH>;
      clocks = <&crg HISTB_USB3_BUS_CLK>,
               <&crg HISTB_USB3_UTMI_CLK>,
               <&crg HISTB_USB3_PIPE_CLK>,
               <&crg HISTB_USB3_SUSPEND_CLK>;
      clock-names = "bus", "utmi", "pipe", "suspend";
      resets = <&crg 0xb0 12>;
      reset-names = "soft";
      phys = <&usb2_phy1_port1 0>, <&combphy0 PHY_TYPE_USB3>;
      phy-names = "inno", "combo";
    };
```

## Documentation/devicetree/bindings/usb/marvell,pxa-ohci.yaml
```yaml
# SPDX-License-Identifier: (GPL-2.0-only OR BSD-2-Clause)
%YAML 1.2
---
$id: http://devicetree.org/schemas/usb/marvell,pxa-ohci.yaml#
$schema: http://devicetree.org/meta-schemas/core.yaml#

title: PXA USB controllers OHCI
maintainers:
  - Daniel Mack <zonque@gmail.com>
  - Robert Jarzmik <robert.jarzmik@free.fr>
  - Rob Herring <robh@kernel.org>
description: |
  PXA USB controllers

  OHCI

properties:
  compatible:
    items:
      - const: marvell,pxa-ohci
    description: Compatible string for the PXA OHCI USB controller.
  reg:
    maxItems: 1

  interrupts:
    maxItems: 1

  marvell,enable-port1:
    type: boolean
    description: Enables port 1 of the controller.
  marvell,enable-port2:
    type: boolean
    description: Enables port 2 of the controller.
  marvell,enable-port3:
    type: boolean
    description: Enables port 3 of the controller.
  marvell,port-mode:
    $ref: /schemas/types.yaml#/definitions/uint32
    enum: [1, 2, 3]
    description: "Selects the mode of the ports: 1=PMM_NPS_MODE, 2=PMM_GLOBAL_MODE, 3=PMM_PERPORT_MODE."
  marvell,power-sense-low:
    type: boolean
    description: Power sense pin is low-active.
  marvell,power-control-low:
    type: boolean
    description: Power control pin is low-active.
  marvell,no-oc-protection:
    type: boolean
    description: Disable over-current protection.
  marvell,oc-mode-perport:
    type: boolean
    description: Enable per-port over-current protection.
  marvell,power_on_delay:
    $ref: /schemas/types.yaml#/definitions/uint32
    description: Power On to Power Good time, in ms.

required:
  - compatible
  - reg
  - interrupts

additionalProperties: false

examples:
  - |
    usb0: ohci@4c000000 {
        compatible = "marvell,pxa-ohci";
        reg = <0x4c000000 0x100000>;
        interrupts = <18>;
        marvell,enable-port1;
        marvell,port-mode = <2>; /* PMM_GLOBAL_MODE */
    };
```
