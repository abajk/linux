## Documentation/devicetree/bindings/spi/jcore,spi2.yaml
```yaml
# SPDX-License-Identifier: (GPL-2.0-only OR BSD-2-Clause)
# Copyright 2025 Rich Felker
%YAML 1.2
---
$id: http://devicetree.org/schemas/jcore,spi2.yaml#
$schema: http://devicetree.org/meta-schemas/core.yaml#

title: J-Core SPI master

maintainers:
  - Rich Felker <dalias@libc.org>

description: |
  J-Core SPI master

  See spi-bus.txt for additional properties not specific to this device.

properties:
  compatible:
    const: jcore,spi2

  reg:
    description: Memory region for registers.

  '#address-cells':
    description: Number of address cells (must be 1).
    const: 1

  '#size-cells':
    description: Number of size cells (must be 0).
    const: 0

  spi-max-frequency:
    description: Maximum SPI clock frequency in Hz.
    $ref: /schemas/types.yaml#/definitions/uint32

  clocks:
    maxItems: 1
    description: Reference clock phandle for SPI speed programming.

  clock-names:
    items:
      - const: ref_clk

additionalProperties: false

examples:
  - |
    spi@40 {
        compatible = "jcore,spi2";
        #address-cells = <1>;
        #size-cells = <0>;
        reg = <0x40 0x8>;
        spi-max-frequency = <25000000>;
        clocks = <&bus_clk>;
        clock-names = "ref_clk";
    };
```

## Documentation/devicetree/bindings/spi/lantiq,ase-spi.yaml
```yaml
# SPDX-License-Identifier: (GPL-2.0-only OR BSD-2-Clause)
%YAML 1.2
---
$id: http://devicetree.org/schemas/spi/lantiq,ase-spi.yaml#
$schema: http://devicetree.org/meta-schemas/core.yaml#

title: Lantiq Synchronous Serial Controller (SSC) SPI master driver

maintainers:
  - Dilip Kota <eswara.kota@linux.intel.com>
  - Hauke Mehrtens <hauke@hauke-m.de>

allOf:
  - $ref: /schemas/spi/spi-controller.yaml#

properties:
  compatible:
    items:
      - enum:
          - lantiq,ase-spi
          - lantiq,falcon-spi
          - lantiq,xrx100-spi
          - intel,lgm-spi

  reg:
    maxItems: 1

  interrupts:
    description: >
      Interrupts for the SPI master. For intel,lgm-spi it is a single combined
      interrupt. For other compatibles it is three interrupts for RX, TX and errors.
    oneOf:
      - items:
          - description: Combined RX/TX/error interrupt
      - items:
          - description: RX interrupt
          - description: TX interrupt
          - description: Error interrupt

  interrupt-names:
    description: Names corresponding to each interrupt entry
    items:
      - const: spi_rx
      - const: spi_tx
      - const: spi_err

  clocks:
    description: SPI controller clocks
    oneOf:
      - items:
          - description: Primary bus clock
      - items:
          - description: Frequency clock
          - description: Gate clock

  num-cs:
    description: Number of chip selects (default is 8)
    $ref: /schemas/types.yaml#/definitions/uint32

  base-cs:
    description: First chip-select number (default is 1)
    $ref: /schemas/types.yaml#/definitions/uint32

required:
  - compatible
  - reg
  - interrupts
  - interrupt-controller

unevaluatedProperties: false

examples:
  - |
    spi@e100800 {
        compatible = "lantiq,xrx200-spi", "lantiq,xrx100-spi";
        reg = <0xE100800 0x100>;
        interrupts = <22 23 24>;
        interrupt-names = "spi_rx", "spi_tx", "spi_err";
        #address-cells = <1>;
        #size-cells = <1>;
        num-cs = <6>;
        base-cs = <1>;
    };
  - |
    spi@e0800000 {
        compatible = "intel,lgm-spi";
        reg = <0xe0800000 0x400>;
        #address-cells = <1>;
        #size-cells = <0>;
        clocks = <&cgu0 LGM_CLK_NGI>, <&cgu0 LGM_GCLK_SSC0>;
        clock-names = "freq", "gate";
    };
```

## Documentation/devicetree/bindings/spi/microchip,pic32mzda-sqi.yaml
```yaml
# SPDX-License-Identifier: (GPL-2.0-only OR BSD-2-Clause)
%YAML 1.2
---
$id: http://devicetree.org/schemas/microchip,pic32mzda-sqi.yaml#
$schema: http://devicetree.org/meta-schemas/core.yaml#

title: Microchip PIC32 Quad SPI controller

maintainers:
  - Purna Chandra Mandal <purna.mandal@microchip.com>

description: |
  Microchip PIC32 Quad SPI controller

properties:
  compatible:
    $ref: /schemas/types.yaml#/definitions/string-array
    items:
      - const: microchip,pic32mzda-sqi

  reg:
    # The core schema already checks that reg values are numbers, so device
    # specific schema don't need to do those checks.
    # The description of each element defines the order and implicitly defines
    # the number of reg entries.
    items:
      - description: SQI controller register base address
      - description: SQI controller register space length
    # minItems/maxItems equal to 2 is implied

  interrupts:
    description: Interrupt for SQI.
    items:
      - description: SQI interrupt

  clocks:
    description: Clocks used by SQI controller.
    items:
      - description: SPI bus clock
      - description: SQI controller clock

  clock-names:
    items:
      - const: spi_ck
      - const: reg_ck

required:
  - compatible
  - reg
  - interrupts
  - clocks
  - clock-names

additionalProperties: false

examples:
  - |
    sqi1: spi@1f8e2000 {
        compatible = "microchip,pic32mzda-sqi";
        reg = <0x1f8e2000 0x200>;
        clocks = <&rootclk REF2CLK>, <&rootclk PB5CLK>;
        clock-names = "spi_ck", "reg_ck";
        interrupts = <169 IRQ_TYPE_LEVEL_HIGH>;
    };
```

## Documentation/devicetree/bindings/spi/nuvoton,npcm-fiu.yaml
```yaml
# SPDX-License-Identifier: (GPL-2.0-only OR BSD-2-Clause)
# Copyright 2018 Linaro Ltd.

%YAML 1.2
---
$id: http://devicetree.org/schemas/spi/nuvoton,npcm-fiu.yaml#
$schema: http://devicetree.org/meta-schemas/core.yaml#

title: Nuvoton FLASH Interface Unit (FIU) SPI Controller

maintainers:
  - Jonathan Neuschäfer <j.neuschaefer@gmx.net>
  - Tomer Maimon <tmaimon77@gmail.com>

description: |
  Nuvoton FLASH Interface Unit (FIU) SPI Controller

  NPCM FIU supports single, dual and quad communication interface.

  The NPCM7XX supports three FIU modules,
  FIU0 and FIUx supports two chip selects,
  FIU3 support four chip select.

  The NPCM8XX supports four FIU modules,
  FIU0 and FIUx supports two chip selects,
  FIU1 and FIU3 supports four chip selects.

  Aliases:
  All the FIU controller nodes should be represented in the aliases node using
  the following format 'fiu{n}' where n is a unique number for the alias.
  In the NPCM7XX BMC:
      fiu0 represent fiu 0 controller
      fiu1 represent fiu 3 controller
      fiu2 represent fiu x controller

  In the NPCM8XX BMC:
      fiu0 represent fiu 0 controller
      fiu1 represent fiu 1 controller
      fiu2 represent fiu 3 controller
      fiu3 represent fiu x controller

properties:
  compatible:
    description: Compatible string for Nuvoton NPCM FIU SPI controllers.
    items:
      - enum:
          - nuvoton,npcm750-fiu
          - nuvoton,npcm845-fiu

  '#address-cells':
    description: Must be 1.

  '#size-cells':
    description: Must be 0.

  reg:
    description: |
      The first region contains register address and length;
      the second contains memory mapping address and length.
    items:
      - description: register region
      - description: memory mapping region

  reg-names:
    description: Names for the register regions.
    items:
      - const: control
      - const: memory

  clocks:
    description: FIU reference clock.
    items:
      - description: FIU reference clock

  pinctrl-names:
    description: A pinctrl state named "default" must be defined.
    items:
      - const: default

  pinctrl-0:
    description: Phandle referencing pin configuration of the device.
    maxItems: 1

  nuvoton,spix-mode:
    description: Enable spix-mode for an expansion bus to an ASIC or CPLD.
    type: boolean

required:
  - compatible
  - '#address-cells'
  - '#size-cells'
  - reg
  - reg-names
  - clocks

examples:
  - |
    fiu3: spi@c00000000 {
        compatible = "nuvoton,npcm750-fiu";
        #address-cells = <1>;
        #size-cells = <0>;
        reg = <0xfb000000 0x1000>, <0x80000000 0x10000000>;
        reg-names = "control", "memory";
        clocks = <&clk NPCM7XX_CLK_AHB>;
        pinctrl-names = "default";
        pinctrl-0 = <&spi3_pins>;
        flash@0 {
            ...
        };
    };

additionalProperties: false
```

## Documentation/devicetree/bindings/spi/nuvoton,npcm-pspi.yaml
```yaml
# SPDX-License-Identifier: (GPL-2.0-only OR BSD-2-Clause)
%YAML 1.2
---
$id: http://devicetree.org/schemas/spi/nuvoton,npcm-pspi.yaml#
$schema: http://devicetree.org/meta-schemas/core.yaml#

title: Nuvoton NPCM PSPI controller
maintainers:
  - Tomer Maimon <tmaimon77@gmail.com>

description: >
  Nuvoton NPCM Peripheral Serial Peripheral Interface(PSPI) controller driver

  Nuvoton NPCM7xx SOC support two PSPI channels.

allOf:
  - $ref: /schemas/spi/spi-controller.yaml#

properties:
  compatible:
    enum:
      - nuvoton,npcm750-pspi
      - nuvoton,npcm845-pspi

  reg:
    maxItems: 1

  interrupts:
    maxItems: 1

  clocks:
    maxItems: 1

  clock-names:
    items:
      - const: clk_apb5

  resets:
    maxItems: 1

  clock-frequency:
    description: Input clock frequency to PSPI block in Hz
    $ref: /schemas/types.yaml#/definitions/uint32
    default: 25000000

required:
  - compatible
  - reg
  - interrupts
  - clocks
  - clock-names
  - resets
  - cs-gpios

unevaluatedProperties: false

examples:
  - |
    spi@f0200000 {
        compatible = "nuvoton,npcm750-pspi";
        reg = <0xf0200000 0x1000>;
        interrupts = <GIC_SPI 31 IRQ_TYPE_LEVEL_HIGH>;
        clocks = <&clk NPCM7XX_CLK_APB5>;
        clock-names = "clk_apb5";
        resets = <&rstc NPCM7XX_RESET_IPSRST2 NPCM7XX_RESET_PSPI1>;
        cs-gpios = <&gpio6 11 GPIO_ACTIVE_LOW>;
    };
```

## Documentation/devicetree/bindings/spi/opencores,tiny-spi-rtlsvn2.yaml
```yaml
# SPDX-License-Identifier: (GPL-2.0-only OR BSD-2-Clause)
# Copyright 2025 Thomas Chou <thomas@wytron.com.tw>
%YAML 1.2
---
$id: http://devicetree.org/schemas/spi/opencores,tiny-spi-rtlsvn2.yaml#
$schema: http://devicetree.org/meta-schemas/core.yaml#

title: OpenCores tiny SPI

maintainers:
  - Thomas Chou <thomas@wytron.com.tw>

description: |
  OpenCores tiny SPI

  The clock-frequency and baud-width properties are needed only if the divider
  is programmable. They are not needed if the divider is fixed.

properties:
  compatible:
    const: opencores,tiny-spi-rtlsvn2

  gpios:
    description: Chip-select GPIOs
    $ref: /schemas/types.yaml#/definitions/phandle-array

  clock-frequency:
    description: Input clock frequency to the core
    $ref: /schemas/types.yaml#/definitions/uint32

  baud-width:
    description: Divider width in bits of the programmable divider used to scale the input clock to SCLK
    $ref: /schemas/types.yaml#/definitions/uint32

required:
  - compatible
  - gpios

additionalProperties: false
```

## Documentation/devicetree/bindings/spi/qca,ar7100-spi.yaml
```yaml
# SPDX-License-Identifier: (GPL-2.0-only OR BSD-2-Clause)
# Copyright 2025 Alban Bedel
%YAML 1.2
---
$id: http://devicetree.org/schemas/spi/qca,ar7100-spi.yaml#
$schema: http://devicetree.org/meta-schemas/core.yaml#

title: Qualcomm Atheros AR7xxx/AR9xxx SPI controller

maintainers:
  - Alban Bedel <albeu@free.fr>

allOf:
  - $ref: /schemas/spi/spi-controller.yaml#

properties:
  compatible:
    oneOf:
      - items:
          - pattern: '^qca,.*-spi$'
          - const: qca,ar7100-spi
      - items:
          - const: qca,ar7100-spi

  reg:
    maxItems: 1

  clocks:
    maxItems: 1

  clock-names:
    items:
      - const: ahb

unevaluatedProperties: false

examples:
  - |
    spi@1f000000 {
      compatible = "qca,ar9132-spi", "qca,ar7100-spi";
      reg = <0x1f000000 0x10>;
      clocks = <&pll 2>;
      clock-names = "ahb";
      #address-cells = <1>;
      #size-cells = <0>;
    };
```

## Documentation/devicetree/bindings/spi/spi-img-spfi.yaml
```yaml
# SPDX-License-Identifier: (GPL-2.0-only OR BSD-2-Clause)
# Copyright 2025 Imagination Technologies
%YAML 1.2
---
$id: http://devicetree.org/schemas/spi-img-spfi.yaml#
$schema: http://devicetree.org/meta-schemas/core.yaml#

title: IMG Synchronous Peripheral Flash Interface (SPFI) controller

maintainers:
  - Andrew Bresticker <abrestic@chromium.org>
  - Ezequiel Garcia <ezequiel.garcia@imgtec.com>
  - Sifan Naeem <sifan.naeem@imgtec.com>

description: |
  IMG Synchronous Peripheral Flash Interface (SPFI) controller

properties:
  compatible:
    description: Device compatible with IMG SPFI controller.
    items:
      - const: img,spfi

  reg:
    description: Base address and length of the SPFI registers.

  interrupts:
    description: SPFI interrupt.

  clocks:
    description: List of clocks required by the SPFI controller.
    items:
      - description: SPI operating clock
      - description: SPI system interface clock

  clock-names:
    description: Names of the clocks required by the SPFI controller.
    items:
      - const: spfi
      - const: sys

  dmas:
    description: List of DMA channels used by the SPFI controller.
    items:
      - description: RX DMA channel
      - description: TX DMA channel

  dma-names:
    description: Names of the DMA channels used by the SPFI controller.
    items:
      - const: rx
      - const: tx

  cs-gpios:
    description: GPIOs used for chipselect lines.

  '#address-cells':
    const: 1

  '#size-cells':
    const: 0

  img,supports-quad-mode:
    description: Indicates support for quad mode SPI transfers.
    type: boolean

  spfi-max-frequency:
    description: Maximum speed supported by the SPFI block in Hertz.
    $ref: /schemas/types.yaml#/definitions/uint32

required:
  - compatible
  - reg
  - interrupts
  - clocks
  - clock-names
  - dmas
  - dma-names
  - cs-gpios
  - '#address-cells'
  - '#size-cells'

additionalProperties: false

examples:
  - |
    spi@18100f00 {
        compatible = "img,spfi";
        reg = <0x18100f00 0x100>;
        interrupts = <GIC_SHARED 22 IRQ_TYPE_LEVEL_HIGH>;
        clocks = <&spi_clk>, <&system_clk>;
        clock-names = "spfi", "sys";
        dmas = <&mdc 9 0xffffffff 0>, <&mdc 10 0xffffffff 0>;
        dma-names = "rx", "tx";
        cs-gpios = <&gpio0 0>;
        #address-cells = <1>;
        #size-cells = <0>;
    };
```
