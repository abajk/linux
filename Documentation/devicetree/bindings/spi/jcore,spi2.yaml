## Documentation/devicetree/bindings/spi/ti,dm6441-spi.yaml
```yaml
# SPDX-License-Identifier: (GPL-2.0-only OR BSD-2-Clause)
# Copyright 2018 Linaro Ltd.
%YAML 1.2
---
$id: http://devicetree.org/schemas/spi/ti,dm6441-spi.yaml#
$schema: http://devicetree.org/meta-schemas/core.yaml#

title: Davinci SPI controller

maintainers:
  - Alexander A. Klimov <grandmaster@al2klimov.de>
  - Franklin Cooper <fcooper@ti.com>
  - Krzysztof Kozlowski <krzysztof.kozlowski@linaro.org>
  - Masanari Iida <standby24x7@gmail.com>
  - Mauro Carvalho Chehab <mchehab+huawei@kernel.org>
  - Murali Karicheri <m-karicheri2@ti.com>

allOf:
  - $ref: /schemas/spi/spi-controller.yaml#

description: |
  Davinci SPI controller device bindings

  Links on DM:
  Keystone 2 - https://www.ti.com/lit/ug/sprugp2a/sprugp2a.pdf
  dm644x - https://www.ti.com/lit/ug/sprue32a/sprue32a.pdf
  OMAP-L138/da830 - http://www.ti.com/lit/ug/spruh77a/spruh77a.pdf

  Below is timing diagram which shows functional meaning of
  "ti,spi-wdelay" parameter.

             +-+ +-+ +-+ +-+ +-+                           +-+ +-+ +-+
  SPI_CLK      | | | | | | | | | |                           | | | | | |
    +----------+ +-+ +-+ +-+ +-+ +---------------------------+ +-+ +-+ +-

  SPI_SOMI/SIMO+-----------------+                           +-----------
    +----------+ word1           +---------------------------+word2
               +-----------------+                           +-----------
                                            WDELAY
                                  <-------------------------->

allOf:
  - $ref: /schemas/spi/spi-controller.yaml#

properties:
  compatible:
    items:
      - enum:
          - ti,dm6441-spi
          - ti,da830-spi
          - ti,keystone-spi

  reg:
    maxItems: 1

  num-cs:
    description: Number of chip selects, including internal and GPIO chip selects.
    $ref: /schemas/types.yaml#/definitions/uint32

  interrupts:
    maxItems: 1

  clocks:
    maxItems: 1

  power-domains:
    maxItems: 1

  ti,davinci-spi-intr-line:
    description: Interrupt line used to connect the SPI IP to the interrupt controller.
    $ref: /schemas/types.yaml#/definitions/uint32
    enum: [0, 1]

  ti,spi-wdelay:
    description: Delay between transmission of words, specified in number of SPI module clock periods.
    $ref: /schemas/types.yaml#/definitions/uint32

required:
  - compatible
  - reg
  - interrupts

unevaluatedProperties: false

examples:
  - |
    spi@20bf0000 {
      #address-cells = <1>;
      #size-cells = <0>;
      compatible = "ti,dm6441-spi";
      reg = <0x20BF0000 0x1000>;
      num-cs = <4>;
      ti,davinci-spi-intr-line = <0>;
      interrupts = <338>;
      clocks = <&clkspi>;
    };
```

## Documentation/devicetree/bindings/thermal/amazon,al-thermal.yaml
```yaml
# SPDX-License-Identifier: (GPL-2.0-only OR BSD-2-Clause)
# Copyright 2025 Amazon.com
%YAML 1.2
---
$id: http://devicetree.org/schemas/thermal/amazon,al-thermal.yaml#
$schema: http://devicetree.org/meta-schemas/core.yaml#

title: Amazon Annapurna Labs Thermal Sensor
maintainers:
  - Amit Kucheria <amit.kucheria@linaro.org>
  - Talel Shenhar <talel@amazon.com>

description: |
  Amazon's Annapurna Labs Thermal Sensor

  Simple thermal device that allows temperature reading by a single MMIO
  transaction.

properties:
  compatible:
    items:
      - const: amazon,al-thermal

  reg:
    description: The physical base address and length of the sensor's registers
    items:
      - description: register base address (64-bit)
      - description: register length (64-bit)

  '#thermal-sensor-cells':
    description: Must be 1 for this thermal sensor
    const: 1

additionalProperties: false

examples:
  - |
    thermal: thermal {
        compatible = "amazon,al-thermal";
        reg = <0x0 0x05002860 0x0 0x1>;
        #thermal-sensor-cells = <0x1>;
    };

    thermal-zones {
        thermal-z0 {
            polling-delay-passive = <250>;
            polling-delay = <1000>;
            thermal-sensors = <&thermal 0>;
            trips {
                critical {
                    temperature = <105000>;
                    hysteresis = <2000>;
                    type = "critical";
                };
            };

        };
    };
```

## Documentation/devicetree/bindings/thermal/armada-thermal.yaml
```yaml
# SPDX-License-Identifier: (GPL-2.0-only OR BSD-2-Clause)
# Copyright 2025 Marvell Electronics
%YAML 1.2
---
$id: http://devicetree.org/schemas/thermal/armada-thermal.yaml#
$schema: http://devicetree.org/meta-schemas/core.yaml#

title: Marvell Armada thermal management

maintainers:
  - Alex Leibovich <alexl@marvell.com>
  - Baruch Siach <baruch@tkos.co.il>
  - Ezequiel Garcia <ezequiel.garcia@free-electrons.com>
  - Mauro Carvalho Chehab <mchehab+huawei@kernel.org>
  - Miquel Raynal <miquel.raynal@bootlin.com>
  - Rob Herring <robh@kernel.org>

description: |
  Marvell Armada 370/375/380/XP thermal management

  Note: these bindings are deprecated for AP806/CP110 and should instead follow the rules described in:
    Documentation/devicetree/bindings/arm/marvell/ap80x-system-controller.txt
    Documentation/devicetree/bindings/arm/marvell/cp110-system-controller.txt

properties:
  compatible:
    oneOf:
      - enum:
          - marvell,armada370-thermal
          - marvell,armada375-thermal
          - marvell,armada380-thermal
          - marvell,armadaxp-thermal
          - marvell,armada-ap806-thermal
          - marvell,armada-ap807-thermal
          - marvell,armada-cp110-thermal
  reg:
    items:
      - description: status register (4B)
      - description: control register (4B or 8B)

required:
  - compatible
  - reg

additionalProperties: false

examples:
  - |
    thermal@d0018300 {
        compatible = "marvell,armada370-thermal";
        reg = <0xd0018300 0x4
               0xd0018304 0x4>;
    };
  - |
    ap_thermal: thermal@6f8084 {
        compatible = "marvell,armada-ap806-thermal";
        reg = <0x6f808C 0x4>,
              <0x6f8084 0x8>;
    };
```

## Documentation/devicetree/bindings/thermal/brcm,sr-thermal.yaml
```yaml
# SPDX-License-Identifier: (GPL-2.0-only OR BSD-2-Clause)
# Copyright 2025 Broadcom
%YAML 1.2
---
$id: http://devicetree.org/schemas/brcm,sr-thermal.yaml#
$schema: http://devicetree.org/meta-schemas/core.yaml#

title: Broadcom Stingray Thermal
maintainers:
  - Pramod Kumar <pramod.kumar@broadcom.com>

description: |
  Broadcom Stingray Thermal.

  This binding describes thermal sensors that are part of Stingray SoCs.

properties:
  compatible:
    items:
      - const: brcm,sr-thermal

  reg:
    description: Memory where tmon data will be available.
    items:
      - description: register address
      - description: size in bytes

  brcm,tmon-mask:
    description: A one-cell bit mask of valid TMON sources. Each bit represents a single TMON source.
    items:
      - description: TMON source mask

  '#thermal-sensor-cells':
    description: Thermal sensor phandler count.
    const: 1

  polling-delay:
    description: Max number of milliseconds to wait between polls.

  thermal-sensors:
    description: >
      A list of thermal sensor phandles and specifiers. The specifier value is the
      TMON ID and it must correspond with brcm,tmon-mask.
    items:
      - description: Thermal sensor phandle
      - description: TMON channel ID

  temperature:
    description: Trip temperature threshold in millidegree celsius.
    items:
      - description: temperature in millidegree celsius

required:
  - compatible
  - reg
  - brcm,tmon-mask
  - '#thermal-sensor-cells'
  - polling-delay
  - thermal-sensors
  - temperature

additionalProperties: false

examples:
  - |
    tmons {
      compatible = "simple-bus";
      #address-cells = <1>;
      #size-cells = <1>;
      ranges = <0x0 0x0 0x8f100000 0x100>;

      tmon: tmon@0 {
        compatible = "brcm,sr-thermal";
        reg = <0x0 0x40>;
        brcm,tmon-mask = <0x3f>;
        #thermal-sensor-cells = <1>;
      };
    };

    thermal-zones {
      ihost0_thermal: ihost0-thermal {
        polling-delay-passive = <0>;
        polling-delay = <1000>;
        thermal-sensors = <&tmon 0>;
        trips {
          cpu-crit {
            temperature = <105000>;
            hysteresis = <0>;
            type = "critical";
          };
        };
      };
      ihost1_thermal: ihost1-thermal {
        polling-delay-passive = <0>;
        polling-delay = <1000>;
        thermal-sensors = <&tmon 1>;
        trips {
          cpu-crit {
            temperature = <105000>;
            hysteresis = <0>;
            type = "critical";
          };
        };
      };
      ihost2_thermal: ihost2-thermal {
        polling-delay-passive = <0>;
        polling-delay = <1000>;
        thermal-sensors = <&tmon 2>;
        trips {
          cpu-crit {
            temperature = <105000>;
            hysteresis = <0>;
            type = "critical";
          };
        };
      };
      ihost3_thermal: ihost3-thermal {
        polling-delay-passive = <0>;
        polling-delay = <1000>;
        thermal-sensors = <&tmon 3>;
        trips {
          cpu-crit {
            temperature = <105000>;
            hysteresis = <0>;
            type = "critical";
          };
        };
      };
      crmu_thermal: crmu-thermal {
        polling-delay-passive = <0>;
        polling-delay = <1000>;
        thermal-sensors = <&tmon 4>;
        trips {
          cpu-crit {
            temperature = <105000>;
            hysteresis = <0>;
            type = "critical";
          };
        };
      };
      nitro_thermal: nitro-thermal {
        polling-delay-passive = <0>;
        polling-delay = <1000>;
        thermal-sensors = <&tmon 5>;
        trips {
          cpu-crit {
            temperature = <105000>;
            hysteresis = <0>;
            type = "critical";
          };
        };
      };
    };
```

## Documentation/devicetree/bindings/thermal/marvell,dove-thermal.yaml
```yaml
# SPDX-License-Identifier: (GPL-2.0-only OR BSD-2-Clause)
# Copyright 2025 Andrew Lunn <andrew@lunn.ch>
%YAML 1.2
---
$id: http://devicetree.org/schemas/marvell,dove-thermal.yaml#
$schema: http://devicetree.org/meta-schemas/core.yaml#

title: Marvell Dove Thermal

maintainers:
  - Andrew Lunn <andrew@lunn.ch>

description: |
  This driver is for Dove SoCs which contain a thermal sensor.

  Required properties:
    - compatible: "marvell,dove-thermal"
    - reg: Address range of the thermal registers

properties:
  compatible:
    const: "marvell,dove-thermal"

  reg:
    description: Address range of the thermal registers
    items:
      - description: Thermal Manager registers
      - description: Thermal Diode Control Registers

required:
  - compatible
  - reg

additionalProperties: false

examples:
  - |
    thermal@10078 {
        compatible = "marvell,dove-thermal";
        reg = <0xd001c 0x0c>, <0xd005c 0x08>;
    };
```

## Documentation/devicetree/bindings/thermal/marvell,kirkwood-thermal.yaml
```yaml
# SPDX-License-Identifier: (GPL-2.0-only OR BSD-2-Clause)
# Copyright 2025 Nobuhiro Iwamatsu <iwamatsu@nigauri.org>
%YAML 1.2
---
$id: http://devicetree.org/schemas/marvell,kirkwood-thermal.yaml#
$schema: http://devicetree.org/meta-schemas/core.yaml#

title: marvell,kirkwood-thermal

maintainers:
  - Nobuhiro Iwamatsu <iwamatsu@nigauri.org>

description: |
  Kirkwood Thermal

  This version is for Kirkwood 88F8262 & 88F6283 SoCs. Other kirkwoods
  don't contain a thermal sensor.

properties:
  compatible:
    description: Binding string for the Kirkwood thermal sensor.
    items:
      - const: marvell,kirkwood-thermal

  reg:
    description: Address range of the thermal registers.
    items:
      - description: Base address of the thermal registers.
      - description: Size of the thermal registers.

required:
  - compatible
  - reg

additionalProperties: false

examples:
  - |
    thermal@10078 {
        compatible = "marvell,kirkwood-thermal";
        reg = <0x10078 0x4>;
    };
```

## Documentation/devicetree/bindings/thermal/maxim,max77620.yaml
```yaml
# SPDX-License-Identifier: (GPL-2.0-only OR BSD-2-Clause)
# Copyright 2025 Amit Kucheria <amit.kucheria@linaro.org>
# Copyright 2025 Laxman Dewangan <ldewangan@nvidia.com>
%YAML 1.2
---
$id: http://devicetree.org/schemas/thermal/maxim,max77620.yaml#
$schema: http://devicetree.org/meta-schemas/core.yaml#

title: MAX77620 Thermal Sensor
maintainers:
  - Amit Kucheria <amit.kucheria@linaro.org>
  - Laxman Dewangan <ldewangan@nvidia.com>
description: |
  Thermal driver for MAX77620 Power management IC from Maxim Semiconductor.

  Maxim Semiconductor MAX77620 supports alarm interrupts when its
  die temperature crosses 120C and 140C. These threshold temperatures
  are not configurable. Device does not provide the real temperature
  of die other than just indicating whether temperature is above or
  below threshold level.

  For more details, please refer generic thermal DT binding document
  <devicetree/bindings/thermal/thermal*.yaml>.

  Please refer <devicetree/bindings/mfd/max77620.txt> for mfd DT binding
  document for the MAX77620.

properties:
  compatible:
    const: maxim,max77620

  reg:
    items:
      - description: address of the device on the I2C bus
    description: I2C bus address of the device

  '#thermal-sensor-cells':
    const: 0
    description: number of thermal-sensor cells; must be zero

  interrupts:
    items:
      - description: alarm interrupt
    description: interrupt triggered on temperature threshold crossing

  interrupt-names:
    items:
      - const: alarm
    description: name of the alarm interrupt

required:
  - compatible
  - reg
  - '#thermal-sensor-cells'
  - interrupts

additionalProperties: false

examples:
  - |
    max77620@3c {
        compatible = "maxim,max77620";
        reg = <0x3c>;
        #thermal-sensor-cells = <0>;
        interrupts = <&intc 5 0>;
        interrupt-names = "alarm";
    };
```
