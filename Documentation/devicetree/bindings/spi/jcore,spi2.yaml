## Documentation/devicetree/bindings/thermal/stericsson,db8500-thermal.yaml
```yaml
# SPDX-License-Identifier: (GPL-2.0-only OR BSD-2-Clause)
# Copyright 2025 Linaro Ltd.
%YAML 1.2
---
$id: http://devicetree.org/schemas/stericsson,db8500-thermal.yaml#
$schema: http://devicetree.org/meta-schemas/core.yaml#

title: ST-Ericsson DB8500 Thermal

maintainers:
  - hongbo.zhang <hongbo.zhang@linaro.com>

description: |
  ST-Ericsson DB8500 Thermal

  Usually the num-trips and tripN-*** are separated in board related dts files.

properties:
  compatible:
    items:
      - const: stericsson,db8500-thermal

  reg:
    description: Registers address range of the thermal sensor
    items:
      - description: Address and size of the thermal sensor registers

  interrupts:
    description: Interrupts generated from PRCMU
    minItems: 1
    items:
      description: Interrupt specifier

  interrupt-names:
    description: Names for the interrupts
    items:
      - const: IRQ_HOTMON_LOW
      - const: IRQ_HOTMON_HIGH

  num-trips:
    description: Number of total trip points, set to 0 if none
    $ref: /schemas/types.yaml#/definitions/uint32

patternProperties:
  ^trip[0-9]+-temp$:
    description: Temperature of trip point N, in millidegree Celsius
    $ref: /schemas/types.yaml#/definitions/int32

  ^trip[0-9]+-type$:
    description: Type of trip point N
    enum:
      - active
      - passive
      - hot
      - critical

  ^trip[0-9]+-cdev-num$:
    description: Number of cooling devices bound to trip point N
    $ref: /schemas/types.yaml#/definitions/uint32

  ^trip[0-9]+-cdev-name[0-9]+$:
    description: Name of the cooling device M for trip point N
    $ref: /schemas/types.yaml#/definitions/string

required:
  - compatible
  - reg
  - interrupts
  - interrupt-names
  - num-trips

additionalProperties: false

examples:
  - |
    thermal@801573c0 {
        compatible = "stericsson,db8500-thermal";
        reg = <0x801573c0 0x40>;
        interrupts = <21 0x4>, <22 0x4>;
        interrupt-names = "IRQ_HOTMON_LOW", "IRQ_HOTMON_HIGH";
        num-trips = <3>;
        trip0-temp = <75000>;
        trip0-type = "active";
        trip0-cdev-num = <1>;
        trip0-cdev-name0 = "thermal-cpufreq-0";
        trip1-temp = <80000>;
        trip1-type = "active";
        trip1-cdev-num = <2>;
        trip1-cdev-name0 = "thermal-cpufreq-0";
        trip1-cdev-name1 = "thermal-fan";
        trip2-temp = <85000>;
        trip2-type = "critical";
        trip2-cdev-num = <0>;
    };
```

## Documentation/devicetree/bindings/thermal/ti,omap34xx-bandgap.yaml
```yaml
# SPDX-License-Identifier: (GPL-2.0-only OR BSD-2-Clause)
# Copyright 2025 Texas Instruments
%YAML 1.2
---
$id: http://devicetree.org/schemas/thermal/ti,omap34xx-bandgap.yaml#
$schema: http://devicetree.org/meta-schemas/core.yaml#

title: TI OMAP SCM Bandgap

maintainers:
  - Eduardo Valentin <eduardo.valentin@ti.com>
  - Eduardo Valentin <edubezval@gmail.com>
  - Pavel Machek <pavel@ucw.cz>

description: |
  * Texas Instrument OMAP SCM bandgap bindings

  In the System Control Module, OMAP supplies a voltage reference
  and a temperature sensor feature that are gathered in the band
  gap voltage and temperature sensor (VBGAPTS) module. The band
  gap provides current and voltage reference for its internal
  circuits and other analog IP blocks. The analog-to-digital
  converter (ADC) produces an output value that is proportional
  to the silicon temperature.

properties:
  compatible:
    description: Must be one of the supported TI bandgap compatibles.
    $ref: /schemas/types.yaml#/definitions/string-array
    items:
      - enum:
          - ti,omap34xx-bandgap
          - ti,omap36xx-bandgap
          - ti,omap4430-bandgap
          - ti,omap4460-bandgap
          - ti,omap4470-bandgap
          - ti,omap5430-bandgap
          - ti,dra752-bandgap

  reg:
    description: Register address and size pairs for the bandgap module; mapping varies per SoC.
    items:
      description: Address and size in cells for each register entry.

  interrupts:
    description: Interrupt specifier for the talert signal.
    items:
      - description: Talert interrupt specifier

  gpios:
    description: GPIO specifier for the tshut signal, treated as an IRQ.
    maxItems: 1

required:
  - compatible
  - reg
  - interrupts

additionalProperties: false

examples:
  - |
    bandgap {
        compatible = "ti,omap4460-bandgap";
        reg = <0x4a002260 0x4
               0x4a00232C 0x4
               0x4a002378 0x18>;
        interrupts = <0 126 4>;
        gpios = <&gpio3 22 0>;
    };
```

## Documentation/devicetree/bindings/unittest.txt
```
# SPDX-License-Identifier: (GPL-2.0-only OR BSD-2-Clause)
%YAML 1.2
---
$id: http://devicetree.org/schemas/unittest.yaml#
$schema: http://devicetree.org/meta-schemas/core.yaml#

title: Unit Test
maintainers:
  - Test Maintainer <test-maintainer@example.com>

description: |
  A minimal schema just for unit‐testing.  

properties: {}
additionalProperties: false
```

## Documentation/devicetree/bindings/unittest.yaml
```yaml
# SPDX-License-Identifier: (GPL-2.0-only OR BSD-2-Clause)
# Copyright 2025 Pantelis Antoniou <pantelis.antoniou@konsulko.com>,
# Rob Herring <robh@kernel.org>, Wang Long <long.wanglong@huawei.com>
%YAML 1.2
---
$id: http://devicetree.org/schemas/unittest.yaml#
$schema: http://devicetree.org/meta-schemas/core.yaml#

title: Unit Test Devices

maintainers:
  - Pantelis Antoniou <pantelis.antoniou@konsulko.com>
  - Rob Herring <robh@kernel.org>
  - Wang Long <long.wanglong@huawei.com>

description: |
  1) OF unittest platform device

  ** unittest

  2) OF unittest i2c adapter platform device

  ** platform device unittest adapter

  3) OF unittest i2c device

  ** I2C unittest device

  4) OF unittest i2c mux device

  ** I2C unittest mux

properties:
  compatible:
    oneOf:
      - items:
          - const: unittest
      - items:
          - const: unittest-i2c-bus
      - items:
          - const: unittest-i2c-dev
      - items:
          - const: unittest-i2c-mux

  reg:
    description: List of register ranges

  '#address-cells':
    description: Number of address cells for child nodes
    const: 1

  '#size-cells':
    description: Number of size cells for child nodes
    const: 0

required:
  - compatible

additionalProperties: true

examples:
  - |
    unittest {
      compatible = "unittest";
    };
  - |
    unittest-i2c-bus {
      compatible = "unittest-i2c-bus";
    };
  - |
    unittest-i2c-dev {
      compatible = "unittest-i2c-dev";
    };
  - |
    unittest-i2c-mux {
      compatible = "unittest-i2c-mux";
      #address-cells = <1>;
      #size-cells = <0>;
      channel-0 {
        reg = <0>;
        #address-cells = <1>;
        #size-cells = <0>;
        i2c-dev {
          reg = <8>;
          compatible = "unittest-i2c-dev";
        };
      };
    };
```

## Documentation/devicetree/bindings/usb/atmel-usb.yaml
```yaml
# SPDX-License-Identifier: (GPL-2.0-only OR BSD-2-Clause)
%YAML 1.2
---
$id: http://devicetree.org/schemas/usb/atmel-usb.yaml#
$schema: http://devicetree.org/meta-schemas/core.yaml#

title: Atmel SOC USB controllers

maintainers:
  - Alexandre Belloni <alexandre.belloni@bootlin.com>
  - Boris Brezillon <bbrezillon@kernel.org>
  - Cristian Birsan <cristian.birsan@microchip.com>
  - Gregory CLEMENT <gregory.clement@bootlin.com>
  - Herve Codina <herve.codina@bootlin.com>
  - Jean-Christophe PLAGNIOL-VILLARD <plagnioj@jcrosoft.com>
  - Marco Franchi <marco.franchi@nxp.com>
  - Nicolas Ferre <nicolas.ferre@microchip.com>
  - Peter Rosin <peda@axentia.se>

description: |
  Atmel SOC USB controllers

  OHCI

  EHCI

  AT91 USB device controller

  Atmel High-Speed USB device controller

properties:
  compatible:
    description: >
      Compatible strings for Atmel SOC USB controllers.
    oneOf:
      - items:
          - const: atmel,at91rm9200-ohci
          - const: usb-ohci
      - items:
          - const: atmel,at91sam9g45-ehci
          - const: usb-ehci
      - items:
          - enum:
              - atmel,at91rm9200-udc
              - atmel,at91sam9260-udc
              - atmel,at91sam9261-udc
              - atmel,at91sam9263-udc
      - items:
          - enum:
              - atmel,at91sam9rl-udc
              - atmel,at91sam9g45-udc
              - atmel,sama5d3-udc
              - microchip,sam9x60-udc
              - microchip,lan9662-udc

  reg:
    items:
      - description: Address and size of the controller’s register window
    description: >
      Register address and length pairs.

  interrupts:
    items:
      - description: Interrupt specifier (<IRQ> <trigger> [<flags>])
    description: >
      Interrupt specifier(s) for the controller.

  clocks:
    description: >
      Phandle list of required clocks (peripheral, PHY/host, system/AHB).

  clock-names:
    items:
      - const: peripheral
      - const: utmi
      - const: hclk
    description: >
      Names for the clocks: peripheral, PHY/host, system/AHB.

  num-ports:
    $ref: /schemas/types.yaml#/definitions/uint32
    description: Number of USB ports supported.

  phy_type:
    description: >
      PHY type for multi-port EHCI controllers: “utmi” or “hsic”.
    enum:
      - utmi
      - hsic

  atmel,vbus-gpio:
    description: GPIO to enable VBUS power.

  atmel,oc-gpio:
    description: GPIO to enable over-current detection.

required:
  - compatible
  - reg
  - interrupts
  - clocks
  - clock-names

additionalProperties: false

examples:
  - |
    usb0: ohci@500000 {
        compatible = "atmel,at91rm9200-ohci", "usb-ohci";
        reg = <0x00500000 0x100000>;
        clocks = <&uhphs_clk>, <&uhphs_clk>, <&uhpck>;
        clock-names = "ohci_clk", "hclk", "uhpck";
        interrupts = <20 4>;
        num-ports = <2>;
        atmel,vbus-gpio = <&pioA 3 0>;
        atmel,oc-gpio = <&pioA 4 0>;
    };
  - |
    usb1: ehci@800000 {
        compatible = "atmel,at91sam9g45-ehci", "usb-ehci";
        reg = <0x00800000 0x100000>;
        clocks = <&utmi>, <&uhphs_clk>;
        clock-names = "usb_clk", "ehci_clk";
        interrupts = <22 4>;
        phy_type = "utmi";
    };
  - |
    usb1: gadget@fffa4000 {
        compatible = "atmel,at91rm9200-udc";
        reg = <0xfffa4000 0x4000>;
        clocks = <&udc_clk>, <&udpck>;
        clock-names = "pclk", "hclk";
        interrupts = <10 4>;
        atmel,vbus-gpio = <&pioC 5 0>;
    };
  - |
    usb2: gadget@fff78000 {
        compatible = "atmel,at91sam9rl-udc";
        reg = <0x00600000 0x80000
               0xfff78000 0x400>;
        clocks = <&utmi>, <&udphs_clk>;
        clock-names = "hclk", "pclk";
        interrupts = <27 4 0>;
        atmel,vbus-gpio = <&pioB 19 0>;
    };
```

## Documentation/devicetree/bindings/usb/brcm,iproc-udc.yaml
```yaml
# SPDX-License-Identifier: (GPL-2.0-only OR BSD-2-Clause)
# Copyright 2025 Broadcom Corporation
%YAML 1.2
---
$id: http://devicetree.org/schemas/usb/brcm,iproc-udc.yaml#
$schema: http://devicetree.org/meta-schemas/core.yaml#

title: Broadcom IProc USB Device Controller

maintainers:
  - Raviteja Garimella <raviteja.garimella@broadcom.com>

description: |
  Broadcom IPROC USB Device controller.

  The device node is used for UDCs integrated into Broadcom's
  iProc family (Northstar2, Cygnus) of SoCs'. The UDC is based
  on Synopsys Designware Cores AHB Subsystem Device Controller IP.

properties:
  compatible:
    # Must be one of the supported USB device controller compatible strings.
    oneOf:
      - items:
          - enum:
              - brcm,ns2-udc
          - const: brcm,iproc-udc
      - items:
          - enum:
              - brcm,cygnus-udc
          - const: brcm,iproc-udc

  reg:
    description: UDC register base address and size
    items:
      - description: UDC register base address
      - description: UDC register size

  interrupts:
    # Interrupt specifier: phandle to interrupt controller, interrupt number, and flags
    items:
      - description: "Interrupt specifier: phandle to interrupt controller, interrupt number, and flags"

  phys:
    maxItems: 1
    description: Phandle to USB PHY

required:
  - compatible
  - reg
  - interrupts
  - phys

additionalProperties: false

examples:
  - |
    udc_dwc: usb@664e0000 {
        compatible = "brcm,ns2-udc", "brcm,iproc-udc";
        reg = <0x664e0000 0x2000>;
        interrupts = <GIC_SPI 424 IRQ_TYPE_LEVEL_HIGH>;
        phys = <&usbdrd_phy>;
    };
```

## Documentation/devicetree/bindings/usb/cavium,octeon-5750-usbn.yaml
```yaml
# SPDX-License-Identifier: (GPL-2.0-only OR BSD-2-Clause)
# Copyright 2025 Aaro Koskinen <aaro.koskinen@iki.fi>
%YAML 1.2
---
$id: http://devicetree.org/schemas/cavium,octeon-5750-usbn.yaml#
$schema: http://devicetree.org/meta-schemas/core.yaml#

title: Cavium OCTEON-5750 USB Main Block
maintainers:
  - Aaro Koskinen <aaro.koskinen@iki.fi>
description: |
  OCTEON/OCTEON+ USB block. This binding describes a USB block with main node
  and its child controller node. The main node compatible must be
  "cavium,octeon-5750-usbn" and the child node compatible must be
  "cavium,octeon-5750-usbc". The main node properties include the physical
  base address, memory mapping, translation settings, reference clock, and
  clock frequency. The child node describes the built-in USB controller with
  its own address, length, and interrupts.

properties:
  compatible:
    items:
      - enum: ["cavium,octeon-5750-usbn"]
  reg:
    description: Physical base address and length of the memory mapped region
    items:
      - description: Address (high 32 bits)
      - description: Address (low 32 bits)
      - description: Size (high 32 bits)
      - description: Size (low 32 bits)
  "#address-cells":
    const: 2
  "#size-cells":
    const: 2
  ranges:
    description: Translation between child and parent address space
  clock-frequency:
    description: Speed of the USB reference clock in Hz
    enum: [12000000, 24000000, 48000000]
  cavium,refclk-type:
    description: Type of the USB reference clock
    enum: [crystal, external]
  refclk-frequency:
    description: Deprecated, use "clock-frequency"
    $ref: /schemas/types.yaml#/definitions/uint32
    deprecated: true
  refclk-type:
    description: Deprecated, use "cavium,refclk-type"
    enum: [crystal, external]
    deprecated: true

patternProperties:
  "^usbc@.*$":
    description: Built-in USB controller node
    type: object
    additionalProperties: false
    properties:
      compatible:
        items:
          - enum: ["cavium,octeon-5750-usbc"]
      reg:
        description: Physical base address and length of the USBC block
        items:
          - description: Address (high 32 bits)
          - description: Address (low 32 bits)
          - description: Size (high 32 bits)
          - description: Size (low 32 bits)
      interrupts:
        description: Interrupt controller specifier and interrupt number for the USB controller
        items:
          - description: Interrupt controller specifier cells
          - description: Interrupt number
    required:
      - compatible
      - reg
      - interrupts

required:
  - compatible
  - reg
  - "#address-cells"
  - "#size-cells"
  - ranges
  - clock-frequency
  - cavium,refclk-type

additionalProperties: false

examples:
  - |
    usbn: usbn@1180068000000 {
        compatible = "cavium,octeon-5750-usbn";
        reg = <0x11800 0x68000000 0x0 0x1000>;
        ranges; /* Direct mapping */
        #address-cells = <2>;
        #size-cells = <2>;
        clock-frequency = <12000000>;
        cavium,refclk-type = "crystal";

        usbc@16f0010000000 {
            compatible = "cavium,octeon-5750-usbc";
            reg = <0x16f00 0x10000000 0x0 0x80000>;
            interrupts = <0 56>;
        };
    };
```
