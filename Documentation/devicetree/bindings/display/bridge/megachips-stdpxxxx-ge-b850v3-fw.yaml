## Documentation/devicetree/bindings/display/ti/ti,omap2-dss.yaml
```yaml
# SPDX-License-Identifier: (GPL-2.0-only OR BSD-2-Clause)
%YAML 1.2
---
$id: http://devicetree.org/schemas/display/ti/ti,omap2-dss.yaml#
$schema: http://devicetree.org/meta-schemas/core.yaml#

title: TI OMAP2 Display Subsystem
maintainers:
  - Peter Ujfalusi <peter.ujfalusi@ti.com>
  - Rob Herring <robh@kernel.org>

description: |
  Texas Instruments OMAP2 Display Subsystem

  See Documentation/devicetree/bindings/display/ti/ti,omap-dss.txt for generic
  description about OMAP Display Subsystem bindings.

properties:
  compatible:
    description: Must be "ti,omap2-dss" for this binding.
    const: ti,omap2-dss

  reg:
    description: Register region for the DSS core.
    items:
      - description: DSS core registers

  ti,hwmods:
    description: Hardware modules used by DSS core.
    items:
      - const: dss_core

  port:
    description: Video port for DPI output.
    type: object
    properties:
      data-lines:
        description: Number of data lines used for DPI output.
        $ref: /schemas/types.yaml#/definitions/uint32
    required:
      - data-lines
    additionalProperties: false

  dispc:
    description: Display controller node.
    type: object
    properties:
      compatible:
        const: ti,omap2-dispc
      reg:
        description: Register region for DISPC.
        items:
          - description: DISPC registers
      ti,hwmods:
        items:
          - const: dss_dispc
      interrupts:
        description: DISPC interrupt.
        items:
          - description: DISPC interrupt
      max-memory-bandwidth:
        description: Input memory bandwidth limit in bytes per second.
        $ref: /schemas/types.yaml#/definitions/uint64
    required:
      - compatible
      - reg
      - ti,hwmods
    additionalProperties: false

  rfbi:
    description: Raster frame buffer interface node.
    type: object
    properties:
      compatible:
        const: ti,omap2-rfbi
      reg:
        description: Register region for RFBI.
        items:
          - description: RFBI registers
      ti,hwmods:
        items:
          - const: dss_rfbi
    required:
      - compatible
      - reg
      - ti,hwmods
    additionalProperties: false

  venc:
    description: Video encoder node.
    type: object
    properties:
      compatible:
        const: ti,omap2-venc
      reg:
        description: Register region for VENC.
        items:
          - description: VENC registers
      ti,hwmods:
        items:
          - const: dss_venc
      vdda-supply:
        description: Power supply for DAC.
      venc-endpoint:
        description: Endpoint for video output.
        type: object
        properties:
          ti,invert-polarity:
            description: Invert the polarity of the video signal.
            type: boolean
          ti,channels:
            description: Number of video channels (1 for composite, 2 for s-video).
            $ref: /schemas/types.yaml#/definitions/uint32
            enum:
              - 1
              - 2
        required:
          - ti,invert-polarity
          - ti,channels
        additionalProperties: false
    required:
      - compatible
      - reg
      - ti,hwmods
    additionalProperties: false

required:
  - compatible
  - reg
  - ti,hwmods

additionalProperties: false

examples:
  - |
    dss@4a000000 {
      compatible = "ti,omap2-dss";
      reg = <0x4a000000 0x1000>;
      ti,hwmods = "dss_core";
      port@0 {
        data-lines = <24>;
      };
      dispc@4a100000 {
        compatible = "ti,omap2-dispc";
        reg = <0x4a100000 0x1000>;
        ti,hwmods = "dss_dispc";
        interrupts = <79>;
        max-memory-bandwidth = <300000000>;
      };
      rfbi@4a200000 {
        compatible = "ti,omap2-rfbi";
        reg = <0x4a200000 0x1000>;
        ti,hwmods = "dss_rfbi";
      };
      venc@4a300000 {
        compatible = "ti,omap2-venc";
        reg = <0x4a300000 0x1000>;
        ti,hwmods = "dss_venc";
        vdda-supply = <&vdd_dac>;
        venc-endpoint {
          ti,invert-polarity;
          ti,channels = <2>;
        };
      };
    };
```

## Documentation/devicetree/bindings/display/ti/ti,omap3-dss.yaml
```yaml
%YAML 1.2
---
$id: http://devicetree.org/schemas/display/ti/ti,omap3-dss.yaml#
$schema: http://devicetree.org/meta-schemas/core.yaml#

title: Texas Instruments OMAP3 Display Subsystem

maintainers:
  - Peter Ujfalusi <peter.ujfalusi@ti.com>
  - Rob Herring <robh@kernel.org>

description: |
  Texas Instruments OMAP3 Display Subsystem

  See Documentation/devicetree/bindings/display/ti/ti,omap-dss.txt for generic
  description about OMAP Display Subsystem bindings.


definitions:
  dispc:
    description: DISPC – display controller sub-module
    type: object
    properties:
      compatible:
        items:
          - const: ti,omap3-dispc
      reg:
        description: Address and length of DISPC register space.
        items:
          - description: Base address of DISPC register space
          - description: Length of DISPC register space
      ti,hwmods:
        description: Hardware module identifier for DISPC.
        items:
          - const: dss_dispc
      interrupts:
        description: DISPC interrupt.
        minItems: 1
        items:
          - description: DISPC interrupt line
      clocks:
        description: Functional clock for DISPC.
        maxItems: 1
      clock-names:
        description: Name for the DISPC clock.
        items:
          - const: fck
      max-memory-bandwidth:
        description: Input memory (from main memory to DISPC) bandwidth limit in bytes per second
        $ref: /schemas/types.yaml#/definitions/uint64
    required:
      - compatible
      - reg
      - ti,hwmods
      - interrupts
      - clocks
      - clock-names

  rfbi:
    description: RFBI – raster frame buffer interface
    type: object
    properties:
      compatible:
        items:
          - const: ti,omap3-rfbi
      reg:
        description: Address and length of RFBI register space.
        items:
          - description: Base address of RFBI register space
          - description: Length of RFBI register space
      ti,hwmods:
        description: Hardware module identifier for RFBI.
        items:
          - const: dss_rfbi
      clocks:
        description: Clocks for RFBI.
        items:
          - description: Functional clock for RFBI
          - description: Interface clock for RFBI
      clock-names:
        description: Names for the RFBI clocks.
        items:
          - const: fck
          - const: ick
    required:
      - compatible
      - reg
      - ti,hwmods
      - clocks
      - clock-names

  venc:
    description: VENC – video encoder
    type: object
    properties:
      compatible:
        items:
          - const: ti,omap3-venc
      reg:
        description: Address and length of VENC register space.
        items:
          - description: Base address of VENC register space
          - description: Length of VENC register space
      ti,hwmods:
        description: Hardware module identifier for VENC.
        items:
          - const: dss_venc
      vdda-supply:
        description: Power supply for DAC.
        $ref: /schemas/types.yaml#/definitions/phandle
      clocks:
        description: Functional clock for VENC.
        maxItems: 1
      clock-names:
        description: Name for the VENC clock.
        items:
          - const: fck
    required:
      - compatible
      - reg
      - ti,hwmods
      - vdda-supply
      - clocks
      - clock-names

  dsi:
    description: DSI – display serial interface
    type: object
    properties:
      compatible:
        items:
          - const: ti,omap3-dsi
      reg:
        description: Register spaces for 'proto', 'phy', and 'pll'.
        items:
          - description: Base address of 'proto' register space
          - description: Length of 'proto' register space
          - description: Base address of 'phy' register space
          - description: Length of 'phy' register space
          - description: Base address of 'pll' register space
          - description: Length of 'pll' register space
      reg-names:
        description: Names for the DSI register spaces.
        items:
          - const: proto
          - const: phy
          - const: pll
      interrupts:
        description: DSI interrupt.
        minItems: 1
        items:
          - description: DSI interrupt line
      ti,hwmods:
        description: Hardware module identifier for DSI.
        items:
          - const: dss_dsi1
      vdd-supply:
        description: Power supply for DSI.
        $ref: /schemas/types.yaml#/definitions/phandle
      clocks:
        description: Clocks used by DSI.
        items:
          - description: Functional clock (fck)
          - description: PHY PLL clock
      clock-names:
        description: Names for the DSI clocks.
        items:
          - const: fck
          - const: sys_clk
    required:
      - compatible
      - reg
      - reg-names
      - interrupts
      - ti,hwmods
      - vdd-supply
      - clocks
      - clock-names

  video-port:
    description: Video port child node
    type: object
    patternProperties:
      '^endpoint@[0-9]+$':
        oneOf:
          - $ref: '#/definitions/dpi-endpoint'
          - $ref: '#/definitions/sdi-endpoint'
    additionalProperties: false

  dpi-endpoint:
    description: DPI endpoint child node
    type: object
    properties:
      data-lines:
        description: Number of data lines used by DPI endpoint.
        $ref: /schemas/types.yaml#/definitions/uint32
    required:
      - data-lines
    additionalProperties: false

  sdi-endpoint:
    description: SDI endpoint child node
    type: object
    properties:
      datapairs:
        description: Number of data pairs used by SDI endpoint.
        $ref: /schemas/types.yaml#/definitions/uint32
    required:
      - datapairs
    additionalProperties: false

properties:
  compatible:
    description: Device compatible string.
    items:
      - enum:
          - ti,omap3-dss
  reg:
    description: Address and length of the DSS core register space.
    items:
      - description: Base address of DSS core register space
      - description: Length of DSS core register space
  ti,hwmods:
    description: Hardware module identifier for DSS core.
    items:
      - const: dss_core
  clocks:
    description: Functional clock for DSS core.
    maxItems: 1
  clock-names:
    description: Name for the DSS core clock.
    items:
      - const: fck
  dispc:
    $ref: '#/definitions/dispc'
  rfbi:
    $ref: '#/definitions/rfbi'
  venc:
    $ref: '#/definitions/venc'
  dsi:
    $ref: '#/definitions/dsi'
patternProperties:
  '^port@[0-9]+$':
    $ref: '#/definitions/video-port'

required:
  - compatible
  - reg
  - ti,hwmods
  - clocks
  - clock-names

additionalProperties: false

examples:
  - |
    &dss_core {
        compatible = "ti,omap3-dss";
        reg = <0x48050000 0x1000>;
        ti,hwmods = "dss_core";
        clocks = <&fclk>;
        clock-names = "fck";

        port@0 {
            endpoint@0 {
                data-lines = <24>;
            };
        };

        port@1 {
            endpoint@0 {
                datapairs = <4>;
            };
        };

        dispc {
            compatible = "ti,omap3-dispc";
            reg = <0x48052000 0x1000>;
            ti,hwmods = "dss_dispc";
            interrupts = <96>;
            clocks = <&fclk>;
            clock-names = "fck";
        };

        rfbi {
            compatible = "ti,omap3-rfbi";
            reg = <0x48054000 0x1000>;
            ti,hwmods = "dss_rfbi";
            clocks = <&fclk>, <&ick>;
            clock-names = "fck", "ick";
        };

        venc {
            compatible = "ti,omap3-venc";
            reg = <0x48055000 0x1000>;
            ti,hwmods = "dss_venc";
            vdda-supply = <&vdda1>;
            clocks = <&fclk>;
            clock-names = "fck";
        };

        dsi {
            compatible = "ti,omap3-dsi";
            reg = <0x48057000 0x1000>, <0x48058000 0x100>, <0x48059000 0x100>;
            reg-names = "proto", "phy", "pll";
            interrupts = <97>;
            ti,hwmods = "dss_dsi1";
            vdd-supply = <&vdda2>;
            clocks = <&fclk>, <&dsiphy_pll_clk>;
            clock-names = "fck", "sys_clk";
        };
    };
```

## Documentation/devicetree/bindings/display/ti/ti,omap4-dss.yaml
```yaml
# SPDX-License-Identifier: (GPL-2.0-only OR BSD-2-Clause)
# Copyright 2025 Texas Instruments
%YAML 1.2
---
$id: http://devicetree.org/schemas/display/ti/ti,omap4-dss.yaml#
$schema: http://devicetree.org/meta-schemas/core.yaml#

title: Texas Instruments OMAP4 Display Subsystem

maintainers:
  - Peter Ujfalusi <peter.ujfalusi@ti.com>
  - Rob Herring <robh@kernel.org>

description: |
  Texas Instruments OMAP4 Display Subsystem

  See Documentation/devicetree/bindings/display/ti/ti,omap-dss.txt for generic
  description about OMAP Display Subsystem bindings.

properties:
  compatible:
    description:
      Must be "ti,omap4-dss".
    oneOf:
      - items:
          - const: ti,omap4-dss

  reg:
    items:
      - description: DSS core register space.

  ti,hwmods:
    description:
      Module identifiers for DSS core hardware modules.
    $ref: /schemas/types.yaml#/definitions/string-array
    items:
      - const: dss_core

  clocks:
    description:
      Functional clock for the DSS core.
    items:
      - description: fck

  clock-names:
    description:
      Name of the functional clock.
    items:
      - const: fck

required:
  - compatible
  - reg
  - ti,hwmods
  - clocks
  - clock-names

additionalProperties: false
```
