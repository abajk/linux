## Documentation/devicetree/bindings/display/st,stih4xx.yaml
```yaml
# SPDX-License-Identifier: (GPL-2.0-only OR BSD-2-Clause)
# Copyright 2025 Linaro Ltd.
%YAML 1.2
---
$id: http://devicetree.org/schemas/display/st,stih4xx.yaml#
$schema: http://devicetree.org/meta-schemas/core.yaml#

title: STMicroelectronics stih4xx platforms

maintainers:
  - Rob Herring <robh@kernel.org>

description: |
  STMicroelectronics stih4xx platforms

properties:
  compatible:
    description: Allowed compatible values for the device.
    items:
      - enum:
          - "st,vtg"
          - "st,vtac-main"
          - "st,vtac-aux"
          - "st,sti-display-subsystem"
          - "st,stih4xx-compositor"
          - "st,stih4xx-tvout"
          - "st,stih4xx-hdmi"
          - "st,stih4xx-hda"
          - "st,stih4xx-dvo"
          - "st,stih4xx-hqvdp"

  reg:
    description: Physical base address and size pairs for the device registers.
    items:
      - description: First register region
      - description: Second register region
      - description: Third register region
      - description: Fourth register region

  reg-names:
    description: Names corresponding to reg entries in the same order.
    items:
      - const: tvout-reg
      - const: hda-reg
      - const: syscfg
      - const: dvo-reg

  clocks:
    description: Device clocks.
    items:
      - description: First clock
      - description: Second clock
      - description: Third clock
      - description: Fourth clock

  clock-names:
    description: Names corresponding to clocks entries in the same order.
    items:
      - enum:
          - vtac
          - compo_main
          - compo_aux
          - pix_main
          - pix_aux
          - pix
          - tmds
          - phy
          - audio
          - dvo_pix
          - dvo
          - main_parent
          - aux_parent
          - hqvdp

  resets:
    description: Reset phandles required by the device.
    items:
      - description: First reset line
      - description: Second reset line

  reset-names:
    description: Names corresponding to resets entries.
    items:
      - const: tvout
      - const: compo-main
      - const: compo-aux
      - const: hqvdp

  interrupts:
    description: IRQs for the device.
    items:
      - description: Primary interrupt
      - description: Secondary interrupt

  interrupt-names:
    description: Names corresponding to interrupts entries.
    items:
      - const: irq

  interrupt-controller: true

  ranges:
    description: Address translation ranges for the display subsystem.

  st,slave:
    description: Phandle to a slave VTG device.
    $ref: /schemas/types.yaml#/definitions/phandle

  ddc:
    description: Phandle of an I2C controller used for DDC EDID probing.

  pinctrl-0:
    description: Phandle for pin control.

  pinctrl-names:
    description: Names of pin control states.
    items:
      - const: default

  sti,panel:
    description: Phandle of the panel connected to the DVO output.
    $ref: /schemas/types.yaml#/definitions/phandle

additionalProperties: false

required:
  - compatible
  - reg
  - interrupts
  - interrupt-controller

examples:
  - |
    / {
        vtg_main_slave: sti-vtg-main-slave@fe85a800 {
            compatible = "st,vtg";
            reg = <0xfe85A800 0x300>;
            interrupts = <GIC_SPI 175 IRQ_TYPE_NONE>;
        };

        vtg_main: sti-vtg-main-master@fd348000 {
            compatible = "st,vtg";
            reg = <0xfd348000 0x400>;
            st,slave = <&vtg_main_slave>;
        };

        vtg_aux_slave: sti-vtg-aux-slave@fd348400 {
            compatible = "st,vtg";
            reg = <0xfe858200 0x300>;
            interrupts = <GIC_SPI 176 IRQ_TYPE_NONE>;
        };

        vtg_aux: sti-vtg-aux-master@fd348400 {
            compatible = "st,vtg";
            reg = <0xfd348400 0x400>;
            st,slave = <&vtg_aux_slave>;
        };

        sti-vtac-rx-main@fee82800 {
            compatible = "st,vtac-main";
            reg = <0xfee82800 0x200>;
            clock-names = "vtac";
            clocks = <&clk_m_a2_div0 CLK_M_VTAC_MAIN_PHY>;
        };

        sti-vtac-rx-aux@fee82a00 {
            compatible = "st,vtac-aux";
            reg = <0xfee82a00 0x200>;
            clock-names = "vtac";
            clocks = <&clk_m_a2_div0 CLK_M_VTAC_AUX_PHY>;
        };

        sti-vtac-tx-main@fd349000 {
            compatible = "st,vtac-main";
            reg = <0xfd349000 0x200>, <0xfd320000 0x10000>;
            clock-names = "vtac";
            clocks = <&clk_s_a1_hs CLK_S_VTAC_TX_PHY>;
        };

        sti-vtac-tx-aux@fd349200 {
            compatible = "st,vtac-aux";
            reg = <0xfd349200 0x200>, <0xfd320000 0x10000>;
            clock-names = "vtac";
            clocks = <&clk_s_a1_hs CLK_S_VTAC_TX_PHY>;
        };

        sti-display-subsystem {
            compatible = "st,sti-display-subsystem";
            ranges;
        };

        sti-compositor@fd340000 {
            compatible = "st,stih416-compositor";
            reg = <0xfd340000 0x1000>;
            clock-names = "compo_main", "compo_aux", "pix_main", "pix_aux";
            clocks = <&clk_m_a2_div1 CLK_M_COMPO_MAIN>, <&clk_m_a2_div1 CLK_M_COMPO_AUX>,
                     <&clockgen_c_vcc CLK_S_PIX_MAIN>, <&clockgen_c_vcc CLK_S_PIX_AUX>;
            reset-names = "compo-main", "compo-aux";
            resets = <&softreset STIH416_COMPO_M_SOFTRESET>, <&softreset STIH416_COMPO_A_SOFTRESET>;
            st,vtg = <&vtg_main>, <&vtg_aux>;
        };

        sti-tvout@fe000000 {
            compatible = "st,stih416-tvout";
            reg = <0xfe000000 0x1000>, <0xfe85a000 0x400>, <0xfe830000 0x10000>;
            reg-names = "tvout-reg", "hda-reg", "syscfg";
            reset-names = "tvout";
            resets = <&softreset STIH416_HDTVOUT_SOFTRESET>;
        };

        sti-hdmi@fe85c000 {
            compatible = "st,stih416-hdmi";
            reg = <0xfe85c000 0x1000>, <0xfe830000 0x10000>;
            reg-names = "hdmi-reg", "syscfg";
            interrupts = <GIC_SPI 173 IRQ_TYPE_NONE>;
            interrupt-names = "irq";
            clock-names = "pix", "tmds", "phy", "audio";
            clocks = <&clockgen_c_vcc CLK_S_PIX_HDMI>, <&clockgen_c_vcc CLK_S_TMDS_HDMI>,
                     <&clockgen_c_vcc CLK_S_HDMI_REJECT_PLL>, <&clockgen_b1 CLK_S_PCM_0>;
        };

        sti-hda@fe85a000 {
            compatible = "st,stih416-hda";
            reg = <0xfe85a000 0x400>, <0xfe83085c 0x4>;
            reg-names = "hda-reg", "video-dacs-ctrl";
            clock-names = "pix", "hddac";
            clocks = <&clockgen_c_vcc CLK_S_PIX_HD>, <&clockgen_c_vcc CLK_S_HDDAC>;
        };

        sti-dvo@8d00400 {
            compatible = "st,stih407-dvo";
            reg = <0x8d00400 0x200>;
            reg-names = "dvo-reg";
            clock-names = "dvo_pix", "dvo", "main_parent", "aux_parent";
            clocks = <&clk_s_d2_flexgen CLK_PIX_DVO>, <&clk_s_d2_flexgen CLK_DVO>,
                     <&clk_s_d2_quadfs 0>, <&clk_s_d2_quadfs 1>;
            pinctrl-names = "default";
            pinctrl-0 = <&pinctrl_dvo>;
            sti,panel = <&panel_dvo>;
        };

        sti-hqvdp@9c000000 {
            compatible = "st,stih407-hqvdp";
            reg = <0x9C00000 0x100000>;
            clock-names = "hqvdp", "pix_main";
            clocks = <&clk_s_c0_flexgen CLK_MAIN_DISP>, <&clk_s_d2_flexgen CLK_PIX_MAIN_DISP>;
            reset-names = "hqvdp";
            resets = <&softreset STIH407_HDQVDP_SOFTRESET>;
            st,vtg = <&vtg_main>;
        };
    };
```

## Documentation/devicetree/bindings/display/ti/ti,dra7-dss.yaml
```yaml
# SPDX-License-Identifier: (GPL-2.0-only OR BSD-2-Clause)
%YAML 1.2
---
$id: http://devicetree.org/schemas/display/ti/ti,dra7-dss.yaml#
$schema: http://devicetree.org/meta-schemas/core.yaml#

title: Texas Instruments DRA7x Display Subsystem

maintainers:
  - Peter Ujfalusi <peter.ujfalusi@ti.com>

description: |
  See Documentation/devicetree/bindings/display/ti/ti,omap-dss.txt for generic
  description about OMAP Display Subsystem bindings.

  DSS Core
  --------

properties:
  compatible:
    const: ti,dra7-dss

  reg:
    maxItems: 1

  ti,hwmods:
    items:
      - const: dss_core
    description: Hardware module for DSS core

  clocks:
    maxItems: 3
    description: Handles to fclk and optional video PLL clocks

  clock-names:
    items:
      - const: fck
      - const: video1_clk
      - const: video2_clk
    description: Clock names for fclk and video PLLs

  syscon:
    $ref: /schemas/types.yaml#/definitions/phandle
    description: Phandle to control module core syscon node

  # ----------------------------------------
  # Child nodes
  # ----------------------------------------

  dispc:
    type: object
    description: DISPC node
    required:
      - compatible
      - reg
      - ti,hwmods
      - interrupts
      - clocks
      - clock-names
    properties:
      compatible:
        const: ti,dra7-dispc
      reg:
        maxItems: 1
      ti,hwmods:
        items:
          - const: dss_dispc
        description: Hardware module for DISPC
      interrupts:
        maxItems: 1
      clocks:
        maxItems: 1
      clock-names:
        items:
          - const: fck
      max-memory-bandwidth:
        $ref: /schemas/types.yaml#/definitions/uint32
        description: Input memory (from main memory to DISPC) bandwidth limit in bytes per second
    additionalProperties: false

  hdmi:
    type: object
    description: HDMI node
    required:
      - compatible
      - reg
      - reg-names
      - interrupts
      - ti,hwmods
      - vdda-supply
      - clocks
      - clock-names
    properties:
      compatible:
        const: ti,dra7-hdmi
      reg:
        maxItems: 4
      reg-names:
        items:
          - const: wp
          - const: pll
          - const: phy
          - const: core
        description: Names for register spaces
      interrupts:
        maxItems: 1

      ti,hwmods:
        items:
          - const: dss_hdmi
        description: Hardware module for HDMI

      vdda-supply:
        description: VDDA power supply

      clocks:
        maxItems: 2
      clock-names:
        items:
          - const: fck
          - const: sys_clk

    additionalProperties: false

  dpi-out:
    type: object
    description: DPI output port endpoint
    required:
      - data-lines
    properties:
      data-lines:
        $ref: /schemas/types.yaml#/definitions/uint32
        description: Number of lines used
    additionalProperties: false

additionalProperties: false
```

## Documentation/devicetree/bindings/display/ti/ti,omap-dss.yaml
```yaml
# SPDX-License-Identifier: (GPL-2.0-only OR BSD-2-Clause)
# Copyright 2018 Linaro Ltd.
%YAML 1.2
---
$id: http://devicetree.org/schemas/display/ti/ti,omap-dss.yaml#
$schema: http://devicetree.org/meta-schemas/core.yaml#

title: Texas Instruments OMAP Display Subsystem

maintainers:
  - Rob Herring <robh@kernel.org>

description: |
  Texas Instruments OMAP Display Subsystem
  ========================================

  Generic Description
  -------------------

  This document is a generic description of the OMAP Display Subsystem bindings.
  Binding details for each OMAP SoC version are described in respective binding
  documentation.

  The OMAP Display Subsystem (DSS) hardware consists of DSS Core, DISPC module and
  a number of encoder modules. All DSS versions contain DSS Core and DISPC, but
  the encoder modules vary.

  The DSS Core is the parent of the other DSS modules, and manages clock routing,
  integration to the SoC, etc.

  DISPC is the display controller, which reads pixels from the memory and outputs
  a RGB pixel stream to encoders.

  The encoder modules encode the received RGB pixel stream to a video output like
  HDMI, MIPI DPI, etc.

  Video Ports
  -----------

  The DSS Core and the encoders have video port outputs. The structure of the
  video ports is described in Documentation/devicetree/bindings/graph.txt,
  and the properties for the ports and endpoints for each encoder are
  described in the SoC's DSS binding documentation.

  The video ports are used to describe connections to external hardware, like
  panels or external encoders.

  Aliases
  -------

  The board dts file may define aliases for displays to assign "displayX" style
  name for each display. If no aliases are defined, a semi-random number is used
  for the display.

properties:
  compatible:
    items:
      - const: ti,omap4-dss
    description: |
      The compatible string for the OMAP Display Subsystem.

  reg:
    maxItems: 1
    description: |
      Base address and size of the DSS core registers.

  status:
    description: |
      Enable or disable the DSS core.
    enum:
      - okay
      - disabled

  ti,hwmods:
    description: |
      Hardware modules used by the DSS core for power management.
    $ref: /schemas/types.yaml#/definitions/string-array

  clocks:
    maxItems: 1
    description: |
      Clock for the DSS core.

  clock-names:
    items:
      - const: fck

  '#address-cells':
    const: 1

  '#size-cells':
    const: 1

  ranges:
    description: |
      Address and size mapping for memory regions accessible by children.

additionalProperties: false

examples:
  - |
    dss: dss@58000000 {
        compatible = "ti,omap4-dss";
        reg = <0x58000000 0x80>;
        status = "disabled";
        ti,hwmods = "dss_core";
        clocks = <&dss_dss_clk>;
        clock-names = "fck";
        #address-cells = <1>;
        #size-cells = <1>;
        ranges;
    };
```
