## Documentation/devicetree/bindings/display/bridge/megachips-stdpxxxx-ge-b850v3-fw.yaml
```yaml
# SPDX-License-Identifier: (GPL-2.0-only OR BSD-2-Clause)
%YAML 1.2
---
$id: http://devicetree.org/schemas/display/bridge/megachips-stdpxxxx-ge-b850v3-fw.yaml#
$schema: http://devicetree.org/meta-schemas/core.yaml#

title: megachips stdpxxxx-ge-b850v3-fw bridges
maintainers:
  - Peter Senna Tschudin <peter.senna@collabora.com>
  - Rob Herring <robh@kernel.org>

description: |
  Drivers for the second video output of the GE B850v3:
     STDP4028-ge-b850v3-fw bridges (LVDS-DP)
     STDP2690-ge-b850v3-fw bridges (DP-DP++)

  The video processing pipeline on the second output on the GE B850v3:

     Host -> LVDS|--(STDP4028)--|DP -> DP|--(STDP2690)--|DP++ -> Video output

  Each bridge has a dedicated flash containing firmware for supporting the custom
  design. The result is that, in this design, neither the STDP4028 nor the
  STDP2690 behave as the stock bridges would. The compatible strings include the
  suffix "-ge-b850v3-fw" to make it clear that the driver is for the bridges with
  the firmware specific for the GE B850v3.

  The hardware does not provide control over the video processing pipeline, as
  the two bridges behave as a single one. The only interfaces exposed by the
  hardware are EDID, HPD, and interrupts.

properties:
  compatible:
    oneOf:
      - items:
          - const: "megachips,stdp4028-ge-b850v3-fw"
      - items:
          - const: "megachips,stdp2690-ge-b850v3-fw"
  reg:
    maxItems: 1

  interrupts:
    maxItems: 1

  ports:
    description: Input and output ports for video data
    $ref: /schemas/graph.yaml#/properties/ports

    properties:
      port@0:
        description: Input port
        $ref: /schemas/graph.yaml#/properties/port

      port@1:
        description: Output port
        $ref: /schemas/graph.yaml#/properties/port

required:
  - compatible
  - reg
  - ports

allOf:
  - if:
      properties:
        compatible:
          contains:
            const: "megachips,stdp4028-ge-b850v3-fw"
    then:
      required:
        - interrupts

additionalProperties: false

examples:
  - |
    &mux2_i2c2 {
        clock-frequency = <100000>;

        stdp4028@73 {
            compatible = "megachips,stdp4028-ge-b850v3-fw";
            #address-cells = <1>;
            #size-cells = <0>;
            reg = <0x73>;
            interrupts = <0 IRQ_TYPE_LEVEL_HIGH>;

            ports {
                #address-cells = <1>;
                #size-cells = <0>;

                port@0 {
                    reg = <0>;
                    stdp4028_in: endpoint {
                        remote-endpoint = <&lvds0_out>;
                    };
                };
                port@1 {
                    reg = <1>;
                    stdp4028_out: endpoint {
                        remote-endpoint = <&stdp2690_in>;
                    };
                };
            };
        };

        stdp2690@72 {
            compatible = "megachips,stdp2690-ge-b850v3-fw";
            #address-cells = <1>;
            #size-cells = <0>;
            reg = <0x72>;

            ports {
                #address-cells = <1>;
                #size-cells = <0>;

                port@0 {
                    reg = <0>;
                    stdp2690_in: endpoint {
                        remote-endpoint = <&stdp4028_out>;
                    };
                };

                port@1 {
                    reg = <1>;
                    stdp2690_out: endpoint {
                        /* Connector for external display */
                    };
                };
            };
        };
    };
```

## Documentation/devicetree/bindings/display/cirrus,ep7209-fb.yaml
```yaml
# SPDX-License-Identifier: (GPL-2.0-only OR BSD-2-Clause)
# Copyright 2018 Linaro Ltd.
%YAML 1.2
---
$id: http://devicetree.org/schemas/display/cirrus,ep7209-fb.yaml#
$schema: http://devicetree.org/meta-schemas/core.yaml#

title: Cirrus Logic CLPS711X Framebuffer

maintainers:
  - Alexander Shiyan <shc_work@mail.ru>
  - Bjorn Helgaas <bhelgaas@google.com>
  - Martin Kaiser <martin@kaiser.cx>
  - Rob Herring <robh@kernel.org>
  - Yegor Yefremov <yegorslists@googlemail.com>

description: |
  * Cirrus Logic CLPS711X Framebuffer

properties:
  compatible:
    description: Device compatibility. Must include "cirrus,ep7209-fb".
    items:
      - enum:
          - cirrus,ep7209-fb
          - cirrus,ep7312-fb
    contains:
      const: cirrus,ep7209-fb

  reg:
    # The order and count of entries is defined by element descriptions.
    items:
      - description: Controller registers (physical base address and length).
      - description: Framebuffer memory (location and size).

  clocks:
    maxItems: 1
    description: FB reference clock phandle specifier pair.

  lcd-supply:
    description: Regulator for LCD supply voltage.

  display:
    description: |
      Phandle to a display node as described in
      Documentation/devicetree/bindings/display/panel/display-timing.txt.
    $ref: /schemas/types.yaml#/definitions/phandle-array
    maxItems: 1

required:
  - compatible
  - reg
  - clocks
  - display

additionalProperties: false

examples:
  - |
    fb: fb@800002c0 {
        compatible = "cirrus,ep7312-fb", "cirrus,ep7209-fb";
        reg = <0x800002c0 0xd44>, <0x60000000 0xc000>;
        clocks = <&clks 2>;
        lcd-supply = <&reg5v0>;
        display = <&display>;
    };

    display: display {
        model = "320x240x4";
        bits-per-pixel = <4>;
        ac-prescale = <17>;

        display-timings {
            native-mode = <&timing0>;
            timing0: 320x240 {
                hactive = <320>;
                hback-porch = <0>;
                hfront-porch = <0>;
                hsync-len = <0>;
                vactive = <240>;
                vback-porch = <0>;
                vfront-porch = <0>;
                vsync-len = <0>;
                clock-frequency = <6500000>;
            };
        };
    };
```

## Documentation/devicetree/bindings/display/fsl,dcu.yaml
```yaml
# SPDX-License-Identifier: (GPL-2.0-only OR BSD-2-Clause)
# Copyright 2018 Linaro Ltd.
%YAML 1.2
---
$id: http://devicetree.org/schemas/display/fsl,dcu.yaml#
$schema: http://devicetree.org/meta-schemas/core.yaml#

title: Freescale DCU DRM Driver

maintainers:
  - Meng Yi <meng.yi@nxp.com>
  - Stefan Agner <stefan@agner.ch>

description: |
  Device Tree bindings for Freescale DCU DRM Driver

properties:
  compatible:
    items:
      - enum:
          - fsl,ls1021a-dcu
          - fsl,vf610-dcu

  reg:
    maxItems: 1

  clocks:
    description: Handle to "dcu" and "pix" clocks (in that order)
    maxItems: 2

  clock-names:
    items:
      - const: dcu
      - const: pix

  big-endian:
    description: LS1021A DCU registers are big-endian
    type: boolean

  port:
    description: Video port for the panel output

  fsl,tcon:
    description: The phandle to the timing controller node
    $ref: /schemas/types.yaml#/definitions/phandle

required:
  - compatible
  - reg
  - clocks
  - clock-names
  - big-endian
  - port

additionalProperties: false

examples:
  - |
    dcu@2ce0000 {
        compatible = "fsl,ls1021a-dcu";
        reg = <0x0 0x2ce0000 0x0 0x10000>;
        clocks = <&platform_clk 0>, <&platform_clk 0>;
        clock-names = "dcu", "pix";
        big-endian;
        fsl,tcon = <&tcon>;

        port {
            dcu_out: endpoint {
                remote-endpoint = <&panel_out>;
            };
        };
    };
```

## Documentation/devicetree/bindings/display/google,goldfish-fb.yaml
```yaml
# SPDX-License-Identifier: (GPL-2.0-only OR BSD-2-Clause)
%YAML 1.2
---
$id: http://devicetree.org/schemas/display/google,goldfish-fb.yaml#
$schema: http://devicetree.org/meta-schemas/core.yaml#

title: Google Goldfish Framebuffer

maintainers:
  - Aleksandar Markovic <aleksandar.markovic@mips.com>

description: |-
  Android Goldfish framebuffer

  Android Goldfish framebuffer device used by Android emulator.

properties:
  compatible:
    const: google,goldfish-fb

  reg:
    items:
      - description: Framebuffer register base address
      - description: Framebuffer register size

  interrupts:
    items:
      - description: Interrupt mapping for the framebuffer device

required:
  - compatible
  - reg
  - interrupts

additionalProperties: false

examples:
  - |
    display-controller@1f008000 {
      compatible = "google,goldfish-fb";
      reg = <0x1f008000 0x100>;
      interrupts = <0x10>;
    };
```

## Documentation/devicetree/bindings/display/hisilicon/hisilicon,hi6220-ade.yaml
```yaml
# SPDX-License-Identifier: (GPL-2.0-only OR BSD-2-Clause)
# Copyright 2018-2025 Linaro Ltd.
%YAML 1.2
---
$id: http://devicetree.org/schemas/display/hisilicon/hisilicon,hi6220-ade.yaml#
$schema: http://devicetree.org/meta-schemas/core.yaml#

title: Hisilicon ADE Display Controller
maintainers:
  - Peter Meerwald-Stadler <pmeerw@pmeerw.net>
  - Xinliang Liu <xinliang.liu@linaro.org>
description: |
  Device-Tree bindings for hisilicon ADE display controller driver

  ADE (Advanced Display Engine) is the display controller which grab image
  data from memory, do composition, do post image processing, generate RGB
  timing stream and transfer to DSI.

properties:
  compatible:
    const: hisilicon,hi6220-ade

  reg:
    items:
      - description: Physical base address and length of the ADE controller's registers.

  reg-names:
    items:
      - const: ade_base

  hisilicon,noc-syscon:
    description: ADE NOC QoS syscon.
    $ref: /schemas/types.yaml#/definitions/phandle

  resets:
    description: ADE reset controller node.
    maxItems: 1

  interrupts:
    items:
      - description: LDI vblank interrupt specifier.

  clocks:
    description: A list of phandle + clock-specifier pairs, one for each entry in clock-names.
    maxItems: 3

  clock-names:
    items:
      - const: clk_ade_core
      - const: clk_codec_jpeg
      - const: clk_ade_pix

  assigned-clocks:
    description: Assigned ADE core and media NOC QoS clock phandle + specifier pairs.
    $ref: /schemas/types.yaml#/definitions/phandle-array

  assigned-clock-rates:
    description: Clock rates for each entry in assigned-clocks.
    $ref: /schemas/types.yaml#/definitions/uint32-array

  dma-coherent:
    description: Indicates DMA operations are coherent.
    type: boolean

  port:
    description: Output port containing an endpoint subnode.

required:
  - compatible
  - reg
  - reg-names
  - hisilicon,noc-syscon
  - resets
  - interrupts
  - clocks
  - clock-names
  - assigned-clocks
  - assigned-clock-rates
  - port

additionalProperties: false

examples:
  - |
    ade: ade@f4100000 {
        compatible = "hisilicon,hi6220-ade";
        reg = <0x0 0xf4100000 0x0 0x7800>;
        reg-names = "ade_base";
        hisilicon,noc-syscon = <&medianoc_ade>;
        resets = <&media_ctrl MEDIA_ADE>;
        interrupts = <0 115 4>;
        clocks = <&media_ctrl HI6220_ADE_CORE>,
                 <&media_ctrl HI6220_CODEC_JPEG>,
                 <&media_ctrl HI6220_ADE_PIX_SRC>;
        clock-names = "clk_ade_core", "clk_codec_jpeg", "clk_ade_pix";
        assigned-clocks = <&media_ctrl HI6220_ADE_CORE>,
                          <&media_ctrl HI6220_CODEC_JPEG>;
        assigned-clock-rates = <360000000>, <288000000>;
        dma-coherent;
        port {
            endpoint {
                remote-endpoint = <&dsi_in>;
            };
        };
    };
```

## Documentation/devicetree/bindings/display/hisilicon/hisilicon,hi6220-dsi.yaml
```yaml
# SPDX-License-Identifier: (GPL-2.0-only OR BSD-2-Clause)
%YAML 1.2
---
$id: http://devicetree.org/schemas/display/hisilicon/hisilicon,hi6220-dsi.yaml#
$schema: http://devicetree.org/meta-schemas/core.yaml#

title: HiSilicon DesignWare DSI Host Controller

maintainers:
  - Xinliang Liu <xinliang.liu@linaro.org>

properties:
  compatible:
    items:
      - const: hisilicon,hi6220-dsi

  reg:
    maxItems: 1

  clocks:
    maxItems: 1
    description: APB clock for the DSI controller.

  clock-names:
    items:
      - const: pclk

  ports:
    $ref: /schemas/graph.yaml#/properties/ports

    properties:
      port@0:
        description: Input port, connects to ADE output endpoint.
        $ref: /schemas/graph.yaml#/properties/port

      port@1:
        description: Output port, connects to panel or bridge endpoints.
        $ref: /schemas/graph.yaml#/properties/port

required:
  - compatible
  - reg
  - clocks
  - clock-names
  - ports

additionalProperties: false

examples:
  - |
    dsi: dsi@f4107800 {
        compatible = "hisilicon,hi6220-dsi";
        reg = <0x0 0xf4107800 0x0 0x100>;
        clocks = <&media_ctrl  HI6220_DSI_PCLK>;
        clock-names = "pclk";
        status = "disabled";

        ports {
            #address-cells = <1>;
            #size-cells = <0>;

            /* 0 for input port */
            port@0 {
                reg = <0>;
                dsi_in: endpoint {
                    remote-endpoint = <&ade_out>;
                };
            };
        };
    };
  - |
    &dsi {
        status = "ok";

        ports {
            /* 1 for output port */
            port@1 {
                reg = <1>;

                dsi_out0: endpoint@0 {
                    remote-endpoint = <&adv7533_in>;
                };
            };
        };
    };
```

## Documentation/devicetree/bindings/display/ilitek,ili9225.yaml
```yaml
# SPDX-License-Identifier: (GPL-2.0-only OR BSD-2-Clause)
# Copyright 2025 David Lechner <david@lechnology.com>
%YAML 1.2
---
$id: http://devicetree.org/schemas/display/ilitek,ili9225.yaml#
$schema: http://devicetree.org/meta-schemas/core.yaml#

title: Ilitek ILI9225 display panels

maintainers:
  - David Lechner <david@lechnology.com>

description: |
  Ilitek ILI9225 display panels

  This binding is for display panels using an Ilitek ILI9225 controller in SPI mode.

  The node for this driver must be a child node of a SPI controller, hence
  all mandatory properties described in ../spi/spi-bus.txt must be specified.

properties:
  compatible:
    description: Must be one of the compatible strings for this display
    items:
      - enum: ["vot,v220hf01a-t"]
      - enum: ["ilitek,ili9225"]

  reg:
    description: Chip select number for the SPI device
    items:
      - description: Chip select

  spi-max-frequency:
    $ref: /schemas/types.yaml#/definitions/uint32
    description: Maximum SPI bus frequency in Hertz

  rs-gpios:
    maxItems: 1
    description: Register select GPIO line

  reset-gpios:
    maxItems: 1
    description: Reset GPIO line

  rotation:
    $ref: /schemas/types.yaml#/definitions/uint32
    description: Panel rotation in degrees counter clockwise
    enum: [0, 90, 180, 270]

required:
  - compatible
  - rs-gpios
  - reset-gpios

additionalProperties: false

examples:
  - |
    display@0 {
        compatible = "vot,v220hf01a-t", "ilitek,ili9225";
        reg = <0>;
        spi-max-frequency = <12000000>;
        rs-gpios = <&gpio0 9 GPIO_ACTIVE_HIGH>;
        reset-gpios = <&gpio0 8 GPIO_ACTIVE_HIGH>;
        rotation = <270>;
    };
```
