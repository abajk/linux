## Documentation/devicetree/bindings/display/marvell,pxa2xx-lcdc.yaml
```yaml
# SPDX-License-Identifier: (GPL-2.0-only OR BSD-2-Clause)
---
$id: http://devicetree.org/schemas/display/marvell,pxa2xx-lcdc.yaml#
$schema: http://devicetree.org/meta-schemas/core.yaml#

title: Marvell PXA2XX LCD Controller

maintainers:
  - Daniel Mack <daniel@zonque.org>
  - Robert Jarzmik <robert.jarzmik@free.fr>

description: |
  PXA LCD Controller.

  Required nodes:
   - port: connection to the LCD panel (see video-interfaces.txt)
       This node must have its properties bus-width and remote-endpoint set.
       If the panel is not a TFT color panel, then a "lcd-type" property in
       the panel should specify the panel type.
       This panel node should be in the board dts.

properties:
  compatible:
    items:
      - enum:
          - marvell,pxa2xx-lcdc
          - marvell,pxa270-lcdc
          - marvell,pxa300-lcdc

  reg:
    maxItems: 1

  interrupts:
    maxItems: 1

  clocks:
    maxItems: 1

  lcd-supply: true

  port:
    description: Connection to the LCD panel (see video-interfaces.txt)
    $ref: /schemas/graph.yaml#/properties/port

additionalProperties: false

examples:
  - |
    lcd-controller@40500000 {
        compatible = "marvell,pxa2xx-lcdc";
        reg = <0x44000000 0x10000>;
        interrupts = <17>;
        clocks = <&clks CLK_LCD>;

        port {
            lcdc_out: endpoint {
                remote-endpoint = <&panel_in>;
                bus-width = <16>;
            };
        };
    };
```

## Documentation/devicetree/bindings/display/marvell,pxa300-gcu.yaml
```yaml
---
$id: http://devicetree.org/schemas/display/marvell,pxa300-gcu.yaml#
$schema: http://devicetree.org/meta-schemas/core.yaml#

title: PXA3xx GCU Controller

maintainers:
  - Daniel Mack <daniel@zonque.org>

description: |
  PXA3xx GCU Controller
  ---------------------

properties:
  compatible:
    items:
      - const: marvell,pxa300-gcu

  reg:
    items:
      - description: register range (address and length)

  interrupts:
    items:
      - description: Controller interrupt

  clocks:
    maxItems: 1
    description: phandle to the PXA specific input clock

required:
  - compatible
  - reg
  - interrupts
  - clocks

additionalProperties: false

examples:
  - |
    display-controller@54000000 {
        compatible = "marvell,pxa300-gcu";
        reg = <0x54000000 0x1000>;
        interrupts = <39>;
        clocks = <&clks CLK_PXA300_GCU>;
    };
```

## Documentation/devicetree/bindings/display/mipi-dsi-bus.yaml
```yaml
# SPDX-License-Identifier: (GPL-2.0-only OR BSD-2-Clause)
%YAML 1.2
---
$id: http://devicetree.org/schemas/display/mipi-dsi-bus.yaml#
$schema: http://devicetree.org/meta-schemas/core.yaml#

title: MIPI DSI (Display Serial Interface) bus

maintainers:
  - Archit Taneja <architt@codeaurora.org>
  - Rob Herring <robh@kernel.org>

description: |
  MIPI DSI (Display Serial Interface) busses
  ==========================================

  The MIPI Display Serial Interface specifies a serial bus and a protocol for
  communication between a host and up to four peripherals. This schema defines
  the syntax used to represent a DSI bus in a device tree.

  This schema describes DSI bus–specific properties only or defines existing
  standard properties in the context of the DSI bus.

  Each DSI host provides a DSI bus. The DSI host controller’s node contains a
  set of properties that characterize the bus. Child nodes describe individual
  peripherals on that bus.

  The following assumes that only a single peripheral is connected to a DSI
  host. Experience shows that this is true for the large majority of setups.

properties:
  compatible:
    items:
      - enum: [mipi, dsi-host]
    description: Must be "mipi,dsi-host" to identify a DSI host node.

  '#address-cells':
    const: 1
    description: Number of cells required to represent an address on the bus.

  '#size-cells':
    const: 0
    description: Must be 0; DSI peripherals do not use size cells.

  clock-master:
    type: boolean
    description: Indicates this host drives the clock for multiple DSI busses.

# Definitions for child nodes (DSI peripherals)
definitions:
  peripheral:
    type: object
    properties:
      compatible:
        items:
          - type: string
        description: Compatible string for the DSI peripheral.
      reg:
        minItems: 1
        items:
          minimum: 0
          maximum: 3
        description: Virtual channel number(s) (0-3) of the peripheral.
    additionalProperties: true

additionalProperties: false

required:
  - compatible
  - '#address-cells'
  - '#size-cells'

examples:
  - |
    dsi-host@0 {
      compatible = "mipi,dsi-host";
      #address-cells = <1>;
      #size-cells = <0>;

      /* single-channel peripheral */
      peripheral@0 {
        compatible = "acme,foo-dsi-panel";
        reg = <0>;
      };
    };
```

## Documentation/devicetree/bindings/display/multi-inno,mi0283qt.yaml
```yaml
# SPDX-License-Identifier: (GPL-2.0-only OR BSD-2-Clause)
# Copyright 2025 Noralf Trønnes <noralf@tronnes.org>
%YAML 1.2
---
$id: http://devicetree.org/schemas/display/multi-inno,mi0283qt.yaml#
$schema: http://devicetree.org/meta-schemas/core.yaml#

title: Multi-Inno MI0283QT display panel
maintainers:
  - Noralf Trønnes <noralf@tronnes.org>

description: |
  Multi-Inno MI0283QT display panel

  The node for this driver must be a child node of a SPI controller, hence
  all mandatory properties described in ../spi/spi-bus.txt must be specified.

properties:
  compatible:
    items:
      - const: multi-inno,mi0283qt
    description: Binding compatible string
  reg:
    description: SPI chip select for the panel
    items:
      - description: SPI chip select
  spi-max-frequency:
    description: Maximum SPI clock frequency in Hz
    $ref: /schemas/types.yaml#/definitions/uint32
  dc-gpios:
    description: Data/Command control GPIO
  reset-gpios:
    description: Reset GPIO for the panel
  power-supply:
    description: Regulator supply for the panel
  backlight:
    description: Backlight device attached to the panel
    $ref: /schemas/types.yaml#/definitions/phandle
  rotation:
    description: Panel rotation in degrees counter clockwise
    $ref: /schemas/types.yaml#/definitions/uint32
    enum: [0, 90, 180, 270]

required:
  - compatible
  - reg

additionalProperties: false

examples:
  - |
    mi0283qt@0 {
      compatible = "multi-inno,mi0283qt";
      reg = <0>;
      spi-max-frequency = <32000000>;
      rotation = <90>;
      dc-gpios = <&gpio 25 0>;
      backlight = <&backlight>;
    };
```

## Documentation/devicetree/bindings/display/pervasive,e1144cs021.yaml
```yaml
# SPDX-License-Identifier: (GPL-2.0-only OR BSD-2-Clause)
# Copyright 2025 Noralf Trønnes <noralf@tronnes.org>
%YAML 1.2
---
$id: http://devicetree.org/schemas/display/pervasive,e1144cs021.yaml#
$schema: http://devicetree.org/meta-schemas/core.yaml#

title: Pervasive Displays RePaper e-ink display

maintainers:
  - Noralf Trønnes <noralf@tronnes.org>

description: |
  Pervasive Displays RePaper branded e-ink displays

  The node for this driver must be a child node of a SPI controller, hence
  all mandatory properties described in ../spi/spi-bus.txt must be specified.

properties:
  compatible:
    description: Supported RePaper display panels
    enum:
      - pervasive,e1144cs021
      - pervasive,e1190cs021
      - pervasive,e2200cs021
      - pervasive,e2271cs021

  reg:
    description: SPI chip select
    maxItems: 1

  spi-max-frequency:
    description: Maximum SPI bus frequency
    $ref: /schemas/types.yaml#/definitions/uint32

  panel-on-gpios:
    description: Timing controller power control
    maxItems: 1

  discharge-gpios:
    description: Discharge control
    maxItems: 1

  reset-gpios:
    description: RESET pin
    maxItems: 1

  busy-gpios:
    description: BUSY pin
    maxItems: 1

  border-gpios:
    description: Border control
    maxItems: 1

  pervasive,thermal-zone:
    description: Name of thermometer's thermal zone
    $ref: /schemas/types.yaml#/definitions/string

required:
  - compatible
  - reg
  - spi-max-frequency
  - panel-on-gpios
  - discharge-gpios
  - reset-gpios
  - busy-gpios

allOf:
  - if:
      properties:
        compatible:
          contains:
            const: pervasive,e2271cs021
    then:
      required:
        - border-gpios
    else:
      properties:
        border-gpios: false

additionalProperties: false

examples:
  - |
    papirus27@0 {
        compatible = "pervasive,e2271cs021";
        reg = <0>;
        spi-max-frequency = <8000000>;
        panel-on-gpios = <&gpio 23 0>;
        border-gpios = <&gpio 14 0>;
        discharge-gpios = <&gpio 15 0>;
        reset-gpios = <&gpio 24 0>;
        busy-gpios = <&gpio 25 0>;
        pervasive,thermal-zone = "display";
    };
```

## Documentation/devicetree/bindings/display/smi-sm501.yaml
```yaml
# SPDX-License-Identifier: (GPL-2.0-only OR BSD-2-Clause)
%YAML 1.2
---
$id: http://devicetree.org/schemas/display/smi-sm501.yaml#
$schema: http://devicetree.org/meta-schemas/core.yaml#

title: smi,sm501

maintainers:
  - Rob Herring <robh@kernel.org>

description: |
  * SM SM501

  The SM SM501 is a LCD controller, with proper hardware, it can also
  drive DVI monitors.

properties:
  compatible:
    items:
      - const: smi,sm501

  reg:
    items:
      - description: System Configuration register.
      - description: IO space (Display Controller register).

  interrupts:
    maxItems: 1

  mode:
    description: "Video mode string in the format: <xres>x<yres>[-<bpp>][@<refresh>]."
    $ref: /schemas/types.yaml#/definitions/string

  edid:
    description: Verbatim EDID data block describing attached display.
    $ref: /schemas/types.yaml#/definitions/binary

  little-endian:
    description: Enable little endian on big endian systems.
    type: boolean

  big-endian:
    description: Enable big endian on little endian systems.
    type: boolean

required:
  - compatible
  - reg
  - interrupts

additionalProperties: false

examples:
  - |
    display@1,0 {
        compatible = "smi,sm501";
        reg = <1 0x00000000 0x00800000
               1 0x03e00000 0x00200000>;
        interrupts = <1 1 3>;
        mode = "640x480-32@60";
        edid = [edid-data];
    };
```

## Documentation/devicetree/bindings/display/snps,arcpgu.yaml
```yaml
# SPDX-License-Identifier: (GPL-2.0-only OR BSD-2-Clause)
# Copyright 2025 Synopsys Inc.
%YAML 1.2
---
$id: http://devicetree.org/schemas/display/snps,arcpgu.yaml#
$schema: http://devicetree.org/meta-schemas/core.yaml#

title: Synopsys ARC PGU

maintainers:
  - Alexey Brodkin <abrodkin@synopsys.com>

description: |
  ARC PGU

  This is a display controller found on several development boards produced
  by Synopsys. The ARC PGU is an RGB streamer that reads the data from a
  framebuffer and sends it to a single digital encoder (usually HDMI).

properties:
  compatible:
    items:
      - const: snps,arcpgu

  reg:
    description: Physical base address and length of the controller's registers.
    items:
      - description: Controller registers

  clocks:
    maxItems: 1
    description: Phandle to pixel clock for the controller.

  clock-names:
    items:
      - const: pxlclk

  port:
    description: PGU connection to an encoder chip.
    type: object
    additionalProperties: false
    properties:
      endpoint:
        description: PGU output endpoint.
        type: object
        additionalProperties: false
        properties:
          remote-endpoint:
            description: Phandle to the downstream endpoint.
            $ref: /schemas/types.yaml#/definitions/phandle-array
        required:
          - remote-endpoint
    required:
      - endpoint

required:
  - compatible
  - reg
  - clocks
  - clock-names
  - port

additionalProperties: false

examples:
  - |
    pgu@XXXXXXXX {
        compatible = "snps,arcpgu";
        reg = <0xXXXXXXXX 0x400>;
        clocks = <&clock_node>;
        clock-names = "pxlclk";
        port {
            pgu_output: endpoint {
                remote-endpoint = <&hdmi_enc_input>;
            };
        };
    };
```

## Documentation/devicetree/bindings/display/solomon,ssd1289fb.yaml
```yaml
# SPDX-License-Identifier: (GPL-2.0-only OR BSD-2-Clause)
# Copyright 2025 Rob Herring <robh@kernel.org>
%YAML 1.2
---
$id: http://devicetree.org/schemas/solomon,ssd1289fb.yaml#
# $schema is the meta-schema this schema should be validated with.
$schema: http://devicetree.org/meta-schemas/core.yaml#

title: Solomon SSD1289 Framebuffer Driver

maintainers:
  - Rob Herring <robh@kernel.org>

description: |
  * Solomon SSD1289 Framebuffer Driver

properties:
  compatible:
    items:
      - const: solomon,ssd1289fb
    description: Must be "solomon,ssd1289fb" to identify this controller.
  reg:
    items:
      - description: Base address of the controller on the LBC bus
      - description: Size of the register window
    description: Memory-mapped register window for the controller.

required:
  - compatible
  - reg

additionalProperties: false

examples:
  - |
    display@2,0 {
        compatible = "solomon,ssd1289fb";
        reg = <0x2 0x0000 0x0004>;
    };
```
