## Documentation/devicetree/bindings/display/tilcdc/ti,am33xx-tilcdc.yaml
```yaml
# SPDX-License-Identifier: (GPL-2.0-only OR BSD-2-Clause)
# Copyright 2018 Linaro Ltd.
%YAML 1.2
---
$id: http://devicetree.org/schemas/display/tilcdc/ti,am33xx-tilcdc.yaml#
$schema: http://devicetree.org/meta-schemas/core.yaml#

title: TI TILCDC DRM driver

maintainers:
  - Alexander A. Klimov <grandmaster@al2klimov.de>
  - Bartosz Golaszewski <brgl@bgdev.pl>
  - Enric Balletbo i Serra <eballetbo@kernel.org>
  - Geert Uytterhoeven <geert+renesas@glider.be>
  - Jyri Sarha <jsarha@ti.com>
  - Mauro Carvalho Chehab <mchehab+huawei@kernel.org>
  - Rob Herring <robh@kernel.org>

description: |
  Device-Tree bindings for tilcdc DRM driver

  Required properties:
  - compatible: value should be one of the following:
      - "ti,am33xx-tilcdc" for AM335x based boards
      - "ti,da850-tilcdc" for DA850/AM18x/OMAP-L138 based boards
  - interrupts: the interrupt number
  - reg: base address and size of the LCDC device

  Recommended properties:
  - ti,hwmods: Name of the hwmod associated to the LCDC

  Optional properties:
  - max-bandwidth: The maximum pixels per second that the memory
      interface / lcd controller combination can sustain
  - max-width: The maximum horizontal pixel width supported by
      the lcd controller.
  - max-pixelclock: The maximum pixel clock that can be supported
      by the lcd controller in KHz.
  - blue-and-red-wiring: Recognized values "straight" or "crossed".
      This property deals with the LCDC revision 2 (found on AM335x)
      color errata [1].
      - "straight" indicates normal wiring that supports RGB565,
        BGR888, and XBGR8888 color formats.
      - "crossed" indicates wiring that has blue and red wires
        crossed. This setup supports BGR565, RGB888 and XRGB8888
        formats.
      - If the property is not present or its value is not recognized
        the legacy mode is assumed. This configuration supports RGB565,
        RGB888 and XRGB8888 formats. However, depending on wiring, the red
        and blue colors are swapped in either 16 or 24-bit color modes.

  Optional nodes:

  - port/ports: to describe a connection to an external encoder. The
      binding follows Documentation/devicetree/bindings/graph.txt and
      supports a single port with a single endpoint.

  - See also Documentation/devicetree/bindings/display/tilcdc/panel.txt and
      Documentation/devicetree/bindings/display/bridge/ti,tfp410.yaml for connecting
      tfp410 DVI encoder or lcd panel to lcdc

  [1] There is an errata about AM335x color wiring. For 16-bit color mode
      the wires work as they should (LCD_DATA[0:4] is for Blue[3:7]),
      but for 24 bit color modes the wiring of blue and red components is
      crossed and LCD_DATA[0:4] is for Red[3:7] and LCD_DATA[11:15] is
      for Blue[3-7]. For more details see section 3.1.1 in AM335x
      Silicon Errata:
      https://www.ti.com/general/docs/lit/getliterature.tsp?baseLiteratureNumber=sprz360

properties:
  compatible:
    description: Compatible strings for this controller.
    items:
      - enum: ["ti,am33xx-tilcdc", "ti,da850-tilcdc"]
  reg:
    description: Base address and size of the LCDC device.
    items:
      - description: Base address of LCDC registers.
      - description: Size of the LCDC register region.
  interrupts:
    description: Interrupt number of the LCDC controller.
    items:
      - description: LCDC interrupt.
  interrupt-controller: true
  ti,hwmods:
    description: Name of the hwmod associated to the LCDC.
    $ref: /schemas/types.yaml#/definitions/string
  max-bandwidth:
    description: The maximum pixels per second that the memory interface /
      lcd controller combination can sustain.
    $ref: /schemas/types.yaml#/definitions/uint32
  max-width:
    description: The maximum horizontal pixel width supported by the lcd controller.
    $ref: /schemas/types.yaml#/definitions/uint32
  max-pixelclock:
    description: The maximum pixel clock that can be supported by the lcd controller in KHz.
    $ref: /schemas/types.yaml#/definitions/uint32
  blue-and-red-wiring:
    description: Wiring configuration for LCDC color errata revision 2.
    enum: [straight, crossed]
  ports:
    description: Graph port node to describe a connection to an external encoder.
    type: object
    additionalProperties: false
    patternProperties:
      "^.*$":
        description: Endpoint node.
        type: object
        properties:
          remote-endpoint:
            description: Remote endpoint phandle.
            $ref: /schemas/types.yaml#/definitions/phandle-array
        required:
          - remote-endpoint
        additionalProperties: false

required:
  - compatible
  - reg
  - interrupts
  - interrupt-controller

additionalProperties: false

examples:
  - |
    fb: fb@4830e000 {
      compatible = "ti,am33xx-tilcdc", "ti,da850-tilcdc";
      reg = <0x4830e000 0x1000>;
      interrupts = <36>;
      interrupt-controller;
      ti,hwmods = "lcdc";
      blue-and-red-wiring = "crossed";
      ports {
        lcdc_0: endpoint {
          remote-endpoint = <&hdmi_0>;
        };
      };
    };
```
