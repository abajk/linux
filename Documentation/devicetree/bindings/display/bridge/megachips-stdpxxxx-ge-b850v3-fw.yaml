## Documentation/devicetree/bindings/display/ti/ti,omap5-dss.yaml
```yaml
%YAML 1.2
---
$id: http://devicetree.org/schemas/display/ti/ti,omap5-dss.yaml#
$schema: http://devicetree.org/meta-schemas/core.yaml#

title: Texas Instruments OMAP5 Display Subsystem

maintainers:
  - Peter Ujfalusi <peter.ujfalusi@ti.com>
  - Rob Herring <robh@kernel.org>

description: |
  Texas Instruments OMAP5 Display Subsystem

  See Documentation/devicetree/bindings/display/ti/ti,omap-dss.txt for generic
  description about OMAP Display Subsystem bindings.

properties:
  compatible:
    description: List of compatible strings for the OMAP5 DSS
    items:
      - const: ti,omap5-dss

  reg:
    maxItems: 1

  ti,hwmods:
    description: Hardware modules for DSS core
    $ref: /schemas/types.yaml#/definitions/string-array
    items:
      - const: dss_core

  clocks:
    description: Clock input for DSS core
    maxItems: 1

  clock-names:
    items:
      - const: fck

  DISPC:
    description: Display controller
    type: object
    properties:
      compatible:
        description: List of compatible strings for DISPC
        items:
          - const: ti,omap5-dispc
      reg:
        description: Base address and length of the DISPC register space
        items:
          - description: DISPC registers
      ti,hwmods:
        description: Hardware modules for DISPC
        $ref: /schemas/types.yaml#/definitions/string-array
        items:
          - const: dss_dispc
      interrupts:
        maxItems: 1

      clocks:
        maxItems: 1

      clock-names:
        items:
          - const: fck

      max-memory-bandwidth:
        description: Input memory (from main memory to DISPC) bandwidth limit in bytes per second

    required:
      - compatible
      - reg
      - ti,hwmods
      - interrupts
      - clocks
      - clock-names
    additionalProperties: false

  RFBI:
    description: Raster frame buffer interface
    type: object
    properties:
      compatible:
        description: List of compatible strings for RFBI
        items:
          - const: ti,omap5-rfbi
      reg:
        description: Base address and length of the RFBI register space
        items:
          - description: RFBI registers
      ti,hwmods:
        description: Hardware modules for RFBI
        $ref: /schemas/types.yaml#/definitions/string-array
        items:
          - const: dss_rfbi
      clocks:
        description: Clocks used by RFBI
      clock-names:
        items:
          - const: fck
          - const: ick
    required:
      - compatible
      - reg
      - ti,hwmods
      - clocks
      - clock-names
    additionalProperties: false

  DSI:
    description: Display Serial Interface controller
    type: object
    properties:
      compatible:
        description: List of compatible strings for DSI
        items:
          - const: ti,omap5-dsi
      reg:
        description: Addresses and lengths of the DSI register spaces
        items:
          - description: proto registers
          - description: phy registers
          - description: pll registers
      reg-names:
        items:
          - const: proto
          - const: phy
          - const: pll
      ti,hwmods:
        description: Hardware modules for DSI
        $ref: /schemas/types.yaml#/definitions/string-array
        items:
          - enum: [dss_dsi1, dss_dsi2]
      vdd-supply: true
      clocks:
        description: Clocks used by DSI
      clock-names:
        items:
          - const: fck
          - const: sys_clk
    required:
      - compatible
      - reg
      - reg-names
      - ti,hwmods
      - vdd-supply
      - clocks
      - clock-names
    additionalProperties: false

  HDMI:
    description: HDMI transmitter
    type: object
    properties:
      compatible:
        description: List of compatible strings for HDMI
        items:
          - const: ti,omap5-hdmi
      reg:
        description: Addresses and lengths of the HDMI register spaces
        items:
          - description: wp registers
          - description: pll registers
          - description: phy registers
          - description: core registers
      reg-names:
        items:
          - const: wp
          - const: pll
          - const: phy
          - const: core
      interrupts:
        description: HDMI interrupt line
        $ref: /schemas/types.yaml#/definitions/interrupt-array
      ti,hwmods:
        description: Hardware modules for HDMI
        $ref: /schemas/types.yaml#/definitions/string-array
        items:
          - const: dss_hdmi
      vdda-supply: true
      clocks:
        description: Clocks used by HDMI
      clock-names:
        items:
          - const: fck
          - const: sys_clk
    required:
      - compatible
      - reg
      - reg-names
      - interrupts
      - ti,hwmods
      - vdda-supply
      - clocks
      - clock-names
    additionalProperties: false

required:
  - compatible
  - reg
  - ti,hwmods
  - clocks
  - clock-names
  - DISPC

additionalProperties: false

examples:
  - |
    dss: display-subsystem@4a000000 {
      compatible = "ti,omap5-dss";
      reg = <0x4a000000 0x1000>;
      ti,hwmods = "dss_core";
      clocks = <&fclk>;
      clock-names = "fck";
      DISPC: dispc@4a002000 {
        compatible = "ti,omap5-dispc";
        reg = <0x4a002000 0x1000>;
        ti,hwmods = "dss_dispc";
        interrupts = <72>;
        clocks = <&fclk>;
        clock-names = "fck";
      };
    };
```

## Documentation/devicetree/bindings/display/ti/ti,opa362.yaml
```yaml
# SPDX-License-Identifier: (GPL-2.0-only OR BSD-2-Clause)
# Copyright 2018 Linaro Ltd.
%YAML 1.2
---
$id: http://devicetree.org/schemas/display/ti/ti,opa362.yaml#
$schema: http://devicetree.org/meta-schemas/core.yaml#

title: TI OPA362 analog video amplifier

maintainers:
  - Rob Herring <robh@kernel.org>

description: |
  OPA362 analog video amplifier

properties:
  compatible:
    items:
      - const: "ti,opa362"
    description: Device compatible with TI OPA362 analog video amplifier.

  enable-gpios:
    maxItems: 1
    description: GPIO to enable or disable video output amplifier.

  ports:
    description: Subnode containing input and output endpoints.
    type: object
    additionalProperties: false
    properties:
      "#address-cells":
        const: 1
      "#size-cells":
        const: 0

      port@0:
        description: Input port for the amplifier.
        type: object
        additionalProperties: false
        properties:
          reg:
            items:
              - description: Identifier for input port.
          endpoint@0:
            description: Endpoint connecting amplifier input to video encoder.
            type: object
            additionalProperties: false
            properties:
              remote-endpoint:
                $ref: /schemas/types.yaml#/definitions/phandle
            required:
              - remote-endpoint
        required:
          - reg
          - endpoint@0

      port@1:
        description: Output port for the amplifier.
        type: object
        additionalProperties: false
        properties:
          reg:
            items:
              - description: Identifier for output port.
          endpoint@0:
            description: Endpoint connecting amplifier output to TV connector.
            type: object
            additionalProperties: false
            properties:
              remote-endpoint:
                $ref: /schemas/types.yaml#/definitions/phandle
            required:
              - remote-endpoint
        required:
          - reg
          - endpoint@0

    required:
      - "#address-cells"
      - "#size-cells"
      - port@0
      - port@1

required:
  - compatible
  - enable-gpios
  - ports

additionalProperties: false

examples:
  - |
    tv_amp: opa362 {
      compatible = "ti,opa362";
      enable-gpios = <&gpio1 23 0>;

      ports {
        #address-cells = <1>;
        #size-cells = <0>;

        port@0 {
          reg = <0>;
          opa_in: endpoint@0 {
            remote-endpoint = <&venc_out>;
          };
        };

        port@1 {
          reg = <1>;
          opa_out: endpoint@0 {
            remote-endpoint = <&tv_connector_in>;
          };
        };
      };
    };
```

## Documentation/devicetree/bindings/display/ti/ti,tpd12s015.yaml
```yaml
# SPDX-License-Identifier: (GPL-2.0-only OR BSD-2-Clause)
# Copyright 2025 Linaro Ltd.
%YAML 1.2
---
$id: http://devicetree.org/schemas/display/ti/ti,tpd12s015.yaml#
$schema: http://devicetree.org/meta-schemas/core.yaml#

title: TPD12S015 HDMI level shifter and ESD protection chip

maintainers:
  - Rob Herring <robh@kernel.org>

description: |
  TPD12S015 HDMI level shifter and ESD protection chip

  Required nodes:
  - Video port 0 for HDMI input
  - Video port 1 for HDMI output

properties:
  compatible:
    items:
      - const: ti,tpd12s015

  gpios:
    items:
      - description: CT CP HPD
      - description: LS OE
      - description: HPD

  ports:
    description: Container node for HDMI input and output ports
    type: object
    additionalProperties: false
    properties:
      port@0:
        description: Video port 0 for HDMI input
        type: object
        additionalProperties: false
        properties:
          reg:
            items:
              - description: Port index
          endpoint@0:
            description: HDMI input endpoint
            type: object
            additionalProperties: false
            properties:
              remote-endpoint:
                $ref: /schemas/types.yaml#/definitions/phandle
                description: Remote endpoint for HDMI input
            required:
              - remote-endpoint
        required:
          - reg
          - endpoint@0

      port@1:
        description: Video port 1 for HDMI output
        type: object
        additionalProperties: false
        properties:
          reg:
            items:
              - description: Port index
          endpoint@0:
            description: HDMI output endpoint
            type: object
            additionalProperties: false
            properties:
              remote-endpoint:
                $ref: /schemas/types.yaml#/definitions/phandle
                description: Remote endpoint for HDMI output
            required:
              - remote-endpoint
        required:
          - reg
          - endpoint@0

required:
  - compatible
  - ports

additionalProperties: false

examples:
  - |
    / {
        compatible = "ti,tpd12s015";
        gpios = <&gpio2 28 GPIO_ACTIVE_HIGH>,
                <&gpio2 9 GPIO_ACTIVE_HIGH>,
                <&gpio2 31 GPIO_ACTIVE_HIGH>;

        ports {
            #address-cells = <1>;
            #size-cells = <0>;

            port@0 {
                reg = <0>;
                endpoint@0: tpd12s015_in {
                    remote-endpoint = <&hdmi_out>;
                };
            };

            port@1 {
                reg = <1>;
                endpoint@0: tpd12s015_out {
                    remote-endpoint = <&hdmi_connector_in>;
                };
            };
        };
    };
```
