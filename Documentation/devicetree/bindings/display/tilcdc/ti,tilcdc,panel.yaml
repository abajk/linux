## Documentation/devicetree/bindings/dma/img-pistachio-mdc-dma.yaml
```yaml
# SPDX-License-Identifier: (GPL-2.0-only OR BSD-2-Clause)
%YAML 1.2
---
$id: http://devicetree.org/schemas/img-pistachio-mdc-dma.yaml#
$schema: http://devicetree.org/meta-schemas/core.yaml#

title: IMG Multi-threaded DMA Controller (MDC)

maintainers:
  - Andrew Bresticker <abrestic@chromium.org>

description: |
  * IMG Multi-threaded DMA Controller (MDC)

properties:
  compatible:
    const: img,pistachio-mdc-dma
    description: Must be "img,pistachio-mdc-dma".
  reg:
    items:
      - description: Base address of the MDC registers.
      - description: Length of the MDC registers.
    description: Base address and length of the MDC registers.
  interrupts:
    minItems: 1
    description: Per-channel DMA interrupts.
  clocks:
    maxItems: 1
    description: Must contain an entry for each entry in clock-names.
      See ../clock/clock-bindings.txt for details.
  clock-names:
    items:
      - const: sys
    description: Name of the MDC system interface clock.
  img,cr-periph:
    $ref: /schemas/types.yaml#/definitions/phandle
    description: Phandle to the peripheral control syscon node which
      contains the DMA request to channel mapping registers.
  img,max-burst-multiplier:
    $ref: /schemas/types.yaml#/definitions/uint32
    description: Maximum supported burst size multiplier.
      The maximum burst size is this value multiplied by the hardware-reported bus width.
  '#dma-cells':
    const: 3
    description: Must be 3. The first cell is the peripheral's DMA request line,
      the second cell is a bitmap specifying to which channels the DMA request
      line may be mapped, the third cell is the thread ID to be used by the
      channel.
  dma-channels:
    $ref: /schemas/types.yaml#/definitions/uint32
    minimum: 1
    maximum: 32
    description: Number of supported DMA channels, up to 32.
      If not specified the number reported by the hardware is used.

required:
  - compatible
  - reg
  - interrupts
  - clocks
  - clock-names
  - img,cr-periph
  - img,max-burst-multiplier
  - '#dma-cells'

additionalProperties: false

examples:
  - |
    mdc: dma-controller@18143000 {
        compatible = "img,pistachio-mdc-dma";
        reg = <0x18143000 0x1000>;
        interrupts = <GIC_SHARED 27 IRQ_TYPE_LEVEL_HIGH>,
                     <GIC_SHARED 28 IRQ_TYPE_LEVEL_HIGH>,
                     <GIC_SHARED 29 IRQ_TYPE_LEVEL_HIGH>,
                     <GIC_SHARED 30 IRQ_TYPE_LEVEL_HIGH>,
                     <GIC_SHARED 31 IRQ_TYPE_LEVEL_HIGH>,
                     <GIC_SHARED 32 IRQ_TYPE_LEVEL_HIGH>,
                     <GIC_SHARED 33 IRQ_TYPE_LEVEL_HIGH>,
                     <GIC_SHARED 34 IRQ_TYPE_LEVEL_HIGH>,
                     <GIC_SHARED 35 IRQ_TYPE_LEVEL_HIGH>,
                     <GIC_SHARED 36 IRQ_TYPE_LEVEL_HIGH>;
        clocks = <&system_clk>;
        clock-names = "sys";
        img,max-burst-multiplier = <16>;
        img,cr-periph = <&cr_periph>;
        #dma-cells = <3>;
    };
```

## Documentation/devicetree/bindings/dma/moxa,moxart-dma.yaml
```yaml
# SPDX-License-Identifier: (GPL-2.0-only OR BSD-2-Clause)
%YAML 1.2
---
$id: http://devicetree.org/schemas/dma/moxa,moxart-dma.yaml#
$schema: http://devicetree.org/meta-schemas/core.yaml#

title: Moxa ART DMA Controller

maintainers:
  - Jonas Jensen <jonas.jensen@gmail.com>
  - Sergei Antonov <saproj@gmail.com>

description: |
  MOXA ART DMA Controller

  See dma.txt first

  Clients:

  DMA clients connected to the MOXA ART DMA controller must use the format
  described in the dma.txt file, using a two-cell specifier for each channel:
  a phandle plus one integer cells.
  The two cells in order are:

  1. A phandle pointing to the DMA controller.
  2. Peripheral identifier for the hardware handshaking interface.

properties:
  compatible:
    # Must match the binding compatible string
    items:
      - const: moxa,moxart-dma

  reg:
    # Registers base address and length of the DMA controller
    items:
      - description: DMA registers base address
      - description: DMA registers length

  interrupts:
    # Interrupt specifier for the DMA controller
    items:
      - description: DMA controller interrupt

  '#dma-cells':
    # Number of DMA cells for the request line
    const: 1

required:
  - compatible
  - reg
  - interrupts
  - '#dma-cells'

additionalProperties: false

examples:
  - |
    dma: dma@90500000 {
        compatible = "moxa,moxart-dma";
        reg = <0x90500080 0x40>;
        interrupts = <24 0>;
        #dma-cells = <1>;
    };
```

## Documentation/devicetree/bindings/dma/renesas,nbpfaxi64dmac1b4.yaml
```yaml
# SPDX-License-Identifier: (GPL-2.0-only OR BSD-2-Clause)
# Copyright 2025 Simon Horman <horms+renesas@verge.net.au>
%YAML 1.2
---
$id: http://devicetree.org/schemas/dma/renesas,nbpfaxi64dmac1b4.yaml#
$schema: http://devicetree.org/meta-schemas/core.yaml#

title: Renesas Type-AXI NBPFAXI DMA controller

maintainers:
  - Simon Horman <horms+renesas@verge.net.au>

description: |
  * Renesas "Type-AXI" NBPFAXI* DMA controllers

  * DMA controller

  You can use dma-channels and dma-requests as described in dma.txt, although they
  won't be used, this information is derived from the compatibility string.

  DMA client
  Required properties:
  dmas and dma-names are required, as described in dma.txt.

properties:
  compatible:
    items:
      - enum:
          - renesas,nbpfaxi64dmac1b4
          - renesas,nbpfaxi64dmac1b8
          - renesas,nbpfaxi64dmac1b16
          - renesas,nbpfaxi64dmac4b4
          - renesas,nbpfaxi64dmac4b8
          - renesas,nbpfaxi64dmac4b16
          - renesas,nbpfaxi64dmac8b4
          - renesas,nbpfaxi64dmac8b8
          - renesas,nbpfaxi64dmac8b16
    description: Device compatible strings.

  reg:
    maxItems: 1

  interrupts:
    maxItems: 1 #FIXME
    description: Interrupt specifiers for each DMA slave request (phandle, IRQ, flags).

  '#dma-cells':
    description: Number of cells for DMA specifier (terminal number and flags).
    const: 2

  dma-channels:
    description: Number of DMA channels.
    $ref: /schemas/types.yaml#/definitions/uint32

  dma-requests:
    description: Number of DMA requests.
    $ref: /schemas/types.yaml#/definitions/uint32

  max-burst-mem-read:
    description: Limit for memory read burst size in bytes.
    $ref: /schemas/types.yaml#/definitions/uint32

  max-burst-mem-write:
    description: Limit for memory write burst size in bytes.
    $ref: /schemas/types.yaml#/definitions/uint32

required:
  - compatible
  - reg
  - interrupts
  - '#dma-cells'

additionalProperties: false

examples:
  - |
    dma: dma-controller@48000000 {
        compatible = "renesas,nbpfaxi64dmac8b4";
        reg = <0x48000000 0x400>;
        interrupts = <0 12 0x4
                      0 13 0x4
                      0 14 0x4
                      0 15 0x4
                      0 16 0x4
                      0 17 0x4
                      0 18 0x4
                      0 19 0x4>;
        #dma-cells = <2>;
        dma-channels = <8>;
        dma-requests = <8>;
    };

  - |
    /* DMA client example */
    dmas = <&dma 0 (NBPF_SLAVE_RQ_HIGH | NBPF_SLAVE_RQ_LEVEL)
            &dma 1 (NBPF_SLAVE_RQ_HIGH | NBPF_SLAVE_RQ_LEVEL)>;
    dma-names = "rx", "tx";
```

## Documentation/devicetree/bindings/dma/socionext,milbeaut-m10v-hdmac.yaml
```yaml
# SPDX-License-Identifier: (GPL-2.0-only OR BSD-2-Clause)
# Copyright 2025 Linaro Ltd.
%YAML 1.2
---
$id: http://devicetree.org/schemas/socionext,milbeaut-m10v-hdmac.yaml#
$schema: http://devicetree.org/meta-schemas/core.yaml#

title: Socionext Milbeaut M10V HDMAC
maintainers:
  - Jassi Brar <jaswinder.singh@linaro.org>

description: |
  * Milbeaut AHB DMA Controller

  Milbeaut AHB DMA controller has transfer capability below.
   - device to memory transfer
   - memory to device transfer

properties:
  compatible:
    items:
      - const: socionext,milbeaut-m10v-hdmac
  reg:
    items:
      - description: DMA registers location and length
  interrupts:
    description: Per-channel DMA interrupts
    items:
      description: DMA channel interrupt
    minItems: 2
    maxItems: 8
  '#dma-cells':
    description: DMA slave ID
    const: 1
  clocks:
    description: Clock for HDMAC module
    maxItems: 1

required:
  - compatible
  - reg
  - interrupts
  - '#dma-cells'
  - clocks

additionalProperties: false

examples:
  - |
    hdmac1: dma-controller@1e110000 {
      compatible = "socionext,milbeaut-m10v-hdmac";
      reg = <0x1e110000 0x10000>;
      interrupts = <0 132 4>,
                   <0 133 4>,
                   <0 134 4>,
                   <0 135 4>,
                   <0 136 4>,
                   <0 137 4>,
                   <0 138 4>,
                   <0 139 4>;
      #dma-cells = <1>;
      clocks = <&dummy_clk>;
    };
```

## Documentation/devicetree/bindings/dma/socionext,milbeaut-m10v-xdmac.yaml
```yaml
# SPDX-License-Identifier: (GPL-2.0-only OR BSD-2-Clause)
# Copyright 2025 Jassi Brar <jaswinder.singh@linaro.org>
%YAML 1.2
---
$id: http://devicetree.org/schemas/dma/socionext,milbeaut-m10v-xdmac.yaml#
$schema: http://devicetree.org/meta-schemas/core.yaml#

title: Milbeaut AXI DMA Controller
maintainers:
  - Jassi Brar <jaswinder.singh@linaro.org>

description: |
  * Milbeaut AXI DMA Controller

  Milbeaut AXI DMA controller has only memory to memory transfer capability.

  * DMA controller

properties:
  compatible:
    items:
      - const: socionext,milbeaut-m10v-xdmac

  reg:
    description: DMA registers location and length
    items:
      - description: DMA register region start address
      - description: DMA register region length

  interrupts:
    description: Per-channel DMA interrupts
    items:
      description: Interrupt specifier tuple (interrupt-parent, IRQ number, flags)
    minItems: 2
    maxItems: 8

  '#dma-cells':
    description: Number of DMA cells
    const: 1

required:
  - compatible
  - reg
  - interrupts
  - '#dma-cells'

additionalProperties: false

examples:
  - |
    xdmac0: dma-controller@1c250000 {
        compatible = "socionext,milbeaut-m10v-xdmac";
        reg = <0x1c250000 0x1000>;
        interrupts = <0 17 0x4>,
                     <0 18 0x4>,
                     <0 19 0x4>,
                     <0 20 0x4>;
        #dma-cells = <1>;
    };
```

## Documentation/devicetree/bindings/dma/st,stih407-fdma-mpe31-11.yaml
```yaml
# SPDX-License-Identifier: (GPL-2.0-only OR BSD-2-Clause)
# Copyright 2025 Linaro Ltd.
%YAML 1.2
---
$id: http://devicetree.org/schemas/dma/st,stih407-fdma-mpe31-11.yaml#
$schema: http://devicetree.org/meta-schemas/core.yaml#

title: STMicroelectronics Flexible Direct Memory Access Controller

maintainers:
  - Peter Griffin <peter.griffin@linaro.org>
  - Rob Herring <robh@kernel.org>

description: |
  STMicroelectronics Flexible Direct Memory Access Device Tree bindings

  The FDMA is a general-purpose direct memory access controller capable of
  supporting 16 independent DMA channels. It accepts up to 32 DMA requests.
  The FDMA is based on a Slim processor which requires a firmware.

  See: Documentation/devicetree/bindings/clock/clock-bindings.txt

properties:
  compatible:
    oneOf:
      - items:
          - enum:
              - st,stih407-fdma-mpe31-11
              - st,stih407-fdma-mpe31-12
              - st,stih407-fdma-mpe31-13
          - const: st,slim-rproc
      - items:
          - const: st,slim-rproc

  reg:
    items:
      - description: slimcore registers
      - description: data memory registers
      - description: peripherals registers
      - description: instruction memory registers

  reg-names:
    items:
      - const: slimcore
      - const: dmem
      - const: peripherals
      - const: imem

  interrupts:
    description: Interrupt line shared by all DMA channels
    items:
      - description: DMA controller interrupt

  clocks:
    description: Clock phandles for each FDMA region
    items:
      - description: slimcore clock
      - description: data memory clock
      - description: peripherals clock
      - description: instruction memory clock

  dma-channels:
    description: Number of DMA channels supported by the controller
    $ref: /schemas/types.yaml#/definitions/uint32

  '#dma-cells':
    description: Number of cells used to specify a DMA request
    const: 3

required:
  - compatible
  - reg
  - reg-names
  - interrupts
  - clocks
  - dma-channels
  - '#dma-cells'

additionalProperties: false

examples:
  - |
    fdma0: dma-controller@8e20000 {
      compatible = "st,stih407-fdma-mpe31-11", "st,slim-rproc";
      reg = <0x8e20000 0x8000>,
            <0x8e30000 0x3000>,
            <0x8e37000 0x1000>,
            <0x8e38000 0x8000>;
      reg-names = "slimcore", "dmem", "peripherals", "imem";
      clocks = <&clk_s_c0_flexgen CLK_FDMA>,
               <&clk_s_c0_flexgen CLK_EXT2F_A9>,
               <&clk_s_c0_flexgen CLK_EXT2F_A9>,
               <&clk_s_c0_flexgen CLK_EXT2F_A9>;
      interrupts = <GIC_SPI 5 IRQ_TYPE_NONE>;
      dma-channels = <16>;
      #dma-cells = <3>;
    };
```

## Documentation/devicetree/bindings/dma/ti,dra7-dma-crossbar.yaml
```yaml
# SPDX-License-Identifier: (GPL-2.0-only OR BSD-2-Clause)
%YAML 1.2
---
$id: http://devicetree.org/schemas/dma/ti,dra7-dma-crossbar.yaml#
$schema: http://devicetree.org/meta-schemas/core.yaml#

title: TI DMA Crossbar

maintainers:
  - Deming Wang <wangdeming@inspur.com>
  - Peter Ujfalusi <peter.ujfalusi@ti.com>
  - Rob Herring <robh@kernel.org>
  - Yu-Chun Lin <eleanor15x@gmail.com>

description: |
  Texas Instruments DMA Crossbar (DMA request router)

  The DMA controller node need to have the following properties:
  - dma-requests: Number of DMA requests the controller can handle

  Notes:
  When requesting channel via ti,dra7-dma-crossbar, the DMA client must request
  the DMA event number as crossbar ID (input to the DMA crossbar).

  For ti,am335x-edma-crossbar: the meaning of parameters of dmas for clients:
  dmas = <&edma_xbar 12 0 1>; where <12> is the DMA request number, <0> is the TC
  the event should be assigned and <1> is the mux selection for in the crossbar.
  When mux 0 is used the DMA channel can be requested directly from edma node.

properties:
  compatible:
    enum:
      - ti,dra7-dma-crossbar
      - ti,am335x-edma-crossbar

  reg:
    maxItems: 1

  '#dma-cells':
    description: Number of cells in the DMA specifier.
    $ref: /schemas/types.yaml#/definitions/uint32

  dma-requests:
    description: Number of DMA requests the crossbar can receive.
    $ref: /schemas/types.yaml#/definitions/uint32

  dma-masters:
    description: Phandle to the DMA controller.
    $ref: /schemas/types.yaml#/definitions/phandle-array

  ti,dma-safe-map:
    description: Safe routing value for unused DMA request lines.
    $ref: /schemas/types.yaml#/definitions/uint32

  ti,reserved-dma-request-ranges:
    description: DMA request ranges that must not be used when mapping inputs.
    $ref: /schemas/types.yaml#/definitions/uint32-matrix
    items:
      items:
        - description: Start of DMA request range
        - description: Count of DMA requests in the range

required:
  - compatible
  - reg
  - '#dma-cells'
  - dma-requests
  - dma-masters

additionalProperties: false

examples:
  - |
    dma-router@4a002b78 {
      compatible = "ti,dra7-dma-crossbar";
      reg = <0x4a002b78 0xfc>;
      #dma-cells = <1>;
      dma-requests = <205>;
      ti,dma-safe-map = <0>;
      ti,reserved-dma-request-ranges = <10 5>, <100 27>;
      dma-masters = <&sdma>;
    };
```
