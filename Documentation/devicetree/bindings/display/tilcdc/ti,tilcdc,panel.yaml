## Documentation/devicetree/bindings/display/tilcdc/ti,tilcdc,panel.yaml
```yaml
# SPDX-License-Identifier: (GPL-2.0-only OR BSD-2-Clause)
# Copyright 2025 Rob Herring <robh@kernel.org>
# Copyright 2025 Yegor Yefremov <yegorslists@googlemail.com>
%YAML 1.2
---
$id: http://devicetree.org/schemas/display/tilcdc/ti,tilcdc,panel.yaml#
$schema: http://devicetree.org/meta-schemas/core.yaml#

title: TI LCDC panel

maintainers:
  - Rob Herring <robh@kernel.org>
  - Yegor Yefremov <yegorslists@googlemail.com>

description: |
  Generic panel output driver for TI LCDC

properties:
  compatible:
    description: Compatible string identifying the panel driver
    items:
      - const: ti,tilcdc,panel

  panel-info:
    description: Configuration info to configure LCDC correctly for the panel
    type: object
    properties:
      ac-bias:
        description: AC Bias Pin Frequency
        $ref: /schemas/types.yaml#/definitions/uint32
      ac-bias-intrpt:
        description: AC Bias Pin Transitions per Interrupt
        $ref: /schemas/types.yaml#/definitions/uint32
      dma-burst-sz:
        description: DMA burst size
        $ref: /schemas/types.yaml#/definitions/uint32
      bpp:
        description: Bits per pixel
        $ref: /schemas/types.yaml#/definitions/uint32
      fdd:
        description: FIFO DMA Request Delay
        $ref: /schemas/types.yaml#/definitions/uint32
      sync-edge:
        description: "Horizontal and Vertical Sync Edge: 0=rising 1=falling"
        $ref: /schemas/types.yaml#/definitions/uint32
      sync-ctrl:
        description: "Horizontal and Vertical Sync Control: 0=ignore"
        $ref: /schemas/types.yaml#/definitions/uint32
      raster-order:
        description: "Raster Data Order Select: 1=Most-to-least 0=Least-to-most"
        $ref: /schemas/types.yaml#/definitions/uint32
      fifo-th:
        description: DMA FIFO threshold
        $ref: /schemas/types.yaml#/definitions/uint32
    additionalProperties: false
    required:
      - ac-bias
      - ac-bias-intrpt
      - dma-burst-sz
      - bpp
      - fdd
      - sync-edge
      - sync-ctrl
      - raster-order
      - fifo-th

  display-timings:
    description: |
      Typical videomode of lcd panel. Multiple video modes can be listed if the panel
      supports multiple timings, but the 'native-mode' should be the preferred/default resolution.
      Refer to Documentation/devicetree/bindings/display/panel/display-timing.txt
      for display timing binding details.
    $ref: /schemas/display/panel/display-timings.yaml#

  backlight:
    description: Phandle of the backlight device attached to the panel
    $ref: /schemas/types.yaml#/definitions/phandle

  enable-gpios:
    description: GPIO pin to enable or disable the panel
    maxItems: 1

required:
  - compatible
  - panel-info
  - display-timings

additionalProperties: false

examples:
  - |
    lcd3 {
      compatible = "ti,tilcdc,panel";
      pinctrl-names = "default";
      pinctrl-0 = <&bone_lcd3_cape_lcd_pins>;
      backlight = <&backlight>;
      enable-gpios = <&gpio3 19 0>;

      panel-info {
        ac-bias = <255>;
        ac-bias-intrpt = <0>;
        dma-burst-sz = <16>;
        bpp = <16>;
        fdd = <0x80>;
        sync-edge = <0>;
        sync-ctrl = <1>;
        raster-order = <0>;
        fifo-th = <0>;
      };
      display-timings {
        native-mode = <&timing0>;
        timing0: 320x240 {
          hactive = <320>;
          vactive = <240>;
          hback-porch = <21>;
          hfront-porch = <58>;
          hsync-len = <47>;
          vback-porch = <11>;
          vfront-porch = <23>;
          vsync-len = <2>;
          clock-frequency = <8000000>;
          hsync-active = <0>;
          vsync-active = <0>;
        };
      };
    };
```

## Documentation/devicetree/bindings/display/via-vt8500-fb.yaml
```yaml
# SPDX-License-Identifier: (GPL-2.0-only OR BSD-2-Clause)
%YAML 1.2
---
$id: http://devicetree.org/schemas/display/via-vt8500-fb.yaml#
$schema: http://devicetree.org/meta-schemas/core.yaml#

title: VIA VT8500 Framebuffer

maintainers:
  - Rob Herring <robh@kernel.org>

description: |
  VIA VT8500 Framebuffer

properties:
  compatible:
    items:
      - const: via,vt8500-fb

  reg:
    maxItems: 1

  interrupts:
    maxItems: 1

  bits-per-pixel:
    description: Framebuffer bit depth
    $ref: /schemas/types.yaml#/definitions/uint32
    enum: [16, 32]

  display-timings:
    description: Display timings sub-node
    $ref: /schemas/display/panel/display-timings.yaml#
    unevaluatedProperties: false

required:
  - compatible
  - reg
  - interrupts
  - bits-per-pixel
  - display-timings

additionalProperties: false

examples:
  - |
    fb@d8050800 {
      compatible = "via,vt8500-fb";
      reg = <0xd800e400 0x400>;
      interrupts = <12>;
      bits-per-pixel = <16>;

      display-timings {
        native-mode = <&timing0>;
        timing0: 800x480 {
          clock-frequency = <0>;
          hactive = <800>;
          vactive = <480>;
          hfront-porch = <40>;
          hback-porch = <88>;
          hsync-len = <0>;
          vback-porch = <32>;
          vfront-porch = <11>;
          vsync-len = <1>;
        };
      };
    };
```

## Documentation/devicetree/bindings/display/wm,prizm-ge-rops.yaml
```yaml
# SPDX-License-Identifier: (GPL-2.0-only OR BSD-2-Clause)
# Copyright 2018 Linaro Ltd.
%YAML 1.2
---
$id: http://devicetree.org/schemas/wm,prizm-ge-rops.yaml#
$schema: http://devicetree.org/meta-schemas/core.yaml#

title: VIA/Wondermedia Graphics Engine Controller

maintainers:
  - Rob Herring <robh@kernel.org>

description: |
  VIA/Wondermedia Graphics Engine Controller
  -----------------------------------------------------

properties:
  compatible:
    description: Device compatible identifier.
    items:
      - const: wm,prizm-ge-rops

  reg:
    description: Physical address and length of the register region.
    items:
      - description: Address of register region
      - description: Size of register region

required:
  - compatible
  - reg

additionalProperties: false

examples:
  - |
    ge_rops@d8050400 {
        compatible = "wm,prizm-ge-rops";
        reg = <0xd8050400 0x100>;
    };
```

## Documentation/devicetree/bindings/display/wm,wm8505-fb.yaml
```yaml
%YAML 1.2
---
$id: http://devicetree.org/schemas/display/wm,wm8505-fb.yaml#
$schema: http://devicetree.org/meta-schemas/core.yaml#

title: Wondermedia WM8505 Framebuffer

description: |
  Wondermedia WM8505 Framebuffer

  Required subnodes:
  - display-timings: see display-timing.txt for information

maintainers:
  - Rob Herring <robh@kernel.org>

properties:
  compatible:
    description: Compatible string for the WM8505 framebuffer.
    items:
      - const: wm,wm8505-fb

  reg:
    description: Framebuffer register region; list contains one element with base address and size.
    items:
      - description: Base address and length of the framebuffer region.

  bits-per-pixel:
    description: Bit depth of the framebuffer; valid values are 16 or 32.
    $ref: /schemas/types.yaml#/definitions/uint32
    enum: [16, 32]

  display-timings:
    description: Subnode containing display timing information.
    $ref: /schemas/display/panel/display-timings.yaml#

required:
  - compatible
  - reg
  - bits-per-pixel

additionalProperties: false

examples:
  - |
    fb@d8051700 {
        compatible = "wm,wm8505-fb";
        reg = <0xd8051700 0x200>;
        bits-per-pixel = <16>;

        display-timings {
            native-mode = <&timing0>;
            timing0: 800x480 {
                clock-frequency = <0>; /* unused but required */
                hactive = <800>;
                vactive = <480>;
                hfront-porch = <40>;
                hback-porch = <88>;
                hsync-len = <0>;
                vback-porch = <32>;
                vfront-porch = <11>;
                vsync-len = <1>;
            };
        };
    };
```

## Documentation/devicetree/bindings/dma/apm-xgene-dma.yaml
```yaml
# SPDX-License-Identifier: (GPL-2.0-only OR BSD-2-Clause)
# Copyright 2025 Rameshwar Prasad Sahu <rsahu@apm.com>
%YAML 1.2
---
$id: http://devicetree.org/schemas/dma/apm-xgene-dma.yaml#
$schema: http://devicetree.org/meta-schemas/core.yaml#

title: APM X-Gene SoC DMA nodes

maintainers:
  - Rameshwar Prasad Sahu <rsahu@apm.com>

description: |
  Applied Micro X-Gene SoC DMA nodes

  DMA nodes are defined to describe on-chip DMA interfaces in APM X-Gene SoC.

properties:
  compatible:
    # list of compatible strings
    items:
      - const: apm,xgene-dma

  device_type:
    const: dma
    description: Must be set to "dma".

  reg:
    # register address spaces for DMA interface in order
    items:
      - description: DMA control and status register address space
      - description: Descriptor ring control and status register address space
      - description: Descriptor ring command register address space
      - description: SoC efuse register address space

  interrupts:
    # interrupt lines for DMA interface
    items:
      - description: DMA error reporting interrupt
      - description: DMA channel 0 completion interrupt
      - description: DMA channel 1 completion interrupt
      - description: DMA channel 2 completion interrupt
      - description: DMA channel 3 completion interrupt

  clocks:
    # DMA clock
    maxItems: 1
    description: Reference to the DMA clock.

  dma-coherent:
    description: Indicates that DMA operations are coherent.
    type: boolean

required:
  - compatible
  - device_type
  - reg
  - interrupts
  - clocks

additionalProperties: false

examples:
  - |
    dma@1f270000 {
      compatible = "apm,xgene-dma";
      device_type = "dma";
      reg = <0x0 0x1f270000 0x0 0x10000>,
            <0x0 0x1f200000 0x0 0x10000>,
            <0x0 0x1b000000 0x0 0x400000>,
            <0x0 0x1054a000 0x0 0x100>;
      interrupts = <0x0 0x82 0x4>,
                   <0x0 0xb8 0x4>,
                   <0x0 0xb9 0x4>,
                   <0x0 0xba 0x4>,
                   <0x0 0xbb 0x4>;
      dma-coherent;
      clocks = <&dmaclk 0>;
    };
```

## Documentation/devicetree/bindings/dma/fsl,mpc5121-dma.yaml
```yaml
# SPDX-License-Identifier: (GPL-2.0-only OR BSD-2-Clause)
%YAML 1.2
---
$id: http://devicetree.org/schemas/dma/fsl,mpc5121-dma.yaml#
$schema: http://devicetree.org/meta-schemas/core.yaml#

title: Freescale MPC512x and MPC8308 DMA Controller

maintainers:
  - Alexander Popov <a13xp0p0v88@gmail.com>

description: |
  * Freescale MPC512x and MPC8308 DMA Controller

  The DMA controller in Freescale MPC512x and MPC8308 SoCs can move
  blocks of memory contents between memory and peripherals or
  from memory to memory.

  Refer to "Generic DMA Controller and DMA request bindings" in
  the dma/dma.txt file for a more detailed description of binding.

properties:
  compatible:
    items:
      - const: fsl,mpc5121-dma
      - const: fsl,mpc8308-dma

  reg:
    description: "DMA controller registers: base address and size."
    items:
      - description: DMA controller register region

  interrupts:
    description: Interrupt specifier for this DMA controller.
    items:
      - description: DMA controller interrupt

  '#dma-cells':
    description: The length of the DMA specifier; must be 1.
    const: 1

required:
  - compatible
  - reg
  - interrupts
  - '#dma-cells'

additionalProperties: false

examples:
  - |
    dma0: dma@14000 {
        compatible = "fsl,mpc5121-dma";
        reg = <0x14000 0x1800>;
        interrupts = <65 0x8>;
        #dma-cells = <1>;
    };
```

## Documentation/devicetree/bindings/dma/hisilicon,k3-dma-1.0.yaml
```yaml
# SPDX-License-Identifier: (GPL-2.0-only OR BSD-2-Clause)
%YAML 1.2
---
$id: http://devicetree.org/schemas/hisilicon,k3-dma-1.0.yaml#
$schema: http://devicetree.org/meta-schemas/core.yaml#

title: Hisilicon K3 DMA controller

maintainers:
  - Youlin Wang <wwx575822@notesmail.huawei.com>
  - Zhangfei Gao <zhangfei.gao@linaro.org>

properties:
  compatible:
    items:
      - enum:
          - hisilicon,k3-dma-1.0
          - hisilicon,hisi-pcm-asp-dma-1.0

  reg:
    maxItems: 1

  interrupts:
    description: Interrupt shared by all channels.
    items:
      - description: Interrupt parent phandle
      - description: Interrupt specifier (IRQ number)
      - description: Interrupt flags

  '#dma-cells':
    const: 1

  dma-channels:
    description: Number of physical DMA channels supported.

  dma-requests:
    description: Number of virtual DMA request lines supported.

  clocks:
    maxItems: 1

required:
  - compatible
  - reg
  - interrupts
  - '#dma-cells'
  - dma-channels
  - dma-requests
  - clocks

additionalProperties: false

examples:
  - |
    dma0: dma@fcd02000 {
        compatible = "hisilicon,k3-dma-1.0";
        reg = <0xfcd02000 0x1000>;
        #dma-cells = <1>;
        dma-channels = <16>;
        dma-requests = <27>;
        interrupts = <0 12 4>;
        clocks = <&pclk>;
    };
```
