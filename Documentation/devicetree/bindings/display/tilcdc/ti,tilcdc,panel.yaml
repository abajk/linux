## Documentation/devicetree/bindings/dma/ti,edma3-tpcc.yaml
```yaml
# SPDX-License-Identifier: (GPL-2.0-only OR BSD-2-Clause)
# Copyright 2018 Linaro Ltd.
%YAML 1.2
---
$id: http://devicetree.org/schemas/dma/ti,edma3-tpcc.yaml#
$schema: http://devicetree.org/meta-schemas/core.yaml#

title: TI eDMA3 Channel Controller

maintainers:
  - Johan Hovold <johan@kernel.org>
  - Lokesh Vutla <lokeshvutla@ti.com>
  - Marco Franchi <marco.franchi@nxp.com>
  - Matt Porter <mdp@ti.com>
  - Mauro Carvalho Chehab <mchehab+huawei@kernel.org>
  - Peter Ujfalusi <peter.ujfalusi@ti.com>
  - Robert P. J. Day <rpjday@crashcourse.ca>
  - Rob Herring <robh@kernel.org>
  - Thomas Gleixner <tglx@linutronix.de>

description: |
  Texas Instruments eDMA

  The eDMA3 consists of two components: Channel controller (CC) and Transfer
  Controller(s) (TC). The CC is the main entry for DMA users since it is
  responsible for the DMA channel handling, while the TCs are responsible to
  execute the actual DMA transfer.

  ------------------------------------------------------------------------------
  eDMA3 Channel Controller

  ------------------------------------------------------------------------------
  eDMA3 Transfer Controller

  ------------------------------------------------------------------------------
  DEPRECATED binding, new DTS files must use the ti,edma3-tpcc/ti,edma3-tptc
  binding.

properties:
  compatible:
    oneOf:
      - items:
          - enum:
              - ti,edma3-tpcc
      - items:
          - enum:
              - ti,k2g-edma3-tpcc
              - ti,edma3-tpcc

  reg:
    maxItems: 1

  reg-names:
    items:
      - const: edma3_cc

  interrupts:
    items:
      - description: Channel controller interrupt (CCINT)
      - description: Memory protection interrupt (MPERR)
      - description: Error interrupt (CCERRINT)

  interrupt-names:
    items:
      - const: edma3_ccint
      - const: edma3_mperr
      - const: edma3_ccerrint

  '#dma-cells':
    const: 2

  dma-requests:
    description: Number of DMA request lines exposed by the CC
    $ref: /schemas/types.yaml#/definitions/uint32

  ti,hwmods:
    description: HW module names associated with this CC
    $ref: /schemas/types.yaml#/definitions/string-array

  ti,tptcs:
    description: List of transfer controllers (TC) and their priorities
    items:
      $ref: /schemas/types.yaml#/definitions/phandle

  ti,edma-memcpy-channels:
    description: Channels reserved for software‐triggered memcpy
    $ref: /schemas/types.yaml#/definitions/uint32-array

  ti,edma-reserved-slot-ranges:
    description: PaRAM slot ranges reserved for other masters
    items:
      - $ref: /schemas/types.yaml#/definitions/uint32-array
        items:
          - description: First slot number
          - description: Number of consecutive slots

  dma-channel-mask:
    description: Mask of channels usable by clients
    $ref: /schemas/types.yaml#/definitions/uint32-array
    items:
      - description: Mask for channels 0–31
      - description: Mask for channels 32–63

required:
  - compatible
  - reg
  - interrupts
  - '#dma-cells'

additionalProperties: false

examples:
  - |
    edma: edma@49000000 {
        compatible = "ti,edma3-tpcc";
        ti,hwmods = "tpcc";
        reg = <0x49000000 0x10000>;
        reg-names = "edma3_cc";
        interrupts = <12 13 14>;
        interrupt-names = "edma3_ccint", "edma3_mperr", "edma3_ccerrint";
        #dma-cells = <2>;
        ti,tptcs = <&edma_tptc0 7>, <&edma_tptc1 7>, <&edma_tptc2 0>;
        ti,edma-memcpy-channels = <20 21>;
        ti,edma-reserved-slot-ranges = <35 10>, <100 10>;
        dma-channel-mask = <0xffffffff 0xffffe007>;
        dma-requests = <64>;
    };
```

## Documentation/devicetree/bindings/dma/xilinx/xlnx,axi-vdma-1.00.a.yaml
```yaml
# SPDX-License-Identifier: (GPL-2.0-only OR BSD-2-Clause)
%YAML 1.2
---
$id: http://devicetree.org/schemas/dma/xilinx/xlnx,axi-vdma-1.00.a.yaml#
$schema: http://devicetree.org/meta-schemas/core.yaml#

title: Xilinx AXI DMA Controller

maintainers:
  - Andrea Merello <andrea.merello@gmail.com>
  - Eric Engestrom <eric@engestrom.ch>
  - Kedareswara rao Appana <appana.durga.rao@xilinx.com>
  - Radhey Shyam Pandey <radhey.shyam.pandey@amd.com>
  - Radhey Shyam Pandey <radhey.shyam.pandey@xilinx.com>
  - Srikanth Thokala <sthokal@xilinx.com>

description: |
  Xilinx AXI VDMA engine, it does transfers between memory and video devices.
  It can be configured to have one channel or two channels. If configured
  as two channels, one is to transmit to the video device and another is
  to receive from the video device.

  Xilinx AXI DMA engine, it does transfers between memory and AXI4 stream
  target devices. It can be configured to have one channel or two channels.
  If configured as two channels, one is to transmit to the device and another
  is to receive from the device.

  Xilinx AXI CDMA engine, it does transfers between memory-mapped source
  address and a memory-mapped destination address.

  Xilinx AXI MCDMA engine, it does transfer between memory and AXI4 stream
  target devices. It can be configured to have up to 16 independent transmit
  and receive channels.

properties:
  compatible:
    oneOf:
      - items:
          - const: xlnx,axi-vdma-1.00.a
      - items:
          - const: xlnx,axi-dma-1.00.a
      - items:
          - const: xlnx,axi-cdma-1.00.a
      - items:
          - const: xlnx,axi-mcdma-1.00.a

  '#dma-cells':
    description: Number of DMA cells
    const: 1

  reg:
    items:
      - description: Register base address
      - description: Register size in bytes

  xlnx,addrwidth:
    description: The DMA addressing size in bits
    $ref: /schemas/types.yaml#/definitions/uint32

  dma-ranges:
    items:
      - description: DMA address
      - description: CPU address
      - description: Maximum transfer length

  clocks:
    maxItems: 5
    description: Input clocks for the DMA engine

  clock-names:
    items:
      - const: s_axi_lite_aclk
      - const: m_axi_mm2s_aclk
      - const: m_axi_s2mm_aclk
      - const: m_axi_sg_aclk
      - const: m_axis_mm2s_aclk
      - const: s_axis_s2mm_aclk

  xlnx,num-fstores:
    description: Number of framebuffers (VDMA only)
    $ref: /schemas/types.yaml#/definitions/uint32

  xlnx,flush-fsync:
    description: Flush on frame sync setting (VDMA only)
    $ref: /schemas/types.yaml#/definitions/uint32

  xlnx,sg-length-width:
    description: Length width of SG register in bits (AXI DMA and MCDMA only)
    $ref: /schemas/types.yaml#/definitions/uint32

  xlnx,axistream-connected:
    description: Whether DMA is connected to AXI Stream IP (AXI DMA only)
    type: boolean

  xlnx,irq-delay:
    description: Interrupt delay timeout value (AXI DMA only)
    $ref: /schemas/types.yaml#/definitions/uint32

  dmas:
    description: List of DMA controllers and channel IDs (DMA clients only)
    $ref: /schemas/types.yaml#/definitions/phandle-array

  dma-names:
    description: DMA channel names (DMA clients only)
    $ref: /schemas/types.yaml#/definitions/string-array

required:
  - compatible
  - '#dma-cells'
  - reg

additionalProperties: false

examples:
  - |
    axi_vdma_0: axivdma@40030000 {
      compatible = "xlnx,axi-vdma-1.00.a";
      #dma-cells = <1>;
      reg = <0x40030000 0x10000>;
      dma-ranges = <0x00000000 0x00000000 0x40000000>;
      xlnx,num-fstores = <0x8>;
      xlnx,flush-fsync = <0x1>;
      xlnx,addrwidth = <0x20>;
      clocks = <&clk 0>, <&clk 1>, <&clk 2>, <&clk 3>, <&clk 4>;
      clock-names = "s_axi_lite_aclk", "m_axi_mm2s_aclk", "m_axi_s2mm_aclk",
                    "m_axi_sg_aclk", "m_axis_mm2s_aclk", "s_axis_s2mm_aclk";
      dma-channel@40030000 {
        compatible = "xlnx,axi-vdma-mm2s-channel";
        interrupts = <0 54 4>;
        xlnx,datawidth = <0x40>;
      };
      dma-channel@40030030 {
        compatible = "xlnx,axi-vdma-s2mm-channel";
        interrupts = <0 53 4>;
        xlnx,datawidth = <0x40>;
      };
    };
  - |
    vdmatest_0: vdmatest@0 {
      compatible = "xlnx,axi-vdma-test-1.00.a";
      dmas = <&axi_vdma_0 0 &axi_vdma_0 1>;
      dma-names = "vdma0", "vdma1";
    };
```

## Documentation/devicetree/bindings/edac/apm-xgene-edac.yaml
```yaml
# SPDX-License-Identifier: (GPL-2.0-only OR BSD-2-Clause)
# Copyright 2025 APM
%YAML 1.2
---
$id: http://devicetree.org/schemas/edac/apm-xgene-edac.yaml#
$schema: http://devicetree.org/meta-schemas/core.yaml#

title: APM X-Gene SoC EDAC node

maintainers:
  - Arnd Bergmann <arnd@arndb.de>
  - Loc Ho <lho@apm.com>

description: |
  APM X-Gene SoC EDAC node

  EDAC node is defined to describe on-chip error detection and correction.

  The following error types are supported:
    memory controller - Memory controller
    PMD (L1/L2)        - Processor module unit (PMD) L1/L2 cache
    L3                 - L3 cache controller
    SoC                - SoC IPs such as Ethernet, SATA, etc

  The following section describes the EDAC DT node binding.

properties:
  compatible:
    items:
      - const: apm,xgene-edac

  regmap-csw:
    description: Regmap of the CPU switch fabric (CSW) resource.
    $ref: /schemas/types.yaml#/definitions/phandle

  regmap-mcba:
    description: Regmap of the MCB-A (memory bridge) resource.
    $ref: /schemas/types.yaml#/definitions/phandle

  regmap-mcbb:
    description: Regmap of the MCB-B (memory bridge) resource.
    $ref: /schemas/types.yaml#/definitions/phandle

  regmap-efuse:
    description: Regmap of the PMD efuse resource.
    $ref: /schemas/types.yaml#/definitions/phandle

  regmap-rb:
    description: Regmap of the register bus resource (optional for compatibility).
    $ref: /schemas/types.yaml#/definitions/phandle

  reg:
    description: First resource shall be the CPU bus (PCP) resource.
    items:
      - description: CPU bus (PCP) resource

  interrupts:
    description: Interrupt-specifier for MCU, PMD, L3, or SoC error IRQ(s).
    items:
      - description: MCU error IRQ
      - description: PMD error IRQ
      - description: L3 error IRQ
      - description: SoC error IRQ
    minItems: 1

required:
  - compatible
  - regmap-csw
  - regmap-mcba
  - regmap-mcbb
  - regmap-efuse
  - reg
  - interrupts

# Child-node bindings
patternProperties:
  '^edacmc@.*$':
    $ref: '#/definitions/edac-mc'
  '^edacpmd@.*$':
    $ref: '#/definitions/edac-pmd'
  '^edacl3@.*$':
    $ref: '#/definitions/edac-l3'
  '^edacsoc@.*$':
    $ref: '#/definitions/edac-soc'

additionalProperties: false

definitions:
  edac-mc:
    type: object
    description: Memory controller subnode
    properties:
      compatible:
        items:
          - const: apm,xgene-edac-mc
      reg:
        description: Memory controller unit (MCU) resource.
        items:
          - description: MCU resource
      memory-controller:
        description: Instance number of the memory controller.
        $ref: /schemas/types.yaml#/definitions/uint32
    required:
      - compatible
      - reg
      - memory-controller
    additionalProperties: false

  edac-pmd:
    type: object
    description: PMD subnode
    properties:
      compatible:
        oneOf:
          - items:
              - const: apm,xgene-edac-pmd
          - items:
              - const: apm,xgene-edac-pmd-v2
      reg:
        description: PMD resource.
        items:
          - description: PMD resource
      pmd-controller:
        description: Instance number of the PMD controller.
        $ref: /schemas/types.yaml#/definitions/uint32
    required:
      - compatible
      - reg
      - pmd-controller
    additionalProperties: false

  edac-l3:
    type: object
    description: L3 subnode
    properties:
      compatible:
        oneOf:
          - items:
              - const: apm,xgene-edac-l3
          - items:
              - const: apm,xgene-edac-l3-v2
      reg:
        description: L3 EDAC resource.
        items:
          - description: L3 EDAC resource
    required:
      - compatible
      - reg
    additionalProperties: false

  edac-soc:
    type: object
    description: SoC subnode
    properties:
      compatible:
        enum:
          - apm,xgene-edac-soc-v1
          - apm,xgene-edac-l3-soc
      reg:
        description: SoC EDAC resource.
        items:
          - description: SoC EDAC resource
    required:
      - compatible
      - reg
    additionalProperties: false

examples:
  - |
    csw: csw@7e200000 {
        compatible = "apm,xgene-csw", "syscon";
        reg = <0x0 0x7e200000 0x0 0x1000>;
    };

    mcba: mcba@7e700000 {
        compatible = "apm,xgene-mcb", "syscon";
        reg = <0x0 0x7e700000 0x0 0x1000>;
    };

    mcbb: mcbb@7e720000 {
        compatible = "apm,xgene-mcb", "syscon";
        reg = <0x0 0x7e720000 0x0 0x1000>;
    };

    efuse: efuse@1054a000 {
        compatible = "apm,xgene-efuse", "syscon";
        reg = <0x0 0x1054a000 0x0 0x20>;
    };

    rb: rb@7e000000 {
        compatible = "apm,xgene-rb", "syscon";
        reg = <0x0 0x7e000000 0x0 0x10>;
    };

    edac@78800000 {
        compatible = "apm,xgene-edac";
        #address-cells = <2>;
        #size-cells = <2>;
        ranges;
        regmap-csw = <&csw>;
        regmap-mcba = <&mcba>;
        regmap-mcbb = <&mcbb>;
        regmap-efuse = <&efuse>;
        regmap-rb = <&rb>;
        reg = <0x0 0x78800000 0x0 0x100>;
        interrupts = <0x0 0x20 0x4>, <0x0 0x21 0x4>, <0x0 0x27 0x4>;

        edacmc@7e800000 {
            compatible = "apm,xgene-edac-mc";
            reg = <0x0 0x7e800000 0x0 0x1000>;
            memory-controller = <0>;
        };

        edacpmd@7c000000 {
            compatible = "apm,xgene-edac-pmd";
            reg = <0x0 0x7c000000 0x0 0x200000>;
            pmd-controller = <0>;
        };

        edacl3@7e600000 {
            compatible = "apm,xgene-edac-l3";
            reg = <0x0 0x7e600000 0x0 0x1000>;
        };

        edacsoc@7e930000 {
            compatible = "apm,xgene-edac-soc-v1";
            reg = <0x0 0x7e930000 0x0 0x1000>;
        };
    };
```

## Documentation/devicetree/bindings/extcon/maxim,max3355.yaml
```yaml
# SPDX-License-Identifier: (GPL-2.0-only OR BSD-2-Clause)
%YAML 1.2
---
$id: http://devicetree.org/schemas/extcon/maxim,max3355.yaml#
$schema: http://devicetree.org/meta-schemas/core.yaml#

title: Maxim Integrated MAX3355 USB OTG chip

maintainers:
  - Sergei Shtylyov <sergei.shtylyov@cogentembedded.com>

description:
  MAX3355 integrates a charge pump and comparators to enable a system with an
  integrated USB OTG dual-role transceiver to function as a USB OTG dual-role
  device.

properties:
  compatible:
    const: maxim,max3355

  id-gpios:
    description: GPIO specifier for the MAX3355 ID_OUT pin.
    maxItems: 1

  maxim,shdn-gpios:
    description: GPIO specifier for the MAX3355 SHDN# pin.
    maxItems: 1

required:
  - compatible
  - id-gpios
  - maxim,shdn-gpios

additionalProperties: false

examples:
  - |
    usb-otg {
      compatible = "maxim,max3355";
      maxim,shdn-gpios = <&gpio2 4 GPIO_ACTIVE_LOW>;
      id-gpios = <&gpio5 31 GPIO_ACTIVE_HIGH>;
    };
```
