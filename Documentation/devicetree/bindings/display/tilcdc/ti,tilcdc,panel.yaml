## Documentation/devicetree/bindings/extcon/richtek,rt8973a-muic.yaml
```yaml
# SPDX-License-Identifier: (GPL-2.0-only OR BSD-2-Clause)
%YAML 1.2
---
$id: http://devicetree.org/schemas/extcon/richtek,rt8973a-muic.yaml#
$schema: http://devicetree.org/meta-schemas/core.yaml#

title: Richtek RT8973A Micro USB Switch

maintainers:
  - Chanwoo Choi <cw00.choi@samsung.com>
  - Rob Herring <robh@kernel.org>

description: |
  Richtek RT8973A - Micro USB Switch device

  The Richtek RT8973A is Micro USB Switch with OVP and I2C interface. The RT8973A
  is a USB port accessory detector and switch that is optimized to protect low
  voltage system from abnormal high input voltage (up to 28V) and supports high
  speed USB operation. Also, RT8973A support 'auto-configuration' mode.
  If auto-configuration mode is enabled, RT8973A would control internal h/w patch
  for USB D-/D+ switching.

properties:
  compatible:
    items:
      - const: richtek,rt8973a-muic
    description: Device compatible string.

  reg:
    description: Specifies the I2C slave address of the MUIC block.
    items:
      - description: I2C slave address.

  interrupts:
    description: Interrupt specifiers for detection interrupt sources.
    items:
      - description: IRQ number of the detection interrupt.
      - description: IRQ flags.

required:
  - compatible
  - reg
  - interrupts

additionalProperties: false

examples:
  - |
    rt8973a@14 {
        compatible = "richtek,rt8973a-muic";
        reg = <0x14>;
        interrupts = <5 0>;
    };
```

## Documentation/devicetree/bindings/extcon/ti,palmas-usb-vid.yaml
```yaml
# SPDX-License-Identifier: (GPL-2.0-only OR BSD-2-Clause)
%YAML 1.2
---
$id: http://devicetree.org/schemas/extcon/ti,palmas-usb-vid.yaml#
$schema: http://devicetree.org/meta-schemas/core.yaml#

title: Palmas USB Comparator

maintainers:
  - Kishon Vijay Abraham I <kishon@kernel.org>
  - Laxman Dewangan <ldewangan@nvidia.com>
  - Roger Quadros <rogerq@ti.com>

description: |
  EXTCON FOR PALMAS/TWL CHIPS

  PALMAS USB COMPARATOR

properties:
  compatible:
    items:
      - enum:
          - ti,palmas-usb-vid
          - ti,twl6035-usb-vid
          - ti,palmas-usb
          - ti,twl6035-usb

  debounce-delay-ms:
    description: Debounce delay for GPIO ID pin in milliseconds.

  id-gpio:
    description: GPIO for ID detection.
    maxItems: 1

  ti,enable-id-detection:
    description: |
      Perform ID detection. If id-gpio is specified it performs
      ID detection using GPIO else using OTG core.
    type: boolean

  ti,enable-vbus-detection:
    description: Perform VBUS detection.
    type: boolean

  ti,wakeup:
    description: To enable the wakeup comparator in probe.
    type: boolean

required:
  - compatible

additionalProperties: false

examples:
  - |
    palmas-usb {
      compatible = "ti,twl6035-usb", "ti,palmas-usb";
      ti,wakeup;
    };
```

## Documentation/devicetree/bindings/firmware/coreboot.yaml
```yaml
# SPDX-License-Identifier: (GPL-2.0-only OR BSD-2-Clause)
# Copyright 2025 Julius Werner
%YAML 1.2
---
$id: http://devicetree.org/schemas/firmware/coreboot.yaml#
$schema: http://devicetree.org/meta-schemas/core.yaml#

title: COREBOOT firmware information

maintainers:
  - Julius Werner <jwerner@chromium.org>

description: |
  COREBOOT firmware information

  The device tree node to communicate the location of coreboot's memory-resident
  bookkeeping structures to the kernel. Since coreboot itself cannot boot a
  device-tree-based kernel (yet), this node needs to be inserted by a
  second-stage bootloader (a coreboot "payload").

properties:
  compatible:
    items:
      - const: coreboot
    description: |
      Must be "coreboot" to identify this node as the coreboot firmware
      information descriptor.

  reg:
    items:
      - description: |
          The coreboot table. This is a list of variable-sized descriptors that
          contain various compile- and run-time generated firmware parameters.
          It is identified by the magic string "LBIO" in its first four bytes.
          See coreboot's src/commonlib/include/commonlib/coreboot_tables.h for
          details.
      - description: |
          The CBMEM area. This is a downward-growing memory region used by
          coreboot to dynamically allocate data structures that remain resident.
          It may or may not include the coreboot table as one of its members.
          It is identified by a root node descriptor with the magic number
          0xc0389481 that resides in the topmost 8 bytes of the area.
          See coreboot's src/include/imd.h for details.
    description: |
      Address and size of each memory region for coreboot’s tables and dynamic
      CBMEM allocator.

  reg-names:
    items:
      - const: coreboot-table
      - const: cbmem
    description: |
      Human-readable names for the two entries in “reg”: the coreboot table and
      the CBMEM allocator region.

required:
  - compatible
  - reg

additionalProperties: false

examples:
  - |
    firmware {
        ranges;

        coreboot {
            compatible = "coreboot";
            reg = <0xfdfea000 0x264>,
                  <0xfdfea000 0x16000>;
        }
    };
```

## Documentation/devicetree/bindings/firmware/cznic,turris-mox-rwtm.yaml
```yaml
# SPDX-License-Identifier: (GPL-2.0-only OR BSD-2-Clause)
%YAML 1.2
---
$id: http://devicetree.org/schemas/firmware/cznic,turris-mox-rwtm.yaml#
$schema: http://devicetree.org/meta-schemas/core.yaml#

title: Turris Mox rWTM firmware driver

maintainers:
  - Marek Behún <kabel@kernel.org>

description: |
  Turris Mox rWTM firmware driver

  Required properties:
   - compatible        : Should be "cznic,turris-mox-rwtm"
   - mboxes            : Must contain a reference to associated mailbox

  This device tree node should be used on Turris Mox, or potentially another A3700
  compatible device running the Mox's rWTM firmware in the secure processor (for
  example it is possible to flash this firmware into EspressoBin).

properties:
  compatible:
    const: cznic,turris-mox-rwtm

  mboxes:
    description: Reference to associated mailbox
    items:
      $ref: /schemas/types.yaml#/definitions/phandle-array

  status:
    description: Device status

required:
  - compatible
  - mboxes

additionalProperties: false

examples:
  - |
    turris-mox-rwtm {
        compatible = "cznic,turris-mox-rwtm";
        mboxes = <&rwtm 0>;
        status = "okay";
    };
```

## Documentation/devicetree/bindings/firmware/nvidia,tegra210-bpmp.yaml
```yaml
# SPDX-License-Identifier: (GPL-2.0-only OR BSD-2-Clause)
%YAML 1.2
---
$id: http://devicetree.org/schemas/nvidia,tegra210-bpmp.yaml#
$schema: http://devicetree.org/meta-schemas/core.yaml#

title: NVIDIA Tegra210 Boot and Power Management Processor (BPMP)

maintainers:
  - Timo Alho <talho@nvidia.com>

description: |
  The Boot and Power Management Processor (BPMP) is a co-processor found
  in Tegra210 SoC. It is designed to handle the early stages of the boot
  process as well as to assisting in entering deep low power state
  (suspend to ram), and also offloading DRAM memory clock scaling on
  some platforms. The binding document defines the resources that would
  be used by the BPMP T210 firmware driver, which can create the
  interprocessor communication (IPC) between the CPU and BPMP.

properties:
  compatible:
    items:
      - const: nvidia,tegra210-bpmp

  reg:
    items:
      - description: Physical base address and length to Tegra atomics hardware
      - description: Physical base address and length to Tegra semaphore hardware

  interrupts:
    description: Specifies interrupt numbers for triggering ("tx") and receiving ("rx") messages
    items:
      - description: Interrupt for triggering messages ("tx")
      - description: Interrupt for receiving messages ("rx")

  interrupt-names:
    items:
      - const: tx
      - const: rx

  '#clock-cells':
    description: Should be 1 for platforms where DRAM clock control is offloaded to bpmp
    const: 1

additionalProperties: false

required:
  - compatible
  - reg
  - interrupts

examples:
  - |
    bpmp@70016000 {
        compatible = "nvidia,tegra210-bpmp";
        reg = <0x0 0x70016000 0x0 0x2000
               0x0 0x60001000 0x0 0x1000>;
        interrupts = <GIC_SPI 6 IRQ_TYPE_EDGE_RISING>,
                     <GIC_SPI 4 IRQ_TYPE_EDGE_RISING>;
        interrupt-names = "tx", "rx";
    };
```

## Documentation/devicetree/bindings/fpga/altr,a10-pr-ip.yaml
```yaml
%YAML 1.2
---
$id: http://devicetree.org/schemas/altr,a10-pr-ip.yaml#
$schema: http://devicetree.org/meta-schemas/core.yaml#

title: Altera Arria10 Partial Reconfiguration IP
maintainers:
  - Matthew Gerlach <matthew.gerlach@linux.intel.com>
description: |
  Altera Arria10 Partial Reconfiguration IP

properties:
  compatible:
    items:
      - const: altr,a10-pr-ip

  reg:
    description: Base address and size of the registers
    items:
      - description: Base address of the registers
      - description: Size of the registers

required:
  - compatible
  - reg

additionalProperties: false

examples:
  - |
    fpga_mgr: fpga-mgr@ff20c000 {
        compatible = "altr,a10-pr-ip";
        reg = <0xff20c000 0x10>;
    };
```

## Documentation/devicetree/bindings/fpga/altr,socfpga-fpga-mgr.yaml
```yaml
# SPDX-License-Identifier: (GPL-2.0-only OR BSD-2-Clause)
%YAML 1.2
---
$id: http://devicetree.org/schemas/fpga/altr,socfpga-fpga-mgr.yaml#
$schema: http://devicetree.org/meta-schemas/core.yaml#

title: Altera SOCFPGA FPGA Manager

maintainers:
  - Alan Tull <atull@opensource.altera.com>
  - Moritz Fischer <moritz.fischer@ettus.com>

description: |
  Altera SOCFPGA FPGA Manager

properties:
  compatible:
    items:
      - const: altr,socfpga-fpga-mgr

  reg:
    description: >
      Register address and size for memory mapped IO.
      The first entry is for FPGA manager register access.
      The second entry is for writing FPGA configuration data.
    items:
      - description: FPGA manager register access
      - description: FPGA configuration data write window

  interrupts:
    description: Interrupt for the FPGA Manager device.
    items:
      - description: FPGA manager interrupt

required:
  - compatible
  - reg
  - interrupts

additionalProperties: false

examples:
  - |
    hps_0_fpgamgr: fpgamgr@ff706000 {
        compatible = "altr,socfpga-fpga-mgr";
        reg = <0xFF706000 0x1000
               0xFFB90000 0x1000>;
        interrupts = <0 175 4>;
    };
```
