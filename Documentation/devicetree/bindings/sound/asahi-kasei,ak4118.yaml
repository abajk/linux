## Documentation/devicetree/bindings/sound/asahi-kasei,ak4118.yaml
```yaml
# SPDX-License-Identifier: (GPL-2.0-only OR BSD-2-Clause)
# Copyright 2025 Clément Péron <peron.clem@gmail.com>
%YAML 1.2
---
$id: http://devicetree.org/schemas/asahi-kasei,ak4118.yaml#
$schema: http://devicetree.org/meta-schemas/core.yaml#

title: AK4118 S/PDIF transceiver

maintainers:
  - Clément Péron <peron.clem@gmail.com>

description: |
  AK4118 S/PDIF transceiver

  This device supports I2C mode.

properties:
  compatible:
    items:
      - const: asahi-kasei,ak4118

  reg:
    items:
      - description: The I2C address of the device for I2C

  reset-gpios:
    maxItems: 1
    description: A GPIO specifier for the reset pin

  irq-gpios:
    maxItems: 1
    description: A GPIO specifier for the IRQ pin

required:
  - compatible
  - reg
  - reset-gpios
  - irq-gpios

additionalProperties: false

examples:
  - |
    &i2c {
        ak4118: ak4118@13 {
            #sound-dai-cells = <0>;
            compatible = "asahi-kasei,ak4118";
            reg = <0x13>;
            reset-gpios = <&gpio 0 GPIO_ACTIVE_LOW>;
            irq-gpios = <&gpio 1 GPIO_ACTIVE_HIGH>;
        };
    };
```

## Documentation/devicetree/bindings/sound/asahi-kasei,ak5386.yaml
```yaml
# SPDX-License-Identifier: (GPL-2.0-only OR BSD-2-Clause)
# Copyright 2025 Daniel Mack <zonque@gmail.com>
%YAML 1.2
---
$id: http://devicetree.org/schemas/asahi-kasei,ak5386.yaml#
$schema: http://devicetree.org/meta-schemas/core.yaml#

title: Asahi Kasei AK5386 ADC

maintainers:
  - Daniel Mack <zonque@gmail.com>

description: |
  AK5386 Single-ended 24-Bit 192kHz delta-sigma ADC

  This device has no control interface.

properties:
  compatible:
    items:
      - const: asahi-kasei,ak5386
    description: Device compatible with AK5386 ADC.
  reset-gpio:
    description: Reset/power-down pin.
  va-supply:
    description: Analog supply (5.0V).
  vd-supply:
    description: Digital supply (3.3V).

required:
  - compatible

additionalProperties: false

examples:
  - |
    spdif: ak5386@0 {
        compatible = "asahi-kasei,ak5386";
        reset-gpio = <&gpio0 23>;
        va-supply = <&vdd_5v0_reg>;
        vd-supply = <&vdd_3v3_reg>;
    };
```

## Documentation/devicetree/bindings/sound/atmel,at91sam9263-ac97c.yaml
```yaml
# SPDX-License-Identifier: (GPL-2.0-only OR BSD-2-Clause)
%YAML 1.2
---
$id: http://devicetree.org/schemas/sound/atmel,at91sam9263-ac97c.yaml#
$schema: http://devicetree.org/meta-schemas/core.yaml#

title: Atmel AC97 controller

maintainers:
  - Alexander Stein <alexanders83@web.de>

properties:
  compatible:
    items:
      - const: atmel,at91sam9263-ac97c

  reg:
    maxItems: 1

  interrupts:
    maxItems: 1

  ac97-gpios:
    description: Please refer to soc-ac97link.txt, only ac97-reset is used
    maxItems: 1

required:
  - compatible
  - reg
  - interrupts

additionalProperties: false

examples:
  - |
    sound@fffa0000 {
        compatible = "atmel,at91sam9263-ac97c";
        pinctrl-names = "default";
        pinctrl-0 = <&pinctrl_ac97>;
        reg = <0xfffa0000 0x4000>;
        interrupts = <18 IRQ_TYPE_LEVEL_HIGH 5>;
        ac97-gpios = <&pioB 0 0 &pioB 2 0 &pioC 29 GPIO_ACTIVE_LOW>;
    };
```

## Documentation/devicetree/bindings/sound/brcm,bcm2835-i2s.yaml
```yaml
# SPDX-License-Identifier: (GPL-2.0-only OR BSD-2-Clause)
%YAML 1.2
---
$id: http://devicetree.org/schemas/sound/brcm,bcm2835-i2s.yaml#
$schema: http://devicetree.org/meta-schemas/core.yaml#

title: Broadcom BCM2835 SoC I2S/PCM module

maintainers:
  - Scott Branden <sbranden@broadcom.com>
  - Stefan Wahren <wahrenst@gmx.net>

description: |
  Broadcom BCM2835 SoC I2S/PCM module

properties:
  compatible:
    items:
      - const: brcm,bcm2835-i2s

  reg:
    items:
      - description: PCM registers location and length.

  clocks:
    maxItems: 1
    description: PCM clock to use.

  dmas:
    description: List of DMA controller phandle and request line pairs.
    items:
      - description: Transmission DMA controller phandle and request line.
      - description: Reception DMA controller phandle and request line.

  dma-names:
    description: Names for the DMA channels corresponding to the entries in "dmas".
    items:
      - const: tx
      - const: rx

required:
  - compatible
  - reg
  - clocks
  - dmas
  - dma-names

additionalProperties: false

examples:
  - |
    i2s@7e203000 {
        compatible = "brcm,bcm2835-i2s";
        reg = <0x7e203000 0x24>;
        clocks = <&clocks BCM2835_CLOCK_PCM>;
        dmas = <&dma 2>, <&dma 3>;
        dma-names = "tx", "rx";
    };
```

## Documentation/devicetree/bindings/sound/brcm,bcm63xx-i2s.yaml
```yaml
# SPDX-License-Identifier: (GPL-2.0-only OR BSD-2-Clause)
# Copyright 2025 Broadcom Inc.
%YAML 1.2
---
$id: http://devicetree.org/schemas/sound/brcm,bcm63xx-i2s.yaml#
$schema: http://devicetree.org/meta-schemas/core.yaml#

title: Broadcom DSL/PON BCM63xx Audio I2S controller

maintainers:
  - Kevin Li <kevin-ke.li@broadcom.com>

description: |
  Broadcom DSL/PON BCM63xx Audio I2S controller

  (1) : The generated clock is required only when any of TX and RX
        works on Master Mode.
  (2) : The fixed 200MHz clock is from internal chip and always on

properties:
  '#address-cells':
    # A simple case where the value must always be '1'.
    const: 1

  '#size-cells':
    # A simple case where the value must always be '0'.
    const: 0

  compatible:
    items:
      - const: brcm,bcm63xx-i2s

  reg:
    description: Audio registers location and length.

  interrupts:
    description: Interrupt for the audio controller.

  clocks:
    description: Clock phandles for the I2S bus.
    items:
      - description: Generated clock used for I2S when TX or RX in master mode.
      - description: Fixed 200MHz clock from internal chip.

  clock-names:
    items:
      - const: i2sclk
      - const: i2sosc

required:
  - '#address-cells'
  - '#size-cells'
  - compatible
  - reg
  - interrupts
  - clocks
  - clock-names

additionalProperties: false

examples:
  - |
    i2s: bcm63xx-i2s {
        #address-cells = <1>;
        #size-cells = <0>;
        compatible = "brcm,bcm63xx-i2s";
        reg = <0xFF802080 0xFF>;
        interrupts = <GIC_SPI 84 IRQ_TYPE_LEVEL_HIGH>;
        clocks = <&i2sclk>, <&osc>;
        clock-names = "i2sclk", "i2sosc";
    };
```

## Documentation/devicetree/bindings/sound/brcm,cygnus-audio.yaml
```yaml
# SPDX-License-Identifier: (GPL-2.0-only OR BSD-2-Clause)
# Copyright 2025 Broadcom Ltd.
%YAML 1.2
---
$id: http://devicetree.org/schemas/brcm,cygnus-audio.yaml#
$schema: http://devicetree.org/meta-schemas/core.yaml#
title: BROADCOM Cygnus Audio I2S/TDM/SPDIF controller
maintainers:
  - Rob Herring <robh@kernel.org>
  - Simran Rai <ssimran@broadcom.com>
description: |
  BROADCOM Cygnus Audio I2S/TDM/SPDIF controller
properties:
  compatible:
    description: Device compatibility
    items:
      - const: brcm,cygnus-audio
  "#address-cells":
    description: Number of address cells for child nodes
    const: 1
  "#size-cells":
    description: Number of size cells for child nodes
    const: 0
  reg:
    description: Audio registers locations and length
    items:
      - description: Set of DMA, I2S_OUT and SPDIF registers
      - description: Set of I2S_IN registers
  reg-names:
    description: Names corresponding to entries in reg property
    items:
      - const: aud
      - const: i2s_in
  clocks:
    description: PLL and leaf clocks used by audio ports
    items:
      - description: PLL audio clock channel 0
      - description: PLL audio clock channel 1
      - description: PLL audio clock channel 2
  assigned-clocks:
    description: PLL and leaf clocks assigned to audio ports
    items:
      - description: PLL audio clock
      - description: Leaf clock for audio channel 0
      - description: Leaf clock for audio channel 1
      - description: Leaf clock for audio channel 2
  assigned-clock-parents:
    description: Parent clocks of the assigned clocks (usually the PLL)
    items:
      - description: Parent PLL audio clock
  assigned-clock-rates:
    description: List of clock frequencies of the assigned clocks
    items:
      - description: Rate of PLL audio clock in Hz
      - description: Rate of channel 0 leaf clock in Hz
      - description: Rate of channel 1 leaf clock in Hz
      - description: Rate of channel 2 leaf clock in Hz
  clock-names:
    description: Names of leaf clocks used by audio ports
    items:
      - const: ch0_audio
      - const: ch1_audio
      - const: ch2_audio
  interrupts:
    description: Audio DMA interrupt specifier
    items:
      - description: Interrupt controller phandle
      - description: Interrupt number
      - description: Interrupt type
patternProperties:
  "^ssp_port@[0-2]$":
    description: SSP port subnode
    type: object
    properties:
      reg:
        description: Index of the SSP port interface to use
        items:
          - const: 0
    required:
      - reg
    additionalProperties: false
  "^spdif_port@[3]$":
    description: SPDIF port subnode
    type: object
    properties:
      reg:
        description: Index of the SPDIF port interface to use
        items:
          - const: 3
    required:
      - reg
    additionalProperties: false
required:
  - compatible
  - "#address-cells"
  - "#size-cells"
  - reg
  - reg-names
  - clocks
  - assigned-clocks
  - assigned-clock-parents
  - assigned-clock-rates
  - clock-names
  - interrupts
additionalProperties: false
examples:
  - |
    audio@180ae000 {
        compatible = "brcm,cygnus-audio";
        #address-cells = <1>;
        #size-cells = <0>;
        reg = <0x180ae000 0xafd>, <0x180aec00 0x1f8>;
        reg-names = "aud", "i2s_in";
        clocks = <&audiopll BCM_CYGNUS_AUDIOPLL_CH0>,
                 <&audiopll BCM_CYGNUS_AUDIOPLL_CH1>,
                 <&audiopll BCM_CYGNUS_AUDIOPLL_CH2>;
        assigned-clocks = <&audiopll BCM_CYGNUS_AUDIOPLL>,
                          <&audiopll BCM_CYGNUS_AUDIOPLL_CH0>,
                          <&audiopll BCM_CYGNUS_AUDIOPLL_CH1>,
                          <&audiopll BCM_CYGNUS_AUDIOPLL_CH2>;
        assigned-clock-parents = <&audiopll BCM_CYGNUS_AUDIOPLL>;
        assigned-clock-rates = <1769470191>,
                                <0>,
                                <0>,
                                <0>;
        clock-names = "ch0_audio", "ch1_audio", "ch2_audio";
        interrupts = <GIC_SPI 143 IRQ_TYPE_LEVEL_HIGH>;
        ssp0: ssp_port@0 {
            reg = <0>;
        };
        ssp1: ssp_port@1 {
            reg = <1>;
        };
        ssp2: ssp_port@2 {
            reg = <2>;
        };
        spdif: spdif_port@3 {
            reg = <3>;
        };
    };
```

## Documentation/devicetree/bindings/sound/cdns,xtfpga-i2s.yaml
```yaml
# SPDX-License-Identifier: (GPL-2.0-only OR BSD-2-Clause)
# Copyright 2025 NXP
%YAML 1.2
---
$id: http://devicetree.org/schemas/sound/cdns,xtfpga-i2s.yaml#
$schema: http://devicetree.org/meta-schemas/core.yaml#

title: Xilinx FPGA I2S Controller
maintainers:
  - Marco Franchi <marco.franchi@nxp.com>
  - Max Filippov <jcmvbkbc@gmail.com>

description: |
  Bindings for I2S controller built into xtfpga Xtensa bitstreams.

properties:
  "#sound-dai-cells":
    description: Number of sound DAI cells.
    const: 0

  compatible:
    const: cdns,xtfpga-i2s

  reg:
    description: Memory region (address and length) containing device registers.
    items:
      - description: Address of device registers
      - description: Length of device registers

  interrupts:
    description: Interrupt for the I2S controller.
    items:
      - description: Interrupt specifier

  clocks:
    description: Phandle to the clock used as master clock; I2S bus clock is derived from it.
    items:
      - description: Master clock phandle and specifier

required:
  - compatible
  - reg
  - interrupts
  - clocks

additionalProperties: false

examples:
  - |
    i2s0: xtfpga-i2s@d080000 {
        #sound-dai-cells = <0>;
        compatible = "cdns,xtfpga-i2s";
        reg = <0x0d080000 0x40>;
        interrupts = <2 1>;
        clocks = <&cdce706 4>;
    };
```

## Documentation/devicetree/bindings/sound/cirrus,cs35l32.yaml
```yaml
# SPDX-License-Identifier: (GPL-2.0-only OR BSD-2-Clause)
# Copyright 2025 Cirrus Logic
%YAML 1.2
---
$id: http://devicetree.org/schemas/sound/cirrus,cs35l32.yaml#
$schema: http://devicetree.org/meta-schemas/core.yaml#

title: Cirrus CS35L32 audio CODEC

maintainers:
  - Brian Austin <brian.austin@cirrus.com>

description: |
  CS35L32 audio CODEC

properties:
  compatible:
    items:
      - enum: [cirrus, cs35l32]
  reg:
    items:
      - description: |
          the I2C address of the device as determined by the level of the AD0 pin.
          Level 0 is 0x40 while Level 1 is 0x41.
  reset-gpios:
    maxItems: 1
    description: |
      A GPIO spec for the reset pin.
      If specified, it will be deasserted before communication to the codec starts.
  VA-supply:
    description: Power supply for VA; see Documentation/devicetree/bindings/regulator/regulator.txt.
  VP-supply:
    description: Power supply for VP; see Documentation/devicetree/bindings/regulator/regulator.txt.
  cirrus,battery-recovery:
    description: Low battery nominal recovery threshold, rising VP.
    $ref: /schemas/types.yaml#/definitions/uint32
    enum: [0, 1, 2, 3]
  cirrus,battery-threshold:
    description: Low battery nominal threshold, falling VP.
    $ref: /schemas/types.yaml#/definitions/uint32
    enum: [0, 1, 2, 3, 4, 5]
  cirrus,boost-manager:
    description: Boost voltage control.
    $ref: /schemas/types.yaml#/definitions/uint32
    enum: [0, 1, 2, 3]
  cirrus,sdout-datacfg:
    description: Data configuration for dual CS35L32 applications only.
    $ref: /schemas/types.yaml#/definitions/uint32
    enum: [0, 1, 2, 3]
  cirrus,sdout-share:
    description: SDOUT sharing. Determines whether one or two CS35L32 devices are on board sharing SDOUT.
    $ref: /schemas/types.yaml#/definitions/uint32
    enum: [0, 1]

required:
  - compatible
  - reg
  - VA-supply
  - VP-supply

additionalProperties: false

examples:
  - |
    codec: codec@40 {
        compatible = "cirrus,cs35l32";
        reg = <0x40>;
        reset-gpios = <&gpio 10 0>;
        cirrus,boost-manager = <0x03>;
        cirrus,sdout-datacfg = <0x02>;
        VA-supply = <&reg_audio>;
    };
```
