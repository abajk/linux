## Documentation/devicetree/bindings/sound/cirrus,cs42l56.yaml
```yaml
# SPDX-License-Identifier: (GPL-2.0-only OR BSD-2-Clause)
%YAML 1.2
---
$id: http://devicetree.org/schemas/sound/cirrus,cs42l56.yaml#
$schema: http://devicetree.org/meta-schemas/core.yaml#

title: CS42L52 audio CODEC

maintainers:
  - Andrew F. Davis <afd@ti.com>
  - Brian Austin <brian.austin@cirrus.com>

description: |
  CS42L52 audio CODEC

properties:
  compatible:
    description: |
      Must be "cirrus,cs42l56".
    enum:
      - cirrus,cs42l56

  reg:
    description: |
      The I2C address of the device for I2C.
    items:
      - description: I2C address

  VA-supply: true

  VCP-supply: true

  VLDO-supply: true

  cirrus,gpio-nreset:
    description: |
      GPIO controller's phandle and the number of the GPIO used to reset the codec.
    items:
      - description: phandle to GPIO controller
      - description: GPIO line number

  cirrus,chgfreq-divisor:
    description: |
      Values used to set the Charge Pump Frequency.
      Allowable values of 0x00 through 0x0F.
      These are raw values written to the register, not the actual frequency.
      The frequency is determined by the following.
      Frequency = MCLK / 4 * (N+2)
      N = chgfreq_val
      MCLK = frequency of the mclk signal after the MCLKDIV2 circuit.
    $ref: /schemas/types.yaml#/definitions/uint32
    minimum: 0
    maximum: 15

  cirrus,ain1a-ref-cfg:
    description: |
      If present, AIN1A is configured as a pseudo-differential input referenced to AIN1REF/AIN3A.
    type: boolean

  cirrus,ain1b-ref-cfg:
    description: |
      If present, AIN1B is configured as a pseudo-differential input referenced to AIN1REF/AIN3A.
    type: boolean

  cirrus,ain2a-ref-cfg:
    description: |
      If present, AIN2A is configured as a pseudo-differential input referenced to AIN2REF/AIN3B.
    type: boolean

  cirrus,ain2b-ref-cfg:
    description: |
      If present, AIN2B is configured as a pseudo-differential input referenced to AIN2REF/AIN3B.
    type: boolean

  cirrus,micbias-lvl:
    description: |
      Set the output voltage level on the MICBIAS Pin.
      0 = 0.5 x VA
      1 = 0.6 x VA
      2 = 0.7 x VA
      3 = 0.8 x VA
      4 = 0.83 x VA
      5 = 0.91 x VA
    $ref: /schemas/types.yaml#/definitions/uint32
    enum: [0, 1, 2, 3, 4, 5]

  cirrus,adaptive-pwr-cfg:
    description: |
      Configures how the power to the Headphone and Lineout Amplifiers adapt to the output signal levels.
      0 = Adapt to Volume Mode. Voltage level determined by the sum of the relevant volume settings.
      1 = Fixed - Headphone and Line Amp supply = + or - VCP/2.
      2 = Fixed - Headphone and Line Amp supply = + or - VCP.
      3 = Adapted to Signal; Voltage level is dynamically determined by the output signal.
    $ref: /schemas/types.yaml#/definitions/uint32
    enum: [0, 1, 2, 3]

  cirrus,hpf-left-freq:
    description: |
      Sets the corner frequency (-3dB point) for the internal High-Pass Filter on the left channel.
      0 = 1.8Hz
      1 = 119Hz
      2 = 236Hz
      3 = 464Hz
    $ref: /schemas/types.yaml#/definitions/uint32
    enum: [0, 1, 2, 3]

  cirrus,hpf-right-freq:
    description: |
      Sets the corner frequency (-3dB point) for the internal High-Pass Filter on the right channel.
      0 = 1.8Hz
      1 = 119Hz
      2 = 236Hz
      3 = 464Hz
    $ref: /schemas/types.yaml#/definitions/uint32
    enum: [0, 1, 2, 3]

required:
  - compatible
  - reg
  - VA-supply
  - VCP-supply
  - VLDO-supply

additionalProperties: false

examples:
  - |
    codec: codec@4b {
        compatible = "cirrus,cs42l56";
        reg = <0x4b>;
        cirrus,gpio-nreset = <&gpio 10 0>;
        cirrus,chgfreq-divisor = <0x05>;
        cirrus.ain1_ref_cfg;
        cirrus,micbias-lvl = <5>;
        VA-supply = <&reg_audio>;
    };
```

## Documentation/devicetree/bindings/sound/cirrus,cs42l73.yaml
```yaml
# SPDX-License-Identifier: (GPL-2.0-only OR BSD-2-Clause)
# Copyright 2025 Cirrus Logic
%YAML 1.2
---
$id: http://devicetree.org/schemas/sound/cirrus,cs42l73.yaml#
$schema: http://devicetree.org/meta-schemas/core.yaml#

title: cirrus,cs42l73

maintainers:
  - Brian Austin <brian.austin@cirrus.com>
  - Geert Uytterhoeven <geert+renesas@glider.be>

description: |
  CS42L73 audio CODEC

properties:
  compatible:
    items:
      - const: cirrus,cs42l73

  reg:
    items:
      - description: The I2C address of the device.

  reset_gpio:
    description: A GPIO spec for the reset pin.

  chgfreq:
    description: Charge Pump Frequency values 0x00-0x0F
    $ref: /schemas/types.yaml#/definitions/uint32
    minimum: 0
    maximum: 15

required:
  - compatible
  - reg

additionalProperties: false

examples:
  - |
    cs42l73@4a {
        compatible = "cirrus,cs42l73";
        reg = <0x4a>;
        reset_gpio = <&gpio 10 0>;
        chgfreq = <0x05>;
    };
```

## Documentation/devicetree/bindings/sound/cirrus,cs43130.yaml
```yaml
# SPDX-License-Identifier: (GPL-2.0-only OR BSD-2-Clause)
# Copyright 2025 Cirrus Logic
%YAML 1.2
---
$id: http://devicetree.org/schemas/sound/cirrus,cs43130.yaml#
$schema: http://devicetree.org/meta-schemas/core.yaml#

title: Cirrus Logic CS43130 DAC

maintainers:
  - Li Xu <li.xu@cirrus.com>

description: |
  CS43130 DAC

properties:
  compatible:
    items:
      - enum:
          - cirrus,cs43130
          - cirrus,cs4399
          - cirrus,cs43131
          - cirrus,cs43198

  reg:
    maxItems: 1

  reset-gpios:
    maxItems: 1

  VA-supply: true
  VP-supply: true
  VL-supply: true
  VCP-supply: true
  VD-supply: true

  interrupts:
    items:
      - description: TX or combined interrupt.
      - description: RX interrupt.

  cirrus,xtal-ibias:
    description: |
      When external MCLK is generated by external crystal oscillator, CS43130
      can be used to provide bias current for external crystal. Amount of
      bias current sent is set as:
      1 = 7.5uA
      2 = 12.5uA
      3 = 15uA
    $ref: /schemas/types.yaml#/definitions/uint32
    enum: [1, 2, 3]

  cirrus,dc-measure:
    description: Enable headphone DC impedance measurement.
    type: boolean

  cirrus,ac-measure:
    description: Enable headphone AC impedance measurement. DC impedance must
      also be enabled for AC impedance measurement.
    type: boolean

  cirrus,dc-threshold:
    description: |
      Define 2 DC impedance thresholds in ohms for HP output control. Default
      values are 50 and 120 Ohms.
    items:
      - description: Lower threshold in ohms.
      - description: Upper threshold in ohms.
    default: [50, 120]

  cirrus,ac-freq:
    description: |
      Define the frequencies at which to measure HP AC impedance. Only used if
      "cirrus,dc-measure" is defined. Exactly 10 frequencies must be defined.
      If this property is undefined, by default following frequencies are used:
      <24 43 93 200 431 928 2000 4309 9283 20000>. The above frequencies are
      logarithmically equally spaced.
    $ref: /schemas/types.yaml#/definitions/uint32-array
    minItems: 10
    maxItems: 10
    default: [24, 43, 93, 200, 431, 928, 2000, 4309, 9283, 20000]

required:
  - compatible
  - reg
  - VA-supply
  - VP-supply
  - VL-supply
  - VCP-supply
  - VD-supply

dependencies:
  cirrus,ac-measure:
    - cirrus,dc-measure

additionalProperties: false

examples:
  - |
    cs43130: audio-codec@30 {
        compatible = "cirrus,cs43130";
        reg = <0x30>;
        reset-gpios = <&axi_gpio 54 0>;
        VA-supply = <&dummy_vreg>;
        VP-supply = <&dummy_vreg>;
        VL-supply = <&dummy_vreg>;
        VCP-supply = <&dummy_vreg>;
        VD-supply = <&dummy_vreg>;
        cirrus,xtal-ibias = <2>;
        interrupts = <55 8>;
        cirrus,dc-measure;
        cirrus,ac-measure;
        cirrus,dc-threshold = /bits/ 16 <20 100>;
        cirrus,ac-freq = /bits/ 16 <24 43 93 200 431 928 2000 4309 9283 20000>;
    };
```

## Documentation/devicetree/bindings/sound/cirrus,cs4341a.yaml
```yaml
# SPDX-License-Identifier: (GPL-2.0-only OR BSD-2-Clause)
# Copyright 2025 Alexander Shiyan <shc_work@mail.ru>, Rob Herring <robh@kernel.org>
%YAML 1.2
---
$id: http://devicetree.org/schemas/sound/cirrus,cs4341a.yaml#
$schema: http://devicetree.org/meta-schemas/core.yaml#

title: Cirrus Logic CS4341 audio DAC

maintainers:
  - Alexander Shiyan <shc_work@mail.ru>
  - Rob Herring <robh@kernel.org>

description: |
  Cirrus Logic CS4341 audio DAC

  This device supports both I2C and SPI (configured with pin strapping on the board).

  For required properties on I2C-bus, please consult
  dtschema schemas/i2c/i2c-controller.yaml
  For required properties on SPI-bus, please consult
  Documentation/devicetree/bindings/spi/spi-bus.txt

properties:
  compatible:
    description: Device compatibility string.
    items:
      - const: cirrus,cs4341a

  reg:
    description: The I2C address for I2C devices or the SPI chip select number.
    items:
      - description: Address or chip select

  spi-max-frequency:
    description: SPI bus maximum frequency in Hz.
    $ref: /schemas/types.yaml#/definitions/uint32

  '#sound-dai-cells':
    description: Number of cells for the sound-dai-cells property.
    const: 0

required:
  - compatible
  - reg
  - '#sound-dai-cells'

additionalProperties: false

examples:
  - |
    codec: cs4341@0 {
        #sound-dai-cells = <0>;
        compatible = "cirrus,cs4341a";
        reg = <0>;
        spi-max-frequency = <6000000>;
    };
```

## Documentation/devicetree/bindings/sound/cirrus,cs4349.yaml
```yaml
# SPDX-License-Identifier: (GPL-2.0-only OR BSD-2-Clause)
# Copyright 2025 Cirrus Logic
%YAML 1.2
---
$id: http://devicetree.org/schemas/cirrus,cs4349.yaml#
$schema: http://devicetree.org/meta-schemas/core.yaml#

title: Cirrus CS4349 audio CODEC

maintainers:
  - Tim Howe <tim.howe@cirrus.com>

description: |
  CS4349 audio CODEC

properties:
  compatible:
    items:
      - enum: [cirrus, cs4349]
  reg:
    items:
      - description: I2C address of the device
  reset-gpios:
    maxItems: 1
    description: A connection for the reset pin.

additionalProperties: false

examples:
  - |
    codec: cs4349@48 {
        compatible = "cirrus,cs4349";
        reg = <0x48>;
        reset-gpios = <&gpio 54 0>;
    };
```

## Documentation/devicetree/bindings/sound/cirrus,cs53l30.yaml
```yaml
# SPDX-License-Identifier: (GPL-2.0-only OR BSD-2-Clause)
%YAML 1.2
---
$id: http://devicetree.org/schemas/cirrus,cs53l30.yaml#
$schema: http://devicetree.org/meta-schemas/core.yaml#

title: CS53L30 audio CODEC

maintainers:
  - Bjorn Helgaas <bhelgaas@google.com>
  - Nicolin Chen <nicoleotsuka@gmail.com>

description: |
  CS53L30 audio CODEC

properties:
  compatible:
    items:
      - enum: ["cirrus,cs53l30"]
    description: Device compatible string.

  reg:
    items:
      - description: I2C address of the device

  VA-supply: true
  VP-supply: true

  reset-gpios:
    maxItems: 1
    description: Reset pin GPIO spec.

  mute-gpios:
    maxItems: 1
    description: Mute pin GPIO spec. Active state handled automatically.

  cirrus,micbias-lvl:
    description: >-
      Set the output voltage level on the MICBIAS pin.
      0 = Hi-Z, 1 = 1.80 V, 2 = 2.75 V.
    enum: [0, 1, 2]

  cirrus,use-sdout2:
    description: >-
      If present, hardware design connects both SDOUT1 and SDOUT2 pins
      to output data. Otherwise, only SDOUT1 is connected.
    type: boolean

required:
  - compatible
  - reg
  - VA-supply
  - VP-supply

additionalProperties: false

examples:
  - |-
    codec: cs53l30@48 {
        compatible = "cirrus,cs53l30";
        reg = <0x48>;
        reset-gpios = <&gpio 54 0>;
        VA-supply = <&cs53l30_va>;
        VP-supply = <&cs53l30_vp>;
    };
```
