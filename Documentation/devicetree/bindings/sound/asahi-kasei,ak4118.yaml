## Documentation/devicetree/bindings/sound/cirrus,cs35l36.yaml
```yaml
# SPDX-License-Identifier: (GPL-2.0-only OR BSD-2-Clause)
%YAML 1.2
---
$id: http://devicetree.org/schemas/cirrus,cs35l36.yaml#
$schema: http://devicetree.org/meta-schemas/core.yaml#

title: cirrus,cs35l36

maintainers:
  - Bjorn Helgaas <bhelgaas@google.com>
  - James Schulman <james.schulman@cirrus.com>

description: |
  CS35L36 Speaker Amplifier

  Required properties:

    - compatible : "cirrus,cs35l36"

    - reg : the I2C address of the device for I2C

    - VA-supply, VP-supply : power supplies for the device,
      as covered in
      Documentation/devicetree/bindings/regulator/regulator.txt.

    - cirrus,boost-ctl-millivolt : Boost Voltage Value.  Configures the boost
      converter's output voltage in mV. The range is from 2550mV to 12000mV with
      increments of 50mV. (Default) VP

    - cirrus,boost-peak-milliamp : Boost-converter peak current limit in mA.
      Configures the peak current by monitoring the current through the boost FET.
      Range starts at 1600mA and goes to a maximum of 4500mA with increments of
      50mA. (Default) 4.50 Amps

    - cirrus,boost-ind-nanohenry : Inductor estimation LBST reference value.
      Seeds the digital boost converter's inductor estimation block with the initial
      inductance value to reference.
      1000 = 1uH (Default)
      1200 = 1.2uH

  Optional properties:

    - cirrus,multi-amp-mode : Boolean to determine if there are more than
      one amplifier in the system. If more than one it is best to Hi-Z the ASP
      port to prevent bus contention on the output signal

    - cirrus,boost-ctl-select : Boost converter control source selection.
      Selects the source of the BST_CTL target VBST voltage for the boost
      converter to generate.
      0x00 - Control Port Value
      0x01 - Class H Tracking (Default)
      0x10 - MultiDevice Sync Value

    - cirrus,amp-pcm-inv : Boolean to determine Amplifier will invert incoming
      PCM data

    - cirrus,imon-pol-inv : Boolean to determine Amplifier will invert the
      polarity of outbound IMON feedback data

    - cirrus,vmon-pol-inv : Boolean to determine Amplifier will invert the
      polarity of outbound VMON feedback data

    - cirrus,dcm-mode-enable : Boost converter automatic DCM Mode enable.
      This enables the digital boost converter to operate in a low power
      (Discontinuous Conduction) mode during low loading conditions.

    - cirrus,weak-fet-disable : Boolean : The strength of the output drivers is
      reduced when operating in a Weak-FET Drive Mode and must not be used to drive
      a large load.

    - cirrus,classh-wk-fet-delay : Weak-FET entry delay. Controls the delay
      (in ms) before the Class H algorithm switches to the weak-FET voltage
      (after the audio falls and remains below the value specified in WKFET_AMP_THLD).
      0 = 0ms
      1 = 5ms
      2 = 10ms
      3 = 50ms
      4 = 100ms (Default)
      5 = 200ms
      6 = 500ms
      7 = 1000ms

    - cirrus,classh-weak-fet-thld-millivolt : Weak-FET amplifier drive threshold.
      Configures the signal threshold at which the PWM output stage enters
      weak-FET operation. The range is 50mV to 700mV in 50mV increments.

    - cirrus,temp-warn-threshold : Amplifier overtemperature warning threshold.
      Configures the threshold at which the overtemperature warning condition occurs.
      When the threshold is met, the overtemperature warning attenuation is applied
      and the TEMP_WARN_EINT interrupt status bit is set. If TEMP_WARN_MASK = 0, INTb is asserted.
      0 = 105C
      1 = 115C
      2 = 125C (Default)
      3 = 135C

    - cirrus,irq-drive-select : Selects the driver type of the selected interrupt
      output. 0 = Open-drain, 1 = Push-pull (Default)

    - cirrus,irq-gpio-select : Selects the pin to serve as the programmable
      interrupt output. 0 = PDM_DATA / SWIRE_SD / INT (Default), 1 = GPIO

  Optional properties for the "cirrus,vpbr-config" sub-node:

    - cirrus,vpbr-en : VBST brownout prevention enable. 0 = disabled (default), 1 = enabled

    - cirrus,vpbr-thld : Initial VPBR threshold. Configures the VP brownout threshold voltage

    - cirrus,vpbr-atk-rate : Attenuation attack step rate.

    - cirrus,vpbr-atk-vol : VP brownout prevention step size.

    - cirrus,vpbr-max-attn : Maximum attenuation that the VP brownout prevention can apply.

    - cirrus,vpbr-wait : Delay between brownout clearance and attenuation release.

    - cirrus,vpbr-rel-rate : Attenuation release step rate.

    - cirrus,vpbr-mute-en : Mute audio if vpbr-max-attn reached during attack.

properties:
  compatible:
    enum:
      - cirrus,cs35l36

  reg:
    items:
      - description: I2C address of the device

  VA-supply: true
  VP-supply: true

  reset-gpios:
    maxItems: 1
    description: Reset GPIO line.

  interrupts:
    items:
      - description: Interrupt number and flags

  interrupt-names:
    items:
      - const: IRQ

  cirrus,boost-ctl-millivolt:
    description: Boost converter output voltage in millivolts (2550–12000, step 50).
    $ref: /schemas/types.yaml#/definitions/uint32

  cirrus,boost-peak-milliamp:
    description: Boost-converter peak current limit in mA (1600–4500, step 50).
    $ref: /schemas/types.yaml#/definitions/uint32

  cirrus,boost-ind-nanohenry:
    description: Initial inductor estimation reference value in nanohenry (1000=1μH default,1200=1.2μH).
    $ref: /schemas/types.yaml#/definitions/uint32

  cirrus,multi-amp-mode:
    description: Hi-Z ASP port when more than one amplifier in system.
    type: boolean

  cirrus,boost-ctl-select:
    description: Boost converter control source selection (0x00=Control Port,0x01=Class H,0x10=Sync).
    $ref: /schemas/types.yaml#/definitions/uint32
    enum: [0x00, 0x01, 0x10]

  cirrus,amp-pcm-inv:
    description: Invert incoming PCM data when true.
    type: boolean

  cirrus,imon-pol-inv:
    description: Invert polarity of outbound IMON feedback when true.
    type: boolean

  cirrus,vmon-pol-inv:
    description: Invert polarity of outbound VMON feedback when true.
    type: boolean

  cirrus,dcm-mode-enable:
    description: Enable boost converter automatic Discontinuous Conduction Mode.
    type: boolean

  cirrus,weak-fet-disable:
    description: Reduce output driver strength in Weak-FET Drive Mode when true.
    type: boolean

  cirrus,classh-wk-fet-delay:
    description: Weak-FET entry delay in ms (0=0,1=5,2=10,3=50,4=100 default,5=200,6=500,7=1000).
    $ref: /schemas/types.yaml#/definitions/uint32
    enum: [0, 1, 2, 3, 4, 5, 6, 7]

  cirrus,classh-weak-fet-thld-millivolt:
    description: Weak-FET drive threshold in mV (50–700 in 50 mV steps).
    $ref: /schemas/types.yaml#/definitions/uint32
    enum: [50, 100, 150, 200, 250, 300, 350, 400, 450, 500, 550, 600, 650, 700]

  cirrus,temp-warn-threshold:
    description: Overtemperature warning threshold (0=105°C,1=115°C,2=125°C default,3=135°C).
    $ref: /schemas/types.yaml#/definitions/uint32
    enum: [0, 1, 2, 3]

  cirrus,irq-drive-select:
    description: Interrupt output driver type (0=open-drain,1=push-pull default).
    $ref: /schemas/types.yaml#/definitions/uint32
    enum: [0, 1]

  cirrus,irq-gpio-select:
    description: Programmable IRQ pin selection (0=PDM_DATA/SWIRE_SD/INT default,1=GPIO).
    $ref: /schemas/types.yaml#/definitions/uint32
    enum: [0, 1]

  cirrus,vpbr-config:
    description: Brownout prevention configuration sub-node
    $ref: "#/definitions/cirrus,vpbr-config"

definitions:
  cirrus,vpbr-config:
    type: object
    description: Brownout prevention configuration sub-node
    properties:
      cirrus,vpbr-en:
        description: VBST brownout prevention enable.
        type: boolean
      cirrus,vpbr-thld:
        description: Initial VPBR threshold voltage.
        $ref: /schemas/types.yaml#/definitions/uint32
      cirrus,vpbr-atk-rate:
        description: Attenuation attack step rate.
        $ref: /schemas/types.yaml#/definitions/uint32
      cirrus,vpbr-atk-vol:
        description: VP brownout prevention step size.
        $ref: /schemas/types.yaml#/definitions/uint32
      cirrus,vpbr-max-attn:
        description: Maximum attenuation during VP brownout prevention.
        $ref: /schemas/types.yaml#/definitions/uint32
      cirrus,vpbr-wait:
        description: Delay between brownout clearance and attenuation release.
        $ref: /schemas/types.yaml#/definitions/uint32
      cirrus,vpbr-rel-rate:
        description: Attenuation release step rate.
        $ref: /schemas/types.yaml#/definitions/uint32
      cirrus,vpbr-mute-en:
        description: Mute audio if maximum attenuation reached.
        type: boolean
    additionalProperties: false

required:
  - compatible
  - reg
  - VA-supply
  - VP-supply
  - interrupts

additionalProperties: false

examples:
  - |
    cs35l36: cs35l36@40 {
        compatible = "cirrus,cs35l36";
        reg = <0x40>;
        VA-supply = <&dummy_vreg>;
        VP-supply = <&dummy_vreg>;
        reset-gpios = <&gpio0 54 0>;
        interrupts = <3 IRQ_TYPE_LEVEL_LOW>;

        cirrus,boost-ind-nanohenry = <1000>;
        cirrus,boost-ctl-millivolt = <10000>;
        cirrus,boost-peak-milliamp = <4500>;
        cirrus,boost-ctl-select = <0x00>;
        cirrus,weak-fet-delay = <0x04>;
        cirrus,weak-fet-thld = <0x01>;
        cirrus,temp-warn-threshold = <0x01>;
        cirrus,multi-amp-mode;
        cirrus,irq-drive-select = <0x01>;
        cirrus,irq-gpio-select = <0x01>;

        cirrus,vpbr-config {
            cirrus,vpbr-en = <0x00>;
            cirrus,vpbr-thld = <0x05>;
            cirrus,vpbr-atk-rate = <0x02>;
            cirrus,vpbr-atk-vol = <0x01>;
            cirrus,vpbr-max-attn = <0x09>;
            cirrus,vpbr-wait = <0x01>;
            cirrus,vpbr-rel-rate = <0x05>;
            cirrus,vpbr-mute-en = <0x00>;
        };
    };
```

## Documentation/devicetree/bindings/sound/cirrus,cs4265.yaml
```yaml
# SPDX-License-Identifier: (GPL-2.0-only OR BSD-2-Clause)
%YAML 1.2
---
$id: http://devicetree.org/schemas/sound/cirrus,cs4265.yaml#
$schema: http://devicetree.org/meta-schemas/core.yaml#

title: cirrus,cs4265 codec

maintainers:
  - Paul Handrigan <Paul.Handrigan@cirrus.com>

description: |
  CS4265 audio CODEC

  This device supports I2C only.

properties:
  compatible:
    items:
      - const: cirrus,cs4265

  reg:
    description: >
      The I2C address of the device. The address depends on the state of the
      AD0 pin. If AD0 is high, the address is 0x4f; if low, it is 0x4e.
    items:
      - description: I2C address

  reset-gpios:
    maxItems: 1
    description: >
      GPIO specification for the reset pin. If specified, it will be
      deasserted before communication to the codec starts.

required:
  - compatible
  - reg

additionalProperties: false

examples:
  - |
    cs4265@4f {
      compatible = "cirrus,cs4265";
      reg = <0x4f>;
    };

  - |
    cs4265@4e {
      compatible = "cirrus,cs4265";
      reg = <0x4e>;
    };
```

## Documentation/devicetree/bindings/sound/cirrus,cs42l52.yaml
```yaml
# SPDX-License-Identifier: (GPL-2.0-only OR BSD-2-Clause)
%YAML 1.2
---
$id: http://devicetree.org/schemas/sound/cirrus,cs42l52.yaml#
$schema: http://devicetree.org/meta-schemas/core.yaml#

title: Cirrus Logic CS42L52 audio CODEC

maintainers:
  - Brian Austin <brian.austin@cirrus.com>

description: |
  CS42L52 audio CODEC

  Required properties:
    • compatible must be "cirrus,cs42l52"
    • reg must be the I2C address of the device

  Optional properties:
    • cirrus,reset-gpio: GPIO controller's phandle and the number of the GPIO used to reset the codec.
    • cirrus,chgfreq-divisor: Raw register value 0x00–0x0F used to set the Charge Pump Frequency.
      Frequency = (64 × Fs) / (N + 2).
    • cirrus,mica-differential-cfg: If true, configure MICA input as differential;
      if false or not present, single-ended input.
    • cirrus,micb-differential-cfg: If true, configure MICB input as differential;
      if false or not present, single-ended input.
    • cirrus,micbias-lvl: Output voltage level on MICBIAS pin:
        0 = 0.5 × VA
        1 = 0.6 × VA
        2 = 0.7 × VA
        3 = 0.8 × VA
        4 = 0.83 × VA
        5 = 0.91 × VA

properties:
  compatible:
    items:
      - const: cirrus,cs42l52

  reg:
    description: I2C address of the device
    items:
      - description: I2C device address

  cirrus,reset-gpio:
    description: GPIO controller's phandle and the number of the GPIO used to reset the codec
    maxItems: 1

  cirrus,chgfreq-divisor:
    description: Raw register value 0x00–0x0F used to set the Charge Pump Frequency
    $ref: /schemas/types.yaml#/definitions/uint8
    minimum: 0
    maximum: 15

  cirrus,mica-differential-cfg:
    description: Configure MICA input as differential when true; single-ended when false or absent
    type: boolean

  cirrus,micb-differential-cfg:
    description: Configure MICB input as differential when true; single-ended when false or absent
    type: boolean

  cirrus,micbias-lvl:
    description: Output voltage level on MICBIAS pin
    $ref: /schemas/types.yaml#/definitions/uint32
    enum: [0, 1, 2, 3, 4, 5]

required:
  - compatible
  - reg

additionalProperties: false

examples:
  - |
    codec: codec@4a {
        compatible = "cirrus,cs42l52";
        reg = <0x4a>;
        cirrus,reset-gpio = <&gpio 10 0>;
        cirrus,chgfreq-divisor = <0x05>;
        cirrus,mica-differential-cfg;
        cirrus,micbias-lvl = <5>;
    };
```
