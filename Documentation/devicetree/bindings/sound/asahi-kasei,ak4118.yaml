## Documentation/devicetree/bindings/sound/cirrus,cs35l33.yaml
```yaml
# SPDX-License-Identifier: (GPL-2.0-only OR BSD-2-Clause)
%YAML 1.2
---
$id: http://devicetree.org/schemas/sound/cirrus,cs35l33.yaml#
$schema: http://devicetree.org/meta-schemas/core.yaml#

title: Cirrus Logic CS35L33 Speaker Amplifier

maintainers:
  - Paul Handrigan <Paul.Handrigan@cirrus.com>

description: |
  CS35L33 Speaker Amplifier

  Optional H/G Algorithm sub-node:

  The cs35l33 node can have a single "cirrus,hg-algo" sub-node that will
  enable the internal H/G Algorithm.

properties:
  compatible:
    items:
      - const: cirrus,cs35l33

  reg:
    description: I2C address of the device
    items:
      - description: I2C address (7-bit)

  VA-supply:
    description: Power supply for VA

  VP-supply:
    description: Power supply for VP

  reset-gpios:
    maxItems: 1

  interrupts:
    maxItems: 1

  cirrus,boost-ctl:
    description: Booster control; if 0 VBST=VP, else VBST=3300mV + (value-1)*100mV.
    $ref: /schemas/types.yaml#/definitions/uint32

  cirrus,ramp-rate:
    description: "Soft ramp rate: 0 disables (20ms), 1=40ms, 2=60ms, 3=100ms, 4=175ms."
    $ref: /schemas/types.yaml#/definitions/uint32
    enum: [0, 1, 2, 3]

  cirrus,boost-ipk:
    description: Maximum current for the boost converter in microamperes.
    $ref: /schemas/types.yaml#/definitions/uint32
    minimum: 1850000
    maximum: 3600000
    multipleOf: 15625
    default: 2500000

  cirrus,imon-adc-scale:
    description: Scaling of IMON ADC data bits.
    $ref: /schemas/types.yaml#/definitions/uint32
    enum: [0, 6, 7, 8]

  cirrus,hg-algo:
    description: Internal Class H/G algorithm controlling the amplifier supplies.
    type: boolean

required:
  - compatible
  - reg
  - VA-supply
  - VP-supply

additionalProperties: false

examples:
  - |
    cs35l33@40 {
        compatible = "cirrus,cs35l33";
        reg = <0x40>;
        VA-supply = <&ldo5_reg>;
        VP-supply = <&ldo5_reg>;
        interrupts = <3 IRQ_TYPE_LEVEL_LOW>;
        reset-gpios = <&cs47l91 34 0>;
        cirrus,ramp-rate = <0x0>;
        cirrus,boost-ctl = <0x30>;
        cirrus,boost-ipk = <0xE0>;
        cirrus,imon-adc-scale = <0>;
        cirrus,hg-algo {
            cirrus,mem-depth = <0x3>;
            cirrus,release-rate = <0x3>;
            cirrus,ldo-thld = <0x1>;
            cirrus,ldo-path-disable;
            cirrus,ldo-entry-delay = <0x4>;
            cirrus,vp-hg-auto;
            cirrus,vp-hg = <0xF>;
            cirrus,vp-hg-rate = <0x2>;
            cirrus,vp-hg-va = <0x0>;
        };
    };
```

## Documentation/devicetree/bindings/sound/cirrus,cs35l34.yaml
```yaml
# SPDX-License-Identifier: (GPL-2.0-only OR BSD-2-Clause)
%YAML 1.2
---
$id: http://devicetree.org/schemas/sound/cirrus,cs35l34.yaml#
$schema: http://devicetree.org/meta-schemas/core.yaml#

title: Cirrus CS35L34 Speaker Amplifier

maintainers:
  - Paul Handrigan <Paul.Handrigan@cirrus.com>

description: |
  CS35L34 Speaker Amplifier

properties:
  compatible:
    items:
      - const: cirrus,cs35l34

  reg:
    maxItems: 1

  VA-supply:
    description: Power supply for the VA line.

  VP-supply:
    description: Power supply for the VP line.

  reset-gpios:
    description: GPIO used to reset the amplifier.

  interrupts:
    maxItems: 1

  cirrus,boost-vtge-millivolt:
    description: Boost converter output voltage in mV. Values from VP supply voltage to 8000 mV in steps of 100 mV.
    $ref: /schemas/types.yaml#/definitions/uint32
    minimum: 1000
    maximum: 8000
    multipleOf: 100

  cirrus,boost-nanohenry:
    description: Inductor value for boost converter in nH.
    $ref: /schemas/types.yaml#/definitions/uint32
    enum: [1000, 1100, 1200, 1500, 2200]

  cirrus,boost-peak-milliamp:
    description: Boost converter peak current limit in mA.
    minimum: 1200
    maximum: 3840
    multipleOf: 80
    default: 2480

  cirrus,i2s-sdinloc:
    description: ADSP SDIN I2S channel location.
    $ref: /schemas/types.yaml#/definitions/uint32
    enum: [0, 1, 2, 3]
    default: 0

  cirrus,gain-zc-disable:
    description: If set, the gain change will take effect without waiting for a zero cross.
    type: boolean

  cirrus,tdm-rising-edge:
    description: If set, data is on the rising edge of SCLK. Otherwise, data is on the falling edge of SCLK.
    type: boolean

required:
  - compatible
  - reg
  - VA-supply
  - VP-supply
  - cirrus,boost-vtge-millivolt
  - cirrus,boost-nanohenry

additionalProperties: false

examples:
  - |
    cs35l34: cs35l34@40 {
        compatible = "cirrus,cs35l34";
        reg = <0x40>;
        VA-supply = <&vdd1>;
        VP-supply = <&vdd2>;
        interrupts = <3 IRQ_TYPE_LEVEL_LOW>;
        reset-gpios = <&gpio 10 0>;
        cirrus,boost-vtge-millivolt = <8000>; /* 8V */
        cirrus,boost-nanohenry = <1000>;     /* 1uH */
        cirrus,boost-peak-milliamp = <3000>; /* 3A */
        cirrus,i2s-sdinloc = <0>;
        cirrus,gain-zc-disable;
        cirrus,tdm-rising-edge;
    };
```

## Documentation/devicetree/bindings/sound/cirrus,cs35l35.yaml
```yaml
# SPDX-License-Identifier: (GPL-2.0-only OR BSD-2-Clause)
# Copyright 2025 Bjorn Helgaas, Brian Austin, Charles Keepax, Rob Herring
---
$id: http://devicetree.org/schemas/sound/cirrus,cs35l35.yaml#
$schema: http://devicetree.org/meta-schemas/core.yaml#

title: CS35L35 Boosted Speaker Amplifier

maintainers:
  - Bjorn Helgaas <bhelgaas@google.com>
  - Brian Austin <brian.austin@cirrus.com>
  - Charles Keepax <ckeepax@opensource.wolfsonmicro.com>
  - Rob Herring <robh@kernel.org>

description: |
  CS35L35 Boosted Speaker Amplifier

  The cs35l35 node can have a single "cirrus,classh-internal-algo" sub-node
  that will disable automatic control of the internal H/G Algorithm.

  It is strongly recommended that the Datasheet be referenced when adjusting
  or using these Class H Algorithm controls over the internal Algorithm.
  Serious damage can occur to the Device and surrounding components.

  The cs35l35 node can have a single "cirrus,monitor-signal-format" sub-node
  for adjusting the Depth, Location and Frame of the Monitoring Signals
  for Algorithms.

  See Sections 4.8.2 through 4.8.4 Serial-Port Control in the Datasheet.

  If not used, the defaults for the 6 monitor signals is used.

  Sections 7.44 - 7.53 lists values for the depth, location, and frame
  for each monitoring signal.

properties:
  compatible:
    items:
      - const: cirrus,cs35l35

  reg:
    items:
      - description: I2C address of the device

  VA-supply: true
  VP-supply: true

  reset-gpios:
    maxItems: 1
    description: GPIO used to reset the amplifier

  interrupts:
    items:
      - description: IRQ line information for the amplifier

  cirrus,boost-ind-nanohenry:
    $ref: /schemas/types.yaml#/definitions/uint32
    enum:
      - 1000
      - 1200
      - 1500
      - 2200
    description: Inductor value for boost converter in nH

  cirrus,stereo-config:
    type: boolean
    description: Boolean to enable two amplifiers in stereo configuration

  cirrus,audio-channel:
    $ref: /schemas/types.yaml#/definitions/uint32
    enum:
      - 0
      - 1
    description: Location of the audio signal on serial port (0=Left,1=Right)

  cirrus,advisory-channel:
    $ref: /schemas/types.yaml#/definitions/uint32
    enum:
      - 0
      - 1
    description: Location of the advisory signal on serial port (0=Left,1=Right)

  cirrus,shared-boost:
    type: boolean
    description: Enable ClassH tracking of advisory signal when sharing boost

  cirrus,external-boost:
    type: boolean
    description: Specify use of external boost supply

  cirrus,sp-drv-strength:
    $ref: /schemas/types.yaml#/definitions/uint32
    enum:
      - 0
      - 1
    description: Serial port drive strength (0=1x,1=0.5x)

  cirrus,sp-drv-unused:
    $ref: /schemas/types.yaml#/definitions/uint32
    enum:
      - 0
      - 2
      - 3
    description: How unused slots are driven (0=Hi-Z,2=Drive-0,3=Drive-1)

  cirrus,bst-pdn-fet-on:
    type: boolean
    description: Control PDN FET on/off when shutting down boost

  cirrus,boost-ctl-millivolt:
    $ref: /schemas/types.yaml#/definitions/uint32
    description: Boost converter output voltage in mV

  cirrus,boost-peak-milliamp:
    $ref: /schemas/types.yaml#/definitions/uint32
    description: Boost-converter peak current limit in mA

  cirrus,amp-gain-zc:
    type: boolean
    description: Use amplifier gain-change zero-cross

  cirrus,classh-internal-algo:
    description: Sub-node for the Internal Class H Algorithm
    type: object
    additionalProperties: false

    properties:
      cirrus,classh-bst-overide:
        type: boolean
        description: Override for Class H boost control
      cirrus,classh-bst-max-limit:
        $ref: /schemas/types.yaml#/definitions/uint32
        description: Maximum boost limit
      cirrus,classh-mem-depth:
        $ref: /schemas/types.yaml#/definitions/uint32
        description: Class H memory depth
      cirrus,classh-headroom:
        $ref: /schemas/types.yaml#/definitions/uint32
        description: Class H headroom control value in mV
      cirrus,classh-release-rate:
        $ref: /schemas/types.yaml#/definitions/uint32
        description: Class H release rate
      cirrus,classh-wk-fet-disable:
        type: boolean
        description: Disable weak FET drive in Class H
      cirrus,classh-wk-fet-delay:
        $ref: /schemas/types.yaml#/definitions/uint32
        description: Weak FET drive delay
      cirrus,classh-wk-fet-thld:
        $ref: /schemas/types.yaml#/definitions/uint32
        description: Weak FET drive threshold
      cirrus,classh-vpch-auto:
        type: boolean
        description: Automatic VPCH control in Class H
      cirrus,classh-vpch-rate:
        $ref: /schemas/types.yaml#/definitions/uint32
        description: VPCH rate
      cirrus,classh-vpch-man:
        $ref: /schemas/types.yaml#/definitions/uint32
        description: Manual VPCH control

  cirrus,monitor-signal-format:
    description: Sub-node for monitor signal formatting on the I2S port
    type: object
    additionalProperties: false
    properties:
      cirrus,imon:
        $ref: /schemas/types.yaml#/definitions/uint8-array
        description: Depth, location, frame, and ADC scale of the IMON signal
      cirrus,vmon:
        $ref: /schemas/types.yaml#/definitions/uint8-array
        description: Depth, location, and frame of the VMON signal
      cirrus,vpmon:
        $ref: /schemas/types.yaml#/definitions/uint8-array
        description: Depth, location, and frame of the VPMON signal
      cirrus,vbstmon:
        $ref: /schemas/types.yaml#/definitions/uint8-array
        description: Depth, location, and frame of the VBSTMON signal
      cirrus,vpbrstat:
        $ref: /schemas/types.yaml#/definitions/uint8-array
        description: Depth, location, and frame of the VPBRSTAT signal
      cirrus,zerofill:
        $ref: /schemas/types.yaml#/definitions/uint8-array
        description: Zero-fill packet formatting

required:
  - compatible
  - reg
  - VA-supply
  - VP-supply
  - interrupts

additionalProperties: false

examples:
  - |
    cs35l35@20 {
      compatible = "cirrus,cs35l35";
      reg = <0x20>;
      VA-supply = <&dummy_vreg>;
      VP-supply = <&dummy_vreg>;
      reset-gpios = <&axi_gpio 54 0>;
      interrupts = <3 IRQ_TYPE_LEVEL_LOW>;
      cirrus,boost-ctl-millivolt = <9000>;
      cirrus,stereo-config;
      cirrus,audio-channel = <0x00>;
      cirrus,advisory-channel = <0x01>;
      cirrus,shared-boost;
      cirrus,classh-internal-algo {
        cirrus,classh-bst-overide;
        cirrus,classh-bst-max-limit = <0x01>;
        cirrus,classh-mem-depth = <0x01>;
        cirrus,classh-release-rate = <0x08>;
        cirrus,classh-headroom = <0x0B>;
        cirrus,classh-wk-fet-disable = <0x01>;
        cirrus,classh-wk-fet-delay = <0x04>;
        cirrus,classh-wk-fet-thld = <0x01>;
        cirrus,classh-vpch-auto = <0x01>;
        cirrus,classh-vpch-rate = <0x02>;
        cirrus,classh-vpch-man = <0x05>;
      };
      cirrus,monitor-signal-format {
        cirrus,imon = /bits/ 8 <0x03 0x00 0x01>;
        cirrus,vmon = /bits/ 8 <0x03 0x00 0x00>;
        cirrus,vpmon = /bits/ 8 <0x03 0x04 0x00>;
        cirrus,vbstmon = /bits/ 8 <0x03 0x04 0x01>;
        cirrus,vpbrstat = /bits/ 8 <0x00 0x04 0x00>;
        cirrus,zerofill = /bits/ 8 <0x00 0x00 0x00>;
      };
    };
```
