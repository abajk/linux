## Documentation/devicetree/bindings/sound/dlg,da7218.yaml
```yaml
# SPDX-License-Identifier: (GPL-2.0-only OR BSD-2-Clause)
%YAML 1.2
---
$id: http://devicetree.org/schemas/sound/dlg,da7218.yaml#
$schema: http://devicetree.org/meta-schemas/core.yaml#

title: Dialog Semiconductor DA7218 Audio Codec

maintainers:
  - Adam Thomson <Adam.Thomson.Opensource@diasemi.com>

description: |
  Dialog Semiconductor DA7218 Audio Codec bindings

  DA7218 is an audio codec with HP detect feature.

properties:
  compatible:
    items:
      - enum: ['dlg,da7217', 'dlg,da7218']

  reg:
    description: Specifies the I2C slave address

  VDD-supply:
    description: VDD power supply for the device

  VDDMIC-supply:
    description: VDDMIC power supply for the device

  VDDIO-supply:
    description: VDDIO power supply for the device

  interrupts:
    maxItems: 1

  interrupt-names:
    description: >-
      Name associated with interrupt line. Should be "wakeup" if interrupt is
      to be used to wake system, otherwise "irq".
    items:
      - enum: [wakeup, irq]

  wakeup-source: true

  clocks:
    description: Phandle and clock specifier for codec MCLK.
    maxItems: 1

  clock-names:
    items:
      - const: mclk

  dlg,micbias1-lvl-millivolt:
    description: Voltage (mV) for Mic Bias 1
    enum: [1200, 1600, 1800, 2000, 2200, 2400, 2600, 2800, 3000]

  dlg,micbias2-lvl-millivolt:
    description: Voltage (mV) for Mic Bias 2
    enum: [1200, 1600, 1800, 2000, 2200, 2400, 2600, 2800, 3000]

  dlg,mic1-amp-in-sel:
    description: Mic1 input source type
    enum: [diff, se_p, se_n]

  dlg,mic2-amp-in-sel:
    description: Mic2 input source type
    enum: [diff, se_p, se_n]

  dlg,dmic1-data-sel:
    description: DMIC1 channel select based on clock edge.
    enum: [lrise_rfall, lfall_rrise]

  dlg,dmic1-samplephase:
    description: When to sample audio from DMIC1.
    enum: [on_clkedge, between_clkedge]

  dlg,dmic1-clkrate-hz:
    description: DMIC1 clock frequency (Hz).
    enum: [1500000, 3000000]

  dlg,dmic2-data-sel:
    description: DMIC2 channel select based on clock edge.
    enum: [lrise_rfall, lfall_rrise]

  dlg,dmic2-samplephase:
    description: When to sample audio from DMIC2.
    enum: [on_clkedge, between_clkedge]

  dlg,dmic2-clkrate-hz:
    description: DMIC2 clock frequency (Hz).
    enum: [1500000, 3000000]

  dlg,hp-diff-single-supply:
    description: Boolean flag, use single supply for HP (DA7217 only)

  da7218_hpldet:
    description: DA7218 hot-plug detect child node.
    type: object
    additionalProperties: false
    properties:
      dlg,jack-rate-us:
        description: Time between jack detect measurements (us).
        enum: [5, 10, 20, 40, 80, 160, 320, 640]
      dlg,jack-debounce:
        description: Number of debounce measurements taken for jack detect.
        enum: [0, 2, 3, 4]
      dlg,jack-threshold-pct:
        description: Threshold level for jack detection (% of VDD).
        enum: [84, 88, 92, 96]
      dlg,comp-inv:
        description: Boolean flag, invert comparator output.
        type: boolean
      dlg,hyst:
        description: Boolean flag, enable hysteresis.
        type: boolean
      dlg,discharge:
        description: Boolean flag, auto discharge of Mic Bias on jack removal.
        type: boolean

required:
  - compatible
  - reg
  - VDD-supply
  - VDDMIC-supply
  - VDDIO-supply

additionalProperties: false

examples:
  - |
    codec: da7218@1a {
        compatible = "dlg,da7218";
        reg = <0x1a>;
        interrupts = <11 IRQ_TYPE_LEVEL_LOW>;
        wakeup-source;
        VDD-supply = <&reg_audio>;
        VDDMIC-supply = <&reg_audio>;
        VDDIO-supply = <&reg_audio>;
        clocks = <&clks 201>;
        clock-names = "mclk";
        dlg,micbias1-lvl-millivolt = <2600>;
        dlg,micbias2-lvl-millivolt = <2600>;
        dlg,mic1-amp-in-sel = "diff";
        dlg,mic2-amp-in-sel = "diff";
        dlg,dmic1-data-sel = "lrise_rfall";
        dlg,dmic1-samplephase = "on_clkedge";
        dlg,dmic1-clkrate-hz = <3000000>;
        dlg,dmic2-data-sel = "lrise_rfall";
        dlg,dmic2-samplephase = "on_clkedge";
        dlg,dmic2-clkrate-hz = <3000000>;
        da7218_hpldet {
            dlg,jack-rate-us = <40>;
            dlg,jack-debounce = <2>;
            dlg,jack-threshold-pct = <84>;
            dlg,hyst;
        };
    };
```

## Documentation/devicetree/bindings/sound/dlg,da9055-codec.yaml
```yaml
# SPDX-License-Identifier: (GPL-2.0-only OR BSD-2-Clause)
%YAML 1.2
---
$id: http://devicetree.org/schemas/dlg,da9055-codec.yaml#
$schema: http://devicetree.org/meta-schemas/core.yaml#

title: Dialog DA9055 Audio CODEC
maintainers:
  - Adam Thomson <Adam.Thomson.Opensource@diasemi.com>
  - Randy Dunlap <rdunlap@infradead.org>

description: |
  * Dialog DA9055 Audio CODEC

  DA9055 provides Audio CODEC support (I2C only).

  The Audio CODEC device in DA9055 has its own I2C address which is configurable,
  so the device is instantiated separately from the PMIC (MFD) device.

  For details on accompanying PMIC I2C device, see the following:
  Documentation/devicetree/bindings/mfd/da9055.txt

properties:
  compatible:
    items:
      - const: dlg,da9055-codec
  reg:
    items:
      - description: I2C slave address

required:
  - compatible
  - reg

additionalProperties: false

examples:
  - |
    codec: da9055-codec@1a {
        compatible = "dlg,da9055-codec";
        reg = <0x1a>;
    };
```

## Documentation/devicetree/bindings/sound/eukrea,asoc-tlv320.yaml
```yaml
# SPDX-License-Identifier: (GPL-2.0-only OR BSD-2-Clause)
# Copyright 2025 Eukrea
%YAML 1.2
---
$id: http://devicetree.org/schemas/eukrea,asoc-tlv320.yaml#
$schema: http://devicetree.org/meta-schemas/core.yaml#

title: Audio complex for Eukrea boards with tlv320aic23 codec.

maintainers:
  - Denis Carikli <denis@eukrea.com>
  - Nicolin Chen <nicoleotsuka@gmail.com>

description: |
  Audio complex for Eukrea boards with tlv320aic23 codec.

  Note: The AUDMUX port numbering should start at 1, which is consistent with
  hardware manual.

properties:
  compatible:
    items:
      - const: eukrea,asoc-tlv320

  eukrea,model:
    description: The user-visible name of this sound complex.
    $ref: /schemas/types.yaml#/definitions/string

  ssi-controller:
    description: The phandle of the SSI controller.
    $ref: /schemas/types.yaml#/definitions/phandle

  fsl,mux-int-port:
    description: The internal port of the i.MX audio muxer (AUDMUX).
    $ref: /schemas/types.yaml#/definitions/uint32

  fsl,mux-ext-port:
    description: The external port of the i.MX audio muxer.
    $ref: /schemas/types.yaml#/definitions/uint32

additionalProperties: false

examples:
  - |
    sound {
        compatible = "eukrea,asoc-tlv320";
        eukrea,model = "imx51-eukrea-tlv320aic23";
        ssi-controller = <&ssi2>;
        fsl,mux-int-port = <2>;
        fsl,mux-ext-port = <3>;
    };
```

## Documentation/devicetree/bindings/sound/fsl,imx-audio-sgtl5000.yaml
```yaml
# SPDX-License-Identifier: (GPL-2.0-only OR BSD-2-Clause)
# Copyright 2025
%YAML 1.2
---
$id: http://devicetree.org/schemas/fsl,imx-audio-sgtl5000.yaml#
$schema: http://devicetree.org/meta-schemas/core.yaml#

title: Freescale i.MX audio complex with SGTL5000 codec

maintainers:
  - Nicolin Chen <nicoleotsuka@gmail.com>
  - Shawn Guo <shawn.guo@linaro.org>

description: |
  Freescale i.MX audio complex with SGTL5000 codec

  Required properties:

    - compatible: "fsl,imx-audio-sgtl5000"
    - model: The user-visible name of this sound complex
    - ssi-controller: The phandle of the i.MX SSI controller
    - audio-codec: The phandle of the SGTL5000 audio codec
    - audio-routing: A list of the connections between audio components.
      Each entry is a pair of strings, the first being the connection's sink,
      the second being the connection's source. Valid names could be power supplies,
      SGTL5000 pins, and the jacks on the board:
        * Power supplies:
           - Mic Bias
        * SGTL5000 pins:
           - MIC_IN
           - LINE_IN
           - HP_OUT
           - LINE_OUT
        * Board connectors:
           - Mic Jack
           - Line In Jack
           - Headphone Jack
           - Line Out Jack
           - Ext Spk
    - mux-int-port: The internal port of the i.MX audio muxer (AUDMUX)
    - mux-ext-port: The external port of the i.MX audio muxer

properties:
  compatible:
    const: fsl,imx-audio-sgtl5000

  model:
    $ref: /schemas/types.yaml#/definitions/string
    description: A user-visible name for this audio complex.

  ssi-controller:
    $ref: /schemas/types.yaml#/definitions/phandle
    description: The phandle of the i.MX SSI controller.

  audio-codec:
    $ref: /schemas/types.yaml#/definitions/phandle
    description: The phandle of the SGTL5000 audio codec.

  audio-routing:
    $ref: /schemas/types.yaml#/definitions/string-array
    description: A list of the connections between audio components.
      Each entry is a pair of strings (sink, source).

  mux-int-port:
    $ref: /schemas/types.yaml#/definitions/uint32
    description: The internal port number of the i.MX audio muxer (AUDMUX).

  mux-ext-port:
    $ref: /schemas/types.yaml#/definitions/uint32
    description: The external port number of the i.MX audio muxer (AUDMUX).

required:
  - compatible
  - model
  - ssi-controller
  - audio-codec
  - audio-routing
  - mux-int-port
  - mux-ext-port

additionalProperties: false

examples:
  - |
    sound {
      compatible = "fsl,imx-audio-sgtl5000";
      model = "imx-sgtl5000-audio";
      ssi-controller = <&ssi1>;
      audio-codec = <&sgtl5000>;
      audio-routing = "MIC_IN", "Mic Jack",
                      "Mic Jack", "Mic Bias",
                      "Headphone Jack", "HP_OUT";
      mux-int-port = <1>;
      mux-ext-port = <3>;
    };
```

## Documentation/devicetree/bindings/sound/google,storm-audio.yaml
```yaml
# SPDX-License-Identifier: (GPL-2.0-only OR BSD-2-Clause)
# Copyright 2025 Kenneth Westfield <quic_kwestfie@quicinc.com>
%YAML 1.2
---
$id: http://devicetree.org/schemas/google,storm-audio.yaml#
$schema: http://devicetree.org/meta-schemas/core.yaml#

title: google,storm-audio

maintainers:
  - Kenneth Westfield <quic_kwestfie@quicinc.com>

description: |
  * Sound complex for Storm boards
  Models a soundcard for Storm boards with the Qualcomm Technologies IPQ806x SOC
  connected to a MAX98357A DAC via I2S.

properties:
  compatible:
    description: Device compatibility string.
    items:
      - const: google,storm-audio

  cpu:
    description: Phandle of the CPU DAI.
    $ref: /schemas/types.yaml#/definitions/phandle

  codec:
    description: Phandle of the codec DAI.
    $ref: /schemas/types.yaml#/definitions/phandle

  qcom,model:
    description: The user-visible name of this sound card.
    $ref: /schemas/types.yaml#/definitions/string

required:
  - compatible
  - cpu
  - codec

additionalProperties: false

examples:
  - |
    sound {
        compatible = "google,storm-audio";
        qcom,model = "ipq806x-storm";
        cpu = <&lpass_cpu>;
        codec = <&max98357a>;
    };
```
