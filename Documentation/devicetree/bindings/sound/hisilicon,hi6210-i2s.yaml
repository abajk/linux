## Documentation/devicetree/bindings/sound/hisilicon,hi6210-i2s.yaml
```yaml
# SPDX-License-Identifier: (GPL-2.0-only OR BSD-2-Clause)
# Copyright 2018 Linaro Ltd.
%YAML 1.2
---
$id: http://devicetree.org/schemas/sound/hisilicon,hi6210-i2s.yaml#

$schema: http://devicetree.org/meta-schemas/core.yaml#

title: Hisilicon 6210 I2S controller

maintainers:
  - John Stultz <john.stultz@linaro.org>

description: |
  Hisilicon 6210 i2s controller

properties:
  compatible:
    items:
      - const: hisilicon,hi6210-i2s

  reg:
    items:
      - description: physical base address of the i2s controller unit
      - description: length of memory mapped region

  interrupts:
    maxItems: 1
    description: Interrupt specifier for the I2S controller. Should contain the I2S interrupt.

  clocks:
    description: List of phandle and clock-specifier pairs for the controller
    items:
      - description: phandle and specifier for dacodec clock
      - description: phandle and specifier for i2s-base clock

  clock-names:
    items:
      - const: dacodec
      - const: i2s-base

  dmas:
    description: DMA specifiers for the controller; see the DMA client binding
    items:
      - description: first DMA specifier
      - description: second DMA specifier

  dma-names:
    items:
      - const: rx
      - const: tx

  hisilicon,sysctrl-syscon: true

  '#sound-dai-cells':
    const: 1

additionalProperties: false

examples:
  - |
    i2s0: i2s@f7118000{
        compatible = "hisilicon,hi6210-i2s";
        reg = <0x0 0xf7118000 0x0 0x8000>; /* i2s unit */
        interrupts = <GIC_SPI 123 IRQ_TYPE_LEVEL_HIGH>; /* 155 "DigACodec_intr"-32 */
        clocks = <&sys_ctrl HI6220_DACODEC_PCLK>,
                 <&sys_ctrl HI6220_BBPPLL0_DIV>;
        clock-names = "dacodec", "i2s-base";
        dmas = <&dma0 15 &dma0 14>;
        dma-names = "rx", "tx";
        hisilicon,sysctrl-syscon = <&sys_ctrl>;
        #sound-dai-cells = <1>;
    };

    Then when referencing the i2s controller:
        sound-dai = <&i2s0 0>; /* index 0 => S2 interface */
```

## Documentation/devicetree/bindings/sound/img,i2s-in.yaml
```yaml
# SPDX-License-Identifier: (GPL-2.0-only OR BSD-2-Clause)
%YAML 1.2
---
$id: http://devicetree.org/schemas/sound/img,i2s-in.yaml#
$schema: http://devicetree.org/meta-schemas/core.yaml#

title: Imagination Technologies I2S Input Controller

maintainers:
  - Damien.Horsley <Damien.Horsley@imgtec.com>

description: |
  Imagination Technologies I2S Input Controller

properties:
  compatible:
    contains:
      const: img,i2s-in

  '#sound-dai-cells':
    const: 0

  reg:
    maxItems: 1

  clocks:
    # Single system clock entry.
    maxItems: 1
    description: System clock.

  clock-names:
    items:
      - const: sys

  dmas:
    # Single DMA channel entry.
    maxItems: 1
    description: DMA channels used by the I2S input controller.

  dma-names:
    items:
      - const: rx

  img,i2s-channels:
    description: Number of I2S channels instantiated.
    $ref: /schemas/types.yaml#/definitions/uint32

  interrupts:
    description: I2S input interrupts, one per channel in ascending channel order.
    maxItems: 1

  resets:
    description: Reset signals for the I2S input controller.
    maxItems: 1

  reset-names:
    items:
      - const: rst

required:
  - compatible
  - '#sound-dai-cells'
  - reg
  - clocks
  - clock-names
  - dmas
  - dma-names
  - img,i2s-channels

additionalProperties: false

examples:
  - |
    i2s_in: i2s-in@18100800 {
        compatible = "img,i2s-in";
        reg = <0x18100800 0x200>;
        clocks = <&cr_periph SYS_CLK_I2S_IN>;
        clock-names = "sys";
        dmas = <&mdc 30 0xffffffff 0>;
        dma-names = "rx";
        img,i2s-channels = <6>;
        #sound-dai-cells = <0>;
        interrupts = <GIC_SHARED 7 IRQ_TYPE_LEVEL_HIGH>;
        resets = <&rst>;
        reset-names = "rst";
    };
```

## Documentation/devicetree/bindings/sound/img,i2s-out.yaml
```yaml
# SPDX-License-Identifier: (GPL-2.0-only OR BSD-2-Clause)
%YAML 1.2
---
$id: http://devicetree.org/schemas/img,i2s-out.yaml#
$schema: http://devicetree.org/meta-schemas/core.yaml#

title: Imagination Technologies I2S Output Controller

maintainers:
  - Damien.Horsley <Damien.Horsley@imgtec.com>
  - Rob Herring <robh@kernel.org>

description: |
  Imagination Technologies I2S Output Controller

  Required Properties:
    - #sound-dai-cells: Must be equal to 0
    - reg: Offset and length of the register set for the device
    - clocks: Contains an entry for each entry in clock-names
    - clock-names: Must include the following entries:
        "sys": The system clock
        "ref": The reference clock
    - dmas: Contains an entry for each entry in dma-names.
    - dma-names: Must include the following entry:
        "tx": Single DMA channel used by all active I2S channels
    - img,i2s-channels: Number of I2S channels instantiated in the I2S out block
    - resets: Contains a phandle to the I2S out reset signal
    - reset-names: Contains the reset signal name "rst"

  Optional Properties:
    - interrupts: |
        Contains the I2S out interrupts. Depending on the configuration,
        there may be no interrupts, one interrupt,
        or an interrupt per I2S channel. For the case where there is
        one interrupt per channel, the interrupts should be listed
        in ascending channel order

properties:
  compatible:
    description: A list of compatible strings.
    items:
      - const: img,i2s-out

  '#sound-dai-cells':
    description: Must be equal to 0.
    const: 0

  reg:
    maxItems: 1

  clocks:
    maxItems: 2

  clock-names:
    description: Names for clocks.
    items:
      - const: sys
      - const: ref

  dmas:
    maxItems: 1

  dma-names:
    description: Names for DMA channels.
    items:
      - const: tx

  img,i2s-channels:
    description: Number of I2S channels instantiated in the I2S out block.
    $ref: /schemas/types.yaml#/definitions/uint32

  resets:
    description: A reset phandle for I2S out.
    items:
      description: A phandle and specifier for a reset line.

  reset-names:
    description: Names for reset lines.
    items:
      - const: rst

  interrupts:
    description: I2S out interrupts.
    items:
      description: An interrupt specifier.

required:
  - compatible
  - '#sound-dai-cells'
  - reg
  - clocks
  - clock-names
  - dmas
  - dma-names
  - img,i2s-channels
  - resets
  - reset-names

additionalProperties: false

examples:
  - |
    i2s_out: i2s-out@18100a00 {
        compatible = "img,i2s-out";
        reg = <0x18100A00 0x200>;
        interrupts = <GIC_SHARED 13 IRQ_TYPE_LEVEL_HIGH>;
        dmas = <&mdc 23 0xffffffff 0>;
        dma-names = "tx";
        clocks = <&cr_periph SYS_CLK_I2S_OUT>,
                 <&clk_core CLK_I2S>;
        clock-names = "sys", "ref";
        img,i2s-channels = <6>;
        resets = <&pistachio_reset PISTACHIO_RESET_I2S_OUT>;
        reset-names = "rst";
        #sound-dai-cells = <0>;
    };
```

## Documentation/devicetree/bindings/sound/img,parallel-out.yaml
```yaml
# SPDX-License-Identifier: (GPL-2.0-only OR BSD-2-Clause)
# Copyright 2025 Imagination Technologies
%YAML 1.2
---
$id: http://devicetree.org/schemas/img,parallel-out.yaml#
$schema: http://devicetree.org/meta-schemas/core.yaml#

title: Imagination Technologies Parallel Output Controller

maintainers:
  - Damien.Horsley <Damien.Horsley@imgtec.com>
  - Rob Herring <robh@kernel.org>

description: |
  Imagination Technologies Parallel Output Controller

properties:
  compatible:
    items:
      - const: img,parallel-out
  '#sound-dai-cells':
    description: Must be equal to 0.
    const: 0
  reg:
    maxItems: 1

  dmas:
    maxItems: 1

  dma-names:
    items:
      - const: tx
  clocks:
    maxItems: 2

  clock-names:
    items:
      - const: sys
      - const: ref

  resets:
    maxItems: 1

  reset-names:
    items:
      - const: rst

  interrupts:
    maxItems: 1

required:
  - compatible
  - '#sound-dai-cells'
  - reg
  - dmas
  - dma-names
  - clocks
  - clock-names
  - resets
  - reset-names

additionalProperties: false

examples:
  - |
    parallel_out: parallel-out@18100c00 {
        compatible = "img,parallel-out";
        #sound-dai-cells = <0>;
        reg = <0x18100C00 0x100>;
        dmas = <&mdc 16 0xffffffff 0>;
        dma-names = "tx";
        clocks = <&cr_periph SYS_CLK_PAUD_OUT>,
                 <&clk_core CLK_AUDIO_DAC>;
        clock-names = "sys", "ref";
        resets = <&pistachio_reset PISTACHIO_RESET_PRL_OUT>;
        reset-names = "rst";
        interrupts = <GIC_SHARED 19 IRQ_TYPE_LEVEL_HIGH>;
    };
```

## Documentation/devicetree/bindings/sound/img,pistachio-internal-dac.yaml
```yaml
# SPDX-License-Identifier: (GPL-2.0-only OR BSD-2-Clause)
%YAML 1.2
---
$id: http://devicetree.org/schemas/img,pistachio-internal-dac.yaml#
$schema: http://devicetree.org/meta-schemas/core.yaml#

title: IMG Pistachio Internal DAC

maintainers:
  - Damien.Horsley <Damien.Horsley@imgtec.com>

description: |
  Pistachio internal DAC DT bindings

properties:
  compatible:
    const: img,pistachio-internal-dac

  img,cr-top:
    description: |
      Must contain a phandle to the top level control syscon node which
      contains the internal DAC control registers
    $ref: /schemas/types.yaml#/definitions/phandle

  VDD-supply:
    description: Digital power supply regulator (+1.8V or +3.3V)

required:
  - compatible
  - img,cr-top
  - VDD-supply

additionalProperties: false

examples:
  - |
    internal_dac: internal-dac {
        compatible = "img,pistachio-internal-dac";
        img,cr-top = <&cr_top>;
        VDD-supply = <&supply3v3>;
    };
```

## Documentation/devicetree/bindings/sound/img,spdif-in.yaml
```yaml
# SPDX-License-Identifier: (GPL-2.0-only OR BSD-2-Clause)
%YAML 1.2
---
$id: http://devicetree.org/schemas/img,spdif-in.yaml#
$schema: http://devicetree.org/meta-schemas/core.yaml#

title: Imagination Technologies SPDIF Input Controller

maintainers:
  - Damien.Horsley <Damien.Horsley@imgtec.com>
  - Rob Herring <robh@kernel.org>

description: |
  Imagination Technologies SPDIF Input Controller

properties:
  compatible:
    items:
      - const: img,spdif-in

  reg:
    maxItems: 1

  interrupts:
    maxItems: 1

  dmas:
    maxItems: 1

  dma-names:
    items:
      - const: rx

  clocks:
    maxItems: 1

  clock-names:
    items:
      - const: sys

  '#sound-dai-cells':
    const: 0

  resets:
    maxItems: 1

  reset-names:
    items:
      - const: rst

required:
  - compatible
  - reg
  - interrupts
  - dmas
  - dma-names
  - clocks
  - clock-names
  - '#sound-dai-cells'

additionalProperties: false

examples:
  - |
    spdif_in: spdif-in@18100e00 {
      compatible = "img,spdif-in";
      reg = <0x18100E00 0x100>;
      interrupts = <GIC_SHARED 20 IRQ_TYPE_LEVEL_HIGH>;
      dmas = <&mdc 15 0xffffffff 0>;
      dma-names = "rx";
      clocks = <&cr_periph SYS_CLK_SPDIF_IN>;
      clock-names = "sys";
      #sound-dai-cells = <0>;
    };
```

## Documentation/devicetree/bindings/sound/img,spdif-out.yaml
```yaml
# SPDX-License-Identifier: (GPL-2.0-only OR BSD-2-Clause)
# Copyright 2025 Imagination Technologies
%YAML 1.2
---
$id: http://devicetree.org/schemas/sound/img,spdif-out.yaml#
$schema: http://devicetree.org/meta-schemas/core.yaml#

title: Imagination Technologies SPDIF Output Controller

maintainers:
  - Damien.Horsley <Damien.Horsley@imgtec.com>
  - Rob Herring <robh@kernel.org>

description: |
  Imagination Technologies SPDIF Output Controller

properties:
  compatible:
    const: img,spdif-out

  reg:
    items:
      - description: Offset and length of the register set for the device.

  '#sound-dai-cells':
    const: 0

  interrupts:
    description: Parallel audio output interrupt.
    items:
      - description: Interrupt specifier (GIC_SHARED, IRQ number, flags).

  dmas:
    description: DMA controller channels used by the SPDIF controller.
    items:
      - description: DMA controller phandle, channel number, and flags.

  dma-names:
    items:
      - const: tx

  clocks:
    description: Clock inputs to the SPDIF controller.
    items:
      - description: System clock.
      - description: Reference clock.

  clock-names:
    items:
      - const: sys
      - const: ref

  resets:
    description: Reset controls for the SPDIF controller.
    items:
      - description: Reset phandle and specifier.

  reset-names:
    items:
      - const: rst

required:
  - compatible
  - reg
  - '#sound-dai-cells'
  - dmas
  - dma-names
  - clocks
  - clock-names
  - resets
  - reset-names

additionalProperties: false

examples:
  - |
    spdif_out: spdif-out@18100d00 {
        compatible = "img,spdif-out";
        reg = <0x18100D00 0x100>;
        interrupts = <GIC_SHARED 21 IRQ_TYPE_LEVEL_HIGH>;
        dmas = <&mdc 14 0xffffffff 0>;
        dma-names = "tx";
        clocks = <&cr_periph SYS_CLK_SPDIF_OUT>,
                 <&clk_core CLK_SPDIF>;
        clock-names = "sys", "ref";
        resets = <&pistachio_reset PISTACHIO_RESET_SPDIF_OUT>;
        reset-names = "rst";
        #sound-dai-cells = <0>;
    };
```

## Documentation/devicetree/bindings/sound/marvell,a370db-audio.yaml
```yaml
# SPDX-License-Identifier: (GPL-2.0-only OR BSD-2-Clause)
# Copyright 2025 Linaro Ltd.
%YAML 1.2
---
$id: http://devicetree.org/schemas/marvell,a370db-audio.yaml#
$schema: http://devicetree.org/meta-schemas/core.yaml#

title: Armada 370 DB audio

maintainers:
  - Rob Herring <robh@kernel.org>
  - Thomas Petazzoni <thomas.petazzoni@free-electrons.com>

description: |
  Device Tree bindings for the Armada 370 DB audio

  These Device Tree bindings are used to describe the audio complex
  found on the Armada 370 DB platform.

properties:
  compatible:
    items:
      - const: marvell,a370db-audio

  marvell,audio-controller:
    description: Phandle to the Armada 370 SoC audio controller
    $ref: /schemas/types.yaml#/definitions/phandle

  marvell,audio-codec:
    description: Three phandles for the connected audio codec and SPDIF interfaces
    $ref: /schemas/types.yaml#/definitions/phandle-array
    items:
      - description: Analog audio codec
      - description: S/PDIF transceiver
      - description: S/PDIF receiver

required:
  - compatible
  - marvell,audio-controller
  - marvell,audio-codec

additionalProperties: false

examples:
  - |
      sound {
          compatible = "marvell,a370db-audio";
          marvell,audio-controller = <&audio_controller>;
          marvell,audio-codec = <&audio_codec &spdif_out &spdif_in>;
      };
```
