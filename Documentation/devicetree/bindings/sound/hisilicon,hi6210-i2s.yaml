## Documentation/devicetree/bindings/sound/marvell,kirkwood-audio.yaml
```yaml
# SPDX-License-Identifier: (GPL-2.0-only OR BSD-2-Clause)
%YAML 1.2
---
$id: http://devicetree.org/schemas/sound/marvell,kirkwood-audio.yaml#
$schema: http://devicetree.org/meta-schemas/core.yaml#

title: Marvell mvebu Audio Controller

maintainers:
  - Jean-Francois Moine <moinejf@free.fr>
  - Marcin Wojtas <mw@semihalf.com>
  - Thomas Petazzoni <thomas.petazzoni@free-electrons.com>

description: |
  * mvebu (Kirkwood, Dove, Armada 370) audio controller

properties:
  compatible:
    items:
      - const: marvell,kirkwood-audio
      - const: marvell,dove-audio
      - const: marvell,armada370-audio
      - const: marvell,armada-380-audio

  reg:
    description: Physical base address and length of memory mapped region(s).
    oneOf:
      - items:
          - description: I2S controller registers
      - items:
          - description: I2S controller registers
          - description: Audio PLL configuration registers
          - description: SoC control registers

  interrupts:
    description: Interrupts for the audio controller.
    oneOf:
      - items:
          - description: Audio interrupt
      - items:
          - description: Data flow interrupt
          - description: Error interrupt

  clocks:
    description: Controller clocks.
    oneOf:
      - items:
          - description: Internal clock
      - items:
          - description: Internal clock
          - description: External clock

  clock-names:
    description: Names for each clock phandle.
    items:
      - const: internal
      - const: extclk

  spdif-mode:
    description: Enable S/PDIF mode on Armada 38x; disables I2S.
    type: boolean

required:
  - compatible
  - reg
  - interrupts
  - clocks
  - clock-names

additionalProperties: false

examples:
  - |
    audio-controller@b4000 {
      compatible = "marvell,dove-audio";
      reg = <0xb4000 0x2210>;
      interrupts = <21>, <22>;
      clocks = <&gate_clk 13>;
      clock-names = "internal";
    };
```

## Documentation/devicetree/bindings/sound/marvell,pxa2xx-ac97.yaml
```yaml
# SPDX-License-Identifier: (GPL-2.0-only OR BSD-2-Clause)
# Copyright 2025 Robert Jarzmik <robert.jarzmik@free.fr>
%YAML 1.2
---
$id: http://devicetree.org/schemas/sound/marvell,pxa2xx-ac97.yaml#
$schema: http://devicetree.org/meta-schemas/core.yaml#

title: Marvell PXA2xx AC97 audio complex

maintainers:
  - Robert Jarzmik <robert.jarzmik@free.fr>

description: |
  Marvell PXA2xx audio complex

  This description matches the AC97 controller found in pxa2xx and pxa3xx series.

properties:
  compatible:
    enum:
      - marvell,pxa250-ac97
      - marvell,pxa270-ac97
      - marvell,pxa300-ac97

  reg:
    description: MMIO address space for the AC97 controller.
    items:
      - description: Address and size for AC97 registers.

  interrupts:
    description: Interrupt line used by the AC97 controller.
    items:
      - description: AC97 interrupt.

  clocks:
    description: Input clock for the AC97 controller.
    maxItems: 1

  reset-gpios:
    description: GPIO used to reset the AC97 controller.
    maxItems: 1

  pinctrl-names:
    description: Pin control state names.
    items:
      - const: default

  pinctrl-0:
    description: Pin control configuration for default state.

  '#sound-dai-cells':
    description: Number of cells for sound DAI.
    const: 1

required:
  - compatible
  - reg
  - interrupts
  - clocks

additionalProperties: false

examples:
  - |
    ac97: sound@40500000 {
        compatible = "marvell,pxa250-ac97";
        reg = <0x40500000 0x1000>;
        interrupts = <14>;
        reset-gpios = <&gpio 113 GPIO_ACTIVE_HIGH>;
        #sound-dai-cells = <1>;
        pinctrl-names = "default";
        pinctrl-0 = <&pmux_ac97_default>;
    };
```

## Documentation/devicetree/bindings/sound/maxim,max98373.yaml
```yaml
# SPDX-License-Identifier: (GPL-2.0-only OR BSD-2-Clause)
# Copyright 2025 Maxim Integrated
%YAML 1.2
---
$id: http://devicetree.org/schemas/maxim,max98373.yaml#
$schema: http://devicetree.org/meta-schemas/core.yaml#

title: Maxim Integrated MAX98373 Speaker Amplifier

maintainers:
  - Ryan Lee <ryans.lee@maximintegrated.com>

description: |
  Maxim Integrated MAX98373 Speaker Amplifier

  This device supports I2C.

properties:
  compatible:
    items:
      - const: maxim,max98373

  reg:
    description: The I2C address of the device.
    items:
      - description: I2C bus device address

  maxim,vmon-slot-no:
    description: Slot number used to send voltage information or as interleave slot
    $ref: /schemas/types.yaml#/definitions/uint32
    default: 0

  maxim,imon-slot-no:
    description: Slot number used to send current information
    $ref: /schemas/types.yaml#/definitions/uint32
    default: 0

  maxim,spkfb-slot-no:
    description: Slot number used to send speaker feedback information
    $ref: /schemas/types.yaml#/definitions/uint32
    default: 0

  maxim,interleave-mode:
    description: Enable interleave mode to alternate current and voltage data output on a single channel
    type: boolean
    default: false

additionalProperties: false

required:
  - compatible
  - reg

examples:
  - |
    codec: max98373@31 {
        compatible = "maxim,max98373";
        reg = <0x31>;
        maxim,vmon-slot-no = <0>;
        maxim,imon-slot-no = <1>;
        maxim,spkfb-slot-no = <2>;
        maxim,interleave-mode;
    };
```

## Documentation/devicetree/bindings/sound/maxim,max9860.yaml
```yaml
# SPDX-License-Identifier: (GPL-2.0-only OR BSD-2-Clause)
# Copyright 2025 Peter Rosin <peda@axentia.se>
%YAML 1.2
---
$id: http://devicetree.org/schemas/sound/maxim,max9860.yaml#
$schema: http://devicetree.org/meta-schemas/core.yaml#

title: MAX9860 Mono Audio Voice Codec

maintainers:
  - Peter Rosin <peda@axentia.se>

description: |
  MAX9860 Mono Audio Voice Codec

properties:
  compatible:
    items:
      - const: maxim,max9860

  reg:
    description: The I2C address of the device
    items:
      - description: I2C register address

  AVDD-supply:
    description: Power supply for the analog domain

  DVDD-supply:
    description: Power supply for the digital core domain

  DVDDIO-supply:
    description: Power supply for the digital I/O domain

  clock-names:
    items:
      - const: mclk

  clocks:
    description: Master clock input for the codec
    items:
      - description: MCLK signal

additionalProperties: false

examples:
  - |
    max9860: max9860@10 {
        compatible = "maxim,max9860";
        reg = <0x10>;
        AVDD-supply = <&reg_1v8>;
        DVDD-supply = <&reg_1v8>;
        DVDDIO-supply = <&reg_3v0>;
        clock-names = "mclk";
        clocks = <&pck2>;
    };
```

## Documentation/devicetree/bindings/sound/mediatek,mt2701-cs42448-machine.yaml
```yaml
# SPDX-License-Identifier: (GPL-2.0-only OR BSD-2-Clause)
%YAML 1.2
---
$id: http://devicetree.org/schemas/sound/mediatek,mt2701-cs42448-machine.yaml#
$schema: http://devicetree.org/meta-schemas/core.yaml#

title: mediatek,mt2701-cs42448-machine
maintainers:
  - Garlic Tseng <garlic.tseng@mediatek.com>

description: |
  MT2701 with CS42448 CODEC

properties:
  compatible:
    oneOf:
      - items:
          - const: mediatek,mt2701-cs42448-machine

  mediatek,platform:
    description: the phandle of MT2701 ASoC platform
    $ref: /schemas/types.yaml#/definitions/phandle

  audio-routing:
    description: a list of the connections between audio
    $ref: /schemas/types.yaml#/definitions/string-array

  mediatek,audio-codec:
    description: the phandles of cs42448 codec
    $ref: /schemas/types.yaml#/definitions/phandle

  mediatek,audio-codec-bt-mrg:
    description: the phandles of bt-sco dummy codec
    $ref: /schemas/types.yaml#/definitions/phandle

  pinctrl-names:
    description: Should contain only one value - "default"
    items:
      - const: default

  pinctrl-0:
    description: pin control groups used for this controller
    $ref: /schemas/types.yaml#/definitions/phandle-array

  i2s1-in-sel-gpio1:
    description: Should specify a gpio pin to control I2S1-in mux
    $ref: /schemas/types.yaml#/definitions/phandle-array

  i2s1-in-sel-gpio2:
    description: Should specify a gpio pin to control I2S1-in mux
    $ref: /schemas/types.yaml#/definitions/phandle-array

required:
  - compatible
  - mediatek,platform
  - audio-routing
  - mediatek,audio-codec
  - mediatek,audio-codec-bt-mrg
  - pinctrl-names
  - pinctrl-0
  - i2s1-in-sel-gpio1
  - i2s1-in-sel-gpio2

additionalProperties: false

examples:
  - |
    sound:sound {
        compatible = "mediatek,mt2701-cs42448-machine";
        mediatek,platform = <&afe>;
        /* CS42448 Machine name */
        audio-routing =
            "Line Out Jack", "AOUT1L",
            "Line Out Jack", "AOUT1R",
            "Line Out Jack", "AOUT2L",
            "Line Out Jack", "AOUT2R",
            "Line Out Jack", "AOUT3L",
            "Line Out Jack", "AOUT3R",
            "Line Out Jack", "AOUT4L",
            "Line Out Jack", "AOUT4R",
            "AIN1L", "AMIC",
            "AIN1R", "AMIC",
            "AIN2L", "Tuner In",
            "AIN2R", "Tuner In",
            "AIN3L", "Satellite Tuner In",
            "AIN3R", "Satellite Tuner In",
            "AIN3L", "AUX In",
            "AIN3R", "AUX In";
        mediatek,audio-codec = <&cs42448>;
        mediatek,audio-codec-bt-mrg = <&bt_sco_codec>;
        pinctrl-names = "default";
        pinctrl-0 = <&aud_pins_default>;
        i2s1-in-sel-gpio1 = <&pio 53 0>;
        i2s1-in-sel-gpio2 = <&pio 54 0>;
    };
```

## Documentation/devicetree/bindings/sound/mediatek,mt6351-sound.yaml
```yaml
# SPDX-License-Identifier: (GPL-2.0-only OR BSD-2-Clause)
# Copyright 2025 MediaTek Inc.
%YAML 1.2
---
$id: http://devicetree.org/schemas/mediatek,mt6351-sound.yaml#
$schema: http://devicetree.org/meta-schemas/core.yaml#

title: Mediatek MT6351 Audio Codec

maintainers:
  - Kai Chieh Chuang <kaichieh.chuang@mediatek.com>

description: |
  Mediatek MT6351 Audio Codec

  The communication between MT6351 and SoC is through Mediatek PMIC wrapper.
  For more detail, please visit Mediatek PMIC wrapper documentation.

  Must be a child node of PMIC wrapper.

properties:
  compatible:
    items:
      - const: "mediatek,mt6351-sound"
    description: Identifies this node as a Mediatek MT6351 audio codec.

required:
  - compatible

additionalProperties: false

examples:
  - |
    mt6351_snd {
        compatible = "mediatek,mt6351-sound";
    };
```

## Documentation/devicetree/bindings/sound/mediatek,mt6358-sound.yaml
```yaml
# SPDX-License-Identifier: (GPL-2.0-only OR BSD-2-Clause)
%YAML 1.2
---
$id: http://devicetree.org/schemas/sound/mediatek,mt6358-sound.yaml#
$schema: http://devicetree.org/meta-schemas/core.yaml#

title: Mediatek MT6358 Audio Codec

maintainers:
  - Jiaxin Yu <jiaxin.yu@mediatek.com>
  - Shunli Wang <shunli.wang@mediatek.com>

description: |
  Mediatek MT6358 Audio Codec

  The communication between MT6358 and SoC is through Mediatek PMIC wrapper.
  For more detail, please visit Mediatek PMIC wrapper documentation.

  Must be a child node of PMIC wrapper.

properties:
  compatible:
    description: Device compatible with Mediatek MT6358 or MT6366 audio codec.
    items:
      - enum:
          - mediatek,mt6358-sound
          - mediatek,mt6366-sound

  Avdd-supply: true

  mediatek,dmic-mode:
    description: Indicates how many data pins are used to transmit two channels of
      PDM signal. 0 means two wires, 1 means one wire.
    $ref: /schemas/types.yaml#/definitions/uint32
    default: 0

required:
  - compatible
  - Avdd-supply

additionalProperties: false

examples:
  - |
    mt6358_snd {
      compatible = "mediatek,mt6358-sound";
      Avdd-supply = <&mt6358_vaud28_reg>;
      mediatek,dmic-mode = <0>;
    };
```

## Documentation/devicetree/bindings/sound/mediatek,mt6797-audio.yaml
```yaml
# SPDX-License-Identifier: (GPL-2.0-only OR BSD-2-Clause)
# Copyright 2025 MediaTek Inc.
%YAML 1.2
---
$id: http://devicetree.org/schemas/sound/mediatek,mt6797-audio.yaml#
$schema: http://devicetree.org/meta-schemas/core.yaml#

title: Mediatek AFE PCM controller for mt6797
maintainers:
  - Kai Chieh Chuang <kaichieh.chuang@mediatek.com>

description: |
  Mediatek AFE PCM controller for mt6797

properties:
  compatible:
    items:
      - const: mediatek,mt6797-audio

  reg:
    items:
      - description: register location and size

  interrupts:
    items:
      - description: AFE interrupt

  power-domains:
    description: Should define the power domain
    $ref: /schemas/types.yaml#/definitions/phandle-array

  clocks:
    description: Must contain an entry for each entry in clock-names
    items:
      - description: infra_sys_audio_clk clock
      - description: infra_sys_audio_26m clock
      - description: mtkaif_26m_clk clock
      - description: top_mux_audio clock
      - description: top_mux_aud_intbus clock
      - description: top_sys_pll3_d4 clock
      - description: top_sys_pll1_d4 clock
      - description: top_clk26m_clk clock

  clock-names:
    items:
      - const: infra_sys_audio_clk
      - const: infra_sys_audio_26m
      - const: mtkaif_26m_clk
      - const: top_mux_audio
      - const: top_mux_aud_intbus
      - const: top_sys_pll3_d4
      - const: top_sys_pll1_d4
      - const: top_clk26m_clk

required:
  - compatible
  - reg
  - interrupts
  - power-domains
  - clocks
  - clock-names

additionalProperties: false

examples:
  - |
    afe: mt6797-afe-pcm@11220000 {
        compatible = "mediatek,mt6797-audio";
        reg = <0 0x11220000 0 0x1000>;
        interrupts = <GIC_SPI 151 IRQ_TYPE_LEVEL_LOW>;
        power-domains = <&scpsys MT6797_POWER_DOMAIN_AUDIO>;
        clocks = <&infrasys CLK_INFRA_AUDIO>,
                 <&infrasys CLK_INFRA_AUDIO_26M>,
                 <&infrasys CLK_INFRA_AUDIO_26M_PAD_TOP>,
                 <&topckgen CLK_TOP_MUX_AUDIO>,
                 <&topckgen CLK_TOP_MUX_AUD_INTBUS>,
                 <&topckgen CLK_TOP_SYSPLL3_D4>,
                 <&topckgen CLK_TOP_SYSPLL1_D4>,
                 <&clk26m>;
        clock-names = "infra_sys_audio_clk",
                      "infra_sys_audio_26m",
                      "mtkaif_26m_clk",
                      "top_mux_audio",
                      "top_mux_aud_intbus",
                      "top_sys_pll3_d4",
                      "top_sys_pll1_d4",
                      "top_clk26m_clk";
    };
```

## Documentation/devicetree/bindings/sound/mediatek,mt6797-mt6351-sound.yaml
```yaml
# SPDX-License-Identifier: (GPL-2.0-only OR BSD-2-Clause)
# Copyright 2025 MediaTek Inc.
%YAML 1.2
---
$schema: http://devicetree.org/meta-schemas/core.yaml#
$id: http://devicetree.org/schemas/mediatek,mt6797-mt6351-sound.yaml#

title: MT6797 with MT6351 CODEC

maintainers:
  - Kai Chieh Chuang <kaichieh.chuang@mediatek.com>

description: |
  MT6797 with MT6351 CODEC

properties:
  compatible:
    const: mediatek,mt6797-mt6351-sound
    description: Device compatible string

  mediatek,platform:
    description: Phandle to the MT6797 ASoC platform
    $ref: /schemas/types.yaml#/definitions/phandle

  mediatek,audio-codec:
    description: Phandle to the MT6351 audio codec
    $ref: /schemas/types.yaml#/definitions/phandle

required:
  - compatible
  - mediatek,platform
  - mediatek,audio-codec

additionalProperties: false

examples:
  - |
    sound {
        compatible = "mediatek,mt6797-mt6351-sound";
        mediatek,audio-codec = <&mt6351_snd>;
        mediatek,platform = <&afe>;
    };
```
