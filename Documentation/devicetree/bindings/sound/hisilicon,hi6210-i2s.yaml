## Documentation/devicetree/bindings/sound/mediatek,mt8173-max98090.yaml
```yaml
# SPDX-License-Identifier: (GPL-2.0-only OR BSD-2-Clause)
%YAML 1.2
---
$id: http://devicetree.org/schemas/sound/mediatek,mt8173-max98090.yaml#
$schema: http://devicetree.org/meta-schemas/core.yaml#

title: MT8173 with MAX98090 CODEC

maintainers:
  - Koro Chen <koro.chen@mediatek.com>

description: |
  MT8173 with MAX98090 CODEC

properties:
  compatible:
    items:
      - const: mediatek,mt8173-max98090

  mediatek,audio-codec:
    description: The phandle of the MAX98090 audio codec
    $ref: /schemas/types.yaml#/definitions/phandle

  mediatek,platform:
    description: The phandle of MT8173 ASoC platform
    $ref: /schemas/types.yaml#/definitions/phandle

required:
  - compatible
  - mediatek,audio-codec
  - mediatek,platform

additionalProperties: false

examples:
  - |
    sound {
        compatible = "mediatek,mt8173-max98090";
        mediatek,audio-codec = <&max98090>;
        mediatek,platform = <&afe>;
    };
```

## Documentation/devicetree/bindings/sound/mediatek,mt8173-rt5650-rt5514.yaml
```yaml
# SPDX-License-Identifier: (GPL-2.0-only OR BSD-2-Clause)
# Copyright 2025 MediaTek Inc.
%YAML 1.2
---
$id: http://devicetree.org/schemas/sound/mediatek,mt8173-rt5650-rt5514.yaml#
$schema: http://devicetree.org/meta-schemas/core.yaml#

title: MT8173 with RT5650 RT5514 CODECS

maintainers:
  - Koro Chen <koro.chen@mediatek.com>

description: |
  MT8173 with RT5650 RT5514 CODECS

properties:
  compatible:
    items:
      - const: "mediatek,mt8173-rt5650-rt5514"
    description: Binding compatible string
  mediatek,audio-codec:
    description: Phandles of RT5650 and RT5514 codecs
    items:
      - $ref: /schemas/types.yaml#/definitions/phandle
      - $ref: /schemas/types.yaml#/definitions/phandle
  mediatek,platform:
    description: Phandle of MT8173 ASoC platform
    $ref: /schemas/types.yaml#/definitions/phandle

required:
  - compatible
  - mediatek,audio-codec
  - mediatek,platform

additionalProperties: false

examples:
  - |
    sound {
        compatible = "mediatek,mt8173-rt5650-rt5514";
        mediatek,audio-codec = <&rt5650 &rt5514>;
        mediatek,platform = <&afe>;
    };
```

## Documentation/devicetree/bindings/sound/mediatek,mt8173-rt5650-rt5676.yaml
```yaml
# SPDX-License-Identifier: (GPL-2.0-only OR BSD-2-Clause)
# Copyright 2025 MediaTek
%YAML 1.2
---
$id: http://devicetree.org/schemas/sound/mediatek,mt8173-rt5650-rt5676.yaml#
$schema: http://devicetree.org/meta-schemas/core.yaml#

title: MT8173 with RT5650 RT5676 CODECS and HDMI via I2S

maintainers:
  - Koro Chen <koro.chen@mediatek.com>

description: |
  MT8173 with RT5650 RT5676 CODECS and HDMI via I2S

  Required properties:
  - compatible: "mediatek,mt8173-rt5650-rt5676"
  - mediatek,audio-codec: the phandles of rt5650 and rt5676 codecs and of the HDMI encoder node
  - mediatek,platform: the phandle of MT8173 ASoC platform

properties:
  compatible:
    items:
      - const: mediatek,mt8173-rt5650-rt5676

  mediatek,audio-codec:
    description: phandles for rt5650, rt5676 codecs and HDMI encoder node
    $ref: /schemas/types.yaml#/definitions/phandle-array
    items:
      - $ref: /schemas/types.yaml#/definitions/phandle
      - $ref: /schemas/types.yaml#/definitions/phandle
      - $ref: /schemas/types.yaml#/definitions/phandle

  mediatek,platform:
    description: phandle for the MT8173 ASoC platform
    $ref: /schemas/types.yaml#/definitions/phandle

required:
  - compatible
  - mediatek,audio-codec
  - mediatek,platform

additionalProperties: false

examples:
  - |
    sound {
      compatible = "mediatek,mt8173-rt5650-rt5676";
      mediatek,audio-codec = <&rt5650 &rt5676 &hdmi0>;
      mediatek,platform = <&afe>;
    };
```

## Documentation/devicetree/bindings/sound/mediatek,mt8173-rt5650.yaml
```yaml
# SPDX-License-Identifier: (GPL-2.0-only OR BSD-2-Clause)
# Copyright 2025 MediaTek Inc.
%YAML 1.2
---
$id: http://devicetree.org/schemas/sound/mediatek,mt8173-rt5650.yaml#
$schema: http://devicetree.org/meta-schemas/core.yaml#

title: MT8173 with RT5650 CODECS and HDMI via I2S

maintainers:
  - Koro Chen <koro.chen@mediatek.com>
  - PC Liao <pc.liao@mediatek.com>

description: |
  MT8173 with RT5650 CODECS and HDMI via I2S

properties:
  compatible:
    const: "mediatek,mt8173-rt5650"

  mediatek,audio-codec:
    description: Phandles of RT5650 codecs and HDMI encoder node
    $ref: /schemas/types.yaml#/definitions/phandle-array

  mediatek,platform:
    description: Phandle of MT8173 ASoC platform
    $ref: /schemas/types.yaml#/definitions/phandle

  mediatek,mclk:
    description: |
      The MCLK source
      0: external oscillator (MCLK = 12.288M)
      1: internal source from MT8173 (MCLK = sampling rate*256)
    $ref: /schemas/types.yaml#/definitions/uint32
    enum: [0, 1]

  codec-capture:
    description: Subnode of RT5650 codec capture
    type: object
    additionalProperties: false
    properties:
      sound-dai:
        description: Audio codec DAI name on capture path
        maxItems: 1

    required:
      - sound-dai

required:
  - compatible
  - mediatek,audio-codec
  - mediatek,platform

additionalProperties: false

examples:
  - |
    sound {
        compatible = "mediatek,mt8173-rt5650";
        mediatek,audio-codec = <&rt5650 &hdmi0>;
        mediatek,platform = <&afe>;
        mediatek,mclk = <0>;
        codec-capture {
            sound-dai = <&rt5650 1>;
        };
    };
```

## Documentation/devicetree/bindings/sound/mediatek,mt8183-audio.yaml
```yaml
# SPDX-License-Identifier: (GPL-2.0-only OR BSD-2-Clause)
# Copyright 2025 MediaTek Inc.
%YAML 1.2
---
$id: http://devicetree.org/schemas/sound/mediatek,mt8183-audio.yaml#
$schema: http://devicetree.org/meta-schemas/core.yaml#

title: mediatek,mt8183-audio

maintainers:
  - Jiaxin Yu <jiaxin.yu@mediatek.com>
  - Shunli Wang <shunli.wang@mediatek.com>

description: |
  Mediatek AFE PCM controller for mt8183

properties:
  compatible:
    items:
      - const: mediatek,mt8183-audio

  reg:
    description: Register location and size

  interrupts:
    description: AFE interrupt
    items:
      - description: AFE interrupt

  resets:
    description: Reset controller phandle

  reset-names:
    items:
      - const: audiosys

  power-domains:
    description: Power domain for audio

  clocks:
    description: Clocks required by PCM controller
    items:
      - description: infra_sys_audio_clk
      - description: mtkaif_26m_clk
      - description: top_mux_audio
      - description: top_mux_aud_intbus
      - description: top_sys_pll3_d4
      - description: top_clk26m_clk

  clock-names:
    items:
      - const: infra_sys_audio_clk
      - const: mtkaif_26m_clk
      - const: top_mux_audio
      - const: top_mux_aud_intbus
      - const: top_sys_pll3_d4
      - const: top_clk26m_clk

required:
  - compatible
  - reg
  - interrupts
  - resets
  - reset-names
  - power-domains
  - clocks
  - clock-names

additionalProperties: false

examples:
  - |
    afe: mt8183-afe-pcm@11220000  {
        compatible = "mediatek,mt8183-audio";
        reg = <0 0x11220000 0 0x1000>;
        interrupts = <GIC_SPI 161 IRQ_TYPE_LEVEL_LOW>;
        resets = <&watchdog MT8183_TOPRGU_AUDIO_SW_RST>;
        reset-names = "audiosys";
        power-domains = <&scpsys MT8183_POWER_DOMAIN_AUDIO>;
        clocks = <&infrasys CLK_INFRA_AUDIO>,
                 <&infrasys CLK_INFRA_AUDIO_26M_BCLK>,
                 <&topckgen CLK_TOP_MUX_AUDIO>,
                 <&topckgen CLK_TOP_MUX_AUD_INTBUS>,
                 <&topckgen CLK_TOP_SYSPLL_D2_D4>,
                 <&clk26m>;
        clock-names = "infra_sys_audio_clk",
                      "mtkaif_26m_clk",
                      "top_mux_audio",
                      "top_mux_aud_intbus",
                      "top_sys_pll_d2_d4",
                      "top_clk26m_clk";
    };
```

## Documentation/devicetree/bindings/sound/mediatek,mt8183_da7219_max98357.yaml
```yaml
# SPDX-License-Identifier: (GPL-2.0-only OR BSD-2-Clause)
# Copyright 2025 MediaTek
%YAML 1.2
---
$id: http://devicetree.org/schemas/sound/mediatek,mt8183_da7219_max98357.yaml#
$schema: http://devicetree.org/meta-schemas/core.yaml#

title: MT8183 with MT6358, DA7219, MAX98357, and RT1015 CODECS

maintainers:
  - Shunli Wang <shunli.wang@mediatek.com>
  - Tzung-Bi Shih <tzungbi@kernel.org>

description: |
  MT8183 with MT6358, DA7219, MAX98357, and RT1015 CODECS

properties:
  compatible:
    description: Device compatibility, selecting one of supported codecs.
    items:
      - enum:
          - mediatek,mt8183_da7219_max98357
          - mediatek,mt8183_da7219_rt1015
          - mediatek,mt8183_da7219_rt1015p

  mediatek,headset-codec:
    description: Phandles of DA7219 codecs.
    $ref: /schemas/types.yaml#/definitions/phandle-array

  mediatek,hdmi-codec:
    description: Phandles of HDMI codec.
    $ref: /schemas/types.yaml#/definitions/phandle-array

  mediatek,platform:
    description: Phandle of MT8183 ASoC platform.
    $ref: /schemas/types.yaml#/definitions/phandle

required:
  - compatible
  - mediatek,headset-codec
  - mediatek,platform

additionalProperties: false

examples:
  - |
    sound {
        compatible = "mediatek,mt8183_da7219_max98357";
        mediatek,headset-codec = <&da7219>;
        mediatek,hdmi-codec = <&it6505dptx>;
        mediatek,platform = <&afe>;
    };
```

## Documentation/devicetree/bindings/sound/mediatek,mt8183_mt6358_ts3a227_max98357.yaml
```yaml
# SPDX-License-Identifier: (GPL-2.0-only OR BSD-2-Clause)
# Copyright 2025 MediaTek
%YAML 1.2
---
$id: http://devicetree.org/schemas/sound/mediatek,mt8183_mt6358_ts3a227_max98357.yaml#
$schema: http://devicetree.org/meta-schemas/core.yaml#

title: MT8183 with MT6358, TS3A227, MAX98357, and RT1015 codecs

maintainers:
  - Shunli Wang <shunli.wang@mediatek.com>
  - Tzung-Bi Shih <tzungbi@kernel.org>

description: |
  MT8183 with MT6358, TS3A227, MAX98357, and RT1015 CODECS

properties:
  compatible:
    items:
      - enum:
          - mediatek,mt8183_mt6358_ts3a227_max98357
          - mediatek,mt8183_mt6358_ts3a227_max98357b
          - mediatek,mt8183_mt6358_ts3a227_rt1015
          - mediatek,mt8183_mt6358_ts3a227_rt1015p

  mediatek,headset-codec:
    description: TS3A227 headset codec phandles
    $ref: /schemas/types.yaml#/definitions/phandle-array

  mediatek,ec-codec:
    description: EC codec phandle
    $ref: /schemas/types.yaml#/definitions/phandle

  mediatek,hdmi-codec:
    description: HDMI codec phandles
    $ref: /schemas/types.yaml#/definitions/phandle-array

  mediatek,platform:
    description: MT8183 ASoC platform phandle
    $ref: /schemas/types.yaml#/definitions/phandle

required:
  - compatible
  - mediatek,platform

additionalProperties: false

examples:
  - |
    sound {
        compatible = "mediatek,mt8183_mt6358_ts3a227_max98357";
        mediatek,headset-codec = <&ts3a227>;
        mediatek,ec-codec = <&ec_codec>;
        mediatek,hdmi-codec = <&it6505dptx>;
        mediatek,platform = <&afe>;
    };
```

## Documentation/devicetree/bindings/sound/mediatek,mtk-btcvsd-snd.yaml
```yaml
# SPDX-License-Identifier: (GPL-2.0-only OR BSD-2-Clause)
# Copyright 2025 Mediatek
%YAML 1.2
---
$id: http://devicetree.org/schemas/mediatek,mtk-btcvsd-snd.yaml#
$schema: http://devicetree.org/meta-schemas/core.yaml#

title: Mediatek ALSA BT SCO CVSD/MSBC Driver

maintainers:
  - KaiChieh Chuang <kaichieh.chuang@mediatek.com>

description: |
  Mediatek ALSA BT SCO CVSD/MSBC Driver

properties:
  compatible:
    items:
      - const: mediatek,mtk-btcvsd-snd
    description: Mediatek BT CVSD driver compatible string.
  reg:
    description: Register location and size of PKV and SRAM_BANK2.
    items:
      - description: PKV register
      - description: SRAM_BANK2 register
  interrupts:
    items:
      - description: BTSCO interrupt
    description: Should contain the BTSCO interrupt.
  mediatek,infracfg:
    $ref: /schemas/types.yaml#/definitions/phandle-array
    description: The phandles of INFRASYS.
  mediatek,offset:
    $ref: /schemas/types.yaml#/definitions/uint32-array
    description: Array of register offsets and masks.
    items:
      - description: infra_misc_offset
      - description: infra_conn_bt_cvsd_mask
      - description: cvsd_mcu_read_offset
      - description: cvsd_mcu_write_offset
      - description: cvsd_packet_indicator_offset

required:
  - compatible
  - reg
  - interrupts
  - mediatek,infracfg
  - mediatek,offset

additionalProperties: false

examples:
  - |
    mtk-btcvsd-snd@18000000 {
        compatible = "mediatek,mtk-btcvsd-snd";
        reg = <0 0x18000000 0 0x1000>,
              <0 0x18080000 0 0x8000>;
        interrupts = <GIC_SPI 286 IRQ_TYPE_LEVEL_LOW>;
        mediatek,infracfg = <&infrasys>;
        mediatek,offset = <0xf00 0x800 0xfd0 0xfd4 0xfd8>;
    };
```
