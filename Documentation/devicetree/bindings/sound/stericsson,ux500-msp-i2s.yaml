## Documentation/devicetree/bindings/sound/stericsson,ux500-msp-i2s.yaml
```yaml
%YAML 1.2
---
$id: http://devicetree.org/schemas/sound/stericsson,ux500-msp-i2s.yaml#
$schema: http://devicetree.org/meta-schemas/core.yaml#

title: stericsson,ux500-msp-i2s

maintainers:
  - Lee Jones <lee@kernel.org>
  - Rob Herring <robh@kernel.org>

description: |
  * ux500 MSP (CPU-side Digital Audio Interface)

properties:
  compatible:
    const: stericsson,ux500-msp-i2s

  reg:
    description: Physical base address and length of the device's registers.

  interrupts:
    description: The interrupt output from the device.

patternProperties:
  ".*-supply":
    description: Phandle to the regulator <name> supply

additionalProperties: false

examples:
  - |
      msp1: msp@80124000 {
          compatible = "stericsson,ux500-msp-i2s";
          reg = <0x80124000 0x1000>;
          interrupts = <0 62 0x4>;
          v-ape-supply = <&db8500_vape_reg>;
      };

      msp3: msp@80125000 {
          compatible = "stericsson,ux500-msp-i2s";
          reg = <0x80125000 0x1000>;
          interrupts = <0 62 0x4>;
          v-ape-supply = <&db8500_vape_reg>;
      };
```

## Documentation/devicetree/bindings/sound/tempo,tscs42A1.yaml
```yaml
# SPDX-License-Identifier: (GPL-2.0-only OR BSD-2-Clause)
# Copyright 2025 Steven Eckhoff
%YAML 1.2
---
$id: http://devicetree.org/schemas/sound/tempo,tscs42A1.yaml#
$schema: http://devicetree.org/meta-schemas/core.yaml#

title: tempo,tscs42A1 Audio CODEC

maintainers:
  - Steven Eckhoff <steven.eckhoff.opensource@gmail.com>

description: |
  TSCS42XX Audio CODEC

  Required Properties:
    - compatible: "tempo,tscs42A1" for analog mic
      "tempo,tscs42A2" for digital mic
    - reg: <0x71> for analog mic
      <0x69> for digital mic
    - clock-names: Must be one of the following "mclk1", "xtal", "mclk2"
    - clocks: phandle of the clock that provides the codec sysclk

properties:
  compatible:
    items:
      - enum:
          - tempo,tscs42A1
          - tempo,tscs42A2

  reg:
    items:
      - description: Codec register address. Must be 0x71 for analog mic or 0x69 for digital mic.

  clocks:
    maxItems: 1
    description: Phandle to clock that provides the codec sysclk.

  clock-names:
    items:
      - enum:
          - mclk1
          - xtal
          - mclk2

required:
  - compatible
  - reg
  - clocks
  - clock-names

additionalProperties: false

examples:
  - |
    wookie: codec@69 {
        compatible = "tempo,tscs42A2";
        reg = <0x69>;
        clock-names = "xtal";
        clocks = <&audio_xtal>;
    };
```

## Documentation/devicetree/bindings/sound/tempo,tscs454.yaml
```yaml
# SPDX-License-Identifier: (GPL-2.0-only OR BSD-2-Clause)
# Maintainers: Steven Eckhoff <steven.eckhoff.opensource@gmail.com>
%YAML 1.2
---
$id: http://devicetree.org/schemas/sound/tempo,tscs454.yaml#
$schema: http://devicetree.org/meta-schemas/core.yaml#

title: TSCS454 Audio CODEC

maintainers:
  - Steven Eckhoff <steven.eckhoff.opensource@gmail.com>

description: |
  TSCS454 Audio CODEC

  Note: If clock is not provided then bit clock is assumed

properties:
  '#sound-dai-cells':
    description: Number of cells for the sound DAI
    const: 1
  compatible:
    items:
      - const: tempo,tscs454
  reg:
    items:
      - description: Codec register address
  clock-names:
    items:
      - enum: [xtal, mclk1, mclk2]
  clocks:
    description: Phandle of the clock that provides the codec sysclk
    maxItems: 1

required:
  - compatible
  - reg
  - clock-names

additionalProperties: false

examples:
  - |
    redwood: codec@69 {
        #sound-dai-cells = <1>;
        compatible = "tempo,tscs454";
        reg = <0x69>;
        clock-names = "mclk1";
        clocks = <&audio_mclk>;
    };
```

## Documentation/devicetree/bindings/sound/ti,abe-twl6040.yaml
```yaml
# SPDX-License-Identifier: (GPL-2.0-only OR BSD-2-Clause)
# Copyright 2025 H. Nikolaus Schaller <hns@goldelico.com>
# Copyright 2025 Peter Ujfalusi <peter.ujfalusi@ti.com>
%YAML 1.2
---
$id: http://devicetree.org/schemas/sound/ti,abe-twl6040.yaml#
$schema: http://devicetree.org/meta-schemas/core.yaml#

title: Texas Instruments OMAP4+ ABE TWL6040 audio setup

maintainers:
  - H. Nikolaus Schaller <hns@goldelico.com>
  - Peter Ujfalusi <peter.ujfalusi@ti.com>

description: |
  * Texas Instruments OMAP4+ and twl6040 based audio setups

  Available audio endpoints for the audio-routing table:

  Board connectors:
   * Headset Stereophone
   * Earphone Spk
   * Ext Spk
   * Line Out
   * Vibrator
   * Headset Mic
   * Main Handset Mic
   * Sub Handset Mic
   * Line In
   * Digital Mic

  twl6040 pins:
   * HSOL
   * HSOR
   * EP
   * HFL
   * HFR
   * AUXL
   * AUXR
   * VIBRAL
   * VIBRAR
   * HSMIC
   * MAINMIC
   * SUBMIC
   * AFML
   * AFMR
   * Headset Mic Bias
   * Main Mic Bias
   * Digital Mic1 Bias
   * Digital Mic2 Bias

  Digital mic pins:
   * DMic

properties:
  compatible:
    items:
      - const: ti,abe-twl6040
  ti,model:
    description: Name of the sound card (for example "SDP4430").
    $ref: /schemas/types.yaml#/definitions/string
  ti,mclk-freq:
    description: MCLK frequency for HPPLL operation.
  ti,mcpdm:
    description: Phandle for the McPDM node.
  ti,dmic:
    description: Phandle for the OMAP dmic node.
  ti,twl6040:
    description: Phandle for the twl6040 core node.
  ti,audio-routing:
    description: |
      List of connections between audio components; each entry is one string drawn
      from the set of board connectors or TWL6040/dmic pins.
      Values occur in pairs (sink, source).
    $ref: /schemas/types.yaml#/definitions/string-array
    items:
      enum:
        - Headset Stereophone
        - Earphone Spk
        - Ext Spk
        - Line Out
        - Vibrator
        - Headset Mic
        - Main Handset Mic
        - Sub Handset Mic
        - Line In
        - Digital Mic
        - HSOL
        - HSOR
        - EP
        - HFL
        - HFR
        - AUXL
        - AUXR
        - VIBRAL
        - VIBRAR
        - HSMIC
        - MAINMIC
        - SUBMIC
        - AFML
        - AFMR
        - Headset Mic Bias
        - Main Mic Bias
        - Digital Mic1 Bias
        - Digital Mic2 Bias
        - DMic
  ti,jack-detection:
    description: Present if jack insertion and removal detection is supported.
    type: boolean

required:
  - compatible
  - ti,model
  - ti,mclk-freq
  - ti,mcpdm
  - ti,twl6040
  - ti,audio-routing

additionalProperties: false

examples:
  - |
    sound {
      compatible = "ti,abe-twl6040";
      ti,model = "SDP4430";
      ti,jack-detection;
      ti,mclk-freq = <38400000>;
      ti,mcpdm = <&mcpdm>;
      ti,dmic = <&dmic>;
      ti,twl6040 = <&twl6040>;

      /* Audio routing */
      ti,audio-routing =
        "Headset Stereophone", "HSOL",
        "Headset Stereophone", "HSOR",
        "Earphone Spk", "EP",
        "Ext Spk", "HFL",
        "Ext Spk", "HFR",
        "Line Out", "AUXL",
        "Line Out", "AUXR",
        "Vibrator", "VIBRAL",
        "Vibrator", "VIBRAR",
        "HSMIC", "Headset Mic",
        "Headset Mic", "Headset Mic Bias",
        "MAINMIC", "Main Handset Mic",
        "Main Handset Mic", "Main Mic Bias",
        "SUBMIC", "Sub Handset Mic",
        "Sub Handset Mic", "Main Mic Bias",
        "AFML", "Line In",
        "AFMR", "Line In",
        "DMic", "Digital Mic",
        "Digital Mic", "Digital Mic1 Bias";
    };
```

## Documentation/devicetree/bindings/sound/ti,ads117x.yaml
```yaml
# SPDX-License-Identifier: (GPL-2.0-only OR BSD-2-Clause)
# Copyright 2018 Linaro Ltd.
%YAML 1.2
---
$id: http://devicetree.org/schemas/sound/ti,ads117x.yaml#
$schema: http://devicetree.org/meta-schemas/core.yaml#

title: Texas Intstruments ADS117x ADC

maintainers:
  - Florian Vaussard <florian.vaussard@gmail.com>

description: |
  Texas Intstruments ADS117x ADC

properties:
  compatible:
    # List of supported compatible strings for this ADC
    items:
      - enum:
          - ti,ads1174
          - ti,ads1178

required:
  - compatible

additionalProperties: false

examples:
  - |
    ads1178 {
        compatible = "ti,ads1178";
    };
```

## Documentation/devicetree/bindings/sound/ti,da830-evm-audio.yaml
```yaml
# SPDX-License-Identifier: (GPL-2.0-only OR BSD-2-Clause)
%YAML 1.2
---
$id: http://devicetree.org/schemas/ti,da830-evm-audio.yaml#
$schema: http://devicetree.org/meta-schemas/core.yaml#

title: Texas Instruments DA830 EVM Audio

maintainers:
  - Hebbar, Gururaja <gururaja.hebbar@ti.com>
  - Jyri Sarha <jsarha@ti.com>

description: |
  * Texas Instruments SoC audio setups with TLV320AIC3X Codec

  Board connectors:

  * Headphone Jack
  * Line Out
  * Mic Jack
  * Line In

properties:
  compatible:
    description: Must be "ti,da830-evm-audio".
    items:
      - const: ti,da830-evm-audio

  ti,model:
    description: The user-visible name of this sound complex.
    $ref: /schemas/types.yaml#/definitions/string

  ti,audio-codec:
    description: The phandle of the TLV320AIC3x audio codec.
    $ref: /schemas/types.yaml#/definitions/phandle

  ti,mcasp-controller:
    description: The phandle of the McASP controller.
    $ref: /schemas/types.yaml#/definitions/phandle

  ti,codec-clock-rate:
    description: The Codec Clock rate (in Hz) applied to the Codec.
    $ref: /schemas/types.yaml#/definitions/uint32

  clocks:
    maxItems: 1
    description: Reference to the master clock.

  clock-names:
    items:
      - const: mclk

  ti,audio-routing:
    description:
      A list of the connections between audio components. Each entry is a pair of
      strings, the first being the connection's sink, the second being the
      connection's source.
    $ref: /schemas/types.yaml#/definitions/string-array
    items:
      - type: string
      - type: string

additionalProperties: false

required:
  - compatible
  - ti,model
  - ti,audio-codec
  - ti,mcasp-controller

anyOf:
  - required:
      - ti,codec-clock-rate
  - required:
      - clocks

examples:
  - |
    sound {
        compatible = "ti,da830-evm-audio";
        ti,model = "DA830 EVM";
        ti,audio-codec = <&tlv320aic3x>;
        ti,mcasp-controller = <&mcasp1>;
        ti,codec-clock-rate = <12000000>;
        ti,audio-routing =
            "Headphone Jack",       "HPLOUT",
            "Headphone Jack",       "HPROUT",
            "Line Out",             "LLOUT",
            "Line Out",             "RLOUT",
            "MIC3L",                "Mic Bias 2V",
            "MIC3R",                "Mic Bias 2V",
            "Mic Bias 2V",          "Mic Jack",
            "LINE1L",               "Line In",
            "LINE2L",               "Line In",
            "LINE1R",               "Line In",
            "LINE2R",               "Line In";
    };
```

## Documentation/devicetree/bindings/sound/ti,omap-mcbsp.yaml
```yaml
# SPDX-License-Identifier: (GPL-2.0-only OR BSD-2-Clause)
%YAML 1.2
---
$id: http://devicetree.org/schemas/sound/ti,omap-mcbsp.yaml#
$schema: http://devicetree.org/meta-schemas/core.yaml#

title: TI OMAP McBSP

maintainers:
  - Peter Ujfalusi <peter.ujfalusi@ti.com>
  - Rob Herring <robh@kernel.org>

description: |
  * Texas Instruments OMAP2+ McBSP module

properties:
  compatible:
    description: Compatible string for the McBSP port on OMAP SoCs.
    items:
      - enum:
          - ti,omap2420-mcbsp
          - ti,omap2430-mcbsp
          - ti,omap3-mcbsp
          - ti,omap4-mcbsp
  reg:
    description: Register location and size. For OMAP4+ this can be an array of two address-size tuples.
    items:
      - description: MPU access base address and size
      - description: L3 interconnect address and size
  reg-names:
    $ref: /schemas/types.yaml#/definitions/string-array
    items:
      - const: mpu
      - const: sidetone
  interrupts:
    description: Interrupt numbers for the McBSP port on OMAP SoCs.
    items:
      - description: OCP compliant irq
      - description: TX irq
      - description: RX irq
      - description: Sidetone irq
  interrupt-names:
    $ref: /schemas/types.yaml#/definitions/string-array
    items:
      - const: common
      - const: tx
      - const: rx
      - const: sidetone
  ti,buffer-size:
    description: Size of the FIFO on the port (OMAP2430 and newer SoC)
    $ref: /schemas/types.yaml#/definitions/uint32
  ti,hwmods:
    description: Name of the hwmod associated to the McBSP port.
    $ref: /schemas/types.yaml#/definitions/string

required:
  - compatible
  - reg
  - interrupts
  - interrupt-names

additionalProperties: false

examples:
  - |
    mcbsp2: mcbsp@49022000 {
      compatible = "ti,omap3-mcbsp";
      reg = <0x49022000 0xff>,
            <0x49028000 0xff>;
      reg-names = "mpu", "sidetone";
      interrupts = <0 17 0x4>, /* OCP compliant interrupt */
                   <0 62 0x4>, /* TX interrupt */
                   <0 63 0x4>, /* RX interrupt */
                   <0 4 0x4>;  /* Sidetone */
      interrupt-names = "common", "tx", "rx", "sidetone";
      ti,buffer-size = <1280>;
      ti,hwmods = "mcbsp2";
    };
```

## Documentation/devicetree/bindings/sound/ti,omap-twl4030.yaml
```yaml
# SPDX-License-Identifier: (GPL-2.0-only OR BSD-2-Clause)
# Copyright 2025 Marek Belisko <marek@goldelico.com>
%YAML 1.2
---
$id: http://devicetree.org/schemas/sound/ti,omap-twl4030.yaml#
$schema: http://devicetree.org/meta-schemas/core.yaml#

title: TI OMAP TWL4030 sound
maintainers:
  - Marek Belisko <marek@goldelico.com>
  - Peter Ujfalusi <peter.ujfalusi@ti.com>

description: |
  * Texas Instruments SoC with twl4030 based audio setups

  Available audio endpoints for the audio-routing table:

  Board connectors:
    * Headset Stereophone
    * Earpiece Spk
    * Handsfree Spk
    * Ext Spk
    * Main Mic
    * Sub Mic
    * Headset Mic
    * Carkit Mic
    * Digital0 Mic
    * Digital1 Mic
    * Line In

  twl4030 pins:
    * HSOL
    * HSOR
    * EARPIECE
    * HFL
    * HFR
    * PREDRIVEL
    * PREDRIVER
    * CARKITL
    * CARKITR
    * MAINMIC
    * SUBMIC
    * HSMIC
    * DIGIMIC0
    * DIGIMIC1
    * CARKITMIC
    * AUXL
    * AUXR

    * Headset Mic Bias
    * Mic Bias 1 /* Used for Main Mic or Digimic0 */
    * Mic Bias 2 /* Used for Sub Mic or Digimic1 */

properties:
  compatible:
    items:
      - const: ti,omap-twl4030

  ti,model:
    description: Name of the sound card
    $ref: /schemas/types.yaml#/definitions/string

  ti,mcbsp:
    description: phandle for the McBSP node
    $ref: /schemas/types.yaml#/definitions/phandle

  ti,codec:
    description: phandle for the twl4030 audio node
    $ref: /schemas/types.yaml#/definitions/phandle

  ti,mcbsp-voice:
    description: phandle for the McBSP node connected to the voice port of twl
    $ref: /schemas/types.yaml#/definitions/phandle

  ti,jack-det-gpio:
    description: Jack detect GPIO
    maxItems: 1

  ti,audio-routing:
    description: >
      List of connections between audio components. Each entry is a pair
      of strings, the first being the connection's sink, the second being
      the connection's source. If not provided all possible connections
      will be available.
    $ref: /schemas/types.yaml#/definitions/string-array
    minItems: 2
    
required:
  - compatible
  - ti,model
  - ti,mcbsp

additionalProperties: false

examples:
  - |
    sound {
        compatible = "ti,omap-twl4030";
        ti,model = "omap3beagle";

        ti,mcbsp = <&mcbsp2>;
    };
```
