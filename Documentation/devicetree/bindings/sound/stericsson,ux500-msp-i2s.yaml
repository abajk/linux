## Documentation/devicetree/bindings/spi/cavium,octeon-3010-spi.yaml
```yaml
# SPDX-License-Identifier: (GPL-2.0-only OR BSD-2-Clause)
# Copyright 2025 Cavium, Inc.
%YAML 1.2
---
$id: http://devicetree.org/schemas/spi/cavium,octeon-3010-spi.yaml#
$schema: http://devicetree.org/meta-schemas/core.yaml#

title: Cavium Octeon 3010 SPI master controller

maintainers:
  - David Daney <david.daney@cavium.com>

description: |
  Cavium, Inc. OCTEON SOC SPI master controller.

  Child nodes as per the generic SPI binding.

properties:
  compatible:
    items:
      - const: cavium,octeon-3010-spi

  reg:
    description: The register base for the controller.
    items:
      - description: Register base for the controller.

  interrupts:
    description: Controller interrupt.
    items:
      - description: Controller interrupt.

  '#address-cells':
    description: Number of address cells for child nodes.
    const: 1

  '#size-cells':
    description: Number of size cells for child nodes.
    const: 0

additionalProperties: false

required:
  - compatible
  - reg
  - interrupts
  - '#address-cells'
  - '#size-cells'

examples:
  - |
    spi@1070000001000 {
        compatible = "cavium,octeon-3010-spi";
        reg = <0x10700 0x00001000 0x0 0x100>;
        interrupts = <0 58>;
        #address-cells = <1>;
        #size-cells = <0>;

        eeprom@0 {
            compatible = "st,m95256", "atmel,at25";
            reg = <0>;
            spi-max-frequency = <5000000>;
            spi-cpha;
            spi-cpol;

            pagesize = <64>;
            size = <32768>;
            address-width = <16>;
        };
    };
```

## Documentation/devicetree/bindings/spi/cdns,xtfpga-spi.yaml
```yaml
# SPDX-License-Identifier: (GPL-2.0-only OR BSD-2-Clause)
%YAML 1.2
---
$id: http://devicetree.org/schemas/spi/cdns,xtfpga-spi.yaml#
$schema: http://devicetree.org/meta-schemas/core.yaml#

title: Cadence Xtensa XTFPGA platform SPI controller

maintainers:
  - Max Filippov <jcmvbkbc@gmail.com>

description: |
  Cadence Xtensa XTFPGA platform SPI controller.

  This simple SPI master controller is built into xtfpga bitstreams and is used
  to control daughterboard audio codec.

properties:
  compatible:
    items:
      - enum:
          - cdns,xtfpga-spi
  reg:
    items:
      - description: physical base address of the controller
      - description: length of memory mapped region

required:
  - compatible
  - reg

additionalProperties: false

examples:
  - |
    spi@1000 {
        compatible = "cdns,xtfpga-spi";
        reg = <0x1000 0x100>;
    };
```

## Documentation/devicetree/bindings/spi/cirrus,ep7209-spi.yaml
```yaml
# SPDX-License-Identifier: (GPL-2.0-only OR BSD-2-Clause)
%YAML 1.2
---
$id: http://devicetree.org/schemas/spi/cirrus,ep7209-spi.yaml#
$schema: http://devicetree.org/meta-schemas/core.yaml#

title: Cirrus Logic CL-PS71xx SPI Controller

maintainers:
  - Arnd Bergmann <arnd@arndb.de>
  - Rob Herring <robh@kernel.org>

description: |
  Serial Peripheral Interface on Cirrus Logic CL-PS71xx, EP72xx, EP73xx

  An additional register is present in the system controller,
  which is assumed to be in the same device tree and marked
  as compatible with "cirrus,ep7209-syscon3".

properties:
  compatible:
    description: Device compatible string.
    items:
      - const: "cirrus,ep7209-spi"

  '#address-cells':
    description: Address cells for this device.
    const: 1

  '#size-cells':
    description: Size cells for this device.
    const: 0

  reg:
    description: Register address and size.
    items:
      - description: Register address and size.

  interrupts:
    description: SPI interrupt line.
    items:
      - description: SPI interrupt line.

  clocks:
    description: SPI bus clock.
    maxItems: 1

  cs-gpios:
    description: Specifies the GPIO pins to be used for chip selects.
    $ref: /schemas/types.yaml#/definitions/phandle-array

required:
  - compatible
  - '#address-cells'
  - '#size-cells'
  - reg
  - interrupts
  - clocks
  - cs-gpios

additionalProperties: false

examples:
  - |
    spi@80000500 {
      #address-cells = <1>;
      #size-cells = <0>;
      compatible = "cirrus,ep7209-spi";
      reg = <0x80000500 0x4>;
      interrupts = <15>;
      clocks = <&clks CLPS711X_CLK_SPI>;
      cs-gpios = <&gpio0 3>;
    };
```

## Documentation/devicetree/bindings/spi/icpdas,lp8841-spi-rtc.yaml
```yaml
# SPDX-License-Identifier: (GPL-2.0-only OR BSD-2-Clause)
# Copyright 2025 Sergei Ianovich <ynvich@gmail.com>
%YAML 1.2
---
$id: http://devicetree.org/schemas/icpdas,lp8841-spi-rtc.yaml#
$schema: http://devicetree.org/meta-schemas/core.yaml#

title: ICP DAS LP-8841 SPI Controller for RTC

maintainers:
  - Sergei Ianovich <ynvich@gmail.com>

description: |
  * ICP DAS LP-8841 SPI Controller for RTC

  ICP DAS LP-8841 contains a DS-1302 RTC. RTC is connected to an IO
  memory register, which acts as an SPI master device.

  The device uses the standard MicroWire half-duplex transfer timing.
  Master output is set on low clock and sensed by the RTC on the rising
  edge. Master input is set by the RTC on the trailing edge and is sensed
  by the master on low clock.

properties:
  compatible:
    items:
      - const: icpdas,lp8841-spi-rtc

  reg:
    maxItems: 1

  '#address-cells':
    const: 1

  '#size-cells':
    const: 0

patternProperties:
  '^rtc@[0-9]+$':
    description: SPI slave node for DS1302 RTC.
    type: object
    additionalProperties: false
    properties:
      compatible:
        items:
          - const: maxim,ds1302
        description: Compatible string for Maxim DS1302 RTC.
      reg:
        maxItems: 1
      spi-max-frequency:
        $ref: /schemas/types.yaml#/definitions/uint32
        description: Maximum SPI transfer frequency in Hz.
      spi-3wire:
        type: boolean
        description: Use MicroWire 3-wire mode (shared MISO/MOSI).
      spi-lsb-first:
        type: boolean
        description: Transfer least-significant bit first.
      spi-cs-high:
        type: boolean
        description: Use active high chip select.
    required:
      - compatible
      - reg
      - spi-max-frequency
      - spi-3wire
      - spi-lsb-first
      - spi-cs-high

required:
  - '#address-cells'
  - '#size-cells'
  - compatible
  - reg

additionalProperties: false

examples:
  - |
    spi@901c {
        #address-cells = <1>;
        #size-cells = <0>;
        compatible = "icpdas,lp8841-spi-rtc";
        reg = <0x901c 0x1>;

        rtc@0 {
            compatible = "maxim,ds1302";
            reg = <0>;
            spi-max-frequency = <500000>;
            spi-3wire;
            spi-lsb-first;
            spi-cs-high;
        };
    };
```
