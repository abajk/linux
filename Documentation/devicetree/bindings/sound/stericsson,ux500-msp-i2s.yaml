## Documentation/devicetree/bindings/sound/ti,omap4-dmic.yaml
```yaml
# SPDX-License-Identifier: (GPL-2.0-only OR BSD-2-Clause)
# Copyright 2025 Texas Instruments, Inc.
%YAML 1.2
---
$schema: http://devicetree.org/meta-schemas/core.yaml#
$id: http://devicetree.org/schemas/sound/ti,omap4-dmic.yaml#

title: Texas Instruments OMAP4+ Digital Microphone Module

maintainers:
  - Peter Ujfalusi <peter.ujfalusi@ti.com>
  - Rob Herring <robh@kernel.org>

description: |
  * Texas Instruments OMAP4+ Digital Microphone Module

properties:
  compatible:
    items:
      - enum: [ti, omap4-dmic]
    description: Device compatible with the TI OMAP4+ digital microphone.

  reg:
    items:
      - description: MPU private access registers.
      - description: L3 interconnect registers.
    description: Register location and size as an array.

  interrupts:
    items:
      - description: Interrupt number for the DMIC.
    description: Interrupt number for the digital microphone.

  ti,hwmods:
    description: Name of the hwmod associated with the OMAP DMIC IP.
    $ref: /schemas/types.yaml#/definitions/string

required:
  - compatible
  - reg
  - interrupts
  - ti,hwmods

additionalProperties: false

examples:
  - |
    dmic: dmic@4012e000 {
        compatible = "ti,omap4-dmic";
        reg = <0x4012e000 0x7f>,
              <0x4902e000 0x7f>;
        interrupts = <0 114 0x4>;
        ti,hwmods = "dmic";
    };
```

## Documentation/devicetree/bindings/sound/ti,pcm1789.yaml
```yaml
# SPDX-License-Identifier: (GPL-2.0-only OR BSD-2-Clause)
%YAML 1.2
---
$id: http://devicetree.org/schemas/sound/ti,pcm1789.yaml#
$schema: http://devicetree.org/meta-schemas/core.yaml#

title: Texas Instruments PCM1789 audio codec

maintainers:
  - Mylène Josserand <mylene.josserand@bootlin.com>

description: |
  Texas Instruments pcm1789 DT bindings

  PCM1789 is a simple audio codec that can be connected via
  I2C or SPI. Currently, only I2C bus is supported.

properties:
  compatible:
    items:
      - const: ti,pcm1789

  reg:
    items:
      - description: I2C address

  reset-gpios:
    maxItems: 1
    description: GPIO to control the RESET pin

  '#sound-dai-cells':
    # The core schema handles that this must be a single integer.
    const: 0

additionalProperties: false

required:
  - compatible
  - reg
  - reset-gpios
  - '#sound-dai-cells'

examples:
  - |
    audio-codec@4c {
        compatible = "ti,pcm1789";
        reg = <0x4c>;
        reset-gpios = <&gpio2 14 GPIO_ACTIVE_LOW>;
        #sound-dai-cells = <0>;
    };
```

## Documentation/devicetree/bindings/sound/ti,pcm1792a.yaml
```yaml
# SPDX-License-Identifier: (GPL-2.0-only OR BSD-2-Clause)
# Copyright 2025 Teenage Engineering
%YAML 1.2
---
$id: http://devicetree.org/schemas/sound/ti,pcm1792a.yaml#
$schema: http://devicetree.org/meta-schemas/core.yaml#

title: TI PCM1792A audio DAC
maintainers:
  - Jacob Siverskog <jacob@teenage.engineering>
  - Michael Trimarchi <michael@amarulasolutions.com>

description: |
  Texas Instruments pcm179x DT bindings

  This driver supports both the I2C and SPI bus.

  Required properties:

  - compatible: "ti,pcm1792a"

  For required properties on SPI, please consult
  Documentation/devicetree/bindings/spi/spi-bus.txt

  Required properties on I2C:

  - reg: the I2C address

properties:
  compatible:
    items:
      - const: ti,pcm1792a

  reg:
    items:
      - description: the I2C address

  spi-max-frequency:
    description: Maximum SPI bus frequency supported by the codec.
    $ref: /schemas/types.yaml#/definitions/uint32

required:
  - compatible

additionalProperties: false

examples:
  - |
    codec_spi: 1792a@0 {
        compatible = "ti,pcm1792a";
        spi-max-frequency = <600000>;
    };
  - |
    codec_i2c: 1792a@4c {
        compatible = "ti,pcm1792a";
        reg = <0x4c>;
    };
```

## Documentation/devicetree/bindings/sound/ti,pcm1862.yaml
```yaml
# SPDX-License-Identifier: (GPL-2.0-only OR BSD-2-Clause)
# Copyright 2025 Andrew F. Davis <afd@ti.com>
%YAML 1.2
---
$id: http://devicetree.org/schemas/sound/ti,pcm1862.yaml#
$schema: http://devicetree.org/meta-schemas/core.yaml#

title: Texas Instruments PCM186x Universal Audio ADC

maintainers:
  - Andrew F. Davis <afd@ti.com>

description: |
  Texas Instruments PCM186x Universal Audio ADC

  These devices support both I2C and SPI (configured with pin strapping
  on the board).

  The pins can be used in referring sound node's audio-routing property.

properties:
  compatible:
    $ref: /schemas/types.yaml#/definitions/string-array
    items:
      - enum:
          - ti,pcm1862
          - ti,pcm1863
          - ti,pcm1864
          - ti,pcm1865

  reg:
    items:
      - description: I2C address for I2C or chip select number for SPI

  avdd-supply: true

  dvdd-supply: true

  iovdd-supply: true

required:
  - compatible
  - reg
  - avdd-supply
  - dvdd-supply
  - iovdd-supply

additionalProperties: false

examples:
  - |
    pcm186x: audio-codec@4a {
        compatible = "ti,pcm1865";
        reg = <0x4a>;

        avdd-supply = <&reg_3v3_analog>;
        dvdd-supply = <&reg_3v3>;
        iovdd-supply = <&reg_1v8>;
    };
```

## Documentation/devicetree/bindings/sound/ti,pcm3060.yaml
```yaml
# SPDX-License-Identifier: (GPL-2.0-only OR BSD-2-Clause)
%YAML 1.2
---
$id: http://devicetree.org/schemas/sound/ti,pcm3060.yaml#
$schema: http://devicetree.org/meta-schemas/core.yaml#

title: TI PCM3060 audio CODEC

maintainers:
  - Kirill Marinushkin <kmarinushkin@birdec.tech>

description: |
  PCM3060 audio CODEC

  This driver supports both I2C and SPI.

properties:
  compatible:
    items:
      - const: ti,pcm3060

  reg:
    items:
      - description: the I2C address of the device for I2C, the chip select number for SPI.

  ti,out-single-ended:
    description: if output is single-ended; false or not specified if output is differential.
    type: boolean

required:
  - compatible
  - reg

additionalProperties: false

examples:
  - |
    pcm3060: pcm3060@46 {
        compatible = "ti,pcm3060";
        reg = <0x46>;
        ti,out-single-ended;
    };
```

## Documentation/devicetree/bindings/sound/ti,pcm5102a.yaml
```yaml
# SPDX-License-Identifier: (GPL-2.0-only OR BSD-2-Clause)
# Copyright 2025 Florian Meier <florian.meier@koalo.de>
%YAML 1.2
---
$id: http://devicetree.org/schemas/sound/ti,pcm5102a.yaml#
$schema: http://devicetree.org/meta-schemas/core.yaml#

title: ti,pcm5102a

maintainers:
  - Florian Meier <florian.meier@koalo.de>

description: |
  PCM5102a audio CODECs

  These devices does not use I2C or SPI.

properties:
  compatible:
    description: Must be set to "ti,pcm5102a" for PCM5102a audio codecs.
    items:
      - const: ti,pcm5102a

required:
  - compatible

additionalProperties: false

examples:
  - |
    pcm5102a: pcm5102a {
        compatible = "ti,pcm5102a";
    };
```

## Documentation/devicetree/bindings/sound/ti,tas2552.yaml
```yaml
# SPDX-License-Identifier: (GPL-2.0-only OR BSD-2-Clause)
%YAML 1.2
---
$id: http://devicetree.org/schemas/sound/ti,tas2552.yaml#
$schema: http://devicetree.org/meta-schemas/core.yaml#

title: Texas Instruments tas2552 Codec module

maintainers:
  - Alexander A. Klimov <grandmaster@al2klimov.de>
  - Dan Murphy <dmurphy@ti.com>
  - Fabio Estevam <fabio.estevam@nxp.com>
  - Peter Ujfalusi <peter.ujfalusi@ti.com>

description: |
  Texas Instruments - tas2552 Codec module

  The tas2552 serial control bus communicates through I2C protocols

  Required properties:
    - compatible: "ti,tas2552" - TAS2552
    - reg: I2C slave address: it can be 0x40 if ADDR pin is 0 or 0x41 if ADDR pin is 1.
    - vbat-supply: battery voltage
    - iovdd-supply: I/O Voltage
    - avdd-supply: Analog DAC Voltage

  Optional properties:
    - enable-gpio: gpio pin to enable/disable the device

properties:
  compatible:
    items:
      - const: "ti,tas2552"

  reg:
    items:
      - description: I2C slave address

  vbat-supply: true
  iovdd-supply: true
  avdd-supply: true

  enable-gpio:
    maxItems: 1
    description: gpio pin to enable/disable the device

required:
  - compatible
  - reg
  - vbat-supply
  - iovdd-supply
  - avdd-supply

additionalProperties: false

examples:
  - |
    tas2552: tas2552@41 {
      compatible = "ti,tas2552";
      reg = <0x41>;
      vbat-supply = <&reg_vbat>;
      iovdd-supply = <&reg_iovdd>;
      avdd-supply = <&reg_avdd>;
      enable-gpio = <&gpio4 2 GPIO_ACTIVE_HIGH>;
    };
```

## Documentation/devicetree/bindings/sound/ti,tas5086.yaml
```yaml
# SPDX-License-Identifier: (GPL-2.0-only OR BSD-2-Clause)
# Copyright 2025 Daniel Mack <zonque@gmail.com>
%YAML 1.2
---
$id: http://devicetree.org/schemas/ti,tas5086.yaml#
$schema: http://devicetree.org/meta-schemas/core.yaml#

title: Texas Instruments TAS5086 6-channel PWM Processor
maintainers:
  - Daniel Mack <zonque@gmail.com>
description: |
  Texas Instruments TAS5086 6-channel PWM Processor

properties:
  compatible:
    description: Must contain ti,tas5086
    $ref: /schemas/types.yaml#/definitions/string-array
    contains:
      const: ti,tas5086

  reg:
    description: I2C address of TAS5086
    items:
      - description: I2C address of the device

  reset-gpio:
    description: GPIO spec for the chip's !RESET pin

  ti,charge-period:
    description: |
      Time in microseconds for the external single-ended split-capacitor charge
      period (hardware default 1300ms)
    $ref: /schemas/types.yaml#/definitions/uint32

  avdd-supply:
    description: Power supply for AVDD, providing 3.3V

  dvdd-supply:
    description: Power supply for DVDD, providing 3.3V

patternProperties:
  "^ti,mid-z-channel-[1-6]$":
    type: boolean
    description: If true, channel <number> will start with the Mid-Z sequence

required:
  - compatible
  - reg

additionalProperties: false

examples:
  - |
    i2c_bus {
      tas5086@1b {
        compatible = "ti,tas5086";
        reg = <0x1b>;
        reset-gpio = <&gpio 23 0>;
        ti,charge-period = <156000>;
        avdd-supply = <&vdd_3v3_reg>;
        dvdd-supply = <&vdd_3v3_reg>;
      };
    };
```

## Documentation/devicetree/bindings/sound/ti,tas5720.yaml
```yaml
# SPDX-License-Identifier: (GPL-2.0-only OR BSD-2-Clause)
# Copyright 2025 Texas Instruments
%YAML 1.2
---
$id: http://devicetree.org/schemas/ti,tas5720.yaml#
$schema: http://devicetree.org/meta-schemas/core.yaml#

title: Texas Instruments TAS5720 Mono Audio amplifier

maintainers:
  - Alexander A. Klimov <grandmaster@al2klimov.de>
  - Andreas Dannenberg <dannenberg@ti.com>
  - Rob Herring <robh@kernel.org>
  - Steffen Aschbacher <steffen.aschbacher@stihl.de>

description: |
  Texas Instruments TAS5720 Mono Audio amplifier

  The TAS5720 serial control bus communicates through the I2C protocol only. The
  serial bus is also used for periodic codec fault checking/reporting during
  audio playback. For more product information please see the links below:

  https://www.ti.com/product/TAS5720L
  https://www.ti.com/product/TAS5720M
  https://www.ti.com/product/TAS5720A-Q1
  https://www.ti.com/product/TAS5722L

properties:
  compatible:
    items:
      - enum:
          - ti,tas5720
          - ti,tas5720a-q1
          - ti,tas5722

  reg:
    items:
      - description: I2C slave address

  dvdd-supply:
    description: phandle to a 3.3-V supply for the digital circuitry

  pvdd-supply:
    description: phandle to a supply used for the Class-D amp and analog section

required:
  - compatible
  - reg
  - dvdd-supply
  - pvdd-supply

additionalProperties: false

examples:
  - |
    tas5720: tas5720@6c {
        compatible = "ti,tas5720";
        reg = <0x6c>;
        dvdd-supply = <&vdd_3v3_reg>;
        pvdd-supply = <&amp_supply_reg>;
    };
```

## Documentation/devicetree/bindings/sound/ti,tas6424.yaml
```yaml
# SPDX-License-Identifier: (GPL-2.0-only OR BSD-2-Clause)
# Copyright 2025 Texas Instruments Incorporated
%YAML 1.2
---
$id: http://devicetree.org/schemas/sound/ti,tas6424.yaml#
$schema: http://devicetree.org/meta-schemas/core.yaml#

title: Texas Instruments TAS6424 Quad-Channel Audio Amplifier

maintainers:
  - Alexander A. Klimov <grandmaster@al2klimov.de>
  - Jean-Jacques Hiblot <jjhiblot@ti.com>
  - Michael Stecklein <m-stecklein@ti.com>

description: |
  Texas Instruments TAS6424 Quad-Channel Audio amplifier

  The TAS6424 serial control bus communicates through I2C protocols.

  For more product information please see the link below:
  https://www.ti.com/product/TAS6424-Q1

properties:
  compatible:
    items:
      - const: "ti,tas6424"
  reg:
    description: I2C slave address
    items:
      - description: I2C slave address
  '#sound-dai-cells':
    description: Number of DAI cells; must be 0
    const: 0
  standby-gpios:
    maxItems: 1
    description: GPIO used to shut the TAS6424 down
  mute-gpios:
    maxItems: 1
    description: GPIO used to mute all the outputs

required:
  - compatible
  - reg
  - '#sound-dai-cells'
  - standby-gpios
  - mute-gpios

additionalProperties: false

examples:
  - |
    tas6424: tas6424@6a {
        compatible = "ti,tas6424";
        reg = <0x6a>;
        #sound-dai-cells = <0>;
    };
```

## Documentation/devicetree/bindings/sound/wlf,wm8741.yaml
```yaml
# SPDX-License-Identifier: (GPL-2.0-only OR BSD-2-Clause)
# Copyright 2025 NXP
%YAML 1.2
---
$id: http://devicetree.org/schemas/wlf,wm8741.yaml#
$schema: http://devicetree.org/meta-schemas/core.yaml#

title: WM8741 audio CODEC

maintainers:
  - Fabio Estevam <fabio.estevam@nxp.com>
  - Mark Brown <broonie@opensource.wolfsonmicro.com>
  - Sergej Sawazki <ce3a@gmx.de>

description: |
  WM8741 audio CODEC

  This device supports both I2C and SPI (configured with pin strapping
  on the board).

properties:
  compatible:
    items:
      - const: "wlf,wm8741"
  reg:
    items:
      - description: The I2C address of the device for I2C, or the chip select number for SPI.
  diff-mode:
    description: |
      Differential output mode configuration. Default value for field DIFF in
      register R8 (MODE_CONTROL_2). If absent, the default is 0.
    $ref: /schemas/types.yaml#/definitions/uint32
    enum:
      - 0
      - 1
      - 2
      - 3
    default: 0

required:
  - compatible
  - reg

additionalProperties: false

examples:
  - |
    codec@1a {
        compatible = "wlf,wm8741";
        reg = <0x1a>;
        diff-mode = <3>;
    };
```

## Documentation/devicetree/bindings/sound/wlf,wm8770.yaml
```yaml
# SPDX-License-Identifier: (GPL-2.0-only OR BSD-2-Clause)
%YAML 1.2
---
$id: http://devicetree.org/schemas/wlf,wm8770.yaml#
$schema: http://devicetree.org/meta-schemas/core.yaml#

title: WM8770 audio CODEC

maintainers:
  - Fabio Estevam <fabio.estevam@nxp.com>
  - Mark Brown <broonie@opensource.wolfsonmicro.com>

description: |
  WM8770 audio CODEC

  This device supports SPI.

properties:
  compatible:
    description: Compatible string for WM8770 audio CODEC
    items:
      - const: wlf,wm8770

  reg:
    items:
      - description: Chip select number for SPI bus

required:
  - compatible
  - reg

additionalProperties: false

examples:
  - |
    wm8770: codec@1 {
        compatible = "wlf,wm8770";
        reg = <1>;
    };
```

## Documentation/devicetree/bindings/spi/altr,spi-1.0.yaml
```yaml
# SPDX-License-Identifier: (GPL-2.0-only OR BSD-2-Clause)
# Copyright 2025 Altera
%YAML 1.2
---
$id: http://devicetree.org/schemas/spi/altr,spi-1.0.yaml#
$schema: http://devicetree.org/meta-schemas/core.yaml#

title: Altera SPI

maintainers:
  - Dinh Nguyen <dinguyen@altera.com>
  - Thomas Chou <thomas@wytron.com.tw>

description: |
  Altera SPI

properties:
  compatible:
    description: Must be "altr,spi-1.0" or the deprecated "ALTR,spi-1.0".
    items:
      - enum:
          - "ALTR,spi-1.0"
          - "altr,spi-1.0"

required:
  - compatible

additionalProperties: false
```
