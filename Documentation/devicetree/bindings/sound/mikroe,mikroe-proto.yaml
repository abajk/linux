## Documentation/devicetree/bindings/sound/rockchip,rk3399-gru-sound.yaml
```yaml
# SPDX-License-Identifier: (GPL-2.0-only OR BSD-2-Clause)
# Copyright 2025 Rockchip Electronics
%YAML 1.2
---
$id: http://devicetree.org/schemas/rockchip,rk3399-gru-sound.yaml#
$schema: http://devicetree.org/meta-schemas/core.yaml#

title: ROCKCHIP with MAX98357A/RT5514/DA7219 codecs on GRU boards

maintainers:
  - Jeffy Chen <jeffy.chen@rock-chips.com>
  - Wonjoon Lee <woojoo.lee@samsung.com>
  - Xing Zheng <zhengxing@rock-chips.com>

description: |
  ROCKCHIP with MAX98357A/RT5514/DA7219 codecs on GRU boards

properties:
  compatible:
    items:
      - const: rockchip,rk3399-gru-sound

  rockchip,cpu:
    description: The phandle of the Rockchip I2S controller that's connected to the codecs
    $ref: /schemas/types.yaml#/definitions/phandle

  rockchip,codec:
    description: Audio codec phandles in order.
    $ref: /schemas/types.yaml#/definitions/phandle-array
    items:
      - description: phandle to max98357a codec
      - description: phandle to rt5514 codec
      - description: phandle to da7219 codec

  dmic-wakeup-delay-ms:
    description: Delay time (ms) for DMIC ready, to avoid recording before DMIC sends valid data

additionalProperties: false

examples:
  - |
    sound {
        compatible = "rockchip,rk3399-gru-sound";
        rockchip,cpu = <&i2s0>;
        rockchip,codec = <&max98357a &rt5514 &da7219>;
        dmic-wakeup-delay-ms = <20>;
    };
```

## Documentation/devicetree/bindings/sound/rockchip,rockchip-audio-max98090.yaml
```yaml
# SPDX-License-Identifier: (GPL-2.0-only OR BSD-2-Clause)
%YAML 1.2
---
$id: http://devicetree.org/schemas/sound/rockchip,rockchip-audio-max98090.yaml#
$schema: http://devicetree.org/meta-schemas/core.yaml#

title: Rockchip MAX98090 Audio CODEC

maintainers:
  - Cheng-Yi Chiang <cychiang@chromium.org>
  - zhengxing <zhengxing@rock-chips.com>

description: |
  ROCKCHIP with MAX98090 CODEC

properties:
  compatible:
    const: "rockchip,rockchip-audio-max98090"
  rockchip,model:
    description: The user-visible name of this sound complex.
    $ref: /schemas/types.yaml#/definitions/string
  rockchip,i2s-controller:
    description: The phandle of the Rockchip I2S controller that's connected to the CODEC.
    $ref: /schemas/types.yaml#/definitions/phandle
  rockchip,audio-codec:
    description: The phandle of the MAX98090 audio codec.
    $ref: /schemas/types.yaml#/definitions/phandle
  rockchip,headset-codec:
    description: The phandle of Ext chip for jack detection. This is required if there
      is rockchip,audio-codec.
    $ref: /schemas/types.yaml#/definitions/phandle
  rockchip,hdmi-codec:
    description: The phandle of HDMI device for HDMI codec.
    $ref: /schemas/types.yaml#/definitions/phandle

required:
  - compatible
  - rockchip,model
  - rockchip,i2s-controller

dependencies:
  rockchip,headset-codec: [ 'rockchip,audio-codec' ]

additionalProperties: false

examples:
  - |
    sound {
        compatible = "rockchip,rockchip-audio-max98090";
        rockchip,model = "ROCKCHIP-I2S";
        rockchip,i2s-controller = <&i2s>;
        rockchip,audio-codec = <&max98090>;
        rockchip,headset-codec = <&headsetcodec>;
    };
  - |
    sound {
        compatible = "rockchip,rockchip-audio-max98090";
        rockchip,model = "ROCKCHIP-I2S";
        rockchip,i2s-controller = <&i2s>;
        rockchip,hdmi-codec = <&hdmi>;
    };
  - |
    sound {
        compatible = "rockchip,rockchip-audio-max98090";
        rockchip,model = "ROCKCHIP-I2S";
        rockchip,i2s-controller = <&i2s>;
        rockchip,audio-codec = <&max98090>;
        rockchip,headset-codec = <&headsetcodec>;
        rockchip,hdmi-codec = <&hdmi>;
    };
```

## Documentation/devicetree/bindings/sound/rockchip,rockchip-audio-rt5645.yaml
```yaml
# SPDX-License-Identifier: (GPL-2.0-only OR BSD-2-Clause)
# Copyright 2025 Zhengxing
%YAML 1.2
---
$id: http://devicetree.org/schemas/sound/rockchip,rockchip-audio-rt5645.yaml#
$schema: http://devicetree.org/meta-schemas/core.yaml#

title: Rockchip Audio RT5645/RT5650 Codecs

maintainers:
  - zhengxing <zhengxing@rock-chips.com>

description: |
  ROCKCHIP with RT5645/RT5650 CODECS

properties:
  compatible:
    const: rockchip,rockchip-audio-rt5645
  rockchip,model:
    description: The user-visible name of this sound complex
    $ref: /schemas/types.yaml#/definitions/string
  rockchip,i2s-controller:
    description: The phandle of the Rockchip I2S controller that's connected to the CODEC
    $ref: /schemas/types.yaml#/definitions/phandle
  rockchip,audio-codec:
    description: The phandle of the RT5645/RT5650 audio codec
    $ref: /schemas/types.yaml#/definitions/phandle

required:
  - compatible
  - rockchip,model
  - rockchip,i2s-controller
  - rockchip,audio-codec

additionalProperties: false

examples:
  - |
      sound {
          compatible = "rockchip,rockchip-audio-rt5645";
          rockchip,model = "ROCKCHIP-I2S";
          rockchip,i2s-controller = <&i2s>;
          rockchip,audio-codec = <&rt5645>;
      };
```

## Documentation/devicetree/bindings/sound/sirf,sirf-audio-card.yaml
```yaml
# SPDX-License-Identifier: (GPL-2.0-only OR BSD-2-Clause)
%YAML 1.2
---
$id: http://devicetree.org/schemas/sound/sirf,sirf-audio-card.yaml#
$schema: http://devicetree.org/meta-schemas/core.yaml#

title: SiRF Audio Card

maintainers:
  - Rongjun Ying <rongjun.ying@csr.com>

description: |
  * SiRF atlas6 and prima2 internal audio codec and port based audio setups

  Available audio endpoints for the audio-routing table:

  Board connectors:
    * Headset Stereophone
    * Ext Spk
    * Line In
    * Mic

  SiRF internal audio codec pins:
    * HPOUTL
    * HPOUTR
    * SPKOUT
    * Ext Mic
    * Mic Bias

properties:
  compatible:
    items:
      - const: sirf,sirf-audio-card

  sirf,audio-codec:
    description: Phandle to the SiRF internal audio codec node.
    $ref: /schemas/types.yaml#/definitions/phandle

  sirf,audio-platform:
    description: Phandle to the audio platform (audio port) node.
    $ref: /schemas/types.yaml#/definitions/phandle

  hp-pa-gpios:
    maxItems: 1
    description: Control external headphone amplifier.

  spk-pa-gpios:
    maxItems: 1
    description: Control external speaker amplifier.

  hp-switch-gpios:
    maxItems: 1
    description: Detect headphone jack insertion/removal.

required:
  - compatible
  - sirf,audio-codec
  - sirf,audio-platform

additionalProperties: false

examples:
  - |
    sound {
        compatible = "sirf,sirf-audio-card";
        sirf,audio-codec = <&audiocodec>;
        sirf,audio-platform = <&audioport>;
        hp-pa-gpios = <&gpio 44 0>;
        spk-pa-gpios = <&gpio 46 0>;
        hp-switch-gpios = <&gpio 45 0>;
    };
```

## Documentation/devicetree/bindings/sound/sirf-audio-port.yaml
```yaml
# SPDX-License-Identifier: (GPL-2.0-only OR BSD-2-Clause)
%YAML 1.2
---
$id: http://devicetree.org/schemas/sound/sirf-audio-port.yaml#
$schema: http://devicetree.org/meta-schemas/core.yaml#

title: SiRF SoC audio port

maintainers:
  - Rongjun Ying <rongjun.ying@csr.com>

description: |
  * SiRF SoC audio port

properties:
  compatible:
    items:
      - const: sirf,audio-port

  reg:
    items:
      - description: Base address and size entries

  dmas:
    $ref: /schemas/types.yaml#/definitions/phandle-array
    description: List of DMA controller phandle and DMA request line ordered pairs.

  dma-names:
    $ref: /schemas/types.yaml#/definitions/string-array
    description: |
      Identifier string for each DMA request line in the dmas property.
      These strings correspond 1:1 with the ordered pairs in dmas.
      One of the DMA channels will be responsible for transmission
      (should be named "tx") and one for reception (should be named "rx").
    items:
      - const: rx
      - const: tx

required:
  - compatible
  - reg
  - dmas
  - dma-names

additionalProperties: false

examples:
  - |
    audioport: audioport@b0040000 {
        compatible = "sirf,audio-port";
        reg = <0xb0040000 0x10000>;
        dmas = <&dmac1 3>, <&dmac1 8>;
        dma-names = "rx", "tx";
    };
```

## Documentation/devicetree/bindings/sound/st,sta32x.yaml
```yaml
# SPDX-License-Identifier: (GPL-2.0-only OR BSD-2-Clause)
%YAML 1.2
---
$id: http://devicetree.org/schemas/sound/st,sta32x.yaml#
$schema: http://devicetree.org/meta-schemas/core.yaml#

title: st,sta32x

maintainers:
  - Daniel Mack <daniel@zonque.org>
  - Thomas Niederprüm <niederp@physik.uni-kl.de>

description: |
  STA32X audio CODEC

  The driver for this device only supports I2C.

properties:
  compatible:
    description: Must be "st,sta32x"
    items:
      - const: st,sta32x

  reg:
    description: I2C address of the STA32X codec
    items:
      - description: I2C bus address of the codec

  reset-gpios:
    maxItems: 1
    description: Reset GPIO for the codec

  power-down-gpios:
    maxItems: 1
    description: Power-down GPIO for the codec

  Vdda-supply: true
  Vdd3-supply: true
  Vcc-supply: true

  clocks:
    maxItems: 1
    description: XTI input clock for the codec

  clock-names:
    items:
      - const: xti

  st,output-conf:
    description: Output configuration selection
    enum: [0, 1, 2, 3]
    default: 0

  st,ch1-output-mapping:
    description: Channel 1 output mapping
    $ref: /schemas/types.yaml#/definitions/uint32
    enum: [0, 1, 2]
    default: 0

  st,ch2-output-mapping:
    description: Channel 2 output mapping
    $ref: /schemas/types.yaml#/definitions/uint32
    enum: [0, 1, 2]
    default: 0

  st,ch3-output-mapping:
    description: Channel 3 output mapping
    $ref: /schemas/types.yaml#/definitions/uint32
    enum: [0, 1, 2]
    default: 0

  st,thermal-warning-recover:
    description: Thermal warning recovery enabled
    type: boolean

  st,fault-detect-recovery:
    description: Fault detect recovery enabled
    type: boolean

  st,thermal-warning-adjustment:
    description: Thermal warning adjustment enabled
    type: boolean

  st,drop-compensation-ns:
    description: Drop compensation in nanoseconds; only valid in variable-drop-compensation mode
    minimum: 0
    maximum: 300
    multipleOf: 20
    default: 140

  st,max-power-use-mpcc:
    description: Use MPCC bits for MPC coefficients
    type: boolean

  st,max-power-corr:
    description: Power bridge correction for THD reduction near maximum power
    type: boolean

  st,am-reduction-mode:
    description: AM reduction mode for FFX
    type: boolean

  st,odd-pwm-speed-mode:
    description: Odd PWM speed mode (341.3 kHz)
    type: boolean

  st,invalid-input-detect-mute:
    description: Automatic invalid input detect mute
    type: boolean

required:
  - compatible
  - reg
  - reset-gpios
  - power-down-gpios
  - Vdda-supply
  - Vdd3-supply
  - Vcc-supply

additionalProperties: false

examples:
  - |
    codec: sta32x@38 {
        compatible = "st,sta32x";
        reg = <0x1c>;
        clocks = <&clock>;
        clock-names = "xti";
        reset-gpios = <&gpio1 19 0>;
        power-down-gpios = <&gpio1 16 0>;
        st,output-conf = /bits/ 8 <0x3>; /* 2-channel output power/data-out */
        st,ch1-output-mapping = /bits/ 8 <0>; /* set channel 1 output ch 1 */
        st,ch2-output-mapping = /bits/ 8 <0>; /* set channel 2 output ch 1 */
        st,ch3-output-mapping = /bits/ 8 <0>; /* set channel 3 output ch 1 */
        st,max-power-correction; /* enables THD reduction near max power output */
        st,invalid-input-detect-mute; /* mute if no valid digital audio signal is provided. */
    };
```
