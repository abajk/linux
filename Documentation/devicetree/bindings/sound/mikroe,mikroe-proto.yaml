## Documentation/devicetree/bindings/sound/st,sta350.yaml
```yaml
# SPDX-License-Identifier: (GPL-2.0-only OR BSD-2-Clause)
# Copyright 2025 Daniel Mack, Hayato Suzuki, Sven Brandau, Yu-Chun Lin
%YAML 1.2
---
$id: http://devicetree.org/schemas/sound/st,sta350.yaml#
$schema: http://devicetree.org/meta-schemas/core.yaml#

title: ST STA350 audio CODEC

maintainers:
  - Daniel Mack <zonque@gmail.com>
  - Hayato Suzuki <hytszk@gmail.com>
  - Sven Brandau <brandau@gmx.de>
  - Yu-Chun Lin <eleanor15x@gmail.com>

description: |
  STA350 audio CODEC

  The driver for this device only supports I2C.

properties:
  compatible:
    items:
      - const: st,sta350

  reg:
    items:
      - description: I2C device address

  reset-gpios:
    items:
      - description: Reset GPIO for the device

  power-down-gpios:
    items:
      - description: Power-down GPIO for the device

  vdd-dig-supply: true
  vdd-pll-supply: true
  vcc-supply: true

  st,output-conf:
    description: Output configuration. Must be specified as '/bits/ 8' value.
    $ref: /schemas/types.yaml#/definitions/uint32
    enum: [0, 1, 2, 3]

  st,ch1-output-mapping:
    description: Channel 1 output mapping. Must be specified as '/bits/ 8' value.
    $ref: /schemas/types.yaml#/definitions/uint32
    enum: [0, 1, 2]

  st,ch2-output-mapping:
    description: Channel 2 output mapping. Must be specified as '/bits/ 8' value.
    $ref: /schemas/types.yaml#/definitions/uint32
    enum: [0, 1, 2]

  st,ch3-output-mapping:
    description: Channel 3 output mapping. Must be specified as '/bits/ 8' value.
    $ref: /schemas/types.yaml#/definitions/uint32
    enum: [0, 1, 2]

  st,thermal-warning-recover:
    description: Enables thermal warning recovery.
    type: boolean

  st,thermal-warning-adjustment:
    description: Enables thermal warning adjustment.
    type: boolean

  st,fault-detect-recovery:
    description: Enables fault detect recovery.
    type: boolean

  st,ffx-power-output-mode:
    description: FFX power output mode.
    $ref: /schemas/types.yaml#/definitions/string
    enum:
      - drop-compensation
      - tapered-compensation
      - full-power-mode
      - variable-drop-compensation
    default: variable-drop-compensation

  st,drop-compensation-ns:
    description: Drop compensation in nanoseconds.
    minimum: 0
    maximum: 300
    multipleOf: 20
    default: 140

  st,overcurrent-warning-adjustment:
    description: Enables overcurrent warning adjustment.
    type: boolean

  st,max-power-use-mpcc:
    description: Use MPCC bits for MPC coefficients.
    type: boolean

  st,max-power-correction:
    description: Enables power bridge correction for THD reduction near maximum power output.
    type: boolean

  st,am-reduction-mode:
    description: Enables AM reduction mode for FFX.
    type: boolean

  st,odd-pwm-speed-mode:
    description: Enables odd PWM speed mode (341.3 kHz) on all channels.
    type: boolean

  st,distortion-compensation:
    description: Enables distortion compensation using the DCC coefficient.
    type: boolean

  st,invalid-input-detect-mute:
    description: Enables automatic invalid input detect mute.
    type: boolean

  st,activate-mute-output:
    description: Activates mute output when volume reaches lower than -76 dBFS.
    type: boolean

  st,bridge-immediate-off:
    description: Switches off the bridge immediately after the power-down GPIO goes low.
    type: boolean

  st,noise-shape-dc-cut:
    description: Enables noise-shaping on the DC cutoff filter.
    type: boolean

  st,powerdown-master-volume:
    description: Makes power-down pin and I2C power-down functions act on the master volume.
    type: boolean

  st,powerdown-delay-divider:
    description: Divider for bridge power-down time.
    $ref: /schemas/types.yaml#/definitions/uint32
    enum: [1, 2, 4, 8, 16, 32, 64, 128]

required:
  - compatible
  - reg
  - reset-gpios
  - power-down-gpios
  - vdd-dig-supply
  - vdd-pll-supply
  - vcc-supply

additionalProperties: false

examples:
  - |
    codec: sta350@38 {
      compatible = "st,sta350";
      reg = <0x1c>;
      reset-gpios = <&gpio1 19 0>;
      power-down-gpios = <&gpio1 16 0>;
      st,output-conf = /bits/ 8 <0x3>;    // set output to 2-channel
                                          // (full-bridge) power,
                                          // 2-channel data-out
      st,ch1-output-mapping = /bits/ 8 <0>;    // set channel 1 output ch 1
      st,ch2-output-mapping = /bits/ 8 <0>;    // set channel 2 output ch 1
      st,ch3-output-mapping = /bits/ 8 <0>;    // set channel 3 output ch 1
      st,max-power-correction;        // enables power bridge
                                      // correction for THD reduction
                                      // near maximum power output
      st,invalid-input-detect-mute;  // mute if no valid digital
                                      // audio signal is provided.
    };
```

## Documentation/devicetree/bindings/sound/st,sti-asoc-card.yaml
```yaml
# SPDX-License-Identifier: (GPL-2.0-only OR BSD-2-Clause)
# Copyright 2025 STMicroelectronics
%YAML 1.2
---
$id: http://devicetree.org/schemas/sound/st,sti-asoc-card.yaml#
$schema: http://devicetree.org/meta-schemas/core.yaml#

title: STMicroelectronics sti ASoC cards

maintainers:
  - Arnaud Pouliquen <arnaud.pouliquen@st.com>
  - Mathieu Malaterrre <malat@debian.org>
  - Mauro Carvalho Chehab <mchehab+huawei@kernel.org>
  - Moise Gergaud <moise.gergaud@st.com>
  - Peter Griffin <peter.griffin@linaro.org>
  - Rob Herring <robh@kernel.org>

description: |
  STMicroelectronics sti ASoC cards

  The sti ASoC Sound Card can be used, for all sti SoCs using internal
  sti-sas codec or external codecs.

  sti sound drivers allows to expose sti SoC audio interface through the
  generic ASoC simple card. For details about sound card declaration please
  refer to Documentation/devicetree/bindings/sound/simple-card.yaml.

properties:
  compatible:
    description: Supported compatible strings.
    items:
      - enum:
          - st,stih407-uni-player-hdmi
          - st,stih407-uni-player-pcm-out
          - st,stih407-uni-player-dac
          - st,stih407-uni-player-spdif
          - st,stih407-uni-reader-pcm_in
          - st,stih407-uni-reader-hdmi
          - st,stih407-sas-codec
          - st,stih416-sas-codec

  st,syscfg:
    description: Phandle to boot-device system configuration registers.
    $ref: /schemas/types.yaml#/definitions/phandle

  st,reg_audio:
    description: Phandle to boot-device system configuration registers.
    $ref: /schemas/types.yaml#/definitions/phandle

  reg:
    description: CPU DAI IP base address and size entries, listed in the
      same order as the CPU_DAI properties.

  reg-names:
    description: Names of the mapped memory regions listed in reg property
      in the same order.

  interrupts:
    maxItems: 1

  clocks:
    maxItems: 1
    description: CPU_DAI IP clock source, listed in the same order as the
      CPU_DAI properties.

  clock-names:
    items:
      - const: bus

  dmas:
    description: CPU_DAI DMA controller phandle and DMA request line,
      listed in the same order as the CPU_DAI properties.
    $ref: /schemas/types.yaml#/definitions/phandle-array

  dma-names:
    description: Identifier string for each DMA request line in the dmas
      property.
    $ref: /schemas/types.yaml#/definitions/string-array

  st,tdm-mode:
    description: TDM mode for unireader and uniplayer IPs.
    $ref: /schemas/types.yaml#/definitions/uint32

  simple-audio-card,name:
    description: Name of the audio card.
    $ref: /schemas/types.yaml#/definitions/string

  format:
    description: DAI format for the link.
    $ref: /schemas/types.yaml#/definitions/string

  dai-tdm-slot-width:
    description: Width of a TDM slot in bits.
    $ref: /schemas/types.yaml#/definitions/uint32

  dai-tdm-slot-num:
    description: Number of TDM slots.
    $ref: /schemas/types.yaml#/definitions/uint32

  frame-inversion:
    description: Frame inversion flag.
    $ref: /schemas/types.yaml#/definitions/uint32

  dai-tdm-slot-tx-mask:
    description: TX mask for TDM slots.
    $ref: /schemas/types.yaml#/definitions/uint32-array

  sound-dai:
    description: Phandle(s) to CPU or codec DAI(s).
    $ref: /schemas/types.yaml#/definitions/phandle-array

required:
  - compatible
  - st,syscfg
  - reg
  - interrupts

additionalProperties: false

examples:
  - |
    sound {
      compatible = "simple-audio-card";
      simple-audio-card,name = "sti audio card";

      simple-audio-card,dai-link@0 {
        format = "i2s";
        dai-tdm-slot-width = <32>;
        cpu {
          sound-dai = <&sti_uni_player2>;
        };

        codec {
          sound-dai = <&sti_sas_codec 1>;
        };
      };
      simple-audio-card,dai-link@1 {
        format = "left_j";
        cpu {
          sound-dai = <&sti_uni_player3>;
        };

        codec {
          sound-dai = <&sti_sas_codec 0>;
        };
      };
      simple-audio-card,dai-link@2 {
        format = "left_j";
        frame-inversion = <1>;
        cpu {
          sound-dai = <&sti_uni_player1>;
          dai-tdm-slot-num = <16>;
          dai-tdm-slot-width = <16>;
          dai-tdm-slot-tx-mask = <1 1 1 1 0 0 0 0 0 0 1 1 0 0 1 1>;
        };

        codec {
          sound-dai = <&sti_sas_codec 3>;
        };
      };
    };
```

## Documentation/devicetree/bindings/sound/st,tda7419.yaml
```yaml
# SPDX-License-Identifier: (GPL-2.0-only OR BSD-2-Clause)
# Copyright 2025 Matt Porter
%YAML 1.2
---
$id: http://devicetree.org/schemas/sound/st,tda7419.yaml#
$schema: http://devicetree.org/meta-schemas/core.yaml#

title: ST TDA7419 audio processor

maintainers:
  - Matt Porter <mporter@konsulko.com>

description: |
  TDA7419 audio processor

  This device supports I2C only.

  Pins on the device (for linking into audio routes):

    * SE3L
    * SE3R
    * SE2L
    * SE2R
    * SE1L
    * SE1R
    * DIFFL
    * DIFFR
    * MIX
    * OUTLF
    * OUTRF
    * OUTLR
    * OUTRR
    * OUTSW

properties:
  compatible:
    items:
      - const: st,tda7419

  reg:
    items:
      - description: I2C address of the device

  st,mute-gpios:
    maxItems: 1
    description: GPIO to control the MUTE pin

  vdd-supply:
    description: Regulator for common power supply (8-10V)

required:
  - compatible
  - reg
  - vdd-supply

additionalProperties: false

examples:
  - |
      ap: tda7419@44 {
          compatible = "st,tda7419";
          reg = <0x44>;
          vdd-supply = <&vdd_9v0_reg>;
      };
```

## Documentation/devicetree/bindings/sound/stericsson,snd-soc-mop500.yaml
```yaml
# SPDX-License-Identifier: (GPL-2.0-only OR BSD-2-Clause)
# Copyright 2025 Lee Jones
%YAML 1.2
---
$id: http://devicetree.org/schemas/sound/stericsson,snd-soc-mop500.yaml#
$schema: http://devicetree.org/meta-schemas/core.yaml#

title: MOP500 Audio Machine Driver

maintainers:
  - Lee Jones <lee@kernel.org>

description: |
  * MOP500 Audio Machine Driver

  This node is responsible for linking together all ux500 Audio Driver components.

properties:
  compatible:
    items:
      - const: stericsson,snd-soc-mop500

  stericsson,cpu-dai:
    description: Phandle to the CPU-side DAI.
    $ref: /schemas/types.yaml#/definitions/phandle-array
    items:
      - $ref: /schemas/types.yaml#/definitions/phandle
      - $ref: /schemas/types.yaml#/definitions/phandle

  stericsson,audio-codec:
    description: Phandle to the Audio CODEC.
    $ref: /schemas/types.yaml#/definitions/phandle

  stericsson,card-name:
    description: Over-ride default card name.
    $ref: /schemas/types.yaml#/definitions/string

required:
  - compatible

additionalProperties: false

examples:
  - |
    sound {
        compatible = "stericsson,snd-soc-mop500";

        stericsson,cpu-dai = <&msp1 &msp3>;
        stericsson,audio-codec = <&codec>;
    };

    msp1: msp@80124000 {
        compatible = "stericsson,ux500-msp-i2s";
        reg = <0x80124000 0x1000>;
        interrupts = <0 62 0x4>;
        v-ape-supply = <&db8500_vape_reg>;
    };

    msp3: msp@80125000 {
        compatible = "stericsson,ux500-msp-i2s";
        reg = <0x80125000 0x1000>;
        interrupts = <0 62 0x4>;
        v-ape-supply = <&db8500_vape_reg>;
    };

    codec: ab8500-codec {
        compatible = "stericsson,ab8500-codec";
        stericsson,earpeice-cmv = <950>; /* Units in mV. */
    };
```
