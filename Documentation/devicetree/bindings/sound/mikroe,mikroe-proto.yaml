## Documentation/devicetree/bindings/sound/realtek,rt1308.yaml
```yaml
# SPDX-License-Identifier: (GPL-2.0-only OR BSD-2-Clause)
# Copyright 2025 Realtek
%YAML 1.2
---
$id: http://devicetree.org/schemas/sound/realtek,rt1308.yaml#
$schema: http://devicetree.org/meta-schemas/core.yaml#

title: RT1308 Audio Amplifier

maintainers:
  - Derek Fang <derek.fang@realtek.com>
  - Oder Chiou <oder_chiou@realtek.com>

description: |
  RT1308 audio Amplifier

  This device supports I2C only.

properties:
  compatible:
    items:
      - const: realtek,rt1308

  reg:
    description: I2C device address.
    items:
      - description: I2C address of the device

required:
  - compatible
  - reg

additionalProperties: false

examples:
  - |
    rt1308: rt1308@10 {
        compatible = "realtek,rt1308";
        reg = <0x10>;
    };
```

## Documentation/devicetree/bindings/sound/realtek,rt274.yaml
```yaml
# SPDX-License-Identifier: (GPL-2.0-only OR BSD-2-Clause)
# Copyright 2025 Realtek
%YAML 1.2
---
$id: http://devicetree.org/schemas/sound/realtek,rt274.yaml#
$schema: http://devicetree.org/meta-schemas/core.yaml#

title: Realtek RT274 Audio CODEC

maintainers:
  - Bard Liao <bardliao@realtek.com>
  - Fabio Estevam <fabio.estevam@nxp.com>

description: |
  RT274 audio CODEC

  This device supports I2C only.

  Pins on the device (for linking into audio routes) for RT274:

    * DMIC1 Pin
    * DMIC2 Pin
    * MIC
    * LINE1
    * LINE2
    * HPO Pin
    * SPDIF
    * LINE3

properties:
  compatible:
    items:
      - const: realtek,rt274

  reg:
    description: The I2C address of the device.
    items:
      - description: I2C address

  interrupts:
    description: CODEC interrupt output
    items:
      - description: Interrupt output for the CODEC

required:
  - compatible
  - reg

additionalProperties: false

examples:
  - |
    rt274: codec@1c {
        compatible = "realtek,rt274";
        reg = <0x1c>;
        interrupts = <7 IRQ_TYPE_EDGE_FALLING>;
    };
```

## Documentation/devicetree/bindings/sound/realtek,rt5651.yaml
```yaml
# SPDX-License-Identifier: (GPL-2.0-only OR BSD-2-Clause)
# Copyright 2025 Realtek
%YAML 1.2
---
$id: http://devicetree.org/schemas/realtek,rt5651.yaml#
$schema: http://devicetree.org/meta-schemas/core.yaml#

title: Realtek RT5651 audio CODEC

maintainers:
  - Bard Liao <bardliao@realtek.com>
  - Fabio Estevam <fabio.estevam@nxp.com>
  - Hans de Goede <hdegoede@redhat.com>

description: |
  RT5651 audio CODEC

  This device supports I2C only.

  Pins on the device (for linking into audio routes) for RT5651:

    * DMIC L1
    * DMIC R1
    * IN1P
    * IN2P
    * IN2N
    * IN3P
    * HPOL
    * HPOR
    * LOUTL
    * LOUTR
    * PDML
    * PDMR

properties:
  compatible:
    items:
      - const: realtek,rt5651
    description: Must be "realtek,rt5651".
  reg:
    description: The I2C address of the device.
    items:
      - description: I2C address.
  realtek,in2-differential:
    type: boolean
    description: Indicate MIC2 input are differential, rather than single-ended.
  realtek,dmic-en:
    type: boolean
    description: True if DMIC is used.
  realtek,jack-detect-source:
    $ref: /schemas/types.yaml#/definitions/uint32
    description: Select jack-detect input pin.
    enum: [1, 2, 3]
  realtek,jack-detect-not-inverted:
    type: boolean
    description: |
      Normal jack-detect switches give an inverted (active-low) signal;
      set this bool in the rare case you've a jack-detect switch which is not inverted.
  realtek,over-current-threshold-microamp:
    description: Micbias over-current detection threshold in µA.
    enum: [600, 1500, 2000]
  realtek,over-current-scale-factor:
    $ref: /schemas/types.yaml#/definitions/uint32
    description: |
      Micbias over-current detection scale factor; 0: scale current by 0.5,
      1: scale current by 0.75, 2: scale current by 1.0, 3: scale current by 1.5.
    enum: [0, 1, 2, 3]

additionalProperties: false

examples:
  - |
    codec@1a {
      compatible = "realtek,rt5651";
      reg = <0x1a>;
      realtek,dmic-en;
      realtek,in2-differential;
    };
```

## Documentation/devicetree/bindings/sound/realtek,rt5660.yaml
```yaml
# SPDX-License-Identifier: (GPL-2.0-only OR BSD-2-Clause)
%YAML 1.2
---
$id: http://devicetree.org/schemas/realtek,rt5660.yaml#
$schema: http://devicetree.org/meta-schemas/core.yaml#

title: Realtek RT5660 Audio CODEC

maintainers:
  - Oder Chiou <oder_chiou@realtek.com>

description: |
  RT5660 audio CODEC

  This device supports I2C only.

  Pins on the device (for linking into audio routes) for RT5660:

    * DMIC L1
    * DMIC R1
    * IN1P
    * IN1N
    * IN2P
    * IN3P
    * IN3N
    * SPO
    * LOUTL
    * LOUTR

properties:
  compatible:
    description: Must be realtek,rt5660.
    items:
      - const: realtek,rt5660

  reg:
    description: I2C address of the device.
    items:
      - description: I2C address

  clocks:
    description: Phandle to the master clock to the CODEC.
    maxItems: 1

  clock-names:
    items:
      - const: mclk

  realtek,dmic1-data-pin:
    description: |
      Control dmic1 data pin.
      0: dmic1 is not used.
      1: using GPIO2 pin as dmic1 data pin.
      2: using IN1P pin as dmic1 data pin.
    enum: [0, 1, 2]

  realtek,in1-differential:
    description: Indicate MIC1 input is differential, rather than single-ended.
    type: boolean

  realtek,in3-differential:
    description: Indicate MIC3 input is differential, rather than single-ended.
    type: boolean

  realtek,poweroff-in-suspend:
    description: |
      If the codec will be powered off in suspend, the resume should
      add delay time for waiting codec power ready.
    type: boolean

required:
  - compatible
  - reg

additionalProperties: false

examples:
  - |
    rt5660@1c {
        compatible = "realtek,rt5660";
        reg = <0x1c>;
        clocks = <&mclk>;
        clock-names = "mclk";
        realtek,in1-differential;
        realtek,in3-differential;
        realtek,poweroff-in-suspend;
        realtek,dmic1-data-pin = <2>;
    };
```

## Documentation/devicetree/bindings/sound/realtek,rt5663.yaml
```yaml
# SPDX-License-Identifier: (GPL-2.0-only OR BSD-2-Clause)
%YAML 1.2
---
$id: http://devicetree.org/schemas/realtek,rt5663.yaml#
$schema: http://devicetree.org/meta-schemas/core.yaml#

title: realtek,rt5663 audio CODEC

maintainers:
  - Bard Liao <bardliao@realtek.com>
  - Bjorn Helgaas <bhelgaas@google.com>
  - Cheng-Yi Chiang <cychiang@chromium.org>
  - Fabio Estevam <fabio.estevam@nxp.com>
  - Oder Chiou <oder_chiou@realtek.com>
  - oder_chiou@realtek.com <oder_chiou@realtek.com>

description: |
  RT5663 audio CODEC

  This device supports I2C only.

  Required properties:

  - compatible: "realtek,rt5663".
  - reg: The I2C address of the device.
  - interrupts: The CODEC's interrupt output.
  - avdd-supply: Power supply for AVDD, providing 1.8V.
  - cpvdd-supply: Power supply for CPVDD, providing 3.5V.

  Optional properties:

  - realtek,dc_offset_l_manual
  - realtek,dc_offset_r_manual
  - realtek,dc_offset_l_manual_mic
  - realtek,dc_offset_r_manual_mic
  - realtek,impedance_sensing_num
  - realtek,impedance_sensing_table

properties:
  compatible:
    items:
      - enum: [realtek, rt5663]
  reg:
    description: I2C address of the device.
    items:
      - description: I2C address
  interrupts:
    description: CODEC's interrupt output.
    items:
      - description: Interrupt specifier
  interrupt-controller: true
  avdd-supply:
    description: Power supply for AVDD, providing 1.8V.
  cpvdd-supply:
    description: Power supply for CPVDD, providing 3.5V.
  realtek,dc_offset_l_manual:
    description: Manual DC offset for left headphone channel.
    $ref: /schemas/types.yaml#/definitions/uint32
  realtek,dc_offset_r_manual:
    description: Manual DC offset for right headphone channel.
    $ref: /schemas/types.yaml#/definitions/uint32
  realtek,dc_offset_l_manual_mic:
    description: Manual DC offset for left microphone channel.
    $ref: /schemas/types.yaml#/definitions/uint32
  realtek,dc_offset_r_manual_mic:
    description: Manual DC offset for right microphone channel.
    $ref: /schemas/types.yaml#/definitions/uint32
  realtek,impedance_sensing_num:
    description: Number of impedance sensing table rows; 0 indicates unsupported.
    $ref: /schemas/types.yaml#/definitions/uint32
  realtek,impedance_sensing_table:
    description: Matrix rows of the impedance sensing table.
    items:
      - description: Minimum impedance.
        $ref: /schemas/types.yaml#/definitions/uint32
      - description: Maximum impedance.
        $ref: /schemas/types.yaml#/definitions/uint32
      - description: Volume.
        $ref: /schemas/types.yaml#/definitions/uint32
      - description: DC offset without microphone for left channel.
        $ref: /schemas/types.yaml#/definitions/uint32
      - description: DC offset without microphone for right channel.
        $ref: /schemas/types.yaml#/definitions/uint32
      - description: DC offset with microphone for left channel.
        $ref: /schemas/types.yaml#/definitions/uint32
      - description: DC offset with microphone for right channel.
        $ref: /schemas/types.yaml#/definitions/uint32

required:
  - compatible
  - reg
  - interrupts
  - interrupt-controller

additionalProperties: false

examples:
  - |
    rt5663: codec@12 {
        compatible = "realtek,rt5663";
        reg = <0x12>;
        interrupts = <7 IRQ_TYPE_EDGE_FALLING>;
        avdd-supply = <&pp1800_a_alc5662>;
        cpvdd-supply = <&pp3500_a_alc5662>;
    };
```

## Documentation/devicetree/bindings/sound/realtek,rt5665.yaml
```yaml
# SPDX-License-Identifier: (GPL-2.0-only OR BSD-2-Clause)
%YAML 1.2
---
$id: http://devicetree.org/schemas/realtek,rt5665.yaml#
$schema: http://devicetree.org/meta-schemas/core.yaml#

title: Realtek RT5665/RT5666 audio CODEC

maintainers:
  - Bard Liao <bardliao@realtek.com>
  - Joe Perches <joe@perches.com>
  - Krzysztof Kozlowski <krzk@kernel.org>

description: |
  RT5665/RT5666 audio CODEC

  This device supports I2C only.

properties:
  compatible:
    description: Vendor and model of the audio CODEC.
    items:
      - enum: [realtek, rt5665]
      - enum: [realtek, rt5666]

  reg:
    description: I2C address of the CODEC.
    items:
      - description: I2C address

  interrupts:
    description: CODEC interrupt output.
    items:
      - description: Interrupt output

  realtek,in1-differential:
    description: MIC1 input is differential if true.
    type: boolean

  realtek,in2-differential:
    description: MIC2 input is differential if true.
    type: boolean

  realtek,in3-differential:
    description: MIC3 input is differential if true.
    type: boolean

  realtek,in4-differential:
    description: MIC4 input is differential if true.
    type: boolean

  realtek,dmic1-data-pin:
    description: Data pin selection for DMIC1.
    items:
      - const: 0  # dmic1 is not used
      - const: 1  # using GPIO4 pin as dmic1 data pin
      - const: 2  # using IN2N pin as dmic1 data pin

  realtek,dmic2-data-pin:
    description: Data pin selection for DMIC2.
    items:
      - const: 0  # dmic2 is not used
      - const: 1  # using GPIO5 pin as dmic2 data pin
      - const: 2  # using IN2P pin as dmic2 data pin

  realtek,jd-src:
    description: Jack detect source selection.
    items:
      - const: 0  # No JD is used
      - const: 1  # using JD1 as JD source

  realtek,ldo1-en-gpios:
    description: The GPIO that controls the CODEC's LDO1_EN pin.
    maxItems: 1

required:
  - compatible
  - reg
  - interrupts

additionalProperties: false

examples:
  - |
    codec@1b {
      compatible = "realtek,rt5665";
      reg = <0x1b>;
      interrupts = <TEGRA_GPIO(W, 3) IRQ_TYPE_LEVEL_HIGH>;
      realtek,ldo1-en-gpios = <&gpio TEGRA_GPIO(V, 3) GPIO_ACTIVE_HIGH>;
    };
```

## Documentation/devicetree/bindings/sound/realtek,rt5668b.yaml
```yaml
# SPDX-License-Identifier: (GPL-2.0-only OR BSD-2-Clause)
%YAML 1.2
---
$id: http://devicetree.org/schemas/sound/realtek,rt5668b.yaml#
$schema: http://devicetree.org/meta-schemas/core.yaml#

title: Realtek RT5668B audio CODEC

maintainers:
  - Bard Liao <bardliao@realtek.com>
  - Krzysztof Kozlowski <krzk@kernel.org>

description: |
  RT5668B audio CODEC

  This device supports I2C only.

  Pins on the device (for linking into audio routes) for RT5668B:

    * DMIC L1
    * DMIC R1
    * IN1P
    * HPOL
    * HPOR

properties:
  compatible:
    items:
      - enum: [realtek, rt5668b]
    description: A list of compatible strings; must be "realtek,rt5668b".

  reg:
    description: I2C address of the device.
    items:
      - description: I2C bus address

  interrupts:
    maxItems: 1
    description: Interrupt output from the CODEC.

  realtek,dmic1-data-pin:
    description: |
      Determine DMIC1 data pin: 0 for not used; 1 for using GPIO2 pin; 2 for using GPIO5 pin.
    $ref: /schemas/types.yaml#/definitions/uint32
    enum: [0, 1, 2]

  realtek,dmic1-clk-pin:
    description: |
      Determine DMIC1 clock pin: 0 for using GPIO1 pin; 1 for using GPIO3 pin.
    $ref: /schemas/types.yaml#/definitions/uint32
    enum: [0, 1]

  realtek,jd-src:
    description: |
      Jack detect source: 0 for no JD; 1 for using JD1.
    $ref: /schemas/types.yaml#/definitions/uint32
    enum: [0, 1]

  realtek,ldo1-en-gpios:
    maxItems: 1
    description: The GPIO that controls the CODEC's LDO1_EN pin.

required:
  - compatible
  - reg

additionalProperties: false

examples:
  - |
    rt5668@1a {
        compatible = "realtek,rt5668b";
        reg = <0x1a>;
        interrupts = <TEGRA_GPIO(U, 6) IRQ_TYPE_LEVEL_HIGH>;
        realtek,ldo1-en-gpios = <&gpio TEGRA_GPIO(R, 2) GPIO_ACTIVE_HIGH>;
        realtek,dmic1-data-pin = <1>;
        realtek,dmic1-clk-pin = <1>;
        realtek,jd-src = <1>;
    };
```

## Documentation/devicetree/bindings/sound/rockchip,rk3288-hdmi-analog.yaml
```yaml
# SPDX-License-Identifier: (GPL-2.0-only OR BSD-2-Clause)
%YAML 1.2
---
$id: http://devicetree.org/schemas/sound/rockchip,rk3288-hdmi-analog.yaml#
$schema: http://devicetree.org/meta-schemas/core.yaml#

title: Rockchip RK3288 with HDMI and analog audio
maintainers:
  - Bjorn Helgaas <bhelgaas@google.com>
  - Ezequiel Garcia <ezequiel@collabora.co.uk>
  - Romain Perier <romain.perier@collabora.com>

properties:
  compatible:
    items:
      - const: rockchip,rk3288-hdmi-analog

  rockchip,model:
    description: The user-visible name of this sound complex
    $ref: /schemas/types.yaml#/definitions/string

  rockchip,i2s-controller:
    description: Phandle of the Rockchip I2S controller connected to the CODEC
    $ref: /schemas/types.yaml#/definitions/phandle

  rockchip,audio-codec:
    description: Phandle of the analog audio codec
    $ref: /schemas/types.yaml#/definitions/phandle

  rockchip,routing:
    description: A list of connections between audio components; each pair is sink then source.
    $ref: /schemas/types.yaml#/definitions/string-array

  rockchip,hp-en-gpios:
    description: GPIO controlling power up/down of headphone
    maxItems: 1

  rockchip,hp-det-gpios:
    description: GPIO detecting presence of headphone
    maxItems: 1

required:
  - compatible
  - rockchip,model
  - rockchip,i2s-controller
  - rockchip,audio-codec
  - rockchip,routing

additionalProperties: false

examples:
  - |
    sound {
      compatible = "rockchip,rk3288-hdmi-analog";
      rockchip,model = "Analog audio output";
      rockchip,i2s-controller = <&i2s>;
      rockchip,audio-codec = <&es8388>;
      rockchip,routing = "Analog", "LOUT2",
                         "Analog", "ROUT2";
      rockchip,hp-en-gpios = <&gpio8 0 GPIO_ACTIVE_HIGH>;
      rockchip,hp-det-gpios = <&gpio7 7 GPIO_ACTIVE_HIGH>;
      pinctrl-names = "default";
      pinctrl-0 = <&headphone>;
    };
```
