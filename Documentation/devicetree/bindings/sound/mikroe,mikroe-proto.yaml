## Documentation/devicetree/bindings/sound/mikroe,mikroe-proto.yaml
```yaml
# SPDX-License-Identifier: (GPL-2.0-only OR BSD-2-Clause)
# Copyright 2025 Microchip Technology
%YAML 1.2
---
$id: http://devicetree.org/schemas/sound/mikroe,mikroe-proto.yaml#
$schema: http://devicetree.org/meta-schemas/core.yaml#

title: Mikroe-PROTO audio board

maintainers:
  - Codrin Ciubotariu <codrin.ciubotariu@microchip.com>

description: |
  Mikroe-PROTO audio board

  Required properties:
    - compatible: "mikroe,mikroe-proto"
    - dai-format: Must be "i2s".
    - i2s-controller: The phandle of the I2S controller.
    - audio-codec: The phandle of the WM8731 audio codec.

  Optional properties:
    - model: The user-visible name of this sound complex.
    - bitclock-master: Indicates dai-link bit clock master; for details see simple-card.txt (1).
    - frame-master: Indicates dai-link frame master; for details see simple-card.txt (1).

    (1): There must be the same master for both bit and frame clocks.

properties:
  compatible:
    items:
      - const: mikroe,mikroe-proto

  model:
    description: The user-visible name of this sound complex.
    $ref: /schemas/types.yaml#/definitions/string

  i2s-controller:
    description: The phandle of the I2S controller.
    $ref: /schemas/types.yaml#/definitions/phandle

  audio-codec:
    description: The phandle of the WM8731 audio codec.
    $ref: /schemas/types.yaml#/definitions/phandle

  dai-format:
    description: Must be "i2s".
    $ref: /schemas/types.yaml#/definitions/string
    enum: [i2s]

  bitclock-master:
    description: Indicates dai-link bit clock master; for details see simple-card.txt (1).
    type: boolean

  frame-master:
    description: Indicates dai-link frame master; for details see simple-card.txt (1).
    type: boolean

required:
  - compatible
  - dai-format
  - i2s-controller
  - audio-codec

additionalProperties: false

examples:
  - |
    sound {
        compatible = "mikroe,mikroe-proto";
        model = "wm8731 @ sama5d2_xplained";
        i2s-controller = <&i2s0>;
        audio-codec = <&wm8731>;
        dai-format = "i2s";
    };
```

## Documentation/devicetree/bindings/sound/mrvl,pxa-ssp-dai.yaml
```yaml
# SPDX-License-Identifier: (GPL-2.0-only OR BSD-2-Clause)
# Copyright 2025 Daniel Mack
%YAML 1.2
---
$id: http://devicetree.org/schemas/sound/mrvl,pxa-ssp-dai.yaml#
$schema: http://devicetree.org/meta-schemas/core.yaml#

title: Marvell PXA SSP CPU DAI

maintainers:
  - Daniel Mack <daniel@zonque.org>
  - Daniel Mack <zonque@gmail.com>

description: |
  Marvell PXA SSP CPU DAI bindings

properties:
  compatible:
    description: Must be "mrvl,pxa-ssp-dai".
    items:
      - const: mrvl,pxa-ssp-dai

  port:
    description: A phandle reference to a PXA SSP upstream device.
    $ref: /schemas/types.yaml#/definitions/phandle

  '#sound-dai-cells':
    description: Number of cells in the DAI phandle; must be zero.
    const: 0

  clock-names:
    description: Names of external clocks; only extclk is supported.
    items:
      - const: extclk

  clocks:
    description: External clock phandles; if extclk is present, it is set to the mclk rate of
      the audio stream and used as clock provider of the DAI.
    maxItems: 1

required:
  - compatible
  - port
  - '#sound-dai-cells'

additionalProperties: false

examples:
  - |
    ssp_dai0: ssp_dai@0 {
        compatible = "mrvl,pxa-ssp-dai";
        port = <&ssp1>;
        #sound-dai-cells = <0>;
        clock-names = "extclk";
        clocks = <&extclk>;
    };
```

## Documentation/devicetree/bindings/sound/nokia,n900-audio.yaml
```yaml
# SPDX-License-Identifier: (GPL-2.0-only OR BSD-2-Clause)
# Copyright 2018 Linaro Ltd.
%YAML 1.2
---
$id: http://devicetree.org/schemas/sound/nokia,n900-audio.yaml#
$schema: http://devicetree.org/meta-schemas/core.yaml#

title: Nokia N900 audio

maintainers:
  - Sebastian Reichel <sre@kernel.org>

description: |
  * Nokia N900 audio setup

properties:
  compatible:
    items:
      - const: nokia,n900-audio
    description: Should contain "nokia,n900-audio"
  nokia,cpu-dai:
    description: phandle for the McBSP node
    $ref: /schemas/types.yaml#/definitions/phandle
  nokia,audio-codec:
    description: phandles for the main TLV320AIC3X node and the auxiliary TLV320AIC3X node (in this order)
    items:
      - $ref: /schemas/types.yaml#/definitions/phandle
      - $ref: /schemas/types.yaml#/definitions/phandle
  nokia,headphone-amplifier:
    description: phandle for the TPA6130A2 node
    $ref: /schemas/types.yaml#/definitions/phandle
  tvout-selection-gpios:
    description: GPIO for tvout selection
    $ref: /schemas/types.yaml#/definitions/phandle-array
  jack-detection-gpios:
    description: GPIO for jack detection
    $ref: /schemas/types.yaml#/definitions/phandle-array
  eci-switch-gpios:
    description: GPIO for ECI (Enhancement Control Interface) switch
    $ref: /schemas/types.yaml#/definitions/phandle-array
  speaker-amplifier-gpios:
    description: GPIO for speaker amplifier
    $ref: /schemas/types.yaml#/definitions/phandle-array

required:
  - compatible
  - nokia,cpu-dai
  - nokia,audio-codec
  - nokia,headphone-amplifier
  - tvout-selection-gpios
  - jack-detection-gpios
  - eci-switch-gpios
  - speaker-amplifier-gpios

additionalProperties: false

examples:
  - |
    sound {
        compatible = "nokia,n900-audio";
        nokia,cpu-dai = <&mcbsp2>;
        nokia,audio-codec = <&tlv320aic3x>, <&tlv320aic3x_aux>;
        nokia,headphone-amplifier = <&tpa6130a2>;
        tvout-selection-gpios = <&gpio2 8 GPIO_ACTIVE_HIGH>; /* 40 */
        jack-detection-gpios = <&gpio6 17 GPIO_ACTIVE_HIGH>; /* 177 */
        eci-switch-gpios = <&gpio6 22 GPIO_ACTIVE_HIGH>; /* 182 */
        speaker-amplifier-gpios = <&twl_gpio 7 GPIO_ACTIVE_HIGH>;
    };
```

## Documentation/devicetree/bindings/sound/nvidia,tegra30-ahub.yaml
```yaml
# SPDX-License-Identifier: (GPL-2.0-only OR BSD-2-Clause)
%YAML 1.2
---
$id: http://devicetree.org/schemas/sound/nvidia,tegra30-ahub.yaml#
$schema: http://devicetree.org/meta-schemas/core.yaml#

title: NVIDIA Tegra30 AHUB (Audio Hub)

maintainers:
  - Paul Walmsley <paul@pwsan.com>
  - Stephen Warren <swarren@nvidia.com>

description: |
  NVIDIA Tegra30 AHUB (Audio Hub)

  Required properties:
  - compatible : For Tegra30, must contain "nvidia,tegra30-ahub".  For Tegra114,
    must contain "nvidia,tegra114-ahub".  For Tegra124, must contain
    "nvidia,tegra124-ahub".  Otherwise, must contain "nvidia,<chip>-ahub",
    plus at least one of the above, where <chip> is tegra132.
  - reg : Should contain the register physical address and length for each of
    the AHUB's register blocks.
    - Tegra30 requires 2 entries, for the APBIF and AHUB/AUDIO register blocks.
    - Tegra114 requires an additional entry, for the APBIF2 register block.
  - interrupts : Should contain AHUB interrupt.
  - clocks : Must contain an entry for each entry in clock-names.
    See ../clocks/clock-bindings.txt for details.
  - clock-names : Must include the following entries:
    - d_audio
    - apbif
  - resets : Must contain an entry for each entry in reset-names.
    See ../reset/reset.txt for details.
  - reset-names : Must include the following entries:
    Tegra30 and later:
    - d_audio
    - apbif
    - i2s0
    - i2s1
    - i2s2
    - i2s3
    - i2s4
    - dam0
    - dam1
    - dam2
    - spdif
    Tegra114 and later additionally require:
    - amx
    - adx
    Tegra124 and later additionally require:
    - amx1
    - adx1
    - afc0
    - afc1
    - afc2
    - afc3
    - afc4
    - afc5
  - ranges : The bus address mapping for the configlink register bus.
    Can be empty since the mapping is 1:1.
  - dmas : Must contain an entry for each DMA channel.
  - dma-names : Must include the following entries:
    - rx0 .. rx<n>
    - tx0 .. tx<n>
      ... where n is:
      Tegra30: 3
      Tegra114, Tegra124: 9
  - "#address-cells" : For the configlink bus. Should be <1>.
  - "#size-cells" : For the configlink bus. Should be <1>.

  AHUB client modules need to specify the IDs of their CIFs (Client Interfaces).
  For RX CIFs, the numbers indicate the register number within AHUB routing
  register space (APBIF 0..3 RX, I2S 0..5 RX, DAM 0..2 RX 0..1, SPDIF RX 0..1).
  For TX CIFs, the numbers indicate the bit position within the AHUB routing
  registers (APBIF 0..3 TX, I2S 0..5 TX, DAM 0..2 TX, SPDIF TX 0..1).

properties:
  compatible:
    items:
      - enum:
          - nvidia,tegra30-ahub
          - nvidia,tegra114-ahub
          - nvidia,tegra124-ahub
          - nvidia,tegra132-ahub

  reg:
    items:
      - description: APBIF register block
      - description: AHUB/AUDIO register block

  interrupts:
    items:
      - description: AHUB interrupt

  nvidia,dma-request-selector:
    description: >
      Selects the DMA request line for the AHUB.
      Contains a phandle to the DMA controller plus a numeric specifier.
    $ref: /schemas/types.yaml#/definitions/phandle-array

  clocks:
    items:
      - description: Clock for d_audio
      - description: Clock for apbif

  clock-names:
    items:
      - const: d_audio
      - const: apbif

  resets:
    items:
      - description: Reset for d_audio
      - description: Reset for apbif
      - description: Reset for i2s0
      - description: Reset for i2s1
      - description: Reset for i2s2
      - description: Reset for i2s3
      - description: Reset for i2s4
      - description: Reset for dam0
      - description: Reset for dam1
      - description: Reset for dam2
      - description: Reset for spdif
      - description: Reset for amx
      - description: Reset for adx
      - description: Reset for amx1
      - description: Reset for adx1
      - description: Reset for afc0
      - description: Reset for afc1
      - description: Reset for afc2
      - description: Reset for afc3
      - description: Reset for afc4
      - description: Reset for afc5

  reset-names:
    items:
      - const: d_audio
      - const: apbif
      - const: i2s0
      - const: i2s1
      - const: i2s2
      - const: i2s3
      - const: i2s4
      - const: dam0
      - const: dam1
      - const: dam2
      - const: spdif
      - const: amx
      - const: adx
      - const: amx1
      - const: adx1
      - const: afc0
      - const: afc1
      - const: afc2
      - const: afc3
      - const: afc4
      - const: afc5

  ranges:
    description: The bus address mapping for the configlink register bus.
      Can be empty since the mapping is 1:1.

  dmas:
    items:
      - description: DMA channel for rx0
      - description: DMA channel for tx0
      - description: DMA channel for rx1
      - description: DMA channel for tx1
      - description: DMA channel for rx2
      - description: DMA channel for tx2
      - description: DMA channel for rx3
      - description: DMA channel for tx3

  dma-names:
    items:
      - const: rx0
      - const: tx0
      - const: rx1
      - const: tx1
      - const: rx2
      - const: tx2
      - const: rx3
      - const: tx3

  "#address-cells":
    const: 1

  "#size-cells":
    const: 1

additionalProperties: false

examples:
  - |
    ahub@70080000 {
        compatible = "nvidia,tegra30-ahub";
        reg = <0x70080000 0x200 0x70080200 0x100>;
        interrupts = <0 103 0x04>;
        nvidia,dma-request-selector = <&apbdma 1>;
        clocks = <&tegra_car 106>, <&tegra_car 107>;
        clock-names = "d_audio", "apbif";
        resets = <&tegra_car 106>, <&tegra_car 107>, <&tegra_car 30>,
            <&tegra_car 11>, <&tegra_car 18>, <&tegra_car 101>,
            <&tegra_car 102>, <&tegra_car 108>, <&tegra_car 109>,
            <&tegra_car 110>, <&tegra_car 10>;
        reset-names = "d_audio", "apbif", "i2s0", "i2s1", "i2s2",
            "i2s3", "i2s4", "dam0", "dam1", "dam2",
            "spdif";
        dmas = <&apbdma 1>, <&apbdma 1>,
               <&apbdma 2>, <&apbdma 2>,
               <&apbdma 3>, <&apbdma 3>,
               <&apbdma 4>, <&apbdma 4>;
        dma-names = "rx0", "tx0", "rx1", "tx1", "rx2", "tx2", "rx3", "tx3";
        ranges;
        #address-cells = <1>;
        #size-cells = <1>;
    };
```

## Documentation/devicetree/bindings/sound/nxp,uda1334.yaml
```yaml
# SPDX-License-Identifier: (GPL-2.0-only OR BSD-2-Clause)
# Copyright 2025 Andra Danciu
%YAML 1.2
---
$id: http://devicetree.org/schemas/nxp,uda1334.yaml#
$schema: http://devicetree.org/meta-schemas/core.yaml#

title: UDA1334 Audio CODEC

maintainers:
  - Andra Danciu <andradanciu1997@gmail.com>

description: |
  UDA1334 audio CODEC

  This device uses simple GPIO pins for controlling codec settings.

properties:
  compatible:
    items:
      - const: nxp,uda1334

  nxp,mute-gpios:
    description: GPIO spec for the MUTE pin
    maxItems: 1

  nxp,deemph-gpios:
    description: GPIO spec for the De-emphasis pin
    maxItems: 1

required:
  - compatible
  - nxp,mute-gpios
  - nxp,deemph-gpios

additionalProperties: false

examples:
  - |
    uda1334: audio-codec {
        compatible = "nxp,uda1334";
        nxp,mute-gpios = <&gpio1 8 GPIO_ACTIVE_LOW>;
        nxp,deemph-gpios = <&gpio3 3 GPIO_ACTIVE_LOW>;
    };
```

## Documentation/devicetree/bindings/sound/realtek,alc5623.yaml
```yaml
# SPDX-License-Identifier: (GPL-2.0-only OR BSD-2-Clause)
# Copyright 2025 Andrew Lunn <andrew@lunn.ch>
%YAML 1.2
---
$id: http://devicetree.org/schemas/sound/realtek,alc5623.yaml#
$schema: http://devicetree.org/meta-schemas/core.yaml#

title: ALC5621/ALC5622/ALC5623 audio Codec

maintainers:
  - Andrew Lunn <andrew@lunn.ch>

description: |
  ALC5621/ALC5622/ALC5623 audio Codec.

properties:
  compatible:
    items:
      - enum:
          - realtek,alc5621
          - realtek,alc5622
          - realtek,alc5623
    description: Device compatible strings.
  reg:
    items:
      - description: I2C address of the device.
  add-ctrl:
    description: |
      Default register value for Reg-40h (Additional Control Register).
      If absent or zero, the register is left untouched.
    $ref: /schemas/types.yaml#/definitions/uint32
  jack-det-ctrl:
    description: |
      Default register value for Reg-5Ah (Jack Detect Control Register).
      If absent or zero, the register is left untouched.
    $ref: /schemas/types.yaml#/definitions/uint32

required:
  - compatible
  - reg

additionalProperties: false

examples:
  - |
    alc5621: alc5621@1a {
      compatible = "realtek,alc5621";
      reg = <0x1a>;
      add-ctrl = <0x3700>;
      jack-det-ctrl = <0x4810>;
    };
```

## Documentation/devicetree/bindings/sound/realtek,rt1011.yaml
```yaml
# SPDX-License-Identifier: (GPL-2.0-only OR BSD-2-Clause)
# Copyright 2025 Realtek
%YAML 1.2
---
$id: http://devicetree.org/schemas/sound/realtek,rt1011.yaml#
$schema: http://devicetree.org/meta-schemas/core.yaml#

title: Realtek RT1011 Mono Class D Audio Amplifier

maintainers:
  - Shuming Fan <shumingf@realtek.com>

description: |
  RT1011 Mono Class D Audio Amplifier

  This device supports I2C only.

properties:
  compatible:
    # exactly one compatible string
    items:
      - const: "realtek,rt1011"

  reg:
    description: I2C address of the device, determined by ASEL1 and ASEL2 input pins.
    items:
      - enum: [56, 57, 58, 59]

  realtek,temperature_calib:
    description: "Temperature measured during calibration (units: Celsius degrees)"
    $ref: /schemas/types.yaml#/definitions/uint32

  realtek,r0_calib:
    description: Factory-mode r0 calibration data
    $ref: /schemas/types.yaml#/definitions/uint32

required:
  - compatible
  - reg

additionalProperties: false

examples:
  - |
    rt1011: codec@38 {
        compatible = "realtek,rt1011";
        reg = <0x38>;
        realtek,temperature_calib = <25>;
        realtek,r0_calib = <0x224050>;
    };
```
