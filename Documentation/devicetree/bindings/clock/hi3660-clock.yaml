## Documentation/devicetree/bindings/clock/snps,axs10x-i2s-pll-clock.yaml
```yaml
# SPDX-License-Identifier: (GPL-2.0-only OR BSD-2-Clause)
%YAML 1.2
---
$id: http://devicetree.org/schemas/clock/snps,axs10x-i2s-pll-clock.yaml#
$schema: http://devicetree.org/meta-schemas/core.yaml#

title: Synopsys AXS10X I2S PLL clock

maintainers:
  - Jose Abreu <Jose.Abreu@synopsys.com>

properties:
  compatible:
    items:
      - const: snps,axs10x-i2s-pll-clock
    description: |
      Device compatible string

  reg:
    maxItems: 1

  clocks:
    maxItems: 1

  '#clock-cells':
    const: 0

required:
  - compatible
  - reg
  - clocks
  - '#clock-cells'

additionalProperties: false

examples:
  - |
    clock-controller@100a0 {
        compatible = "snps,axs10x-i2s-pll-clock";
        reg = <0x100a0 0x10>;
        clocks = <&pll_clock>;
        #clock-cells = <0>;
    };
```

## Documentation/devicetree/bindings/clock/snps,axs10x-pll-clock.yaml
```yaml
# SPDX-License-Identifier: (GPL-2.0-only OR BSD-2-Clause)
%YAML 1.2
---
$id: http://devicetree.org/schemas/clock/snps,axs10x-pll-clock.yaml#
$schema: http://devicetree.org/meta-schemas/core.yaml#

title: AXS10X Generic PLL clock

maintainers:
  - Eugeniy Paltsev <Eugeniy.Paltsev@synopsys.com>

properties:
  compatible:
    enum:
      - snps,axs10x-arc-pll-clock
      - snps,axs10x-i2s-pll-clock
      - snps,axs10x-pgu-pll-clock

  reg:
    minItems: 1
    items:
      - description: PLL configuration registers
      - description: Lock CGU register

  clocks:
    maxItems: 1

  clock-names:
    items:
      - const: input

  '#clock-cells':
    const: 0

required:
  - compatible
  - reg
  - clocks
  - '#clock-cells'

additionalProperties: false

examples:
  - |
    clock-controller@80 {
        compatible = "snps,axs10x-arc-pll-clock";
        reg = <0x80 0x10>, <0x100 0x10>;
        #clock-cells = <0>;
        clocks = <&input-clk>;
    };
```

## Documentation/devicetree/bindings/clock/snps,hsdk-pll-clock.yaml
```yaml
# SPDX-License-Identifier: (GPL-2.0-only OR BSD-2-Clause)
# Copyright 2025 Synopsys
%YAML 1.2
---
$id: http://devicetree.org/schemas/clock/snps,hsdk-pll-clock.yaml#
$schema: http://devicetree.org/meta-schemas/core.yaml#

title: Synopsys HSDK PLL Clock

maintainers:
  - Eugeniy Paltsev <Eugeniy.Paltsev@synopsys.com>

properties:
  compatible:
    enum:
      - snps,hsdk-core-pll-clock
      - snps,hsdk-gp-pll-clock
      - snps,hsdk-hdmi-pll-clock

  reg:
    maxItems: 1

  clocks:
    maxItems: 1

  '#clock-cells':
    const: 0

required:
  - compatible
  - reg
  - clocks
  - '#clock-cells'

additionalProperties: false

examples:
  - |
    clock-controller@0 {
        compatible = "snps,hsdk-core-pll-clock";
        reg = <0x00 0x10>;
        #clock-cells = <0>;
        clocks = <&input_clk>;
    };
```

## Documentation/devicetree/bindings/clock/st,nomadik-hclk-clock.yaml
```yaml
# SPDX-License-Identifier: (GPL-2.0-only OR BSD-2-Clause)
%YAML 1.2
---
$id: http://devicetree.org/schemas/clock/st,nomadik-hclk-clock.yaml#
$schema: http://devicetree.org/meta-schemas/core.yaml#

title: ST Microelectronics Nomadik HCLK Clock

maintainers:
  - Linus Walleij <linus.walleij@linaro.org>
  - Stefan Huber <steffhip@googlemail.com>

description: |
  HCLK nodes represent the clock gates on individual lines from the HCLK clock tree.
  They also represent the gate for individual lines from the PCLK clock tree.

  This binding uses the common clock binding:
  Documentation/devicetree/bindings/clock/clock-bindings.txt

properties:
  compatible:
    items:
      - const: st,nomadik-hclk-clock

  '#clock-cells':
    const: 0

  clock-id:
    description: |
      Clock identifier for HCLK or PCLK line; see the mapping below:
        0: HCLKDMA0
        1: HCLKSMC
        2: HCLKSDRAM
        3: HCLKDMA1
        4: HCLKCLCD
        5: PCLKIRDA
        6: PCLKSSP
        7: PCLKUART0
        8: PCLKSDI
        9: PCLKI2C0
        10: PCLKI2C1
        11: PCLKUART1
        12: PCLMSP0
        13: HCLKUSB
        14: HCLKDIF
        15: HCLKSAA
        16: HCLKSVA
        17: PCLKHSI
        18: PCLKXTI
        19: PCLKUART2
        20: PCLKMSP1
        21: PCLKMSP2
        22: PCLKOWM
        23: HCLKHPI
        24: PCLKSKE
        25: PCLKHSEM
        26: HCLK3D
        27: HCLKHASH
        28: HCLKCRYP
        29: PCLKMSHC
        30: HCLKUSBM
        31: HCLKRNG
        36: CLDCLK
        37: IRDACLK
        38: SSPICLK
        39: UART0CLK
        40: SDICLK
        41: I2C0CLK
        42: I2C1CLK
        43: UART1CLK
        44: MSPCLK0
        45: USBCLK
        46: DIFCLK
        47: IPI2CCLK
        48: IPBMCCLK
        49: HSICLKRX
        50: HSICLKTX
        51: UART2CLK
        52: MSPCLK1
        53: MSPCLK2
        54: OWMCLK
        56: SKECLK
        58: 3DCLK
        59: PCLKMSP3
        60: MSPCLK3
        61: MSHCCLK
        62: USBMCLK
        63: RNGCCLK
    $ref: /schemas/types.yaml#/definitions/uint32
    minimum: 0
    maximum: 63

  clocks:
    maxItems: 1

required:
  - compatible
  - '#clock-cells'
  - clock-id
  - clocks

additionalProperties: false
```

## Documentation/devicetree/bindings/clock/st,nomadik-pll-clock.yaml
```yaml
# SPDX-License-Identifier: (GPL-2.0-only OR BSD-2-Clause)
%YAML 1.2
---
$id: http://devicetree.org/schemas/clock/st,nomadik-pll-clock.yaml#
$schema: http://devicetree.org/meta-schemas/core.yaml#

title: ST Microelectronics Nomadik PLL Clock

maintainers:
  - Linus Walleij <linus.walleij@linaro.org>
  - Stefan Huber <steffhip@googlemail.com>

description:
  PLL nodes represent the two PLLs on the system, which should both have the
  main crystal as parent.

properties:
  compatible:
    const: st,nomadik-pll-clock

  '#clock-cells':
    const: 0

  clock-id:
    description: PLL identifier; must be 1 for PLL1 or 2 for PLL2.
    $ref: /schemas/types.yaml#/definitions/uint32
    enum: [1, 2]

  clocks:
    maxItems: 1

required:
  - compatible
  - '#clock-cells'
  - clock-id
  - clocks

additionalProperties: false
```

## Documentation/devicetree/bindings/clock/st/st,clkgen-c32.yaml
```yaml
# SPDX-License-Identifier: (GPL-2.0-only OR BSD-2-Clause)
%YAML 1.2
---
$id: http://devicetree.org/schemas/clock/st/st,clkgen-c32.yaml#
$schema: http://devicetree.org/meta-schemas/core.yaml#

title: ST clockgen c32
maintainers:
  - Eric Engestrom <eric@engestrom.ch>
  - Gabriel Fernandez <gabriel.fernandez@st.com>
  - Gabriel FERNANDEZ <gabriel.fernandez@st.com>
  - Marco Franchi <marco.franchi@nxp.com>
  - Mauro Carvalho Chehab <mchehab+samsung@kernel.org>

description: |
  Binding for a Clockgen hardware block found on
  certain STMicroelectronics consumer electronics SoC devices.

  A Clockgen node can contain pll, diviser or multiplexer nodes.

  We will find only the base address of the Clockgen, this base
  address is common of all subnode.

  clockgen_node {
    reg = <>;
    pll_node { ... };
    quadfs_node { ... };
    mux_node { ... };
    flexgen_node { ... };
    ...;
  };

  This binding uses the common clock binding[1].
  Each subnode should use the binding described in [2]..[7]

  [1] Documentation/devicetree/bindings/clock/clock-bindings.txt
  [3] Documentation/devicetree/bindings/clock/st/st,clkgen-mux.txt
  [4] Documentation/devicetree/bindings/clock/st/st,clkgen-pll.txt
  [7] Documentation/devicetree/bindings/clock/st/st,quadfs.txt
  [8] Documentation/devicetree/bindings/clock/st/st,flexgen.txt

properties:
  compatible:
    const: st,clkgen-c32

  reg:
    maxItems: 1

required:
  - compatible
  - reg

additionalProperties: false
```

## Documentation/devicetree/bindings/clock/st/st,clkgen-pll.yaml
```yaml
# SPDX-License-Identifier: (GPL-2.0-only OR BSD-2-Clause)
%YAML 1.2
---
$id: http://devicetree.org/schemas/clock/st/st,clkgen-pll.yaml#
$schema: http://devicetree.org/meta-schemas/core.yaml#
title: ST PLL Clock Driver
maintainers:
  - Alain Volmat <avolmat@me.com>
  - Gabriel Fernandez <gabriel.fernandez@linaro.org>
  - Gabriel Fernandez <gabriel.fernandez@st.com>
  - Gabriel FERNANDEZ <gabriel.fernandez@st.com>
description: |
  Binding for a ST pll clock driver.

  This binding uses the common clock binding[1].
  Base address is located to the parent node. See clock binding[2]

  [1] Documentation/devicetree/bindings/clock/clock-bindings.txt
  [2] Documentation/devicetree/bindings/clock/st/st,clkgen.txt

properties:
  compatible:
    description: Allowed compatible strings for this ST PLL clock generator.
    $ref: /schemas/types.yaml#/definitions/string-array
    items:
      - enum:
          - st,clkgen-pll0
          - st,clkgen-pll0-a0
          - st,clkgen-pll0-c0
          - st,clkgen-pll1
          - st,clkgen-pll1-c0
          - st,stih407-clkgen-plla9
          - st,stih418-clkgen-plla9

  '#clock-cells':
    description: Number of clock cells; must be 1.
    const: 1

  clocks:
    description: Input parent clock.
    maxItems: 1

  clock-output-names:
    description: Names for output clock(s).
    $ref: /schemas/types.yaml#/definitions/string-array
    maxItems: 1

required:
  - compatible
  - '#clock-cells'
  - clocks
  - clock-output-names

additionalProperties: false

examples:
  - |
    clockgen-a9-pll {
      #clock-cells = <1>;
      compatible = "st,stih407-clkgen-plla9";
      clocks = <&clk_sysin>;
      clock-output-names = "clockgen-a9-pll-odf";
    };
```

## Documentation/devicetree/bindings/clock/st/st,flexgen.yaml
```yaml
# SPDX-License-Identifier: (GPL-2.0-only OR BSD-2-Clause)
%YAML 1.2
---
$id: http://devicetree.org/schemas/clock/st/st,flexgen.yaml#
$schema: http://devicetree.org/meta-schemas/core.yaml#

title: ST Flexgen Clock
maintainers:
  - Alain Volmat <avolmat@me.com>
  - Gabriel Fernandez <gabriel.fernandez@st.com>
  - Gabriel FERNANDEZ <gabriel.fernandez@st.com>
  - Geert Uytterhoeven <geert+renesas@glider.be>
  - Randy Dunlap <rdunlap@infradead.org>

description: |
  Binding for a type of flexgen structure found on certain
  STMicroelectronics consumer electronics SoC devices

  This structure includes:
  - a clock cross bar (represented by a mux element)
  - a pre and final dividers (represented by a divider and gate elements)

  Flexgen structure is a part of Clockgen[1].

  Please find an example below:

      Clockgen block diagram
      -------------------------------------------------------------------
     |                     Flexgen structure                             |
     |                  ---------------------------------------------    |
     |                 |    -------       --------       --------    |   |
  clk_sysin            |   |       |     |        |     |        |   |   |
  ---|-----------------|-->|       |     |        |     |        |   |   |
     | |               |   |       |     |        |     |        |   |   |
     | |   -------     |   |       |     |        |     |        |   |   |
     | |  |PLL0   |    |   |       |     |Pre     |     |Final   |   |   |
     | |->|       |    |   |       |     |Dividers|     |Dividers|   |   |
     | |  |  odf_0|----|-->|       |     |  x32   |     |  x32   |   |   |
     | |  |       |    |   |       |     |        |     |        |   |   |
     | |  |       |    |   |       |     |        |     |        |   |   |
     | |  |       |    |   |       |     |        |     |        |   |   |
     | |  |       |    |   |       |     |        |     |        |   |   |
     | |   -------     |   |       |     |        |     |        |   |   |
     | |               |   |       |     |        |     |        |   |   |
     | |   -------     |   | Clock |     |        |     |        |   |   |
     | |  |PLL1   |    |   |       |     |        |     |        |   |   |
     | |->|       |    |   | Cross |     |        |     |        |   |   |
     | |  |  odf_0|----|-->|       |     |        |     |        |   |   |
     | |  |       |    |   | Bar   |====>|        |====>|        |   |   |
     | |  |       |    |   |       |     |        |     |        |   |   |
     | |  |       |    |   |       |     |        |     |        |   |   |
     | |   -------     |   |       |     |        |     |        |   |   |
     | |               |   |       |     |        |     |        |   |   |
     | |   -------     |   |       |     |        |     |        |   |   |
     | |  |QUADFS |    |   |       |     |        |     |        |   |   |
     | |->|    ch0|----|-->|       |     |        |     |        |   |   |
     |    |       |    |   |       |     |        |     |        |   |   |
     |    |    ch1|----|-->|       |     |        |     |        |   |   |
     |    |       |    |   |       |     |        |     |        |   |   |
     |    |    ch2|----|-->|       |     | DIV    |     | DIV    |   |   |
     |    |       |    |   |       |     |  1 to  |     |  1 to  |   |   |
     |    |    ch3|----|-->|       |     |   1024 |     |     64 |   |   |
     |     -------     |   |       |     |        |     |        |   |   |
     |                 |    -------       --------       --------    |   |
     |                   --------------------------------------------    |
     |                                                                   |
      -------------------------------------------------------------------

  This binding uses the common clock binding[2].

properties:
  compatible:
    items:
      - const: st,flexgen
      - const: st,flexgen-audio
      - const: st,flexgen-video
      - const: st,flexgen-stih407-a0
      - const: st,flexgen-stih410-a0
      - const: st,flexgen-stih407-c0
      - const: st,flexgen-stih410-c0
      - const: st,flexgen-stih418-c0
      - const: st,flexgen-stih407-d0
      - const: st,flexgen-stih410-d0
      - const: st,flexgen-stih407-d2
      - const: st,flexgen-stih418-d2
      - const: st,flexgen-stih407-d3
  "#clock-cells":
    const: 1
  clocks:
    description: Output clocks phandles from PLLs, QUADFS channels or clk_sysin
    items:
      - description: PLL0 output clock phandle
      - description: PLL1 output clock phandle
      - description: QUADFS channel 0 clock phandle
      - description: QUADFS channel 1 clock phandle
      - description: QUADFS channel 2 clock phandle
      - description: QUADFS channel 3 clock phandle
      - description: System input clock phandle (clk_sysin)
  clock-output-names:
    description: Names of the clock outputs provided by the flexgen structure
    items:
      - const: clk-icn-gpu
      - const: clk-fdma
      - const: clk-nand
      - const: clk-hva
      - const: clk-proc-stfe
      - const: clk-proc-tp
      - const: clk-rx-icn-dmu
      - const: clk-rx-icn-hva
      - const: clk-icn-cpu
      - const: clk-tx-icn-dmu
      - const: clk-mmc-0
      - const: clk-mmc-1
      - const: clk-jpegdec
      - const: clk-ext2fa9
      - const: clk-ic-bdisp-0
      - const: clk-ic-bdisp-1
      - const: clk-pp-dmu
      - const: clk-vid-dmu
      - const: clk-dss-lpc
      - const: clk-st231-aud-0
      - const: clk-st231-gp-1
      - const: clk-st231-dmu
      - const: clk-icn-lmi
      - const: clk-tx-icn-disp-1
      - const: clk-icn-sbc
      - const: clk-stfe-frc2
      - const: clk-eth-phy
      - const: clk-eth-ref-phyclk
      - const: clk-flash-promip
      - const: clk-main-disp
      - const: clk-aux-disp
      - const: clk-compo-dvp

required:
  - compatible
  - "#clock-cells"
  - clocks
  - clock-output-names

additionalProperties: false
```
