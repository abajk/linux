## Documentation/devicetree/bindings/clock/marvell,pxa910-clock.yaml
```yaml
# SPDX-License-Identifier: (GPL-2.0-only OR BSD-2-Clause)
# Copyright 2025 Marvell
%YAML 1.2
---
$id: http://devicetree.org/schemas/clock/marvell,pxa910-clock.yaml#
$schema: http://devicetree.org/meta-schemas/core.yaml#

title: Marvell PXA910 Clock Controller

maintainers:
  - Chao Xie <chao.xie@marvell.com>

description: |
  * Marvell PXA910 Clock Controller

  The PXA910 clock subsystem generates and supplies clock to various
  controllers within the PXA910 SoC.

  Each clock is assigned an identifier and client nodes use this identifier
  to specify the clock which they consume.

  All these identifier could be found in <dt-bindings/clock/marvell-pxa910.h>.

properties:
  compatible:
    description: controller compatible with PXA910 SoC.
    items:
      - const: marvell,pxa910-clock

  reg:
    description: |
      physical base address of the clock subsystem and the length of the
      memory mapped region. There are four places in the SoC that have clock
      control logic: "mpmu", "apmu", "apbc" and "apbcp". Therefore, four reg
      spaces need to be defined.
    items:
      - description: mpmu registers
      - description: apmu registers
      - description: apbc registers
      - description: apbcp registers

  '#clock-cells':
    description: should be 1.
    const: 1

  '#reset-cells':
    description: should be 1.
    const: 1

additionalProperties: false

required:
  - compatible
  - reg
  - '#clock-cells'
  - '#reset-cells'
```

## Documentation/devicetree/bindings/clock/nvidia,tegra124-dfll.yaml
```yaml
# SPDX-License-Identifier: (GPL-2.0-only OR BSD-2-Clause)
# Copyright 2025 NVIDIA Corporation
%YAML 1.2
---
$id: http://devicetree.org/schemas/clock/nvidia,tegra124-dfll.yaml#
$schema: http://devicetree.org/meta-schemas/core.yaml#

title: NVIDIA Tegra124 DFLL FCPU clocksource
maintainers:
  - Joseph Lo <josephl@nvidia.com>
  - Peter De Schrijver <pdeschrijver@nvidia.com>
  - Rob Herring <robh@kernel.org>
  - Thierry Reding <treding@nvidia.com>
  - Tuomas Tynkkynen <ttynkkynen@nvidia.com>

description: |
  NVIDIA Tegra124 DFLL FCPU clocksource

  This binding uses the common clock binding:
  Documentation/devicetree/bindings/clock/clock-bindings.txt

  The DFLL IP block on Tegra is a root clocksource designed for clocking
  the fast CPU cluster. It consists of a free-running voltage controlled
  oscillator connected to the CPU voltage rail (VDD_CPU), and a closed loop
  control module that will automatically adjust the VDD_CPU voltage by
  communicating with an off-chip PMIC either via an I2C bus or via PWM signals.

properties:
  compatible:
    items:
      - enum: ["nvidia,tegra124-dfll", "nvidia,tegra210-dfll"]
  reg:
    description: Register ranges for the DFLL control logic, I2C interface, and RAM.
    items:
      - description: DFLL control logic registers
      - description: I2C output logic registers
      - description: Integrated I2C master controller registers
      - description: Look-up table RAM for voltage register values
  interrupts:
    description: Interrupt for the DFLL block
    items:
      - description: DFLL block interrupt
  clocks:
    description: Clock sources for the DFLL block
    items:
      - description: Clock source for the DFLL control logic
      - description: Closed loop reference clock
      - description: Clock source for the integrated I2C master
  clock-names:
    items:
      - const: soc
      - const: ref
      - const: i2c
  resets:
    description: Reset controls for the DFLL block
    items:
      - description: Reset control for the DFLL DVCO
  reset-names:
    items:
      - const: dvco
  "#clock-cells":
    const: 0
  clock-output-names:
    description: Name of the DFLL CPU clock output
    items:
      - const: dfllCPU_out
  vdd-cpu-supply: true

  nvidia,sample-rate:
    description: Sample rate of the DFLL control loop
    $ref: /schemas/types.yaml#/definitions/uint32
  nvidia,droop-ctrl:
    description: Droop control parameter (CL_DVFS_DROOP_CTRL) in TRM
    $ref: /schemas/types.yaml#/definitions/uint32
  nvidia,force-mode:
    description: Force mode parameter (DFLL_PARAMS_FORCE_MODE) in TRM
    $ref: /schemas/types.yaml#/definitions/uint32
  nvidia,cf:
    description: CF parameter (DFLL_PARAMS_CF_PARAM) in TRM
    $ref: /schemas/types.yaml#/definitions/uint32
  nvidia,ci:
    description: CI parameter (DFLL_PARAMS_CI_PARAM) in TRM
    $ref: /schemas/types.yaml#/definitions/uint32
  nvidia,cg:
    description: CG parameter (DFLL_PARAMS_CG_PARAM) in TRM
    $ref: /schemas/types.yaml#/definitions/uint32
  nvidia,cg-scale:
    description: CG scale flag (DFLL_PARAMS_CG_SCALE) in TRM
    type: boolean
  nvidia,pwm-to-pmic:
    description: Use PWM to control regulator rather than I2C
    type: boolean
  nvidia,i2c-fs-rate:
    description: I2C full speed transfer rate when using I2C mode
    $ref: /schemas/types.yaml#/definitions/uint32
  nvidia,pwm-period-nanoseconds:
    description: Period of PWM square wave in nanoseconds
    $ref: /schemas/types.yaml#/definitions/uint32
  nvidia,pwm-tristate-microvolts:
    description: Regulator voltage in microvolts when PWM control is disabled
    $ref: /schemas/types.yaml#/definitions/uint32
  nvidia,pwm-min-microvolts:
    description: Regulator voltage in microvolts when PWM control is enabled
    $ref: /schemas/types.yaml#/definitions/uint32
  nvidia,pwm-voltage-step-microvolts:
    description: Voltage increase in microvolts per duty cycle increment
    $ref: /schemas/types.yaml#/definitions/uint32
  pinctrl-names:
    items:
      - const: dvfs_pwm_enable
      - const: dvfs_pwm_disable
  pinctrl-0:
    description: I/O pad configuration when PWM control is enabled
    $ref: /schemas/types.yaml#/definitions/phandle-array
  pinctrl-1:
    description: I/O pad configuration when PWM control is disabled
    $ref: /schemas/types.yaml#/definitions/phandle-array

required:
  - compatible
  - reg
  - interrupts
  - clocks
  - clock-names
  - resets
  - reset-names
  - "#clock-cells"
  - clock-output-names
  - vdd-cpu-supply
  - nvidia,sample-rate
  - nvidia,droop-ctrl
  - nvidia,force-mode
  - nvidia,cf
  - nvidia,ci
  - nvidia,cg

additionalProperties: false
```

## Documentation/devicetree/bindings/clock/silabs,si514.yaml
```yaml
# SPDX-License-Identifier: (GPL-2.0-only OR BSD-2-Clause)
%YAML 1.2
---
$id: http://devicetree.org/schemas/clock/silabs,si514.yaml#
$schema: http://devicetree.org/meta-schemas/core.yaml#

title: Silicon Labs Si514 programmable I2C clock generator

maintainers:
  - Alexander A. Klimov <grandmaster@al2klimov.de>
  - Mike Looijmans <mike.looijmans@topic.nl>

description: |
  Binding for Silicon Labs 514 programmable I2C clock generator.

  Details about the device can be found in the datasheet[1].

  [1] Si514 datasheet
      https://www.silabs.com/Support%20Documents/TechnicalDocs/si514.pdf

properties:
  compatible:
    const: silabs,si514

  reg:
    maxItems: 1

  '#clock-cells':
    const: 0

  clock-output-names:
    items:
      - const: si514

required:
  - compatible
  - reg
  - '#clock-cells'

additionalProperties: false

examples:
  - |
    clock-generator@55 {
        reg = <0x55>;
        #clock-cells = <0>;
        compatible = "silabs,si514";
    };
```

## Documentation/devicetree/bindings/clock/silabs,si5341.yaml
```yaml
# SPDX-License-Identifier: (GPL-2.0-only OR BSD-2-Clause)
%YAML 1.2
---
$id: http://devicetree.org/schemas/silabs,si5341.yaml#
$schema: http://devicetree.org/meta-schemas/core.yaml#

title: Silicon Labs Si5340/1/2/4/5 programmable i2c clock generator

maintainers:
  - Mike Looijmans <mike.looijmans@topic.nl>
  - Robert Hancock <robert.hancock@calian.com>

description: |
  Binding for Silicon Labs Si5340, Si5341 Si5342, Si5344 and Si5345 programmable
  i2c clock generator.

  Reference
  [1] Si5341 Data Sheet
      https://www.silabs.com/documents/public/data-sheets/Si5341-40-D-DataSheet.pdf
  [2] Si5341 Reference Manual
      https://www.silabs.com/documents/public/reference-manuals/Si5341-40-D-RM.pdf
  [3] Si5345 Reference Manual
      https://www.silabs.com/documents/public/reference-manuals/Si5345-44-42-D-RM.pdf

  The Si5341 and Si5340 are programmable i2c clock generators with up to 10 output
  clocks. The chip contains a PLL that sources 5 (or 4) multisynth clocks, which
  in turn can be directed to any of the 10 (or 4) outputs through a divider.
  The internal structure of the clock generators can be found in [2].
  The Si5345 is similar to the Si5341 with the addition of fractional input
  dividers and automatic input selection, as described in [3].
  The Si5342 and Si5344 are smaller versions of the Si5345, with 2 or 4 outputs.

  The driver can be used in "as is" mode, reading the current settings from the
  chip at boot, in case you have a (pre-)programmed device. If the PLL is not
  configured when the driver probes, it assumes the driver must fully initialize
  it.

  The device type, speed grade and revision are determined runtime by probing.

  The driver currently does not support any fancy input configurations. They can
  still be programmed into the chip and the driver will leave them "as is".

  ==I2C device node==

  == Child nodes: Outputs ==

  The child nodes list the output clocks.

  Each of the clock outputs can be overwritten individually by using a child node.
  If a child node for a clock output is not set, the configuration remains
  unchanged.

properties:
  compatible:
    enum:
      - silabs,si5340
      - silabs,si5341
      - silabs,si5342
      - silabs,si5344
      - silabs,si5345

  reg:
    maxItems: 1

  "#clock-cells":
    const: 2
  "#address-cells":
    const: 1
  "#size-cells":
    const: 0
  clocks:
    items:
      - description: parent clock phandles for inputs
  clock-names:
    items:
      - const: xtal
      - const: in0
      - const: in1
      - const: in2
  vdd-supply:
    description: Regulator node for VDD
  vdda-supply:
    description: Regulator node for VDDA
  vdds-supply:
    description: Regulator node for VDDS
  silabs,pll-m-num:
    description: Numerator for PLL feedback divider
    $ref: /schemas/types.yaml#/definitions/uint32
  silabs,pll-m-den:
    description: Denominator for PLL feedback divider
    $ref: /schemas/types.yaml#/definitions/uint32
  silabs,reprogram:
    description: Always perform soft-reset and reinitialize PLL
    type: boolean
  silabs,xaxb-ext-clk:
    description: Use XA/XB pins as external reference clock
    type: boolean
  interrupts:
    items:
      - description: Interrupt for INTRb pin
  silabs,iovdd-33:
    description: I2C lines use 3.3V thresholds
    type: boolean

patternProperties:
  "^vddo[0-9]+-supply$": true
  "^out@[0-9]+$":
    type: object
    description: Output-specific override nodes
    properties:
      reg:
        description: Number of clock output
      silabs,format:
        description: Output format
        $ref: /schemas/types.yaml#/definitions/uint32
        enum: [1, 2, 4]
      silabs,common-mode:
        description: Override output common mode
        $ref: /schemas/types.yaml#/definitions/uint32
      silabs,amplitude:
        description: Override output amplitude
        $ref: /schemas/types.yaml#/definitions/uint32
      silabs,synth-master:
        description: Allow dynamic multisynth rate control
        type: boolean
      silabs,disable-high:
        description: Drive output HIGH when disabled
        type: boolean
    required:
      - reg
    additionalProperties: false

required:
  - compatible
  - reg
  - "#clock-cells"
  - "#address-cells"
  - "#size-cells"
  - clocks
  - clock-names

additionalProperties: false
```

## Documentation/devicetree/bindings/clock/silabs,si544.yaml
```yaml
# SPDX-License-Identifier: (GPL-2.0-only OR BSD-2-Clause)
%YAML 1.2
---
$id: http://devicetree.org/schemas/clock/silabs,si544.yaml#
$schema: http://devicetree.org/meta-schemas/core.yaml#

title: Silicon Labs SI544 clock generator

maintainers:
  - Mike Looijmans <mike.looijmans@topic.nl>

description: |
  Binding for Silicon Labs 544 programmable I2C clock generator.

  Reference
  This binding uses the common clock binding[1]. Details about the device can be
  found in the datasheet[2].

  [1] Documentation/devicetree/bindings/clock/clock-bindings.txt
  [2] Si544 datasheet
      https://www.silabs.com/documents/public/data-sheets/si544-datasheet.pdf

properties:
  compatible:
    items:
      - enum: ["silabs,si544a", "silabs,si544b", "silabs,si544c"]
  reg:
    maxItems: 1

  "#clock-cells":
    const: 0

  clock-output-names:
    items:
      - const: si544

required:
  - compatible
  - reg
  - "#clock-cells"

additionalProperties: false

examples:
  - |
    i2c {
        #address-cells = <1>;
        #size-cells = <0>;

        clock-controller@55 {
            reg = <0x55>;
            #clock-cells = <0>;
            compatible = "silabs,si544b";
        };
    };
    
```

## Documentation/devicetree/bindings/clock/silabs,si570.yaml
```yaml
# SPDX-License-Identifier: (GPL-2.0-only OR BSD-2-Clause)
%YAML 1.2
---
$id: http://devicetree.org/schemas/clock/silabs,si570.yaml#
$schema: http://devicetree.org/meta-schemas/core.yaml#

title: Silicon Labs Si570/Si571/Si598/Si599 programmable I2C clock generator

maintainers:
  - Alexander A. Klimov <grandmaster@al2klimov.de>
  - Saeed Nowshadi <saeed.nowshadi@xilinx.com>
  - Soren Brinkmann <soren.brinkmann@xilinx.com>

description: |
  Binding for Silicon Labs 570, 571, 598 and 599 programmable
  I2C clock generators.

  Reference
  This binding uses the common clock binding[1]. Details about the devices can be
  found in the data sheets[2][3].

  [1] Documentation/devicetree/bindings/clock/clock-bindings.txt
  [2] Si570/571 Data Sheet
      https://www.silabs.com/Support%20Documents/TechnicalDocs/si570.pdf
  [3] Si598/599 Data Sheet
      https://www.silabs.com/Support%20Documents/TechnicalDocs/si598-99.pdf

properties:
  compatible:
    description: Device compatibility list.
    $ref: /schemas/types.yaml#/definitions/string-array
    items:
      - enum:
          - 'silabs,si570'
          - 'silabs,si571'
          - 'silabs,si598'
          - 'silabs,si599'

  reg:
    description: I2C device address.
    items:
      - description: I2C device address

  '#clock-cells':
    description: Number of clock specifiers; must be zero.
    const: 0

  factory-fout:
    description: Factory-set default frequency in Hz.
    $ref: /schemas/types.yaml#/definitions/uint32

  temperature-stability:
    description: Temperature stability of the device in PPM.
    $ref: /schemas/types.yaml#/definitions/uint32
    enum:
      - 7
      - 20
      - 50
      - 100

  clock-output-names:
    description: Optional names for clock outputs; recommended to use "si570".
    $ref: /schemas/types.yaml#/definitions/string-array

  clock-frequency:
    description: Output frequency to generate at boot; can be reprogrammed at runtime.
    $ref: /schemas/types.yaml#/definitions/uint32

  silabs,skip-recall:
    description: Skip the NVM-to-RAM recall operation during boot.
    type: boolean

required:
  - compatible
  - reg
  - '#clock-cells'
  - factory-fout
  - temperature-stability

additionalProperties: false
```
