## Documentation/devicetree/bindings/clock/hi3660-clock.yaml
```yaml
# SPDX-License-Identifier: GPL-2.0-only
%YAML 1.2
---
$id: http://devicetree.org/schemas/clock/hi3660-clock.yaml#
$schema: http://devicetree.org/meta-schemas/core.yaml#

title: Hisilicon Hi3660 Clock Controller

maintainers:
  - Leo Yan <leo.yan@linux.dev>
  - Zhangfei Gao <zhangfei.gao@linaro.org>

description: |
  The Hi3660 clock controller generates and supplies clock to various
  controllers within the Hi3660 SoC.

  Each clock is assigned an identifier and client nodes use this identifier
  to specify the clock which they consume.

  All these identifier could be found in <dt-bindings/clock/hi3660-clock.h>.

properties:
  compatible:
    description: List of compatible strings for this controller.
    items:
      - enum:
          - hisilicon,hi3660-crgctrl
          - hisilicon,hi3660-pctrl
          - hisilicon,hi3660-pmuctrl
          - hisilicon,hi3660-sctrl
          - hisilicon,hi3660-iomcu
          - hisilicon,hi3660-stub-clk
      - const: syscon

  reg:
    maxItems: 1

  '#clock-cells':
    const: 1

  mboxes:
    maxItems: 1

additionalProperties: false

examples:
  - |
    clock-controller@fff35000 {
        compatible = "hisilicon,hi3660-crgctrl", "syscon";
        reg = <0x0 0xfff35000 0x0 0x1000>;
        #clock-cells = <1>;
    };
```

## Documentation/devicetree/bindings/clock/hi3670-clock.yaml
```yaml
# SPDX-License-Identifier: (GPL-2.0-only OR BSD-2-Clause)
# Copyright 2025 Manivannan Sadhasivam <manivannan.sadhasivam@linaro.org>
%YAML 1.2
---
$id: http://devicetree.org/schemas/clock/hi3670-clock.yaml#
$schema: http://devicetree.org/meta-schemas/core.yaml#

title: Hisilicon Hi3670 Clock Controller
maintainers:
  - Manivannan Sadhasivam <manivannan.sadhasivam@linaro.org>

description: |
  * Hisilicon Hi3670 Clock Controller

  The Hi3670 clock controller generates and supplies clock to various
  controllers within the Hi3670 SoC.

  Required Properties:

  Each clock is assigned an identifier and client nodes use this identifier
  to specify the clock which they consume.

  All these identifier could be found in <dt-bindings/clock/hi3670-clock.h>.

properties:
  compatible:
    oneOf:
      - items:
          - enum:
              - hisilicon,hi3670-crgctrl
              - hisilicon,hi3670-pctrl
              - hisilicon,hi3670-pmuctrl
              - hisilicon,hi3670-sctrl
              - hisilicon,hi3670-iomcu
              - hisilicon,hi3670-media1-crg
              - hisilicon,hi3670-media2-crg
          - enum:
              - syscon
      - items:
          - enum:
              - hisilicon,hi3670-crgctrl
              - hisilicon,hi3670-pctrl
              - hisilicon,hi3670-pmuctrl
              - hisilicon,hi3670-sctrl
              - hisilicon,hi3670-iomcu
              - hisilicon,hi3670-media1-crg
              - hisilicon,hi3670-media2-crg

  reg:
    description: Physical base address and size of the memory mapped region.
    items:
      - description: Base address of the controller
      - description: Length of the memory region

  '#clock-cells':
    description: Number of clock cells provided by this controller.
    const: 1

required:
  - compatible
  - reg
  - '#clock-cells'

additionalProperties: false
```

## Documentation/devicetree/bindings/clock/hi6220-clock.yaml
```yaml
# SPDX-License-Identifier: (GPL-2.0-only OR BSD-2-Clause)
# Copyright 2025 Linaro Ltd.
%YAML 1.2
---
$id: http://devicetree.org/schemas/clock/hi6220-clock.yaml#
$schema: http://devicetree.org/meta-schemas/core.yaml#

title: Hisilicon Hi6220 Clock Controller

maintainers:
  - Bintian Wang <bintian.wang@huawei.com>
  - Leo Yan <leo.yan@linux.dev>
  - Mauro Carvalho Chehab <mchehab+huawei@kernel.org>
  - Zhangfei Gao <zhangfei.gao@linaro.org>

description: |
  * Hisilicon Hi6220 Clock Controller

  Clock control registers reside in different Hi6220 system controllers,
  please refer the following document to know more about the binding rules
  for these system controllers:

  Documentation/devicetree/bindings/arm/hisilicon/hisilicon.yaml

  Each clock is assigned an identifier and client nodes use this identifier
  to specify the clock which they consume.

  All these identifier could be found in <dt-bindings/clock/hi6220-clock.h>.

properties:
  compatible:
    oneOf:
      - items:
          - enum:
              - hisilicon,hi6220-acpu-sctrl
          - const: syscon
      - const: hisilicon,hi6220-stub-clk

  reg:
    maxItems: 1

  '#clock-cells':
    const: 1

  hisilicon,hi6220-clk-sram:
    description:
      syscon managing the SoC internal sram; driver needs the sram to pass
      parameters for frequency change.
    $ref: /schemas/types.yaml#/definitions/phandle

  mboxes:
    maxItems: 1

required:
  - compatible
  - reg
  - '#clock-cells'

additionalProperties: false
```

## Documentation/devicetree/bindings/clock/hisilicon,hi3519-crg.yaml
```yaml
%YAML 1.2
---
$id: http://devicetree.org/schemas/clock/hisilicon,hi3519-crg.yaml#
$schema: http://devicetree.org/meta-schemas/core.yaml#

title: HiSilicon Clock and Reset Generator (CRG)

maintainers:
  - Jiancheng Xue <xuejiancheng@hisilicon.com>

description: |
  * HiSilicon Clock and Reset Generator(CRG)

  The CRG module provides clock and reset signals to various
  modules within the SoC.

  This binding uses the following bindings:
      Documentation/devicetree/bindings/clock/clock-bindings.txt
      Documentation/devicetree/bindings/reset/reset.txt

  Each clock is assigned an identifier and client nodes use this identifier
  to specify the clock which they consume.

  All these identifier could be found in <dt-bindings/clock/hi3519-clock.h>.

  A reset signal can be controlled by writing a bit register in the CRG module.
  The reset specifier consists of two cells. The first cell represents the
  register offset relative to the base address. The second cell represents the
  bit index in the register.

properties:
  compatible:
    description: Compatibility strings for the CRG controller.
    items:
      - enum:
          - hisilicon,hi3516cv300-crg
          - hisilicon,hi3516cv300-sysctrl
          - hisilicon,hi3519-crg
          - hisilicon,hi3798cv200-crg
          - hisilicon,hi3798cv200-sysctrl

  reg:
    description: Physical base address of the controller and length of memory mapped region.
    items:
      - description: Base address and size of the CRG registers.

  '#clock-cells':
    description: Number of cells used to specify a clock index.
    const: 1

  '#reset-cells':
    description: Number of cells used to specify a reset index.
    const: 2

required:
  - compatible
  - reg
  - '#clock-cells'
  - '#reset-cells'

additionalProperties: false
```

## Documentation/devicetree/bindings/clock/img,boston-clock.yaml
```yaml
# SPDX-License-Identifier: (GPL-2.0-only OR BSD-2-Clause)
%YAML 1.2
---
$id: http://devicetree.org/schemas/clock/img,boston-clock.yaml#
$schema: http://devicetree.org/meta-schemas/core.yaml#
title: Imagination Technologies Boston Clock
maintainers:
  - Paul Burton <paulburton@kernel.org>
description: |
  Binding for Imagination Technologies MIPS Boston clock sources.

  This binding uses the common clock binding[1].

  [1] Documentation/devicetree/bindings/clock/clock-bindings.txt

  The device node must be a child node of the syscon node corresponding to the
  Boston system's platform registers.

properties:
  compatible:
    const: img,boston-clock
  '#clock-cells':
    const: 1
    description: Defines the number of clock specifier cells; must be 1.
  clock-output-names:
    $ref: /schemas/types.yaml#/definitions/string-array
    description: Optional list of names for each clock output.

additionalProperties: false
```

## Documentation/devicetree/bindings/clock/marvell,armada-3700-periph-clock-nb.yaml
```yaml
# SPDX-License-Identifier: (GPL-2.0-only OR BSD-2-Clause)
# Copyright 2025 Bootlin
%YAML 1.2
---
$id: http://devicetree.org/schemas/clock/marvell,armada-3700-periph-clock-nb.yaml#
$schema: http://devicetree.org/meta-schemas/core.yaml#

title: marvell,armada-3700-periph-clock-nb

maintainers:
  - Gregory CLEMENT <gregory.clement@bootlin.com>
  - Miquel Raynal <miquel.raynal@bootlin.com>

description: |
  * Peripheral Clock bindings for Marvell Armada 37xx SoCs

  Marvell Armada 37xx SoCs provide peripheral clocks which are
  used as clock source for the peripheral of the SoC.

  There are two different blocks associated to north bridge and south
  bridge.

  The peripheral clock consumer should specify the desired clock by
  having the clock ID in its "clocks" phandle cell.

  The following is a list of provided IDs for Armada 3700 North bridge clocks:
  ID	Clock name	Description
  -----------------------------------
  0	mmc		MMC controller
  1	sata_host	Sata Host
  2	sec_at		Security AT
  3	sac_dap		Security DAP
  4	tsecm		Security Engine
  5	setm_tmx	Serial Embedded Trace Module
  6	avs		Adaptive Voltage Scaling
  7	sqf		SPI
  8	pwm		PWM
  9	i2c_2		I2C 2
  10	i2c_1		I2C 1
  11	ddr_phy		DDR PHY
  12	ddr_fclk	DDR F clock
  13	trace		Trace
  14	counter		Counter
  15	eip97		EIP 97
  16	cpu		CPU

  The following is a list of provided IDs for Armada 3700 South bridge clocks:
  ID	Clock name	Description
  -----------------------------------
  0	gbe-50		50 MHz parent clock for Gigabit Ethernet
  1	gbe-core	parent clock for Gigabit Ethernet core
  2	gbe-125		125 MHz parent clock for Gigabit Ethernet
  3	gbe1-50		50 MHz clock for Gigabit Ethernet port 1
  4	gbe0-50		50 MHz clock for Gigabit Ethernet port 0
  5	gbe1-125	125 MHz clock for Gigabit Ethernet port 1
  6	gbe0-125	125 MHz clock for Gigabit Ethernet port 0
  7	gbe1-core	Gigabit Ethernet core port 1
  8	gbe0-core	Gigabit Ethernet core port 0
  9	gbe-bm		Gigabit Ethernet Buffer Manager
  10	sdio		SDIO
  11	usb32-sub2-sys	USB 2 clock
  12	usb32-ss-sys	USB 3 clock
  13	pcie		PCIe controller

properties:
  compatible:
    const: marvell,armada-3700-periph-clock-nb

  reg:
    description: Clock register base address and size.

  clocks:
    items:
      - description: TBG-A P clock and specifier
      - description: TBG-B P clock and specifier
      - description: TBG-A S clock and specifier
      - description: TBG-B S clock and specifier
      - description: Xtal clock and specifier

  '#clock-cells':
    const: 1

required:
  - compatible
  - reg
  - clocks
  - '#clock-cells'

additionalProperties: false
```

## Documentation/devicetree/bindings/clock/marvell,armada-3700-xtal-clock.yaml
```yaml
# SPDX-License-Identifier: (GPL-2.0-only OR BSD-2-Clause)
%YAML 1.2
---
$id: http://devicetree.org/schemas/clock/marvell,armada-3700-xtal-clock.yaml#
$schema: http://devicetree.org/meta-schemas/core.yaml#

title: Marvell Armada 3700 Xtal Clock

maintainers:
  - Gregory CLEMENT <gregory.clement@bootlin.com>

description: |
  * Xtal Clock bindings for Marvell Armada 37xx SoCs

  Marvell Armada 37xx SoCs allow to determine the xtal clock frequencies by
  reading the gpio latch register.

  This node must be a subnode of the node exposing the register address
  of the GPIO block where the gpio latch is located.
  See Documentation/devicetree/bindings/pinctrl/marvell,armada-37xx-pinctrl.txt

properties:
  compatible:
    items:
      - const: marvell,armada-3700-xtal-clock

  '#clock-cells':
    const: 0

  clock-output-names:
    description: Overwrites the default clock output name 'xtal'.
    $ref: /schemas/types.yaml#/definitions/string-array
    items:
      - const: xtal

required:
  - compatible
  - '#clock-cells'

additionalProperties: false

examples:
  - |
    pinctrl_nb: pinctrl-nb@13800 {
        compatible = "armada3710-nb-pinctrl", "syscon", "simple-mfd";
        reg = <0x13800 0x100>, <0x13C00 0x20>;

        xtalclk: xtal-clk {
            compatible = "marvell,armada-3700-xtal-clock";
            clock-output-names = "xtal";
            #clock-cells = <0>;
        };
    };
```

## Documentation/devicetree/bindings/clock/marvell,pxa-clocks.yaml
```yaml
# SPDX-License-Identifier: (GPL-2.0-only OR BSD-2-Clause)
%YAML 1.2
---
$id: http://devicetree.org/schemas/marvell,pxa-clocks.yaml#
$schema: http://devicetree.org/meta-schemas/core.yaml#

title: Marvell PXA Clock Provider

maintainers:
  - Robert Jarzmik <robert.jarzmik@free.fr>

properties:
  compatible:
    const: marvell,pxa-clocks

  '#clock-cells':
    const: 1

required:
  - compatible
  - '#clock-cells'

additionalProperties: false

examples:
  - |
    clock-controller@41300004 {
        compatible = "marvell,pxa-clocks";
        #clock-cells = <1>;
    };
```

## Documentation/devicetree/bindings/clock/marvell,pxa168-clock.yaml
```yaml
# SPDX-License-Identifier: (GPL-2.0-only OR BSD-2-Clause)
%YAML 1.2
---
$id: http://devicetree.org/schemas/clock/marvell,pxa168-clock.yaml#
$schema: http://devicetree.org/meta-schemas/core.yaml#

title: Marvell PXA168 Clock Controller

maintainers:
  - Chao Xie <chao.xie@marvell.com>

description:
  The PXA168 clock subsystem generates and supplies clock to various
  controllers within the PXA168 SoC.

properties:
  compatible:
    items:
      - const: marvell,pxa168-clock

  reg:
    items:
      - description: mpmu registers
      - description: apmu registers
      - description: apbc registers

  reg-names:
    items:
      - const: mpmu
      - const: apmu
      - const: apbc

  "#clock-cells":
    const: 1
    description: One cell is used to specify clocks from this controller.

  "#reset-cells":
    const: 1
    description: One cell is used to specify resets from this controller.

required:
  - compatible
  - reg
  - "#clock-cells"
  - "#reset-cells"

additionalProperties: false
```

## Documentation/devicetree/bindings/clock/marvell,pxa1928.yaml
```yaml
# SPDX-License-Identifier: (GPL-2.0-only OR BSD-2-Clause)
%YAML 1.2
---
$id: http://devicetree.org/schemas/clock/marvell,pxa1928.yaml#
$schema: http://devicetree.org/meta-schemas/core.yaml#

title: Marvell PXA1928 Clock Controllers

maintainers:
  - Rob Herring <robh@kernel.org>

description: |
  * Marvell PXA1928 Clock Controllers

  The PXA1928 clock subsystem generates and supplies clock to various
  controllers within the PXA1928 SoC. The PXA1928 contains 3 clock controller
  blocks called APMU, MPMU, and APBC roughly corresponding to internal buses.

  Each clock is assigned an identifier and client nodes use the clock controller
  phandle and this identifier to specify the clock which they consume.

  All these identifiers can be found in <dt-bindings/clock/marvell,pxa1928.h>.

properties:
  compatible:
    items:
      - enum:
          - marvell,pxa1928-apmu
          - marvell,pxa1928-mpmu
          - marvell,pxa1928-apbc

  reg:
    # The core schema already checks that reg values are numbers, so device
    # specific schema don't need to do those checks.
    # The description of each element defines the order and implicitly defines
    # the number of reg entries.
    items:
      - description: Physical base address of the clock controller
      - description: Length of memory mapped region
    # minItems/maxItems equal to 2 is implied

  '#clock-cells':
    const: 1

  '#reset-cells':
    const: 1

required:
  - compatible
  - reg
  - '#clock-cells'
  - '#reset-cells'

additionalProperties: false
```
