## Documentation/devicetree/bindings/clock/st/st,quadfs.yaml
```yaml
# SPDX-License-Identifier: (GPL-2.0-only OR BSD-2-Clause)
# Copyright 2025 STMicroelectronics
%YAML 1.2
---
$id: http://devicetree.org/schemas/clock/st/st,quadfs.yaml#
$schema: http://devicetree.org/meta-schemas/core.yaml#

title: ST QuadFS Clock

maintainers:
  - Alain Volmat <avolmat@me.com>
  - Gabriel Fernandez <gabriel.fernandez@st.com>
  - Gabriel FERNANDEZ <gabriel.fernandez@st.com>

description: |
  Binding for a type of quad channel digital frequency synthesizer found on
  certain STMicroelectronics consumer electronics SoC devices.

  This version contains a programmable PLL which can generate up to 216, 432
  or 660MHz (from a 30MHz oscillator input) as the input to the digital
  synthesizers.

properties:
  compatible:
    items:
      - const: st,quadfs
      - const: st,quadfs-d0
      - const: st,quadfs-d2
      - const: st,quadfs-d3
      - const: st,quadfs-pll

  reg:
    maxItems: 1

  '#clock-cells':
    const: 1

  clocks:
    maxItems: 1
    description: Input clock for the synthesizer.

  clock-output-names:
    maxItems: 4
    description: Names for the generated output clocks.

required:
  - compatible
  - reg
  - clocks
  - clock-output-names
  - '#clock-cells'

additionalProperties: false

examples:
  - |
    clock-controller@9103000 {
        #clock-cells = <1>;
        compatible = "st,quadfs-pll";
        reg = <0x9103000 0x1000>;

        clocks = <&clk_sysin>;

        clock-output-names = "clk-s-c0-fs0-ch0",
                             "clk-s-c0-fs0-ch1",
                             "clk-s-c0-fs0-ch2",
                             "clk-s-c0-fs0-ch3";
    };
```
