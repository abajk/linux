## Documentation/devicetree/bindings/clock/st/st,stih407-clkgen-a9-mux.yaml
```yaml
# SPDX-License-Identifier: (GPL-2.0-only OR BSD-2-Clause)
%YAML 1.2
---
$id: http://devicetree.org/schemas/clock/st/st,stih407-clkgen-a9-mux.yaml#
$schema: http://devicetree.org/meta-schemas/core.yaml#

title: STIH407 Clock Generator A9 Multiplexer

maintainers:
  - Gabriel Fernandez <gabriel.fernandez@st.com>

description: |
  Binding for a ST multiplexed clock driver.

  This binding supports only simple indexed multiplexers, it does not
  support table based parent index to hardware value translations.

properties:
  compatible:
    const: st,stih407-clkgen-a9-mux

  reg:
    maxItems: 1

  "#clock-cells":
    const: 0
    description: Must be zero.

  clocks:
    minItems: 2
    maxItems: 4
    description: Parent clocks for the multiplexer.

required:
  - compatible
  - "#clock-cells"
  - reg
  - clocks

additionalProperties: false
```

## Documentation/devicetree/bindings/clock/stericsson,nomadik-src.yaml
```yaml
# SPDX-License-Identifier: (GPL-2.0-only OR BSD-2-Clause)
%YAML 1.2
---
$id: http://devicetree.org/schemas/clock/stericsson,nomadik-src.yaml#
$schema: http://devicetree.org/meta-schemas/core.yaml#

title: ST Microelectronics Nomadik SRC System Reset and Control

maintainers:
  - Linus Walleij <linus.walleij@linaro.org>
  - Stefan Huber <steffhip@googlemail.com>

description:
  The Nomadik SRC controller is responsible of controlling crystals, PLLs and
  clock gates.

properties:
  compatible:
    items:
      - const: stericsson,nomadik-src

  reg:
    maxItems: 1

  disable-sxtalo:
    description: Disable the SXTALO 32kHz crystal output when the board provides its own oscillator.
    type: boolean

  disable-mxtal:
    description: Disable the MXTALO (~19.2 MHz) crystal output when the board provides its own oscillator.
    type: boolean

required:
  - compatible
  - reg

additionalProperties: false
```

## Documentation/devicetree/bindings/clock/ti,cdce706.yaml
```yaml
# SPDX-License-Identifier: (GPL-2.0-only OR BSD-2-Clause)
%YAML 1.2
---
$id: http://devicetree.org/schemas/ti,cdce706.yaml#
$schema: http://devicetree.org/meta-schemas/core.yaml#

title: TI CDCE706 Clock Synthesizer

maintainers:
  - Alexander A. Klimov <grandmaster@al2klimov.de>
  - Marco Franchi <marco.franchi@nxp.com>
  - Max Filippov <jcmvbkbc@gmail.com>

description: |
  Bindings for Texas Instruments CDCE706 programmable 3-PLL clock synthesizer/multiplier/divider.

  Reference: https://www.ti.com/lit/ds/symlink/cdce706.pdf

properties:
  compatible:
    enum:
      - ti,cdce706

  reg:
    description: I2C device address of the CDCE706.
    items:
      - description: I2C device address; valid range 0x68..0x6b.
        minimum: 104
        maximum: 107

  "#clock-cells":
    const: 1
    description: Number of cells required to identify clock output; shall be 1.

  clocks:
    description: Reference clock(s) connected to CLK_IN0 and CLK_IN1 pins.
    minItems: 1
    items:
      - description: Clock input 0 (CLK_IN0).
      - description: Clock input 1 (CLK_IN1).

  clock-names:
    description: Names for the input clocks.
    minItems: 1
    items:
      - const: clk_in0
      - const: clk_in1

required:
  - compatible
  - reg
  - "#clock-cells"
  - clocks
  - clock-names

additionalProperties: false
```

## Documentation/devicetree/bindings/clock/ti,keystone,main-pll-clock.yaml
```yaml
# SPDX-License-Identifier: (GPL-2.0-only OR BSD-2-Clause)
%YAML 1.2
---
$id: http://devicetree.org/schemas/clock/ti,keystone,main-pll-clock.yaml#
$schema: http://devicetree.org/meta-schemas/core.yaml#

title: Keystone PLL clocks

maintainers:
  - Bjorn Helgaas <bhelgaas@google.com>
  - Krzysztof Kozlowski <krzysztof.kozlowski@linaro.org>
  - Murali Karicheri <m-karicheri2@ti.com>
  - Santosh Shilimkar <santosh.shilimkar@ti.com>

description: |
  Binding for keystone PLLs. The main PLL IP typically has a multiplier,
  a divider and a post divider. The additional PLL IPs like ARMPLL, DDRPLL
  and PAPLL are controlled by the memory mapped register whereas the Main
  PLL is controlled by PLL controller registers along with memory mapped
  registers.

  This binding uses the common clock binding[1].

  Required properties:
    - #clock-cells : shall be 0.
    - compatible : one of "ti,keystone,main-pll-clock",
      "ti,keystone,pll-clock", "ti,keystone,pll-mux-clock",
      or "ti,keystone,pll-divider-clock"
    - clocks : parent clock phandles.
    - reg : register offsets and sizes.
    - reg-names : names for each reg entry.
    - fixed-postdiv : fixed post divider value for main PLL. If absent,
      clkod register bits are used.

  [1] Documentation/devicetree/bindings/clock/clock-bindings.txt

properties:
  compatible:
    items:
      - enum:
          - ti,keystone,main-pll-clock
          - ti,keystone,pll-clock
          - ti,keystone,pll-mux-clock
          - ti,keystone,pll-divider-clock

  # Parent clock phandles
  clocks:
    maxItems: 1
    description: Parent clock phandles.

  # Optional output names
  clock-output-names:
    items:
      - description: Output clock name.

  # Number of clock cells; must be zero.
  '#clock-cells':
    description: Number of clock-cells; must be zero.
    const: 0

  # Register definitions
  reg:
    items:
      - description: Control register.
      - description: Multiplier register.
      - description: Post divider register.

  # Names for register entries
  reg-names:
    items:
      - const: control
      - const: multiplier
      - const: post-divider

  # Fixed post divider for main PLL
  fixed-postdiv:
    description: Fixed post divider value.
    $ref: /schemas/types.yaml#/definitions/uint32

  # Mux/divider bitfields
  bit-shift:
    description: Number of bits to shift the bitmask.
    $ref: /schemas/types.yaml#/definitions/uint32

  bit-mask:
    description: Bitmask for programming the mux or divider.
    $ref: /schemas/types.yaml#/definitions/uint32

additionalProperties: false

oneOf:
  - description: Main PLL clock
    properties:
      compatible:
        contains:
          const: ti,keystone,main-pll-clock
      reg: {}
      reg-names:
        items:
          - const: control
          - const: multiplier
          - const: post-divider
      fixed-postdiv: {}
    additionalProperties: false
    required:
      - compatible
      - reg
      - reg-names

  - description: Secondary PLL clocks (ARMPLL, DDRPLL, PAPLL)
    properties:
      compatible:
        contains:
          const: ti,keystone,pll-clock
      reg:
        maxItems: 1
      reg-names:
        items:
          - const: control
      clock-output-names:
        items:
          - description: Output clock name.

      '#clock-cells':
        description: Number of clock-cells; must be zero.
        const: 0
    additionalProperties: false
    required:
      - compatible
      - reg
      - reg-names

  - description: PLL Mux clock
    properties:
      compatible:
        contains:
          const: ti,keystone,pll-mux-clock
      reg:
        maxItems: 1
      bit-shift: {}
      bit-mask: {}
    additionalProperties: false
    required:
      - compatible
      - reg
      - bit-shift
      - bit-mask

  - description: PLL Divider clock
    properties:
      compatible:
        contains:
          const: ti,keystone,pll-divider-clock
      reg:
        maxItems: 1
      bit-shift: {}
      bit-mask: {}
    additionalProperties: false
    required:
      - compatible
      - reg
      - bit-shift
      - bit-mask
```

## Documentation/devicetree/bindings/clock/ti,keystone,psc-clock.yaml
```yaml
# SPDX-License-Identifier: (GPL-2.0-only OR BSD-2-Clause)
# Copyright 2025 Linaro Ltd.
%YAML 1.2
---
$id: http://devicetree.org/schemas/clock/ti,keystone,psc-clock.yaml#
$schema: http://devicetree.org/meta-schemas/core.yaml#

title: TI Keystone PSC Clock

maintainers:
  - Krzysztof Kozlowski <krzysztof.kozlowski@linaro.org>
  - Santosh Shilimkar <santosh.shilimkar@ti.com>

description: |
  Binding for Keystone gate control driver which uses PSC controller IP.
  This binding uses the common clock binding[1].

  [1] Documentation/devicetree/bindings/clock/clock-bindings.txt

properties:
  compatible:
    items:
      - const: ti,keystone,psc-clock

  '#clock-cells':
    const: 0

  clocks:
    maxItems: 1
    description: Parent PSC controller clock.

  reg:
    items:
      - description: PSC control register.
      - description: PSC domain register.

  reg-names:
    items:
      - const: control
      - const: domain

  domain-id:
    description: PSC domain id needed to check the transition state register.
    $ref: /schemas/types.yaml#/definitions/uint32

  clock-output-names:
    description: Override default output clock name.
    $ref: /schemas/types.yaml#/definitions/string-array

required:
  - compatible
  - '#clock-cells'
  - clocks
  - reg
  - reg-names
  - domain-id

additionalProperties: false

examples:
  - |
    clock-controller@2350008 {
        #clock-cells = <0>;
        compatible = "ti,keystone,psc-clock";
        clocks = <&chipclk16>;
        clock-output-names = "usb";
        reg = <0x02350008 0xb00>, <0x02350000 0x400>;
        reg-names = "control", "domain";
        domain-id = <0>;
    };
```

## Documentation/devicetree/bindings/clock/ti,palmas-clk32kg.yaml
```yaml
# SPDX-License-Identifier: (GPL-2.0-only OR BSD-2-Clause)
# Copyright 2025 Texas Instruments
%YAML 1.2
---
$id: http://devicetree.org/schemas/ti,palmas-clk32kg.yaml#
$schema: http://devicetree.org/meta-schemas/core.yaml#

title: Palmas 32KHz clocks

maintainers:
  - Peter Ujfalusi <peter.ujfalusi@ti.com>

description: |
  * Palmas 32KHz clocks *

  Palmas device has two clock output pins for 32KHz, KG and KG_AUDIO.

  This binding uses the common clock binding ./clock-bindings.txt.

properties:
  compatible:
    items:
      - enum:
          - ti,palmas-clk32kg
          - ti,palmas-clk32kgaudio

  '#clock-cells':
    description: Number of clock cells, must be 0
    const: 0

  ti,external-sleep-control:
    description: |
      External enable input pin controlling clock enable/disable
      missing or 0 means control via register access
    $ref: /schemas/types.yaml#/definitions/uint32
    enum:
      - 1
      - 2
      - 3

required:
  - compatible
  - '#clock-cells'

additionalProperties: false
```

## Documentation/devicetree/bindings/clock/ti/davinci/ti,da830-cfgchip.yaml
```yaml
# SPDX-License-Identifier: (GPL-2.0-only OR BSD-2-Clause)
%YAML 1.2
---
$id: http://devicetree.org/schemas/clock/ti/davinci/ti,da830-cfgchip.yaml#
$schema: http://devicetree.org/meta-schemas/core.yaml#

title: TI DA8XX/OMAP-L13X/AM17XX/AM18XX CFGCHIP clocks

maintainers:
  - David Lechner <david@lechnology.com>

description: |
  TI DA8XX/OMAP-L13X/AM17XX/AM18XX SoCs contain a general purpose set of
  registers call CFGCHIPn. Some of these registers function as clock
  gates. This document describes the bindings for those clocks.

  All of the clock nodes described below must be child nodes of a CFGCHIP node
  (compatible = "ti,da830-cfgchip").

  USB PHY clocks
  --------------
  This node provides two clocks. The clock at index 0 is the USB 2.0 PHY 48MHz
  clock and the clock at index 1 is the USB 1.1 PHY 48MHz clock.

  eHRPWM Time Base Clock (TBCLK)
  ------------------------------

  PLL DIV4.5 divider
  ------------------

  EMIFA clock source (ASYNC1)
  ---------------------------

  ASYNC3 clock source
  -------------------

properties:
  compatible:
    const: ti,da830-cfgchip

  usb-phy-clocks:
    description: USB PHY clock gate providing 'fck', 'usb_refclkin', and 'auxclk'.
    type: object
    additionalProperties: false

    properties:
      compatible:
        const: ti,da830-usb-phy-clocks

      '#clock-cells':
        const: 1

      clocks:
        maxItems: 3

      clock-names:
        items:
          - const: fck
          - const: usb_refclkin
          - const: auxclk

    required: [compatible, '#clock-cells', clocks, clock-names]

  ehrpwm-tbclk:
    description: eHRPWM time base clock (TBCLK) gate.
    type: object
    additionalProperties: false

    properties:
      compatible:
        const: ti,da830-tbclksync

      '#clock-cells':
        const: 0

      clocks:
        maxItems: 1

      clock-names:
        items:
          - const: fck

    required: [compatible, '#clock-cells', clocks, clock-names]

  div4.5:
    description: PLL DIV4.5 divider output clock gate.
    type: object
    additionalProperties: false

    properties:
      compatible:
        const: ti,da830-div4p5ena

      '#clock-cells':
        const: 0

      clocks:
        maxItems: 1

      clock-names:
        items:
          - const: pll0_pllout

    required: [compatible, '#clock-cells', clocks, clock-names]

  async1:
    description: EMIFA ASYNC1 clock source providing 'pll0_sysclk3' and 'div4.5'.
    type: object
    additionalProperties: false

    properties:
      compatible:
        const: ti,da850-async1-clksrc

      '#clock-cells':
        const: 0

      clocks:
        maxItems: 2

      clock-names:
        items:
          - const: pll0_sysclk3
          - const: div4.5

    required: [compatible, '#clock-cells', clocks, clock-names]

  async3:
    description: ASYNC3 clock source providing 'pll0_sysclk2' and 'pll1_sysclk2'.
    type: object
    additionalProperties: false

    properties:
      compatible:
        const: ti,da850-async3-clksrc

      '#clock-cells':
        const: 0

      clocks:
        maxItems: 2

      clock-names:
        items:
          - const: pll0_sysclk2
          - const: pll1_sysclk2

    required: [compatible, '#clock-cells', clocks, clock-names]

additionalProperties: false
```

## Documentation/devicetree/bindings/clock/ti/davinci/ti,da850-psc.yaml
```yaml
# SPDX-License-Identifier: (GPL-2.0-only OR BSD-2-Clause)
%YAML 1.2
---
$id: http://devicetree.org/schemas/clock/ti/davinci/ti,da850-psc.yaml#
$schema: http://devicetree.org/meta-schemas/core.yaml#

title: TI DaVinci Power Sleep Controller (PSC)

maintainers:
  - David Lechner <david@lechnology.com>
  - Krzysztof Kozlowski <krzk@kernel.org>

description: >
  The PSC provides power management, clock gating and reset functionality. It is
  primarily used for clocking.

  Consumers:
    Clock, power domain and reset consumers shall use the local power domain
    module ID (LPSC) as the index corresponding to the clock cell. Refer to
    the device-specific datasheet to find these numbers. NB: Most local domains
    only provide a clock/power domain and not a reset.

properties:
  compatible:
    enum:
      - ti,da850-psc0
      - ti,da850-psc1

  reg:
    maxItems: 1

  "#clock-cells":
    const: 1

  "#power-domain-cells":
    const: 1

  clocks:
    description: phandles to clocks corresponding to the clock-names property

  clock-names:
    description: list of parent clock names; order and count depend on compatible

  "#reset-cells":
    const: 1

additionalProperties: false

examples:
  - |
    psc0: clock-controller@10000 {
      compatible = "ti,da850-psc0";
      reg = <0x10000 0x1000>;
      #clock-cells = <1>;
      #power-domain-cells = <1>;
      #reset-cells = <1>;
      clocks = <&pll0_sysclk 1>, <&pll0_sysclk 2>,
               <&pll0_sysclk 4>, <&pll0_sysclk 6>, <&async1_clk>;
      clock_names = "pll0_sysclk1", "pll0_sysclk2",
                    "pll0_sysclk4", "pll0_sysclk6", "async1";
    };

  - |
    psc1: clock-controller@227000 {
      compatible = "ti,da850-psc1";
      reg = <0x227000 0x1000>;
      #clock-cells = <1>;
      #power-domain-cells = <1>;
      clocks = <&pll0_sysclk 2>, <&pll0_sysclk 4>, <&async3_clk>;
      clock_names = "pll0_sysclk2", "pll0_sysclk4", "async3";
    };
```
