## Documentation/devicetree/bindings/cpufreq/nvidia,tegra20-cpufreq.yaml
```yaml
# SPDX-License-Identifier: (GPL-2.0-only OR BSD-2-Clause)
%YAML 1.2
---
$id: http://devicetree.org/schemas/cpufreq/nvidia,tegra20-cpufreq.yaml#
$schema: http://devicetree.org/meta-schemas/core.yaml#

title: NVIDIA Tegra20 CPU frequency scaling

maintainers:
  - Amit Kucheria <amit.kucheria@linaro.org>
  - Dmitry Osipenko <digetx@gmail.com>

description: |
  Binding for NVIDIA Tegra20 CPUFreq

properties:
  compatible:
    description: Tegra20 CPUFreq compatible string.
    items:
      - const: nvidia,tegra20-cpufreq

  clocks:
    description: CPU clock source.
    maxItems: 1

  operating-points-v2:
    description: Operating performance points table for CPU frequency scaling.
    $ref: /schemas/opp/opp-v2.yaml

  '#cooling-cells':
    description: Number of thermal cooling cells.
    const: 2

  cpu-supply:
    description: Phandle to the CPU power supply.

required:
  - compatible
  - clocks
  - operating-points-v2
  - '#cooling-cells'

additionalProperties: false
```

## Documentation/devicetree/bindings/cpufreq/operating-points-v2.yaml
```yaml
# SPDX-License-Identifier: (GPL-2.0-only OR BSD-2-Clause)
%YAML 1.2
---
$id: http://devicetree.org/schemas/cpufreq/operating-points-v2.yaml#
$schema: http://devicetree.org/meta-schemas/core.yaml#

title: i.MX CPU Operating Performance Points

maintainers:
  - Leonard Crestez <cdleonard@gmail.com>

description: |
  Certain i.MX SoCs support different OPPs depending on the "market segment" and
  "speed grading" value which are written in fuses. These bits are combined with
  the opp-supported-hw values for each OPP to check if the OPP is allowed.

properties:
  compatible:
    const: operating-points-v2

patternProperties:
  "^opp-\\d+$":
    description: An operating performance point entry
    type: object
    required:
      - opp-hz
      - opp-supported-hw
    properties:
      opp-hz:
        description: Frequency in Hz for this operating point
      opp-microvolt:
        description: Operating voltage in microvolts
      opp-supported-hw:
        description: Selector bitmaps for speed grade and market segment
        items:
          - $ref: /schemas/types.yaml#/definitions/uint32
            description: Supported speed grade mask
          - $ref: /schemas/types.yaml#/definitions/uint32
            description: Supported market segment mask
        $ref: /schemas/types.yaml#/definitions/uint32-array
    additionalProperties: false

additionalProperties: false

examples:
  - |
    opp_table {
        compatible = "operating-points-v2";
        opp-1000000000 {
            opp-hz = /bits/ 64 <1000000000>;
            /* grade >= 0, consumer only */
            opp-supported-hw = <0xf>, <0x3>;
        };

        opp-1300000000 {
            opp-hz = /bits/ 64 <1300000000>;
            opp-microvolt = <1000000>;
            /* grade >= 1, all segments */
            opp-supported-hw = <0xe>, <0x7>;
        };
    };
```

## Documentation/devicetree/bindings/csky/csky,610.yaml
```yaml
# SPDX-License-Identifier: (GPL-2.0-only OR BSD-2-Clause)
# Copyright 2025 Guo Ren <guoren@kernel.org>
%YAML 1.2
---
$id: http://devicetree.org/schemas/csky/csky,610.yaml#
$schema: http://devicetree.org/meta-schemas/core.yaml#

title: C-SKY CPU nodes

maintainers:
  - Guo Ren <guoren@kernel.org>

description: |
  ==================
  C-SKY CPU Bindings
  ==================

  The device tree allows to describe the layout of CPUs in a system through
  the "cpus" node, which in turn contains a number of subnodes (ie "cpu")
  defining properties for every cpu.

  Only SMP system need to care about the cpus node and single processor
  needn't define cpus node at all.

  =====================================
  cpus and cpu node bindings definition
  =====================================

  - cpus node

      Description: Container of cpu nodes

      The node name must be "cpus".

  - cpu node

      Description: Describes one of SMP cores

properties:
  '#address-cells':
    description: Number of address cells for child nodes.
    const: 1

  '#size-cells':
    description: Number of size cells for child nodes.
    const: 0

patternProperties:
  "^cpu@.*":
    type: object
    description: CPU subnode
    additionalProperties: true
    properties:
      device_type:
        description: Must be "cpu".
        const: cpu
      reg:
        description: CPU index.
        items:
          - description: CPU index.
      compatible:
        items:
          - enum:
              - csky,610
              - csky,807
              - csky,810
              - csky,860
    required:
      - device_type
      - reg
      - compatible

required:
  - "#address-cells"
  - "#size-cells"

additionalProperties: false

examples:
  - |
    cpus {
      #address-cells = <1>;
      #size-cells = <0>;
      cpu@0 {
        device_type = "cpu";
        reg = <0>;
        compatible = "csky,610";
        status = "ok";
      };
      cpu@1 {
        device_type = "cpu";
        reg = <1>;
        compatible = "csky,610";
        status = "ok";
      };
    };
```

## Documentation/devicetree/bindings/csky/csky,csky-pmu.yaml
```yaml
# SPDX-License-Identifier: (GPL-2.0-only OR BSD-2-Clause)
%YAML 1.2
---
$id: http://devicetree.org/schemas/csky,csky-pmu.yaml#
$schema: http://devicetree.org/meta-schemas/core.yaml#

title: C-SKY Performance Monitor Units

maintainers:
  - Mao Han <han_mao@c-sky.com>

description: |
  C-SKY Performance Monitor Units

  C-SKY Performance Monitor is designed for ck807/ck810/ck860 SMP soc and
  it could count cpu's events for helping analysis performance issues.

  PMU node bindings definition

  Describes PMU

properties:
  compatible:
    description: Binding compatible string
    items:
      - const: csky,csky-pmu

  interrupts:
    description: IRQ number and trigger type for PMU interrupts
    items:
      - description: PMU interrupt

  count-width:
    description: Width of each PMU counter
    $ref: /schemas/types.yaml#/definitions/uint32

required:
  - compatible
  - interrupts

additionalProperties: false

examples:
  - |
    pmu: performace-monitor {
        compatible = "csky,csky-pmu";
        interrupts = <23 IRQ_TYPE_EDGE_RISING>;
        count-width = <48>;
    };
```

## Documentation/devicetree/bindings/display/armada/marvell,dove-lcd.yaml
```yaml
# SPDX-License-Identifier: (GPL-2.0-only OR BSD-2-Clause)
# Copyright 2025 Rob Herring
%YAML 1.2
---
$id: http://devicetree.org/schemas/display/armada/marvell,dove-lcd.yaml#
$schema: http://devicetree.org/meta-schemas/core.yaml#

title: Armada DRM CRTC driver

maintainers:
  - Rob Herring <robh@kernel.org>

description: |
  Device Tree bindings for Armada DRM CRTC driver

  Note: all clocks are optional but at least one must be specified.
  Further clocks may be added in the future according to requirements of different SoCs.

properties:
  compatible:
    items:
      - const: marvell,dove-lcd

  reg:
    maxItems: 1

  interrupts:
    maxItems: 1

  port:
    description: Video output port with endpoints, as described by graph.txt.

  clocks:
    maxItems: 1

  clock-names:
    description: Clock names for pixel clock sources.
    items:
      - enum: [axiclk, plldivider, ext_ref_clk0, ext_ref_clk1]

additionalProperties: false

examples:
  - |
    lcd0: lcd-controller@820000 {
        compatible = "marvell,dove-lcd";
        reg = <0x820000 0x1000>;
        interrupts = <47>;
        clocks = <&si5351 0>;
        clock-names = "ext_ref_clk1";
        port {
            endpoint {
                remote-endpoint;
            };
        };
    };
```
