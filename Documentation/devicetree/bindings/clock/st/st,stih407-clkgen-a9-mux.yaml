## Documentation/devicetree/bindings/clock/ti/ti,dm814-adpll-s-clock.yaml
```yaml
# SPDX-License-Identifier: (GPL-2.0-only OR BSD-2-Clause)
# Copyright 2018 Linaro Ltd.
%YAML 1.2
---
$id: http://devicetree.org/schemas/clock/ti/ti,dm814-adpll-s-clock.yaml#
$schema: http://devicetree.org/meta-schemas/core.yaml#

title: TI DM814 ADPLL Clock Controller

maintainers:
  - Krzysztof Kozlowski <krzysztof.kozlowski@linaro.org>
  - Tony Lindgren <tony@atomide.com>

description: |
  Binding for Texas Instruments ADPLL clock.

  This binding uses the common clock binding[1]. It assumes a
  register-mapped ADPLL with two to three selectable input clocks
  and three to four children.

properties:
  compatible:
    enum:
      - ti,dm814-adpll-s-clock
      - ti,dm814-adpll-lj-clock

  '#clock-cells':
    const: 1
    description: Number of cells in clock specifier; must be 1.

  reg:
    description: Address and length of the register set for controlling the ADPLL.
    items:
      - description: Register base address.
      - description: Register size.

  clocks:
    description: "Phandle list of parent clocks: clkinp, clkinpulow, and optional clkinphif."
    minItems: 2
    items:
      - description: Primary reference input clock.
      - description: Low-power reference input clock.
      - description: Optional high-frequency reference input clock.

  clock-names:
    description: Names corresponding to each parent clock phandle.
    minItems: 2
    items:
      - const: clkinp
      - const: clkinpulow
      - const: clkinphif

  clock-output-names:
    description: |
      Names of clocks generated by the ADPLL: DCO clock local oscillator output,
      primary output clock, double-frequency output clock, and optional
      high-frequency output clock.
    minItems: 3
    items:
      - description: DCO clock local oscillator output.
      - description: Primary output clock.
      - description: Double-frequency output clock.
      - description: Optional high-frequency output clock.

required:
  - compatible
  - '#clock-cells'
  - reg
  - clocks

additionalProperties: false
```

## Documentation/devicetree/bindings/clock/ti/ti,dm816-fapll-clock.yaml
```yaml
# SPDX-License-Identifier: (GPL-2.0-only OR BSD-2-Clause)
%YAML 1.2
---
$id: http://devicetree.org/schemas/clock/ti/ti,dm816-fapll-clock.yaml#
$schema: http://devicetree.org/meta-schemas/core.yaml#

title: TI DM816 FAPLL Clock

maintainers:
  - Krzysztof Kozlowski <krzysztof.kozlowski@linaro.org>
  - Tony Lindgren <tony@atomide.com>

description:
  It assumes a register-mapped FAPLL with usually two selectable input clocks
  (reference clock and bypass clock), and one or more child synthesizers.

properties:
  compatible:
    const: ti,dm816-fapll-clock

  "#clock-cells":
    const: 1

  reg:
    maxItems: 1

  clocks:
    description: Parent reference and bypass clocks.
    maxItems: 2

  clock-indices:
    description: Synthesizer output indices.
    items:
      - description: Index of child synthesizer output 1.
      - description: Index of child synthesizer output 2.
      - description: Index of child synthesizer output 3.
      - description: Index of child synthesizer output 4.
      - description: Index of child synthesizer output 5.
      - description: Index of child synthesizer output 6.
      - description: Index of child synthesizer output 7.

  clock-output-names:
    description: Names for each child synthesizer output.
    items:
      - description: Name of child clock output 1.
      - description: Name of child clock output 2.
      - description: Name of child clock output 3.
      - description: Name of child clock output 4.
      - description: Name of child clock output 5.
      - description: Name of child clock output 6.
      - description: Name of child clock output 7.

required:
  - compatible
  - reg
  - clocks
  - "#clock-cells"

additionalProperties: false

examples:
  - |
    clock-controller@400 {
        compatible = "ti,dm816-fapll-clock";
        reg = <0x400 0x40>;
        #clock-cells = <1>;
        clocks = <&sys_clkin_ck>, <&sys_clkin_ck>;
        clock-indices = <1>, <2>, <3>, <4>, <5>,
                         <6>, <7>;
        clock-output-names = "main_pll_clk1",
                             "main_pll_clk2",
                             "main_pll_clk3",
                             "main_pll_clk4",
                             "main_pll_clk5",
                             "main_pll_clk6",
                             "main_pll_clk7";
    };
```

## Documentation/devicetree/bindings/clock/ti/ti,dra7-apll-clock.yaml
```yaml
# SPDX-License-Identifier: (GPL-2.0-only OR BSD-2-Clause)
%YAML 1.2
---
$id: http://devicetree.org/schemas/clock/ti/ti,dra7-apll-clock.yaml#
$schema: http://devicetree.org/meta-schemas/core.yaml#

title: Texas Instruments APLL clock

maintainers:
  - J Keerthy <j-keerthy@ti.com>
  - Krzysztof Kozlowski <krzysztof.kozlowski@linaro.org>
  - Tero Kristo <t-kristo@ti.com>

description: |
  Binding for Texas Instruments APLL clock.

  This binding uses the common clock binding[1].  It assumes a
  register-mapped APLL with usually two selectable input clocks
  (reference clock and bypass clock), with analog phase locked
  loop logic for multiplying the input clock to a desired output
  clock. This clock also typically supports different operation
  modes (locked, low power stop etc.) APLL mostly behaves like
  a subtype of a DPLL [2], although a simplified one at that.

  [1] Documentation/devicetree/bindings/clock/clock-bindings.txt
  [2] Documentation/devicetree/bindings/clock/ti/dpll.txt

properties:
  compatible:
    items:
      - enum:
          - "ti,dra7-apll-clock"
          - "ti,omap2-apll-clock"
    description: Device compatible string.

  "#clock-cells":
    const: 0
    description: Must be set to 0 for this clock.

  clocks:
    description: Parent clock phandles.
    items:
      - description: Reference clock phandle.
      - description: Bypass clock phandle.

  reg:
    description: APLL control register offsets.
    items:
      - description: Control register offset.
      - description: Idlest register offset.
      - description: Autoidle register offset (OMAP2 only).

  ti,bit-shift:
    $ref: /schemas/types.yaml#/definitions/uint32
    description: Bit-shift for enable and autoidle fields (OMAP2 only).

  ti,idlest-shift:
    $ref: /schemas/types.yaml#/definitions/uint32
    description: Bit-shift for idlest field (OMAP2 only).

  ti,clock-frequency:
    $ref: /schemas/types.yaml#/definitions/uint32
    description: Static clock frequency in Hz (OMAP2 only).

required:
  - compatible
  - "#clock-cells"
  - clocks
  - reg

additionalProperties: false

allOf:
  - if:
      properties:
        compatible:
          contains:
            const: "ti,omap2-apll-clock"
    then:
      required:
        - ti,bit-shift
        - ti,idlest-shift
        - ti,clock-frequency
      properties:
        reg:
          minItems: 3
    else:
      properties:
        ti,bit-shift: false
        ti,idlest-shift: false
        ti,clock-frequency: false
        reg:
          maxItems: 2
```

## Documentation/devicetree/bindings/clock/ti/ti,dra7-atl.yaml
```yaml
# SPDX-License-Identifier: (GPL-2.0-only OR BSD-2-Clause)
%YAML 1.2
---
$id: http://devicetree.org/schemas/clock/ti/ti,dra7-atl.yaml#
$schema: http://devicetree.org/meta-schemas/core.yaml#

title: TI DRA7 ATL and ATL-clock

maintainers:
  - Peter Ujfalusi <peter.ujfalusi@ti.com>

description: |
  ATL (Audio Tracking Logic) Clocks of DRA7 SoC.

  The ATL IP is used to generate clock to be used to synchronize baseband and
  audio codec. A single ATL IP provides four ATL clock instances sharing the same
  functional clock but can be configured to provide different clocks.
  ATL can maintain a clock averages to some desired frequency based on the
  bws/aws signals - can compensate the drift between the two ws signal.

  In order to provide the support for ATL and its output clocks (which can be
  used internally within the SoC or external components) two sets of bindings
  are needed:

    * Clock tree binding:
      This binding uses the common clock binding[1].
      To be able to integrate the ATL clocks with DT clock tree.
      Provides ccf level representation of the ATL clocks to be used by drivers.
      Since the clock instances are part of a single IP this binding is used as
      a node for the DT clock tree, the IP driver is needed to handle the actual
      configuration of the IP.

    * Binding for the IP driver:
      This binding is used to configure the IP driver which is going to handle
      the configuration of the IP for the ATL clock instances.

  [1] Documentation/devicetree/bindings/clock/clock-bindings.txt

properties:
  compatible:
    enum:
      - ti,dra7-atl-clock
      - ti,dra7-atl

  reg:
    maxItems: 1

  "#clock-cells":
    const: 0

  clocks:
    maxItems: 1

  ti,hwmods:
    description: Hardware modules associated with ATL IP.
    enum:
      - atl

  ti,provided-clocks:
    description: Phandles to the clocks provided by ATL IP.
    $ref: /schemas/types.yaml#/definitions/phandle-array

    minItems: 1
    maxItems: 4
    items:
      items:
        - description: ATL provided clock phandle 0.

  clock-names:
    items:
      - const: fck

patternProperties:
  "^atl[0-3]$":
    description: Configuration node for an ATL instance.
    type: object
    additionalProperties: false
    properties:
      bws:
        description: Baseband word select signal selection.
        $ref: /schemas/types.yaml#/definitions/uint32
      aws:
        description: Audio word select signal selection.
        $ref: /schemas/types.yaml#/definitions/uint32
    required:
      - bws
      - aws

required:
  - compatible

allOf:
  - if:
      properties:
        compatible:
          contains:
            const: ti,dra7-atl-clock
    then:
      required:
        - "#clock-cells"
        - clocks
  - if:
      properties:
        compatible:
          contains:
            const: ti,dra7-atl
    then:
      required:
        - reg
        - ti,hwmods
        - ti,provided-clocks
        - clocks
        - clock-names

additionalProperties: false

examples:
  - |
    #include <dt-bindings/clock/ti-dra7-atl.h>

    atl_clkin0_ck: atl_clkin0_ck {
        #clock-cells = <0>;
        compatible = "ti,dra7-atl-clock";
        clocks = <&atl_gfclk_mux>;
    };
    atl_clkin1_ck: atl_clkin1_ck {
        #clock-cells = <0>;
        compatible = "ti,dra7-atl-clock";
        clocks = <&atl_gfclk_mux>;
    };
    atl_clkin2_ck: atl_clkin2_ck {
        #clock-cells = <0>;
        compatible = "ti,dra7-atl-clock";
        clocks = <&atl_gfclk_mux>;
    };
    atl_clkin3_ck: atl_clkin3_ck {
        #clock-cells = <0>;
        compatible = "ti,dra7-atl-clock";
        clocks = <&atl_gfclk_mux>;
    };

    atl@4843c000 {
        compatible = "ti,dra7-atl";
        reg = <0x4843c000 0x3ff>;
        ti,hwmods = "atl";
        ti,provided-clocks = <&atl_clkin0_ck>, <&atl_clkin1_ck>,
                             <&atl_clkin2_ck>, <&atl_clkin3_ck>;
        clocks = <&atl_gfclk_mux>;
        clock-names = "fck";

        atl2 {
            bws = <DRA7_ATL_WS_MCASP2_FSX>;
            aws = <DRA7_ATL_WS_MCASP3_FSX>;
        };
    };
```

## Documentation/devicetree/bindings/clock/ti/ti,omap3-dpll-clock.yaml
```yaml
# SPDX-License-Identifier: (GPL-2.0-only OR BSD-2-Clause)
# Copyright 2025 Dario Binacchi <dariobin@libero.it>
# Copyright 2025 Krzysztof Kozlowski <krzysztof.kozlowski@linaro.org>
# Copyright 2025 Nishanth Menon <nm@ti.com>
# Copyright 2025 Tero Kristo <t-kristo@ti.com>
%YAML 1.2
---
$id: http://devicetree.org/schemas/clock/ti/ti,omap3-dpll-clock.yaml#
$schema: http://devicetree.org/meta-schemas/core.yaml#

title: Texas Instruments DPLL clock

maintainers:
  - Dario Binacchi <dariobin@libero.it>
  - Krzysztof Kozlowski <krzysztof.kozlowski@linaro.org>
  - Nishanth Menon <nm@ti.com>
  - Tero Kristo <t-kristo@ti.com>

description: |
  Binding for Texas Instruments DPLL clock.

  This binding uses the common clock binding[1]. It assumes a
  register-mapped DPLL with usually two selectable input clocks
  (reference clock and bypass clock), with digital phase locked
  loop logic for multiplying the input clock to a desired output
  clock. This clock also typically supports different operation
  modes (locked, low power stop etc.) and covers several sub-types
  with slightly different setup.

  [1] Documentation/devicetree/bindings/clock/clock-bindings.txt

properties:
  compatible:
    enum:
      - ti,omap3-dpll-clock
      - ti,omap3-dpll-core-clock
      - ti,omap3-dpll-per-clock
      - ti,omap3-dpll-per-j-type-clock
      - ti,omap4-dpll-clock
      - ti,omap4-dpll-x2-clock
      - ti,omap4-dpll-core-clock
      - ti,omap4-dpll-m4xen-clock
      - ti,omap4-dpll-j-type-clock
      - ti,omap5-mpu-dpll-clock
      - ti,am3-dpll-no-gate-clock
      - ti,am3-dpll-j-type-clock
      - ti,am3-dpll-no-gate-j-type-clock
      - ti,am3-dpll-clock
      - ti,am3-dpll-core-clock
      - ti,am3-dpll-x2-clock
      - ti,omap2-dpll-core-clock

  reg:
    minItems: 4
    items:
      - description: Control register base address
      - description: Idlest status register base address
      - description: Multiplier/divider register base address
      - description: Autoidle register base address
      - description: Spread-spectrum delta M register base address
      - description: Spread-spectrum modulation frequency register base address

  '#clock-cells':
    const: 0

  clocks:
    items:
      - description: Reference clock phandle
      - description: Bypass clock phandle

  ti,low-power-stop:
    description: Enable low power stop mode to gate DPLL output.
    type: boolean

  ti,low-power-bypass:
    description: Bypass DPLL, output matches bypass clock rate.
    type: boolean

  ti,lock:
    description: Lock DPLL to programmed rate.
    type: boolean

  ti,min-div:
    description: Minimum divisor for DPLL rate rounding.
    $ref: /schemas/types.yaml#/definitions/uint32

  ti,ssc-deltam:
    description: Spread spectrum delta M in permille (0.1%).
    $ref: /schemas/types.yaml#/definitions/uint32

  ti,ssc-modfreq-hz:
    description: Spread spectrum modulation frequency in Hz.

  ti,ssc-downspread:
    description: Enable downspread feature for spread spectrum clocking.
    type: boolean

required:
  - compatible
  - '#clock-cells'
  - clocks
  - reg

additionalProperties: false

examples:
  - |
    bus {
        #address-cells = <1>;
        #size-cells = <0>;
        dpll_core_ck@490 {
            compatible = "ti,omap4-dpll-core-clock";
            reg = <0x490>, <0x45c>, <0x488>, <0x468>;
            #clock-cells = <0>;
            clocks = <&sys_clkin_ck>, <&sys_clkin_ck>;
        };
    };

  - |
    bus {
        #address-cells = <1>;
        #size-cells = <0>;
        dpll_disp_ck@498 {
            compatible = "ti,am3-dpll-no-gate-clock";
            reg = <0x0498>, <0x0448>, <0x0454>, <0x044c>, <0x0450>;
            #clock-cells = <0>;
            clocks = <&sys_clkin_ck>, <&sys_clkin_ck>;
        };
    };
```
