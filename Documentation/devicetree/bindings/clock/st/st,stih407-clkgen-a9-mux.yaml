## Documentation/devicetree/bindings/clock/vt8500.yaml
```yaml
# SPDX-License-Identifier: (GPL-2.0-only OR BSD-2-Clause)
# Copyright 2025 Tony Prisk <linux@prisktech.co.nz>
%YAML 1.2
---
$id: http://devicetree.org/schemas/clock/vt8500.yaml#
$schema: http://devicetree.org/meta-schemas/core.yaml#

title: VT8500 Clock Controller

maintainers:
  - Tony Prisk <linux@prisktech.co.nz>

properties:
  compatible:
    description: Binding compatible strings
    items:
      - enum:
          - via,vt8500-pll-clock
          - wm,wm8650-pll-clock
          - wm,wm8750-pll-clock
          - wm,wm8850-pll-clock
          - via,vt8500-device-clock

  reg:
    description: Control register offset from PMC base for the PLL clock
    maxItems: 1

  clocks:
    maxItems: 1

  '#clock-cells':
    const: 0

  enable-reg:
    description: Register offset from PMC base for the enable register
    $ref: /schemas/types.yaml#/definitions/uint32

  enable-bit:
    description: Bit within enable-reg to enable or disable the clock
    $ref: /schemas/types.yaml#/definitions/uint32

  divisor-reg:
    description: Register offset from PMC base for the divisor register
    $ref: /schemas/types.yaml#/definitions/uint32

  divisor-mask:
    description: Mask for the divisor register
    default: 0x1f
    $ref: /schemas/types.yaml#/definitions/uint32

required:
  - compatible
  - clocks
  - '#clock-cells'

additionalProperties: false
```

## Documentation/devicetree/bindings/clock/xlnx,ps7-clkc.yaml
```yaml
# SPDX-License-Identifier: (GPL-2.0-only OR BSD-2-Clause)
%YAML 1.2
---
$id: http://devicetree.org/schemas/clock/xlnx,ps7-clkc.yaml#
$schema: http://devicetree.org/meta-schemas/core.yaml#

title: Xilinx Zynq-7000 PS Clock Controller

maintainers:
  - Josh Cartwright <josh.cartwright@ni.com>
  - Michal Simek <michal.simek@amd.com>
  - Soren Brinkmann <soren.brinkmann@xilinx.com>

description: |
  Device Tree Clock bindings for the Zynq 7000 EPP

  The Zynq EPP has several different clk providers, each with their own bindings.
  The purpose of this document is to document their usage.

  See clock_bindings.txt for more information on the generic clock bindings.
  See Chapter 25 of Zynq TRM for more information about Zynq clocks.

  The clock controller is a logical abstraction of Zynq's clock tree. It reads
  required input clock frequencies from the devicetree and acts as clock provider
  for all clock consumers of PS clocks.

properties:
  compatible:
    const: xlnx,ps7-clkc

  '#clock-cells':
    const: 1

  ps-clk-frequency:
    description: Frequency of the oscillator providing ps_clk in Hz.
    $ref: /schemas/types.yaml#/definitions/uint32

  reg:
    maxItems: 1

  clock-output-names:
    minItems: 1
    maxItems: 48
    items:
      enum:
        - armpll
        - ddrpll
        - iopll
        - cpu_6or4x
        - cpu_3or2x
        - cpu_2x
        - cpu_1x
        - ddr2x
        - ddr3x
        - dci
        - lqspi
        - smc
        - pcap
        - gem0
        - gem1
        - fclk0
        - fclk1
        - fclk2
        - fclk3
        - can0
        - can1
        - sdio0
        - sdio1
        - uart0
        - uart1
        - spi0
        - spi1
        - dma
        - usb0_aper
        - usb1_aper
        - gem0_aper
        - gem1_aper
        - sdio0_aper
        - sdio1_aper
        - spi0_aper
        - spi1_aper
        - can0_aper
        - can1_aper
        - i2c0_aper
        - i2c1_aper
        - uart0_aper
        - uart1_aper
        - gpio_aper
        - lqspi_aper
        - smc_aper
        - swdt
        - dbg_trc
        - dbg_apb

  fclk-enable:
    description: Bitmask to enable FCLKs statically at boot time; bits 0..3 map to FCLK0..FCLK3.
    $ref: /schemas/types.yaml#/definitions/uint32

  clocks:
    description: Optional phandle(s) to alternate clock providers.

  clock-names:
    description: Optional names for the clocks in the "clocks" property.

required:
  - compatible
  - '#clock-cells'
  - reg
  - ps-clk-frequency
  - clock-output-names

additionalProperties: false

examples:
  - |
    clock-controller@100 {
      #clock-cells = <1>;
      compatible = "xlnx,ps7-clkc";
      ps-clk-frequency = <33333333>;
      reg = <0x100 0x100>;
      clock-output-names = "armpll", "ddrpll", "iopll", "cpu_6or4x",
        "cpu_3or2x", "cpu_2x", "cpu_1x", "ddr2x", "ddr3x",
        "dci", "lqspi", "smc", "pcap", "gem0", "gem1",
        "fclk0", "fclk1", "fclk2", "fclk3", "can0", "can1",
        "sdio0", "sdio1", "uart0", "uart1", "spi0", "spi1",
        "dma", "usb0_aper", "usb1_aper", "gem0_aper",
        "gem1_aper", "sdio0_aper", "sdio1_aper",
        "spi0_aper", "spi1_aper", "can0_aper", "can1_aper",
        "i2c0_aper", "i2c1_aper", "uart0_aper", "uart1_aper",
        "gpio_aper", "lqspi_aper", "smc_aper", "swdt",
        "dbg_trc", "dbg_apb";
      clocks = <&clkc 16>, <&clk_foo>;
      clock-names = "gem1_emio_clk", "can_mio_clk_23";
      fclk-enable = <0xf>;
    };
```

## Documentation/devicetree/bindings/cpufreq/brcm,stb-avs-cpu-freq.yaml
```yaml
# SPDX-License-Identifier: (GPL-2.0-only OR BSD-2-Clause)
%YAML 1.2
---
$id: http://devicetree.org/schemas/cpufreq/brcm,stb-avs-cpu-freq.yaml#
$schema: http://devicetree.org/meta-schemas/core.yaml#

title: Broadcom AVS mailbox and interrupt registers

maintainers:
  - Markus Mayer <mmayer@broadcom.com>

description: |
  A total of three DT nodes are required. One node (brcm,avs-cpu-data-mem)
  references the mailbox register used to communicate with the AVS CPU[1]. The
  second node (brcm,avs-cpu-l2-intr) is required to trigger an interrupt on
  the AVS CPU. The interrupt tells the AVS CPU that it needs to process a
  command sent to it by a driver. Interrupting the AVS CPU is mandatory for
  commands to be processed.

  The interface also requires a reference to the AVS host interrupt controller,
  so a driver can react to interrupts generated by the AVS CPU whenever a command
  has been processed. See [2] for more information on the brcm,l2-intc node.

  [1] The AVS CPU is an independent co-processor that runs proprietary
      firmware. On some SoCs, this firmware supports DFS and DVFS in addition to
      Adaptive Voltage Scaling.

  [2] Documentation/devicetree/bindings/interrupt-controller/brcm,l2-intc.yaml

properties:
  compatible:
    oneOf:
      - items:
          - enum:
              - brcm,bcm7271-avs-cpu-data-mem
              - brcm,bcm7268-avs-cpu-data-mem
              - brcm,avs-cpu-data-mem
      - items:
          - const: brcm,avs-cpu-data-mem
      - items:
          - enum:
              - brcm,bcm7271-avs-cpu-l2-intr
              - brcm,bcm7268-avs-cpu-l2-intr
              - brcm,avs-cpu-l2-intr
      - items:
          - const: brcm,avs-cpu-l2-intr

  reg:
    maxItems: 1

  interrupts:
    maxItems: 1

  interrupt-names:
    items:
      - const: sw_intr

additionalProperties: false

examples:
  - |
    avs_host_l2_intc: interrupt-controller@f04d1200 {
        #interrupt-cells = <1>;
        compatible = "brcm,l2-intc";
        interrupt-parent = <&intc>;
        reg = <0xf04d1200 0x48>;
        interrupt-controller;
        interrupts = <0x0 0x19 0x0>;
        interrupt-names = "avs";
    };

    avs-cpu-data-mem@f04c4000 {
        compatible = "brcm,bcm7271-avs-cpu-data-mem",
                     "brcm,avs-cpu-data-mem";
        reg = <0xf04c4000 0x60>;
        interrupts = <0x1a>;
        interrupt-parent = <&avs_host_l2_intc>;
        interrupt-names = "sw_intr";
    };

    avs-cpu-l2-intr@f04d1100 {
        compatible = "brcm,bcm7271-avs-cpu-l2-intr",
                     "brcm,avs-cpu-l2-intr";
        reg = <0xf04d1100 0x10>;
    };
```

## Documentation/devicetree/bindings/cpufreq/cpufreq-dt.yaml
```yaml
# SPDX-License-Identifier: (GPL-2.0-only OR BSD-2-Clause)
# Copyright 2025 Linaro Ltd.
%YAML 1.2
---
$id: http://devicetree.org/schemas/cpufreq/cpufreq-dt.yaml#
$schema: http://devicetree.org/meta-schemas/core.yaml#

title: Generic cpufreq driver

maintainers:
  - Amit Kucheria <amit.kucheria@linaro.org>
  - Richard Genoud <richard.genoud@bootlin.com>
  - Rob Herring <robh@kernel.org>
  - Viresh Kumar <viresh.kumar@linaro.org>

description: |
  Generic cpufreq driver

  It is a generic DT based cpufreq driver for frequency management. It supports
  both uniprocessor (UP) and symmetric multiprocessor (SMP) systems which share
  clock and voltage across all CPUs.

  Both required and optional properties listed below must be defined
  under node /cpus/cpu@0.

properties:
  compatible:
    description: List of CPU compatible strings
    $ref: /schemas/types.yaml#/definitions/string-array

  reg:
    description: CPU index for cpufreq driver
    items:
      - description: CPU index

  next-level-cache:
    description: Phandle to the next-level cache node

  operating-points:
    description: |
      List of operating points as <frequency in kHz voltage in microvolts> pairs.
      Refer to Documentation/devicetree/bindings/opp/opp-v1.yaml for details.
      OPPs *must* be supplied either via DT or populated at runtime.
    items:
      - description: CPU frequency (kHz)
      - description: CPU voltage (µV)

  clock-latency:
    description: Maximum transition latency for clock in nanoseconds

  voltage-tolerance:
    description: CPU voltage tolerance in percentage

  '#cooling-cells':
    description: |
      Number of cooling cells; see Documentation/devicetree/bindings/thermal/thermal-cooling-devices.yaml

additionalProperties: false

examples:
  - |
    cpus {
        #address-cells = <1>;
        #size-cells = <0>;

        cpu@0 {
            compatible = "arm,cortex-a9";
            reg = <0>;
            next-level-cache = <&L2>;
            operating-points = <
                /* kHz    uV */
                792000  1100000
                396000  950000
                198000  850000
            >;
            clock-latency = <61036>; /* two CLK32 periods */
            #cooling-cells = <2>;
        };

        cpu@1 {
            compatible = "arm,cortex-a9";
            reg = <1>;
            next-level-cache = <&L2>;
        };

        cpu@2 {
            compatible = "arm,cortex-a9";
            reg = <2>;
            next-level-cache = <&L2>;
        };

        cpu@3 {
            compatible = "arm,cortex-a9";
            reg = <3>;
            next-level-cache = <&L2>;
        };
    };
```

## Documentation/devicetree/bindings/cpufreq/cpufreq-spear.yaml
```yaml
# SPDX-License-Identifier: (GPL-2.0-only OR BSD-2-Clause)
# Copyright 2025 STMicroelectronics

%YAML 1.2
---
$id: http://devicetree.org/schemas/cpufreq/cpufreq-spear.yaml#
$schema: http://devicetree.org/meta-schemas/core.yaml#

title: SPEAr cpufreq driver

maintainers:
  - Deepak Sikri <deepak.sikri@st.com>

description: |
  SPEAr SoC cpufreq driver for CPU frequency scaling.
  It supports both uniprocessor (UP) and symmetric multiprocessor (SMP) systems
  which share clock across all CPUs.

  Both required and optional properties listed above must be defined under node
  /cpus/cpu@0.

properties:
  compatible:
    items:
      - const: st,spear-cpufreq

  cpufreq_tbl:
    description: Table of frequencies CPU could be transitioned into, in the increasing order.
    $ref: /schemas/types.yaml#/definitions/uint32-array

  clock-latency:
    description: Specify the possible maximum transition latency for clock, in unit of nanoseconds.
    $ref: /schemas/types.yaml#/definitions/uint32

required:
  - compatible
  - cpufreq_tbl

additionalProperties: false
```

## Documentation/devicetree/bindings/cpufreq/cpufreq-st.yaml
```yaml
%YAML 1.2
---
$id: http://devicetree.org/schemas/cpufreq/cpufreq-st.yaml#
$schema: http://devicetree.org/meta-schemas/core.yaml#

title: ST CPUFreq driver

maintainers:
  - Lee Jones <lee@kernel.org>

description: |
  Binding for ST's CPUFreq driver

  ST's CPUFreq driver attempts to read 'process' and 'version' attributes
  from the SoC, then supplies the OPP framework with 'prop' and 'supported
  hardware' information respectively.  The framework is then able to read
  the DT and operate in the usual way.

properties:
  compatible:
    items:
      - const: st,cpufreq

  operating-points: true

  operating-points-v2: true

additionalProperties: false

examples:
  - |
    cpus {
      cpu@0 {
        /* kHz     uV   */
        operating-points = <1500000 0
                            1200000 0
                            800000  0
                            500000  0>;
      };
    };

  - |
    cpus {
      cpu@0 {
        operating-points-v2 = <&cpu0_opp_table>;
      };
    };

  - |
    cpu0_opp_table: opp_table {
        compatible = "operating-points-v2";

        /* ############################################################### */
        /* # WARNING: Do not attempt to copy/replicate these nodes,      # */
        /* #          they are only to be supplied by the bootloader !!! # */
        /* ############################################################### */
        opp0 {
            /*               Major       Minor       Substrate */
            /*               2           all         all         */
            opp-supported-hw      = <0x00000004  0xffffffff  0xffffffff>;
            opp-hz                = /bits/ 64 <1500000000>;
            clock-latency-ns      = <10000000>;

            opp-microvolt-pcode0  = <1200000>;
            opp-microvolt-pcode1  = <1200000>;
            opp-microvolt-pcode2  = <1200000>;
            opp-microvolt-pcode3  = <1200000>;
            opp-microvolt-pcode4  = <1170000>;
            opp-microvolt-pcode5  = <1140000>;
            opp-microvolt-pcode6  = <1100000>;
            opp-microvolt-pcode7  = <1070000>;
        };

        opp1 {
            /*               Major       Minor       Substrate */
            /*               all         all         all       */
            opp-supported-hw      = <0xffffffff  0xffffffff  0xffffffff>;
            opp-hz                = /bits/ 64 <1200000000>;
            clock-latency-ns      = <10000000>;

            opp-microvolt-pcode0  = <1110000>;
            opp-microvolt-pcode1  = <1150000>;
            opp-microvolt-pcode2  = <1100000>;
            opp-microvolt-pcode3  = <1080000>;
            opp-microvolt-pcode4  = <1040000>;
            opp-microvolt-pcode5  = <1020000>;
            opp-microvolt-pcode6  = <980000>;
            opp-microvolt-pcode7  = <930000>;
        };
    };
```

## Documentation/devicetree/bindings/cpufreq/nvidia,tegra124-cpufreq.yaml
```yaml
# SPDX-License-Identifier: (GPL-2.0-only OR BSD-2-Clause)
# Copyright 2025 NVIDIA Corporation
%YAML 1.2
---
$id: http://devicetree.org/schemas/cpufreq/nvidia,tegra124-cpufreq.yaml#
$schema: http://devicetree.org/meta-schemas/core.yaml#

title: Tegra124 CPU frequency scaling

maintainers:
  - Joseph Lo <josephl@nvidia.com>
  - Thierry Reding <treding@nvidia.com>

description: |
  Tegra124 CPU frequency scaling

  Both required and optional properties listed below must be defined
  under node /cpus/cpu@0.

properties:
  compatible:
    # Must match driver binding identifier
    items:
      - const: nvidia,tegra124-cpufreq

  clocks:
    description: Clock sources required for CPU frequency scaling.
    # Fixed order of required clocks
    items:
      - description: CPU cluster clock mux
      - description: Fast PLL clocksource
      - description: Auxiliary PLL used during fast PLL rate changes
      - description: Fast DFLL clocksource that also automatically scales CPU voltage

  clock-names:
    description: Names for each clock entry corresponding to the 'clocks' property.
    items:
      - const: cpu_g
      - const: pll_x
      - const: pll_p
      - const: dfll

  clock-latency:
    description: Specify the possible maximum transition latency for clock, in unit of nanoseconds.
    $ref: /schemas/types.yaml#/definitions/uint32

additionalProperties: false

required:
  - compatible
  - clocks
  - clock-names
```
