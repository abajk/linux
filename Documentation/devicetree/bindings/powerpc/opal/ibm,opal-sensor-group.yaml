## Documentation/devicetree/bindings/pwm/ti,pwm-tipwmss.yaml
```yaml
# SPDX-License-Identifier: (GPL-2.0-only OR BSD-2-Clause)
%YAML 1.2
---
$id: http://devicetree.org/schemas/pwm/ti,pwm-tipwmss.yaml#
$schema: http://devicetree.org/meta-schemas/core.yaml#

title: TI SOC based PWM Subsystem

maintainers:
  - Franklin S Cooper Jr <fcooper@ti.com>
  - Philip, Avinash <avinashphilip@ti.com>
  - Vignesh R <vigneshr@ti.com>

properties:
  compatible:
    oneOf:
      - items:
          - const: "ti,am33xx-pwmss"
      - items:
          - const: "ti,am4372-pwmss"
          - const: "ti,am33xx-pwmss"
      - items:
          - const: "ti,dra746-pwmss"
          - const: "ti,am33xx-pwmss"

  reg:
    maxItems: 1

  '#address-cells':
    const: 1

  '#size-cells':
    const: 1

  ranges:
    if:
      not:
        type: boolean
    then:
      items:
        - description: ECAP register space
        - description: EQEP register space
        - description: EHRPWM register space

  ti,hwmods:
    description: Hardware module identifier for this PWMSS instance
    $ref: /schemas/types.yaml#/definitions/string

required:
  - compatible
  - reg
  - '#address-cells'
  - '#size-cells'
  - ranges

additionalProperties: false

examples:
  - |
    epwmss0: epwmss@48300000 { /* PWMSS for am33xx */
      compatible = "ti,am33xx-pwmss";
      reg = <0x48300000 0x10>;
      ti,hwmods = "epwmss0";
      #address-cells = <1>;
      #size-cells = <1>;
      ranges = <0x48300100 0x48300100 0x80   /* ECAP */
                0x48300180 0x48300180 0x80   /* EQEP */
                0x48300200 0x48300200 0x80>; /* EHRPWM */

      /* child nodes go here */
    };

  - |
    epwmss0: epwmss@48300000 { /* PWMSS for am4372 */
      compatible = "ti,am4372-pwmss","ti,am33xx-pwmss";
      reg = <0x48300000 0x10>;
      ti,hwmods = "epwmss0";
      #address-cells = <1>;
      #size-cells = <1>;
      ranges = <0x48300100 0x48300100 0x80   /* ECAP */
                0x48300180 0x48300180 0x80   /* EQEP */
                0x48300200 0x48300200 0x80>; /* EHRPWM */

      /* child nodes go here */
    };

  - |
    epwmss0: epwmss@4843e000 { /* PWMSS for DRA7xx */
      compatible = "ti,dra746-pwmss", "ti,am33xx-pwmss";
      reg = <0x4843e000 0x30>;
      ti,hwmods = "epwmss0";
      #address-cells = <1>;
      #size-cells = <1>;
      ranges;

      /* child nodes go here */
    };
```

## Documentation/devicetree/bindings/pwm/ti,twl-pwm.yaml
```yaml
# SPDX-License-Identifier: (GPL-2.0-only OR BSD-2-Clause)
%YAML 1.2
---
$id: http://devicetree.org/schemas/pwm/ti,twl-pwm.yaml#
$schema: http://devicetree.org/meta-schemas/core.yaml#

title: Texas Instruments TWL PWM controller
maintainers:
  - Krzysztof Kozlowski <krzk@kernel.org>
  - Laurent Pinchart <laurent.pinchart+renesas@ideasonboard.com>
  - Peter Ujfalusi <peter.ujfalusi@ti.com>

description: |
  Texas Instruments TWL series PWM drivers

  Supported PWMs:
  On TWL4030 series: PWM1 and PWM2
  On TWL6030 series: PWM0 and PWM1

properties:
  compatible:
    items:
      - const: ti,twl4030-pwm
      - const: ti,twl6030-pwm

  "#pwm-cells":
    description: Number of PWM cells as defined in pwm.yaml.
    const: 2

required:
  - compatible
  - "#pwm-cells"

additionalProperties: false

examples:
  - |
    twl_pwm: pwm {
        compatible = "ti,twl6030-pwm";
        #pwm-cells = <2>;
    };
```

## Documentation/devicetree/bindings/pwm/ti,twl-pwmled.yaml
```yaml
# SPDX-License-Identifier: (GPL-2.0-only OR BSD-2-Clause)
# Copyright 2025 Krzysztof Kozlowski, Laurent Pinchart, Peter Ujfalusi
%YAML 1.2
---
$id: http://devicetree.org/schemas/pwm/ti,twl-pwmled.yaml#
$schema: http://devicetree.org/meta-schemas/core.yaml#

title: Texas Instruments TWL series PWMLED
maintainers:
  - Krzysztof Kozlowski <krzk@kernel.org>
  - Laurent Pinchart <laurent.pinchart+renesas@ideasonboard.com>
  - Peter Ujfalusi <peter.ujfalusi@ti.com>
description: |
  Texas Instruments TWL series PWM drivers connected to LED terminals

  Supported PWMs:
  On TWL4030 series: PWMA and PWMB (connected to LEDA and LEDB terminals)
  On TWL6030 series: LED PWM (mainly used as charging indicator LED)

properties:
  compatible:
    items:
      - enum:
          - ti,twl4030-pwmled
          - ti,twl6030-pwmled
  '#pwm-cells':
    description: Number of PWM cells; must be 2.
    const: 2

required:
  - compatible
  - '#pwm-cells'

additionalProperties: false

examples:
  - |
    twl_pwmled: pwmled {
        compatible = "ti,twl6030-pwmled";
        #pwm-cells = <2>;
    };
```

## Documentation/devicetree/bindings/regulator/ams,as3722.yaml
```yaml
%YAML 1.2
---
$id: http://devicetree.org/schemas/ams,as3722.yaml#
$schema: http://devicetree.org/meta-schemas/core.yaml#

title: AMS AS3722 PMIC regulator

maintainers:
  - Laxman Dewangan <ldewangan@nvidia.com>

description: |
  Regulator of AMS AS3722 PMIC.
  Name of the regulator subnode must be "regulators".

  Optional nodes:
  - regulators: Must contain a sub-node per regulator from the list below.
    Each sub-node should contain the constraints and initialization information for that regulator.
    See regulator.txt for a description of standard properties for these sub-nodes.
    Additional custom properties are listed below.

  sd[0-6], ldo[0-7], ldo[9-11].

properties:
  compatible:
    items:
      - const: ams,as3722

  reg:
    description: Register offset of the PMIC
    items:
      - description: Register address offset

  regulators:
    description: Container node for regulator supplies and subnodes
    type: object
    additionalProperties: false
    properties:
      vsup-sd2-supply:
        description: Input supply for SD2
      vsup-sd3-supply:
        description: Input supply for SD3
      vsup-sd4-supply:
        description: Input supply for SD4
      vsup-sd5-supply:
        description: Input supply for SD5
      vin-ldo0-supply:
        description: Input supply for LDO0
      vin-ldo1-6-supply:
        description: Input supply for LDO1 and LDO6
      vin-ldo2-5-7-supply:
        description: Input supply for LDO2, LDO5 and LDO7
      vin-ldo3-4-supply:
        description: Input supply for LDO3 and LDO4
      vin-ldo9-10-supply:
        description: Input supply for LDO9 and LDO10
      vin-ldo11-supply:
        description: Input supply for LDO11
    patternProperties:
      '^(sd[0-6]|ldo([0-7]|9|10|11))$':
        description: Configuration for each regulator sub-node
        type: object
        additionalProperties: false
        properties:
          regulator-name:
            description: Name of the regulator
            $ref: /schemas/types.yaml#/definitions/string
          regulator-min-microvolt:
            description: Minimum voltage this regulator can output
          regulator-max-microvolt:
            description: Maximum voltage this regulator can output
          regulator-always-on:
            description: The regulator is always on
            type: boolean
          ams,ext-control:
            description: |
              External control of the rail.
              Valid values: 0=no external control, 1=ENABLE1, 2=ENABLE2, 3=ENABLE3
            $ref: /schemas/types.yaml#/definitions/uint32
            enum: [0, 1, 2, 3]
          ams,enable-tracking:
            description: Enable tracking with SD1, only supported by LDO3
            type: boolean
        required:
          - regulator-name
          - regulator-min-microvolt
          - regulator-max-microvolt

required:
  - compatible
  - reg

additionalProperties: false

examples:
  - |
    pmic@40 {
      compatible = "ams,as3722";
      reg = <0x40>;

      regulators {
        vsup-sd2-supply = <&vdd_ddr>;
        vin-ldo3-4-supply = <&vdd_sys>;

        sd0 {
          regulator-name = "vdd_cpu";
          regulator-min-microvolt = <700000>;
          regulator-max-microvolt = <1400000>;
          regulator-always-on;
          ams,ext-control = <2>;
        };

        sd1 {
          regulator-name = "vdd_core";
          regulator-min-microvolt = <700000>;
          regulator-max-microvolt = <1400000>;
          regulator-always-on;
          ams,ext-control = <1>;
        };

        sd2 {
          regulator-name = "vddio_ddr";
          regulator-min-microvolt = <1350000>;
          regulator-max-microvolt = <1350000>;
          regulator-always-on;
        };

        ldo3 {
          regulator-name = "avdd-hdmi-pex";
          regulator-min-microvolt = <1050000>;
          regulator-max-microvolt = <1050000>;
          regulator-always-on;
          ams,enable-tracking;
        };
      };
    };
```

## Documentation/devicetree/bindings/regulator/arm,vexpress-volt.yaml
```yaml
# SPDX-License-Identifier: (GPL-2.0-only OR BSD-2-Clause)
# Copyright 2025 Linaro Ltd.
%YAML 1.2
---
$id: http://devicetree.org/schemas/regulator/arm,vexpress-volt.yaml#
$schema: http://devicetree.org/meta-schemas/core.yaml#

title: Versatile Express voltage regulators
maintainers:
  - Mauro Carvalho Chehab <mchehab@kernel.org>
  - Pawel Moll <pawel.moll@arm.com>

description: |
  Versatile Express voltage regulators

  See Documentation/devicetree/bindings/regulator/regulator.txt
  for more details about the regulator properties.

  When no "regulator-[min|max]-microvolt" properties are defined,
  the device is treated as fixed (or rather "read-only") regulator.

properties:
  compatible:
    items:
      - const: arm,vexpress-volt

  arm,vexpress-sysreg,func:
    description: A phandle to the sysreg controller and the function index for this regulator.
    $ref: /schemas/types.yaml#/definitions/phandle-array
    items:
      - description: Sysreg controller phandle
      - description: Function index and flags

  regulator-name:
    description: Unique name of this regulator.

  regulator-min-microvolt:
    description: Minimum voltage in microvolts supported by this regulator.

  regulator-max-microvolt:
    description: Maximum voltage in microvolts supported by this regulator.

  regulator-always-on:
    description: Request that the regulator always remain enabled.
    type: boolean

required:
  - compatible
  - regulator-name
  - regulator-always-on

additionalProperties: false

examples:
  - |
    volt@0 {
        compatible = "arm,vexpress-volt";
        arm,vexpress-sysreg,func = <2 0>;
        regulator-name = "Cores";
        regulator-min-microvolt = <800000>;
        regulator-max-microvolt = <1050000>;
        regulator-always-on;
    };
```

## Documentation/devicetree/bindings/regulator/dlg,da9211.yaml
```yaml
---
$id: http://devicetree.org/schemas/regulator/dlg,da9211.yaml#
$schema: http://devicetree.org/meta-schemas/core.yaml#

title: Dialog Semiconductor DA9211/DA9212/DA9213/DA9223/DA9214/DA9224/DA9215/DA9225 Voltage Regulator

maintainers:
  - Anand K Mistry <amistry@google.com>
  - James Ban <james.ban.opensource@diasemi.com>
  - James Ban <James.Ban.opensource@diasemi.com>

description: |
  Dialog Semiconductor DA9211/DA9212/DA9213/DA9223/DA9214/DA9224/DA9215/DA9225 Voltage Regulator

properties:
  compatible:
    items:
      - enum:
          - dlg,da9211
          - dlg,da9212
          - dlg,da9213
          - dlg,da9223
          - dlg,da9214
          - dlg,da9224
          - dlg,da9215
          - dlg,da9225

  reg:
    maxItems: 1

  interrupts:
    maxItems: 1

  regulators:
    description: |
      A node that houses a sub-node for each regulator within the
      device. Each sub-node is identified using the node's name, with valid
      values listed below. The content of each sub-node is defined by the
      standard binding for regulators; see regulator.txt.
    type: object
    additionalProperties: false
    properties:
      BUCKA:
        $ref: /schemas/regulator/regulator.yaml#
        unevaluatedProperties: false
      BUCKB:
        $ref: /schemas/regulator/regulator.yaml#
        unevaluatedProperties: false
    required:
      - BUCKA
      - BUCKB

  enable-gpios:
    description:
      platform gpio for control of BUCKA/BUCKB.

required:
  - compatible
  - reg
  - interrupts
  - regulators

additionalProperties: false

examples:
  - |
    pmic: da9211@68 {
        compatible = "dlg,da9211";
        reg = <0x68>;
        interrupts = <3 27>;

        regulators {
            BUCKA {
                regulator-name = "VBUCKA";
                regulator-min-microvolt = < 300000>;
                regulator-max-microvolt = <1570000>;
                regulator-min-microamp = <2000000>;
                regulator-max-microamp = <5000000>;
                enable-gpios = <&gpio 27 0>;
                regulator-allowed-modes = <DA9211_BUCK_MODE_SYNC
                                           DA9211_BUCK_MODE_AUTO>;
            };
        };
    };
```

## Documentation/devicetree/bindings/regulator/hisilicon,hi655x-regulator.yaml
```yaml
%YAML 1.2
---
$id: http://devicetree.org/schemas/regulator/hisilicon,hi655x-regulator.yaml#
$schema: http://devicetree.org/meta-schemas/core.yaml#

title: Hisilicon Hi655x Voltage regulators

maintainers:
  - Chen Feng <puck.chen@hisilicon.com>

description: |
  Hisilicon Hi655x Voltage regulators

  Note:
  The Hi655x regulator control is managed by Hi655x PMIC.
  So the node of this regulator must be child node of Hi655x
  PMIC node.

  The driver uses the regulator core framework, so please also
  take the bindings of regulator.txt for reference.

properties:
  compatible:
    items:
      - const: hisilicon,hi655x-regulator

  regulator-enable-ramp-delay:
    description: Ramp delay on enable in microseconds.
    $ref: /schemas/types.yaml#/definitions/uint32

  regulator-max-microvolt:
    description: Maximum output voltage in microvolts.

  regulator-min-microvolt:
    description: Minimum output voltage in microvolts.

  regulator-name:
    description: Name of the regulator.

required:
  - compatible
  - regulator-enable-ramp-delay
  - regulator-max-microvolt
  - regulator-min-microvolt
  - regulator-name

additionalProperties: false

examples:
  - |
    pmic@f8000000 {
      compatible = "hisilicon,hi655x-pmic";
      regulators {
        ldo2: LDO2@a21 {
          compatible = "hisilicon,hi655x-regulator";
          regulator-enable-ramp-delay = <120>;
          regulator-max-microvolt = <3200000>;
          regulator-min-microvolt = <2500000>;
          regulator-name = "LDO2_2V8";
        };
      };
    };
```
