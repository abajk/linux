## Documentation/devicetree/bindings/regulator/isil,isl9305.yaml
```yaml
# SPDX-License-Identifier: (GPL-2.0-only OR BSD-2-Clause)
# Copyright 2025 Arnaud Ebalard
# Copyright 2025 Mark Brown
%YAML 1.2
---
$id: http://devicetree.org/schemas/regulator/isil,isl9305.yaml#
$schema: http://devicetree.org/meta-schemas/core.yaml#

title: Intersil ISL9305/ISL9305H voltage regulator

maintainers:
  - Arnaud Ebalard <arno@natisbad.org>
  - Mark Brown <broonie@kernel.org>

description: |
  Intersil ISL9305/ISL9305H voltage regulator

properties:
  compatible:
    items:
      - enum:
          - isil,isl9305
          - isil,isl9305h

  reg:
    maxItems: 1

  regulators:
    description: Sub-node containing regulators for the device.
    type: object
    additionalProperties: false
    properties:
      dcd1:
        description: DCDC converter 1 regulator sub-node.
        $ref: /schemas/regulator/regulator.yaml#
        unevaluatedProperties: false
      dcd2:
        description: DCDC converter 2 regulator sub-node.
        $ref: /schemas/regulator/regulator.yaml#
        unevaluatedProperties: false
      ldo1:
        description: LDO regulator 1 sub-node.
        $ref: /schemas/regulator/regulator.yaml#
        unevaluatedProperties: false
      ldo2:
        description: LDO regulator 2 sub-node.
        $ref: /schemas/regulator/regulator.yaml#
        unevaluatedProperties: false
    required:
      - dcd1
      - dcd2
      - ldo1
      - ldo2

  VINDCD1-supply:
    description: Regulator supply phandle for VINDCD1.
  VINDCD2-supply:
    description: Regulator supply phandle for VINDCD2.
  VINLDO1-supply:
    description: Regulator supply phandle for VINLDO1.
  VINLDO2-supply:
    description: Regulator supply phandle for VINLDO2.

required:
  - compatible
  - reg
  - regulators

additionalProperties: false

examples:
  - |
    isl9305@68 {
        compatible = "isil,isl9305";
        reg = <0x68>;

        VINDCD1-supply = <&system_power>;
        VINDCD2-supply = <&system_power>;
        VINLDO1-supply = <&system_power>;
        VINLDO2-supply = <&system_power>;

        regulators {
            dcd1 {
                regulator-name = "VDD_DSP";
                regulator-always-on;
            };
        };
    };
```

## Documentation/devicetree/bindings/regulator/marvell,88pg867.yaml
```yaml
# SPDX-License-Identifier: (GPL-2.0-only OR BSD-2-Clause)
# Copyright 2025 Alexander Monakov

%YAML 1.2
---
$id: http://devicetree.org/schemas/regulator/marvell,88pg867.yaml#
$schema: http://devicetree.org/meta-schemas/core.yaml#

title: Marvell 88PG867/88PG868 voltage regulators

maintainers:
  - Alexander Monakov <amonakov@ispras.ru>

description: |
  Marvell 88PG867/88PG868 voltage regulators

properties:
  compatible:
    # Device compatible strings
    items:
      - enum:
          - marvell,88pg867
          - marvell,88pg868

  reg:
    # I2C slave address
    items:
      - description: I2C slave address

patternProperties:
  "^buck[12]$":
    description: Regulator subnode
    $ref: /schemas/regulator/regulator.yaml#

required:
  - compatible
  - reg

additionalProperties: false

examples:
  - |
    pg868@19 {
        compatible = "marvell,88pg868";
        reg = <0x19>;

        vcpu: buck1 {
            regulator-boot-on;
            regulator-always-on;
            regulator-min-microvolt = <1000000>;
            regulator-max-microvolt = <1350000>;
        };
    };
```

## Documentation/devicetree/bindings/regulator/marvell,88pm800.yaml
```yaml
# SPDX-License-Identifier: (GPL-2.0-only OR BSD-2-Clause)
%YAML 1.2
---
$id: http://devicetree.org/schemas/regulator/marvell,88pm800.yaml#
$schema: http://devicetree.org/meta-schemas/core.yaml#

title: Marvell 88PM800 regulator

maintainers:
  - Chao Xie <chao.xie@marvell.com>

description: |
  Marvell 88PM800 regulator

properties:
  compatible:
    description: Device compatible with marvell,88pm800
    items:
      - const: marvell,88pm800

  reg:
    description: I2C slave address
    items:
      - description: I2C slave address

  regulators:
    description: A node that houses a sub-node for each regulator within the device.
    type: object
    additionalProperties: false
    patternProperties:
      '^(buck[1-5]|ldo([1-9]|1[0-9]))$':
        $ref: /schemas/regulator/regulator.yaml

required:
  - compatible
  - reg
  - regulators

additionalProperties: false

examples:
  - |
    pmic: 88pm800@31 {
        compatible = "marvell,88pm800";
        reg = <0x31>;

        regulators {
            buck1 {
                regulator-min-microvolt = <600000>;
                regulator-max-microvolt = <3950000>;
                regulator-boot-on;
                regulator-always-on;
            };
            ldo1 {
                regulator-min-microvolt = <600000>;
                regulator-max-microvolt = <15000000>;
                regulator-boot-on;
                regulator-always-on;
            };
        };
    };
```

## Documentation/devicetree/bindings/regulator/marvell,88pm860x.yaml
```yaml
# SPDX-License-Identifier: (GPL-2.0-only OR BSD-2-Clause)
%YAML 1.2
---
$id: http://devicetree.org/schemas/regulator/marvell,88pm860x.yaml#
$schema: http://devicetree.org/meta-schemas/core.yaml#

title: Marvell 88PM860x regulator

maintainers:
  - Haojian Zhuang <haojian.zhuang@gmail.com>

properties:
  compatible:
    const: marvell,88pm860x

  reg:
    maxItems: 1

  regulators:
    description: A node containing each regulator sub-node for the device.
    type: object
    additionalProperties:
      $ref: /schemas/regulator/regulator.yaml#
      unevaluatedProperties: false
      properties:
        regulator-compatible:
          description: Identifier for the regulator sub-node.
          enum:
            - BUCK1
            - BUCK3
      required:
        - regulator-compatible
        - regulator-min-microvolt
        - regulator-max-microvolt

required:
  - compatible
  - reg
  - regulators

additionalProperties: false

examples:
  - |
    pmic: 88pm860x@34 {
        compatible = "marvell,88pm860x";
        reg = <0x34>;
        regulators {
            BUCK1 {
                regulator-min-microvolt = <1000000>;
                regulator-max-microvolt = <1500000>;
                regulator-boot-on;
                regulator-always-on;
            };
            BUCK3 {
                regulator-min-microvolt = <1000000>;
                regulator-max-microvolt = <3000000>;
                regulator-boot-on;
                regulator-always-on;
            };
        };
    };
```

## Documentation/devicetree/bindings/regulator/maxim,max1586.yaml
```yaml
# SPDX-License-Identifier: (GPL-2.0-only OR BSD-2-Clause)
# Copyright 2025 Robert Jarzmik <robert.jarzmik@free.fr>
%YAML 1.2
---
$id: http://devicetree.org/schemas/regulator/maxim,max1586.yaml#
$schema: http://devicetree.org/meta-schemas/core.yaml#

title: Maxim MAX1586 voltage regulator

maintainers:
  - Robert Jarzmik <robert.jarzmik@free.fr>

description: |
  Maxim MAX1586 voltage regulator

properties:
  compatible:
    # Only this compatible string is valid for this binding
    items:
      - const: maxim,max1586

  reg:
    description: I2C slave address of the device
    items:
      - description: I2C slave address

  v3-gain:
    description: integer specifying the V3 gain as per datasheet (1 + R24/R25 + R24/185.5kΩ)
    $ref: /schemas/types.yaml#/definitions/uint32

required:
  - compatible
  - reg
  - v3-gain

additionalProperties: false

examples:
  - |
    i2c_master {
        max1586@14 {
            compatible = "maxim,max1586";
            reg = <0x14>;
            v3-gain = <1000000>;

            regulators {
                vcc_core: v3 {
                    regulator-name = "vcc_core";
                    regulator-compatible = "Output_V3";
                    regulator-min-microvolt = <1000000>;
                    regulator-max-microvolt = <1705000>;
                    regulator-always-on;
                };
            };
        };
    };
```

## Documentation/devicetree/bindings/regulator/maxim,max8907.yaml
```yaml
# SPDX-License-Identifier: (GPL-2.0-only OR BSD-2-Clause)
# Copyright 2025 Maxim Integrated

%YAML 1.2
---
$id: http://devicetree.org/schemas/regulator/maxim,max8907.yaml#
$schema: http://devicetree.org/meta-schemas/core.yaml#

title: MAX8907 regulator

maintainers:
  - Gyungoh Yoo <jack.yoo@maxim-ic.com>
  - Stephen Warren <swarren@nvidia.com>

description: |
  MAX8907 regulator

  The valid names for regulators are:

    sd1, sd2, sd3, ldo1, ldo2, ldo3, ldo4, ldo5, ldo6, ldo7, ldo8, ldo9, ldo10,
    ldo11, ldo12, ldo13, ldo14, ldo15, ldo16, ldo17, ldo18, ldo19, ldo20, out5v,
    out33v, bbat, sdby, vrtc.

properties:
  compatible:
    items:
      - const: maxim,max8907

  reg:
    description: I2C slave address
    items:
      - description: I2C slave address

  interrupts:
    description: Interrupt output of the controller
    items:
      - description: Interrupt output of the controller

  mbatt-supply:
    description: The input supply for MBATT, BBAT, SDBY, VRTC

  in-v1-supply:
    description: The input supply for SD1

  in-v2-supply:
    description: The input supply for SD2

  in-v3-supply:
    description: The input supply for SD3

  in1-supply:
    description: The input supply for LDO1

  in2-supply:
    description: The input supply for LDO2

  in3-supply:
    description: The input supply for LDO3

  in4-supply:
    description: The input supply for LDO4

  in5-supply:
    description: The input supply for LDO5

  in6-supply:
    description: The input supply for LDO6

  in7-supply:
    description: The input supply for LDO7

  in8-supply:
    description: The input supply for LDO8

  in9-supply:
    description: The input supply for LDO9

  in10-supply:
    description: The input supply for LDO10

  in11-supply:
    description: The input supply for LDO11

  in12-supply:
    description: The input supply for LDO12

  in13-supply:
    description: The input supply for LDO13

  in14-supply:
    description: The input supply for LDO14

  in15-supply:
    description: The input supply for LDO15

  in16-supply:
    description: The input supply for LDO16

  in17-supply:
    description: The input supply for LDO17

  in18-supply:
    description: The input supply for LDO18

  in19-supply:
    description: The input supply for LDO19

  in20-supply:
    description: The input supply for LDO20

  maxim,system-power-controller:
    description: Boolean property indicating that the PMIC controls the overall system power
    type: boolean

  regulators:
    description: |
      A node that houses a sub-node for each regulator within the device. Each
      sub-node is identified using the node's name (or the deprecated
      regulator-compatible property if present), with valid values listed
      below. The content of each sub-node is defined by the standard binding
      for regulators; see regulator.txt
    type: object
    additionalProperties: false
    patternProperties:
      '^(sd[1-3]|ldo([1-9]|1[0-9]|20)|out5v|out33v|bbat|sdby|vrtc)$':
        $ref: /schemas/regulator/regulator.yaml#
        unevaluatedProperties: false


required:
  - compatible
  - reg
  - interrupts
  - mbatt-supply
  - in-v1-supply
  - in-v2-supply
  - in-v3-supply
  - in1-supply
  - in2-supply
  - in3-supply
  - in4-supply
  - in5-supply
  - in6-supply
  - in7-supply
  - in8-supply
  - in9-supply
  - in10-supply
  - in11-supply
  - in12-supply
  - in13-supply
  - in14-supply
  - in15-supply
  - in16-supply
  - in17-supply
  - in18-supply
  - in19-supply
  - in20-supply
  - regulators

additionalProperties: false

examples:
  - |
    max8907@3c {
        compatible = "maxim,max8907";
        reg = <0x3c>;
        interrupts = <0 86 0x4>;

        maxim,system-power-controller;

        mbatt-supply = <&some_reg>;
        in-v1-supply = <&mbatt_reg>;
        in-v2-supply = <&mbatt_reg>;
        in-v3-supply = <&mbatt_reg>;
        in1-supply = <&mbatt_reg>;
        ...
        in20-supply = <&mbatt_reg>;

        regulators {
            mbatt_reg: mbatt {
                regulator-name = "vbat_pmu";
                regulator-min-microvolt = <5000000>;
                regulator-max-microvolt = <5000000>;
                regulator-always-on;
            };

            sd1 {
                regulator-name = "nvvdd_sv1,vdd_cpu_pmu";
                regulator-min-microvolt = <1000000>;
                regulator-max-microvolt = <1000000>;
                regulator-always-on;
            };

            sd2 {
                regulator-name = "nvvdd_sv2,vdd_core";
                regulator-min-microvolt = <1200000>;
                regulator-max-microvolt = <1200000>;
                regulator-always-on;
            };
            ...
        };
    };
```

## Documentation/devicetree/bindings/regulator/mediatek,mt6311-regulator.yaml
```yaml
# SPDX-License-Identifier: (GPL-2.0-only OR BSD-2-Clause)
# Copyright 2025 MediaTek Inc.
%YAML 1.2
---
$id: http://devicetree.org/schemas/regulator/mediatek,mt6311-regulator.yaml#
$schema: http://devicetree.org/meta-schemas/core.yaml#

title: Mediatek MT6311 Regulator

maintainers:
  - Henry Chen <henryc.chen@mediatek.com>
  - Sean Wang <sean.wang@mediatek.com>

description: |
  Mediatek MT6311 Regulator

  The valid names for regulators are:
  BUCK:
    VDVFS
  LDO:
    VBIASN

properties:
  compatible:
    description: Device compatible string
    items:
      - const: mediatek,mt6311-regulator

  reg:
    description: I2C slave address of the PMIC on the bus
    items:
      - description: I2C slave address

  regulators:
    description: Regulators provided by this controller
    type: object
    additionalProperties: false
    properties:
      VDVFS:
        description: DVFS buck regulator channel
        type: object
        $ref: /schemas/regulator/regulator.yaml#
      VBIASN:
        description: Bias LDO regulator channel
        type: object
        $ref: /schemas/regulator/regulator.yaml#
    required:
      - VDVFS
      - VBIASN

required:
  - compatible
  - reg
  - regulators

additionalProperties: false

examples:
  - |
    mt6311: pmic@6b {
        compatible = "mediatek,mt6311-regulator";
        reg = <0x6b>;
        regulators {
            mt6311_vcpu_reg: VDVFS {
                regulator-name = "VDVFS";
                regulator-min-microvolt = <600000>;
                regulator-max-microvolt = <1400000>;
                regulator-ramp-delay = <10000>;
            };
            mt6311_ldo_reg: VBIASN {
                regulator-name = "VBIASN";
                regulator-min-microvolt = <200000>;
                regulator-max-microvolt = <800000>;
            };
        };
    };
```
