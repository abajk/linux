## Documentation/devicetree/bindings/regulator/mediatek,mt6380-regulator.yaml
```yaml
# SPDX-License-Identifier: (GPL-2.0-only OR BSD-2-Clause)
# Copyright 2025 MediaTek Inc.
%YAML 1.2
---
$id: http://devicetree.org/schemas/mediatek,mt6380-regulator.yaml#
$schema: http://devicetree.org/meta-schemas/core.yaml#

title: MediaTek MT6380 Regulator

maintainers:
  - Sean Wang <sean.wang@mediatek.com>

description: |
  All voltage regulators provided by the MT6380 PMIC are described as the
  subnodes of the MT6380 regulators node. Each regulator is named according
  to its regulator type, buck-<name> and ldo-<name>. The definition for each
  of these nodes is defined using the standard binding for regulators at
  Documentation/devicetree/bindings/regulator/regulator.yaml.

properties:
  compatible:
    const: mediatek,mt6380-regulator
    description: Must be "mediatek,mt6380-regulator".

  buck-core1:
    type: object
    description: Core1 buck regulator.
    additionalProperties: false
    properties:
      regulator-name:
        description: Override name of the regulator.
        $ref: /schemas/types.yaml#/definitions/string
      regulator-min-microvolt:
        description: Minimum voltage in microvolts.
      regulator-max-microvolt:
        description: Maximum voltage in microvolts.
      regulator-ramp-delay:
        description: Voltage ramp delay (microvolts per microsecond).
        $ref: /schemas/types.yaml#/definitions/uint32
      regulator-always-on:
        description: Whether the regulator is always on.
        type: boolean
      regulator-boot-on:
        description: Whether the regulator is enabled at boot.
        type: boolean
    required:
      - regulator-min-microvolt
      - regulator-max-microvolt
      - regulator-ramp-delay

  buck-vcore:
    type: object
    description: Core buck regulator.
    additionalProperties: false
    properties:
      regulator-name:
        description: Override name of the regulator.
        $ref: /schemas/types.yaml#/definitions/string
      regulator-min-microvolt:
        description: Minimum voltage in microvolts.
      regulator-max-microvolt:
        description: Maximum voltage in microvolts.
      regulator-ramp-delay:
        description: Voltage ramp delay (microvolts per microsecond).
        $ref: /schemas/types.yaml#/definitions/uint32
      regulator-always-on:
        description: Whether the regulator is always on.
        type: boolean
      regulator-boot-on:
        description: Whether the regulator is enabled at boot.
        type: boolean
    required:
      - regulator-min-microvolt
      - regulator-max-microvolt
      - regulator-ramp-delay

  buck-vrf:
    type: object
    description: VRF buck regulator.
    additionalProperties: false
    properties:
      regulator-name:
        description: Override name of the regulator.
        $ref: /schemas/types.yaml#/definitions/string
      regulator-min-microvolt:
        description: Minimum voltage in microvolts.
      regulator-max-microvolt:
        description: Maximum voltage in microvolts.
      regulator-ramp-delay:
        description: Voltage ramp delay (microvolts per microsecond).
        $ref: /schemas/types.yaml#/definitions/uint32
      regulator-always-on:
        description: Whether the regulator is always on.
        type: boolean
      regulator-boot-on:
        description: Whether the regulator is enabled at boot.
        type: boolean
    required:
      - regulator-min-microvolt
      - regulator-max-microvolt
      - regulator-ramp-delay

  ldo-vm:
    type: object
    description: VM LDO regulator.
    additionalProperties: false
    properties:
      regulator-name:
        description: Override name of the regulator.
        $ref: /schemas/types.yaml#/definitions/string
      regulator-min-microvolt:
        description: Minimum voltage in microvolts.
      regulator-max-microvolt:
        description: Maximum voltage in microvolts.
      regulator-ramp-delay:
        description: Voltage ramp delay (microvolts per microsecond).
        $ref: /schemas/types.yaml#/definitions/uint32
      regulator-always-on:
        description: Whether the regulator is always on.
        type: boolean
      regulator-boot-on:
        description: Whether the regulator is enabled at boot.
        type: boolean
    required:
      - regulator-min-microvolt
      - regulator-max-microvolt
      - regulator-ramp-delay

  ldo-va:
    type: object
    description: VA LDO regulator.
    additionalProperties: false
    properties:
      regulator-name:
        description: Override name of the regulator.
        $ref: /schemas/types.yaml#/definitions/string
      regulator-min-microvolt:
        description: Minimum voltage in microvolts.
      regulator-max-microvolt:
        description: Maximum voltage in microvolts.
      regulator-ramp-delay:
        description: Voltage ramp delay (microvolts per microsecond).
        $ref: /schemas/types.yaml#/definitions/uint32
      regulator-always-on:
        description: Whether the regulator is always on.
        type: boolean
      regulator-boot-on:
        description: Whether the regulator is enabled at boot.
        type: boolean
    required:
      - regulator-min-microvolt
      - regulator-max-microvolt
      - regulator-ramp-delay

  ldo-vphy:
    type: object
    description: VPHY LDO regulator.
    additionalProperties: false
    properties:
      regulator-name:
        description: Override name of the regulator.
        $ref: /schemas/types.yaml#/definitions/string
      regulator-min-microvolt:
        description: Minimum voltage in microvolts.
      regulator-max-microvolt:
        description: Maximum voltage in microvolts.
      regulator-ramp-delay:
        description: Voltage ramp delay (microvolts per microsecond).
        $ref: /schemas/types.yaml#/definitions/uint32
      regulator-always-on:
        description: Whether the regulator is always on.
        type: boolean
      regulator-boot-on:
        description: Whether the regulator is enabled at boot.
        type: boolean
    required:
      - regulator-min-microvolt
      - regulator-max-microvolt
      - regulator-ramp-delay

  ldo-vddr:
    type: object
    description: VDDR LDO regulator.
    additionalProperties: false
    properties:
      regulator-name:
        description: Override name of the regulator.
        $ref: /schemas/types.yaml#/definitions/string
      regulator-min-microvolt:
        description: Minimum voltage in microvolts.
      regulator-max-microvolt:
        description: Maximum voltage in microvolts.
      regulator-ramp-delay:
        description: Voltage ramp delay (microvolts per microsecond).
        $ref: /schemas/types.yaml#/definitions/uint32
      regulator-always-on:
        description: Whether the regulator is always on.
        type: boolean
      regulator-boot-on:
        description: Whether the regulator is enabled at boot.
        type: boolean
    required:
      - regulator-min-microvolt
      - regulator-max-microvolt
      - regulator-ramp-delay

  ldo-vt:
    type: object
    description: VT LDO regulator.
    additionalProperties: false
    properties:
      regulator-name:
        description: Override name of the regulator.
        $ref: /schemas/types.yaml#/definitions/string
      regulator-min-microvolt:
        description: Minimum voltage in microvolts.
      regulator-max-microvolt:
        description: Maximum voltage in microvolts.
      regulator-ramp-delay:
        description: Voltage ramp delay (microvolts per microsecond).
        $ref: /schemas/types.yaml#/definitions/uint32
      regulator-always-on:
        description: Whether the regulator is always on.
        type: boolean
      regulator-boot-on:
        description: Whether the regulator is enabled at boot.
        type: boolean
    required:
      - regulator-min-microvolt
      - regulator-max-microvolt
      - regulator-ramp-delay

required:
  - compatible

additionalProperties: false

examples:
  - |
    regulators {
      compatible = "mediatek,mt6380-regulator";

      buck-core1 {
        regulator-name = "vcore1";
        regulator-min-microvolt = <600000>;
        regulator-max-microvolt = <1393750>;
        regulator-ramp-delay = <6250>;
        regulator-always-on;
        regulator-boot-on;
      };

      buck-vcore {
        regulator-name = "vcore";
        regulator-min-microvolt = <600000>;
        regulator-max-microvolt = <1393750>;
        regulator-ramp-delay = <6250>;
      };

      buck-vrf {
        regulator-name = "vrf";
        regulator-min-microvolt = <1200000>;
        regulator-max-microvolt = <1575000>;
        regulator-ramp-delay = <0>;
        regulator-always-on;
        regulator-boot-on;
      };

      ldo-vm {
        regulator-name = "vm";
        regulator-min-microvolt = <1050000>;
        regulator-max-microvolt = <1400000>;
        regulator-ramp-delay = <0>;
        regulator-always-on;
        regulator-boot-on;
      };

      ldo-va {
        regulator-name = "va";
        regulator-min-microvolt = <2200000>;
        regulator-max-microvolt = <3300000>;
        regulator-ramp-delay = <0>;
        regulator-always-on;
        regulator-boot-on;
      };

      ldo-vphy {
        regulator-name = "vphy";
        regulator-min-microvolt = <1800000>;
        regulator-max-microvolt = <1800000>;
        regulator-ramp-delay = <0>;
        regulator-always-on;
        regulator-boot-on;
      };

      ldo-vddr {
        regulator-name = "vddr";
        regulator-min-microvolt = <1240000>;
        regulator-max-microvolt = <1840000>;
        regulator-ramp-delay = <0>;
        regulator-always-on;
        regulator-boot-on;
      };

      ldo-vt {
        regulator-name = "vt";
        regulator-min-microvolt = <2200000>;
        regulator-max-microvolt = <3300000>;
        regulator-ramp-delay = <0>;
        regulator-always-on;
        regulator-boot-on;
      };
    };
```
