## Documentation/devicetree/bindings/powerpc/opal/ibm,opal-sensor-group.yaml
```yaml
# SPDX-License-Identifier: (GPL-2.0-only OR BSD-2-Clause)
# Copyright 2025 IBM
%YAML 1.2
---
$id: http://devicetree.org/schemas/powerpc/opal/ibm,opal-sensor-group.yaml#
$schema: http://devicetree.org/meta-schemas/core.yaml#

title: IBM OPAL Sensor Groups

maintainers:
  - Shilpasri G Bhat <shilpa.bhat@linux.vnet.ibm.com>

description: |
  Node: /ibm,opal/sensor-groups

  Contains sensor groups available in the Powernv P9 servers. Each child node indicates a sensor group.

properties:
  compatible:
    items:
      - const: ibm,opal-sensor-group

  "type":
    description: String to indicate the type of sensor-group.
    $ref: /schemas/types.yaml#/definitions/string

  sensor-group-id:
    description: >
      Abstract unique identifier provided by firmware for sensor-group
      operations like clearing the min/max history of all sensors
      belonging to the group.
    $ref: /schemas/types.yaml#/definitions/uint32

  ibm,chip-id:
    description: Chip ID.
    $ref: /schemas/types.yaml#/definitions/uint32

  sensors:
    description: Phandle array of child nodes of /ibm/opal/sensor/ belonging to this group.
    $ref: /schemas/types.yaml#/definitions/phandle-array

  ops:
    description: >
      Array of OPAL call numbers indicating available operations on sensor
      groups like clearing min/max, enabling/disabling sensor group.
    $ref: /schemas/types.yaml#/definitions/uint32-array

required:
  - compatible
  - type
  - sensor-group-id
  - ibm,chip-id
  - sensors
  - ops

additionalProperties: false

examples:
  - |
    sensor-group@0 {
      compatible = "ibm,opal-sensor-group";
      type = "temperature";
      sensor-group-id = <0x0>;
      ibm,chip-id = <0x1>;
      sensors = <&sensor0>, <&sensor1>;
      ops = <10>, <11>;
    };
```

## Documentation/devicetree/bindings/ptp/brcm,ptp-dte.yaml
```yaml
# SPDX-License-Identifier: (GPL-2.0-only OR BSD-2-Clause)
# Copyright 2018 Linaro Ltd.
%YAML 1.2
---
$id: http://devicetree.org/schemas/brcm,ptp-dte.yaml#
$schema: http://devicetree.org/meta-schemas/core.yaml#

title: Broadcom Digital Timing Engine(DTE) based PTP clock

maintainers:
  - Arun Parameswaran <arun.parameswaran@broadcom.com>
  - Rob Herring <robh@kernel.org>

description: |
  * Broadcom Digital Timing Engine(DTE) based PTP clock

properties:
  compatible:
    oneOf:
      - items:
          - enum:
              - brcm,iproc-ptp-dte
          - const: brcm,ptp-dte
      - items:
          - const: brcm,ptp-dte

  reg:
    description: Address and length of the DTE block’s NCO registers.
    items:
      - description: Register base address
      - description: Register length

required:
  - compatible
  - reg

additionalProperties: false

examples:
  - |
    ptp: ptp-dte@180af650 {
        compatible = "brcm,iproc-ptp-dte", "brcm,ptp-dte";
        reg = <0x180af650 0x10>;
    };
```

## Documentation/devicetree/bindings/ptp/ines,ptp-ctrl.yaml
```yaml
# SPDX-License-Identifier: (GPL-2.0-only OR BSD-2-Clause)
# Copyright 2025 Richard Cochran <richardcochran@gmail.com>
%YAML 1.2
---
$id: http://devicetree.org/schemas/ptp/ines,ptp-ctrl.yaml#
$schema: http://devicetree.org/meta-schemas/core.yaml#

title: "ines,ptp-ctrl"

maintainers:
  - Richard Cochran <richardcochran@gmail.com>

description: |
  Time stamps from MII bus snooping devices

  This binding supports non-PHY devices that snoop the MII bus and
  provide time stamps.  In contrast to PHY time stamping drivers (which
  can simply attach their interface directly to the PHY instance), stand
  alone MII time stamping drivers use this binding to specify the
  connection between the snooping device and a given network interface.

  Non-PHY MII time stamping drivers typically talk to the control
  interface over another bus like I2C, SPI, UART, or via a memory mapped
  peripheral.  This controller device is associated with one or more
  time stamping channels, each of which snoops on a MII bus.

  The "timestamper" property lives in a phy node and links a time
  stamping channel from the controller device to that phy's MII bus.

properties:
  compatible:
    description: |
      Identifies this node as a non-PHY MII time stamping controller.
    items:
      - const: "ines,ptp-ctrl"
  reg:
    description: |
      Register address and size of the time stamping channel:
    items:
      - description: Base address of the controller
      - description: Size of the register block in bytes
  timestamper:
    description: |
      A property in a PHY node linking to a time stamping channel
      exposed by the controller. The first cell is a phandle to the
      controller, the second cell is the zero-based channel index.
    $ref: /schemas/types.yaml#/definitions/phandle-array
    items:
      - description: Controller phandle
      - description: Time stamping channel index

additionalProperties: false

examples:
  - |
    timestamper@10000000 {
        compatible = "ines,ptp-ctrl";
        reg = <0x10000000 0x80>;
    };

    ethernet@20000000 {
        mdio {
            ethernet-phy@1 {
                timestamper = <&timestamper 0>;
            };
        };
    };

    ethernet@30000000 {
        mdio {
            ethernet-phy@2 {
                timestamper = <&timestamper 1>;
            };
        };
    };
```

## Documentation/devicetree/bindings/pwm/cirrus,ep7209-pwm.yaml
```yaml
# SPDX-License-Identifier: (GPL-2.0-only OR BSD-2-Clause)
# Copyright 2025 Alexander Shiyan <shc_work@mail.ru>
%YAML 1.2
---
$id: http://devicetree.org/schemas/pwm/cirrus,ep7209-pwm.yaml#
$schema: http://devicetree.org/meta-schemas/core.yaml#

title: Cirris Logic CLPS711X PWM controller

maintainers:
  - Alexander Shiyan <shc_work@mail.ru>

description: |
  Cirris Logic CLPS711X PWM controller

properties:
  compatible:
    oneOf:
      - items:
          - enum:
              - cirrus,ep7312-pwm
          - const: cirrus,ep7209-pwm
      - items:
          - const: cirrus,ep7209-pwm

  reg:
    description: Physical base address and length of the controller's registers.
    items:
      - description: Base address
      - description: Size

  clocks:
    description: PWM reference clock.
    maxItems: 1

  '#pwm-cells':
    description: Cell specifies the index of the PWM channel.
    const: 1

required:
  - compatible
  - reg
  - clocks
  - '#pwm-cells'

additionalProperties: false

examples:
  - |
    pwm: pwm@80000400 {
        compatible = "cirrus,ep7312-pwm", "cirrus,ep7209-pwm";
        reg = <0x80000400 0x4>;
        clocks = <&clks 8>;
        #pwm-cells = <1>;
    };
```

## Documentation/devicetree/bindings/pwm/hisilicon,hi3516cv300-pwm.yaml
```yaml
# SPDX-License-Identifier: (GPL-2.0-only OR BSD-2-Clause)
%YAML 1.2
---
$id: http://devicetree.org/schemas/pwm/hisilicon,hi3516cv300-pwm.yaml#
$schema: http://devicetree.org/meta-schemas/core.yaml#
title: Hisilicon PWM controller
maintainers:
  - Krzysztof Kozlowski <krzk@kernel.org>
  - Mathieu Othacehe <othacehe@gnu.org>
  - yuanjian <yuanjian12@hisilicon.com>
description: |
  Hisilicon PWM controller

properties:
  compatible:
    description: SoC specific compatible string
    items:
      - enum:
          - hisilicon,hi3516cv300-pwm
          - hisilicon,hi3519v100-pwm
          - hisilicon,hi3559v100-shub-pwm
          - hisilicon,hi3559v100-pwm
  reg:
    description: Physical base address and length of the controller's registers.
    items:
      - description: Base address of the register region
      - description: Size of the register region
  clocks:
    description: PWM reference clock
    maxItems: 1
  resets:
    description: PWM controller reset
    maxItems: 1
  '#pwm-cells':
    description: Number of cells used to specify PWM operations
    const: 3

required:
  - compatible
  - reg
  - clocks
  - resets
  - '#pwm-cells'

additionalProperties: false

examples:
  - |
    pwm: pwm@12130000 {
        compatible = "hisilicon,hi3516cv300-pwm";
        reg = <0x12130000 0x10000>;
        clocks = <&crg_ctrl HI3516CV300_PWM_CLK>;
        resets = <&crg_ctrl 0x38 0>;
        #pwm-cells = <3>;
    };
```

## Documentation/devicetree/bindings/pwm/img-pistachio-pwm.yaml
```yaml
# SPDX-License-Identifier: (GPL-2.0-only OR BSD-2-Clause)
%YAML 1.2
---
$id: http://devicetree.org/schemas/pwm/img-pistachio-pwm.yaml#
$schema: http://devicetree.org/meta-schemas/core.yaml#

title: img,pistachio-pwm
maintainers:
  - Krzysztof Kozlowski <krzk@kernel.org>
  - Naidu Tellapati <naidu.tellapati@gmail.com>

description: |
  *Imagination Technologies PWM DAC driver

properties:
  compatible:
    items:
      - const: img,pistachio-pwm

  reg:
    items:
      - description: Physical base address of PWM registers
      - description: Length of PWM registers

  clocks:
    items:
      - description: PWM operating clock
      - description: PWM system interface clock

  clock-names:
    items:
      - const: pwm
      - const: sys

  '#pwm-cells':
    const: 2

  img,cr-periph:
    description: |
      Must contain a phandle to the peripheral control syscon node which contains
      PWM control registers
    $ref: /schemas/types.yaml#/definitions/phandle

required:
  - compatible
  - reg
  - clocks
  - clock-names
  - '#pwm-cells'
  - img,cr-periph

additionalProperties: false

examples:
  - |
    pwm: pwm@18101300 {
        compatible = "img,pistachio-pwm";
        reg = <0x18101300 0x100>;
        clocks = <&pwm_clk>, <&system_clk>;
        clock-names = "pwm", "sys";
        #pwm-cells = <2>;
        img,cr-periph = <&cr_periph>;
    };
```

## Documentation/devicetree/bindings/pwm/nxp,pca9685-pwm.yaml
```yaml
# SPDX-License-Identifier: (GPL-2.0-only OR BSD-2-Clause)
# Copyright 2025 NXP Semiconductors
%YAML 1.2
---
$id: http://devicetree.org/schemas/nxp,pca9685-pwm.yaml#
$schema: http://devicetree.org/meta-schemas/core.yaml#

title: NXP PCA9685 16-channel 12-bit PWM LED controller

maintainers:
  - Krzysztof Kozlowski <krzk@kernel.org>
  - Laurent Pinchart <laurent.pinchart+renesas@ideasonboard.com>
  - Steffen Trumtrar <s.trumtrar@pengutronix.de>

description: |
  NXP PCA9685 16-channel 12-bit PWM LED controller

properties:
  compatible:
    items:
      - enum:
          - nxp,pca9685-pwm

  "#pwm-cells":
    description: |
      Should be 2. See pwm.yaml in this directory for a description of
      the cells format.
      The index 16 is the ALLCALL channel, that sets all PWM channels at the same
      time.
    const: 2

  reg:
    items:
      - description: PWM controller register address

  invert:
    type: boolean
    description: Boolean to enable inverted logic

  open-drain:
    type: boolean
    description: Boolean to configure outputs with open-drain structure; if omitted use totem-pole structure

required:
  - compatible
  - "#pwm-cells"

additionalProperties: false

examples:
  - |
    For LEDs that are directly connected to the PCA, the following setting is
    applicable:

    pca: pca@41 {
        compatible = "nxp,pca9685-pwm";
        #pwm-cells = <2>;
        reg = <0x41>;
        invert;
        open-drain;
    };
```

## Documentation/devicetree/bindings/pwm/spear-pwm.yaml
```yaml
# SPDX-License-Identifier: (GPL-2.0-only OR BSD-2-Clause)
%YAML 1.2
---
$id: http://devicetree.org/schemas/pwm/spear-pwm.yaml#
$schema: http://devicetree.org/meta-schemas/core.yaml#

title: ST SPEAr SoC PWM controller

maintainers:
  - Krzysztof Kozlowski <krzk@kernel.org>
  - Laurent Pinchart <laurent.pinchart+renesas@ideasonboard.com>
  - Shiraz Hashim <shiraz.linux.kernel@gmail.com>

description: |
  ST SPEAr SoC PWM controller

  Required properties:
  - compatible: should be one of: "st,spear320-pwm", "st,spear1340-pwm"
  - reg: physical base address and length of the controller's registers
  - #pwm-cells: should be 2. See pwm.yaml in this directory for a description of the cells format.

properties:
  compatible:
    items:
      - enum:
          - st,spear320-pwm
          - st,spear1340-pwm

  reg:
    description: Physical base address and length of the controller's registers
    items:
      - description: Base address of the PWM registers
      - description: Size of the PWM register region in bytes

  '#pwm-cells':
    const: 2

required:
  - compatible
  - reg
  - '#pwm-cells'

additionalProperties: false

examples:
  - |
    pwm: pwm@a8000000 {
        compatible = "st,spear320-pwm";
        reg = <0xa8000000 0x1000>;
        #pwm-cells = <2>;
    };
```

## Documentation/devicetree/bindings/pwm/st,pwm.yaml
```yaml
# SPDX-License-Identifier: (GPL-2.0-only OR BSD-2-Clause)
%YAML 1.2
---
$id: http://devicetree.org/schemas/pwm/st,pwm.yaml#
$schema: http://devicetree.org/meta-schemas/core.yaml#

title: STMicroelectronics PWM controller
maintainers:
  - Lee Jones <lee@kernel.org>

description: |
  STMicroelectronics PWM driver bindings

properties:
  compatible:
    description: Must be "st,pwm".
    const: "st,pwm"

  reg:
    description: Physical base address and length of the controller's registers.
    items:
      - description: Base address
      - description: Size of register region

  "#pwm-cells":
    description: |
      Number of cells used to specify a PWM.
      First cell is the per-chip index, second is the period in nanoseconds.
    const: 2

  pinctrl-names:
    items:
      - const: default

  pinctrl-0:
    description: Phandles to pin configuration nodes for the PWM module.
    $ref: /schemas/types.yaml#/definitions/phandle-array

  clock-names:
    items:
      - const: pwm
      - const: capture

  clocks:
    description: Phandles to the clocks used by the PWM module.
    $ref: /schemas/types.yaml#/definitions/phandle-array

  interrupts:
    description: IRQ for the capture device.
    items:
      - description: Capture interrupt number

  st,pwm-num-chan:
    description: Number of available PWM channels.
    $ref: /schemas/types.yaml#/definitions/uint32
    default: 0

  st,capture-num-chan:
    description: Number of available Capture channels.
    $ref: /schemas/types.yaml#/definitions/uint32
    default: 0

required:
  - compatible
  - reg
  - "#pwm-cells"
  - pinctrl-names
  - pinctrl-0
  - clock-names
  - clocks
  - interrupts

additionalProperties: false

examples:
  - |
    pwm1: pwm@fe510000 {
      compatible = "st,pwm";
      reg = <0xfe510000 0x68>;
      #pwm-cells = <2>;
      pinctrl-names = "default";
      pinctrl-0 = <&pinctrl_pwm1_chan0_default
                   &pinctrl_pwm1_chan1_default
                   &pinctrl_pwm1_chan2_default
                   &pinctrl_pwm1_chan3_default>;
      clocks = <&clk_sysin>;
      clock-names = "pwm";
      st,pwm-num-chan = <4>;
      st,capture-num-chan = <2>;
    };
```

## Documentation/devicetree/bindings/pwm/st,stmpe-pwm.yaml
```yaml
# SPDX-License-Identifier: (GPL-2.0-only OR BSD-2-Clause)
%YAML 1.2
---
$id: http://devicetree.org/schemas/pwm/st,stmpe-pwm.yaml#
$schema: http://devicetree.org/meta-schemas/core.yaml#

title: ST STMPE PWM controller

maintainers:
  - Krzysztof Kozlowski <krzk@kernel.org>
  - Linus Walleij <linus.walleij@linaro.org>

description: |
  This is a PWM block embedded in the ST Microelectronics STMPE
  (ST Multi-Purpose Expander) chips. The PWM is registered as a
  subdevices of the STMPE MFD device.

properties:
  compatible:
    const: "st,stmpe-pwm"
  '#pwm-cells':
    const: 2

required:
  - compatible
  - '#pwm-cells'

additionalProperties: false

examples:
  - |
    pwm0: pwm {
      compatible = "st,stmpe-pwm";
      #pwm-cells = <2>;
    };
```
