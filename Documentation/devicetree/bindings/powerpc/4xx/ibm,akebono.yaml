## Documentation/devicetree/bindings/powerpc/fsl/fsl,dcsr.yaml
```yaml
# SPDX-License-Identifier: (GPL-2.0-only OR BSD-2-Clause)
# Copyright 2011 Freescale Semiconductor Inc.
%YAML 1.2
---
$id: http://devicetree.org/schemas/powerpc/fsl/fsl,dcsr.yaml#
$schema: http://devicetree.org/meta-schemas/core.yaml#

title: Freescale DCSR (Debug Control and Status Register)

maintainers:
  - Bjorn Helgaas <bhelgaas@google.com>
  - Carlos Garcia <carlos@cgarcia.org>
  - Rob Herring <robh@kernel.org>
  - Stephen George <stephen.george@freescale.com>

description: |
  Debug Control and Status Register (DCSR) Binding
  Copyright 2011 Freescale Semiconductor Inc.

  NOTE: The bindings described in this document are preliminary and subject
  to change.  Some of the compatible strings that contain only generic names
  may turn out to be inappropriate, or need additional properties to describe
  the integration of the block with the rest of the chip.

  Debug Control and Status Register Memory Map

  This node defines the base address and range for the
  defined DCSR Memory Map. Child nodes will describe the individual
  debug blocks defined within this memory space.

  Event Processing Unit

  This node represents the region of DCSR space allocated to the EPU

  The EPU counters can be configured to assert the performance
  monitor interrupt signal based on either counter overflow or value
  match. Which counter asserted the interrupt is captured in an EPU
  Counter Interrupt Status Register (EPCPUISR).

  The EPU unit can also be configured to assert either or both of
  two interrupt signals based on debug event sources within the SoC.
  The interrupt signals are epu_xt_int0 and epu_xt_int1.
  Which event source asserted the interrupt is captured in an EPU
  Interrupt Status Register (EPISR0,EPISR1).

  Nexus Port Controller

  This node represents the region of DCSR space allocated to the NPC

  The Nexus Port controller occupies two regions in the DCSR space
  with distinct functionality. The first register range describes the Nexus Port Controller
  control and status registers. The second register range describes the Nexus Port Controller
  internal trace buffer.

  Nexus Concentrator

  This node represents the region of DCSR space allocated to the NXC

  CoreNet Debug Controller

  This node represents the region of DCSR space allocated to
  the CoreNet Debug controller.

  Data Path Debug controller

  This node represents the region of DCSR space allocated to
  the DPAA Debug Controller. This controller controls debug configuration
  for the QMAN and FMAN blocks.

  OCN Debug controller

  This node represents the region of DCSR space allocated to
  the OCN Debug Controller.

  DDR Controller Debug controller

  This node represents the region of DCSR space allocated to
  the DDR Debug Controller.

  Nexus Aurora Link Controller

  This node represents the region of DCSR space allocated to
  the NAL Controller.

  Run Control and Power Management

  This node represents the region of DCSR space allocated to
  the RCPM Debug Controller.

  Core Service Bridge Proxy

  This node represents the region of DCSR space allocated to
  the Core Service Bridge Proxies.

properties:
  compatible:
    items:
      - const: fsl,dcsr
      - const: simple-bus

  '#address-cells':
    const: 1

  '#size-cells':
    const: 1

  ranges: true

required:
  - compatible
  - '#address-cells'
  - '#size-cells'
  - ranges

additionalProperties: false

examples:
  - |
    dcsr@f00000000 {
        compatible = "fsl,dcsr", "simple-bus";
        #address-cells = <1>;
        #size-cells = <1>;
        ranges = <0x00000000 0xf 0x00000000 0x01008000>;

        dcsr-epu@0 {
            compatible = "fsl,dcsr-epu";
            interrupts = <52 2 0 0
                          84 2 0 0
                          85 2 0 0>;
            reg = <0x0 0x1000>;
        };

        dcsr-npc {
            compatible = "fsl,dcsr-npc";
            reg = <0x1000 0x1000 0x1000000 0x8000>;
        };

        dcsr-nxc@2000 {
            compatible = "fsl,dcsr-nxc";
            reg = <0x2000 0x1000>;
        };

        dcsr-corenet {
            compatible = "fsl,dcsr-corenet";
            reg = <0x8000 0x1000 0xB0000 0x1000>;
        };

        dcsr-dpaa@9000 {
            compatible = "fsl,p4080-dcsr-dpaa", "fsl,dcsr-dpaa";
            reg = <0x9000 0x1000>;
        };

        dcsr-ocn@11000 {
            compatible = "fsl,p4080-dcsr-ocn", "fsl,dcsr-ocn";
            reg = <0x11000 0x1000>;
        };

        dcsr-ddr@12000 {
            compatible = "fsl,dcsr-ddr";
            dev-handle = <&ddr1>;
            reg = <0x12000 0x1000>;
        };

        dcsr-nal@18000 {
            compatible = "fsl,p4080-dcsr-nal", "fsl,dcsr-nal";
            reg = <0x18000 0x1000>;
        };

        dcsr-rcpm@22000 {
            compatible = "fsl,p4080-dcsr-rcpm", "fsl,dcsr-rcpm";
            reg = <0x22000 0x1000>;
        };

        dcsr-cpu-sb-proxy@40000 {
            compatible = "fsl,dcsr-e500mc-sb-proxy",
                         "fsl,dcsr-cpu-sb-proxy";
            cpu-handle = <&cpu0>;
            reg = <0x40000 0x1000>;
        };

        dcsr-cpu-sb-proxy@41000 {
            compatible = "fsl,dcsr-e500mc-sb-proxy",
                         "fsl,dcsr-cpu-sb-proxy";
            cpu-handle = <&cpu1>;
            reg = <0x41000 0x1000>;
        };
    };
```

## Documentation/devicetree/bindings/powerpc/fsl/fsl,diu.yaml
```yaml
# SPDX-License-Identifier: (GPL-2.0-only OR BSD-2-Clause)
# Copyright 2025 Grant Likely <grant.likely@secretlab.ca>
# Copyright 2025 Rob Herring <robh@kernel.org>
%YAML 1.2
---
$id: http://devicetree.org/schemas/powerpc/fsl/fsl,diu.yaml#
$schema: http://devicetree.org/meta-schemas/core.yaml#

title: Freescale Display Interface Unit

maintainers:
  - Grant Likely <grant.likely@secretlab.ca>
  - Rob Herring <robh@kernel.org>

description: |
  The Freescale DIU is a LCD controller, with proper hardware, it can also
  drive DVI monitors.

properties:
  compatible:
    items:
      - enum:
          - fsl,diu
          - fsl,mpc5121-diu
    description: List of supported device compatible strings.

  reg:
    items:
      - description: Start address of the DIU register set.
      - description: Size of the DIU register set.
    description: Physical address and length of the DIU register region.

  interrupts:
    items:
      - description: Interrupt number of the DIU controller.
      - description: Trigger type and flags for the interrupt.
    description: DIU interrupt specifier.

  edid:
    $ref: /schemas/types.yaml#/definitions/uint8-array
    description: Verbatim EDID data block describing attached display.

required:
  - compatible
  - reg
  - interrupts

additionalProperties: false

examples:
  - |
    display@2c000 {
      compatible = "fsl,diu";
      reg = <0x2c000 100>;
      interrupts = <72 2>;
    };
  - |
    display@2100 {
      compatible = "fsl,mpc5121-diu";
      reg = <0x2100 0x100>;
      interrupts = <64 0x8>;
      edid = [edid-data];
    };
```

## Documentation/devicetree/bindings/powerpc/fsl/fsl,ecm.yaml
```yaml
# SPDX-License-Identifier: (GPL-2.0-only OR BSD-2-Clause)
# Copyright 2009 Freescale Semiconductor Inc.
%YAML 1.2
---
$id: http://devicetree.org/schemas/powerpc/fsl/fsl,ecm.yaml#
$schema: http://devicetree.org/meta-schemas/core.yaml#

title: E500 LAW & Coherency Module

maintainers:
  - Grant Likely <grant.likely@secretlab.ca>
  - Rob Herring <robh@kernel.org>

description: |
  =====================================================================
  E500 LAW & Coherency Module Device Tree Binding
  Copyright (C) 2009 Freescale Semiconductor Inc.
  =====================================================================

  Local Access Window (LAW) Node

  The LAW node represents the region of CCSR space where local access
  windows are configured.  For ECM based devices this is the first 4k
  of CCSR space that includes CCSRBAR, ALTCBAR, ALTCAR, BPTR, and some
  number of local access windows as specified by fsl,num-laws.

  E500 Coherency Module Node

  The E500 LAW node represents the region of CCSR space where ECM config
  and error reporting registers exist, this is the second 4k (0x1000)
  of CCSR space.

properties:
  compatible:
    oneOf:
      - items:
          - const: fsl,ecm-law
      - items:
          - pattern: '^fsl,[a-z0-9-]+-ecm$'
          - const: fsl,ecm

  reg:
    items:
      - description: 'CCSR register block region: offset and size'

  interrupts:
    description: ECM error reporting interrupt specifier
    items:
      - description: Interrupt specifier for ECM error reporting

  fsl,num-laws:
    description: Number of local access windows for this device
    $ref: /schemas/types.yaml#/definitions/uint32

required:
  - compatible
  - reg

additionalProperties: false

examples:
  - |
    ecm@0 {
      compatible = "fsl,ecm";
      reg = <0x0000 0x1000>;
      interrupts = <5>;
      fsl,ecm-law@1000 {
        compatible = "fsl,ecm-law";
        reg = <0x1000 0x1000>;
        fsl,num-laws = <4>;
      };
    };
```

## Documentation/devicetree/bindings/powerpc/fsl/fsl,interlaken-lac.yaml
```yaml
# SPDX-License-Identifier: (GPL-2.0-only OR BSD-2-Clause)
# Copyright 2012 Freescale Semiconductor Inc.
%YAML 1.2
---
$id: http://devicetree.org/schemas/powerpc/fsl/fsl,interlaken-lac.yaml#
$schema: http://devicetree.org/meta-schemas/core.yaml#

title: Freescale Interlaken Look-Aside Controller (LAC)
maintainers:
  - Joe Liccese <joe.liccese@freescale.com>
  - Rob Herring <robh@kernel.org>

description: |
  ================================================================================  
  Freescale Interlaken Look-Aside Controller Device Bindings
  Copyright 2012 Freescale Semiconductor Inc.

  The Interlaken is a narrow, high speed channelized chip-to-chip interface. To
  facilitate interoperability between a data path device and a look-aside
  co-processor, the Interlaken Look-Aside protocol is defined for short
  transaction-related transfers. Although based on the Interlaken protocol,
  Interlaken Look-Aside is not directly compatible with Interlaken and can be
  considered a different operation mode.

  The Interlaken LA controller connects internal platform to Interlaken serial
  interface. It accepts LA command through software portals, which are system
  memory mapped 4KB spaces. The LA commands are then translated into the
  Interlaken control words and data words, which are sent on TX side to TCAM
  through SerDes lanes.

  There are two 4KiB spaces defined within the LAC global register memory map.
  There is a full register set at 0x0000-0x0FFF (also known as the "hypervisor"
  version), and a subset at 0x1000-0x1FFF. The former is a superset of the
  latter, and includes certain registers that should not be accessible to
  partitioned software. Separate nodes are used for each region, with a phandle
  linking the hypervisor node to the normal operating node.

  Interlaken Look-Aside Controller (LAC) Software Portal Container Node

  The Interlaken Look-Aside Controller (LAC) utilizes Software Portals to accept
  Interlaken Look-Aside (ILA) commands. The Interlaken LAC software portal
  memory map occupies 128KB of memory space. The software portal memory space is
  intended to be cache-enabled. WIMG for each software space is required to be
  0010 if stashing is enabled; otherwise, WIMG can be 0000 or 0010.

  Interlaken Look-Aside Controller (LAC) Software Portals Child Nodes

  There are up to 24 available software portals with each software portal
  requiring 4KB of consecutive memory within the software portal memory mapped
  space.
properties:
  compatible:
    items:
      - enum:
          - fsl,interlaken-lac
          - fsl,interlaken-lac-hv

  reg:
    items:
      - description: Interlaken LAC configuration registers

  interrupts:
    description: Interrupt mapping for Interlaken LAC error IRQ
    items:
      - description: IRQ specifier cells

  fsl,non-hv-node:
    description: Points to the non-protected LAC CCSR mapped register space node
    $ref: /schemas/types.yaml#/definitions/phandle

required:
  - compatible
  - reg

allOf:
  - if:
      properties:
        compatible:
          contains:
            const: fsl,interlaken-lac-hv
    then:
      required:
        - fsl,non-hv-node
    else:
      properties:
        interrupts: false
  - if:
      properties:
        compatible:
          contains:
            const: fsl,interlaken-lac
    then:
      required:
        - interrupts
    else:
      properties:
        fsl,non-hv-node: false

additionalProperties: false

examples:
  - |
    lac: lac@229000 {
        compatible = "fsl,interlaken-lac";
        reg = <0x229000 0x1000>;
        interrupts = <16 2 1 18>;
    };
  - |
    lac-hv@228000 {
        compatible = "fsl,interlaken-lac-hv";
        reg = <0x228000 0x1000>;
        fsl,non-hv-node = <&lac>;
    };
```

## Documentation/devicetree/bindings/powerpc/fsl/fsl,mcm.yaml
```yaml
# SPDX-License-Identifier: (GPL-2.0-only OR BSD-2-Clause)
%YAML 1.2
---
$id: http://devicetree.org/schemas/powerpc/fsl/fsl,mcm.yaml#
$schema: http://devicetree.org/meta-schemas/core.yaml#

title: Freescale MPX LAW & Coherency Module

maintainers:
  - Grant Likely <grant.likely@secretlab.ca>
  - Rob Herring <robh@kernel.org>

description: |
  =====================================================================
  MPX LAW & Coherency Module Device Tree Binding
  Copyright (C) 2009 Freescale Semiconductor Inc.
  =====================================================================

  Local Access Window (LAW) Node

  The LAW node represents the region of CCSR space where local access
  windows are configured.  For MCM based devices this is the first 4k
  of CCSR space that includes CCSRBAR, ALTCBAR, ALTCAR, BPTR, and some
  number of local access windows as specified by fsl,num-laws.

  MPX Coherency Module Node

  The MPX LAW node represents the region of CCSR space where MCM config
  and error reporting registers exist, this is the second 4k (0x1000)
  of CCSR space.

properties:
  compatible:
    description: Device compatibility strings
    oneOf:
      - items:
          - const: fsl,mcm-law
      - items:
          - pattern: ^fsl,[a-z0-9]+-mcm$
          - const: fsl,mcm
  reg:
    maxItems: 1

  fsl,num-laws:
    description: Number of local access windows for this device
    $ref: /schemas/types.yaml#/definitions/uint32

  interrupts:
    maxItems: 1

additionalProperties: false

allOf:
  - if:
      properties:
        compatible:
          contains:
            const: fsl,mcm-law
    then:
      required:
        - fsl,num-laws
    else:
      properties:
        fsl,num-laws: false
  - if:
      properties:
        compatible:
          contains:
            const: fsl,mcm
    then:
      required:
        - interrupts
    else:
      properties:
        interrupts: false
```
