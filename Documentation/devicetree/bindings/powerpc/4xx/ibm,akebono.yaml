## Documentation/devicetree/bindings/powerpc/4xx/ibm,akebono.yaml
```yaml
# SPDX-License-Identifier: (GPL-2.0-only OR BSD-2-Clause)
%YAML 1.2
---
$id: http://devicetree.org/schemas/powerpc/4xx/ibm,akebono.yaml#
$schema: http://devicetree.org/meta-schemas/core.yaml#

title: IBM Akebono board

maintainers:
  - Alistair Popple <alistair@popple.id.au>
  - Rob Herring <robh@kernel.org>

description: |
  IBM Akebono board device tree
  =============================

  The IBM Akebono board is a development board for the PPC476GTR SoC.

  0) The root node

  1.a) The Secure Digital Host Controller Interface (SDHCI) node

  Represent the Secure Digital Host Controller Interfaces.

  1.b) The Advanced Host Controller Interface (AHCI) SATA node

  Represents the advanced host controller SATA interface.

  1.c) The FPGA node

  The Akebono board stores some board information such as the revision
  number in an FPGA which is represented by this node.

  1.d) The AVR node

  The Akebono board has an Atmel AVR microprocessor attached to the I2C
  bus as a power controller for the board.

properties:
  compatible:
    items:
      - const: ibm,akebono
      - const: ibm,476gtr
    description: Board compatible strings
  model:
    description: Model name of the board
    $ref: /schemas/types.yaml#/definitions/string

patternProperties:
  "^sdhci@.*":
    description: Secure Digital Host Controller Interface node
    type: object
    additionalProperties: false
    properties:
      compatible:
        items:
          - const: ibm,476gtr-sdhci
          - const: generic-sdhci
        description: SDHCI compatible strings
      reg:
        items:
          - description: SDHCI registers location and length
      interrupts:
        items:
          - description: SDHCI interrupt
    required:
      - compatible
      - reg
      - interrupts

  "^ahci@.*":
    description: Advanced Host Controller Interface SATA node
    type: object
    additionalProperties: false
    properties:
      compatible:
        items:
          - const: ibm,476gtr-ahci
        description: AHCI compatible string
      reg:
        items:
          - description: AHCI registers location and length
      interrupts:
        items:
          - description: AHCI interrupt
    required:
      - compatible
      - reg
      - interrupts

  "^fpga@.*":
    description: FPGA node
    type: object
    additionalProperties: false
    properties:
      compatible:
        items:
          - const: ibm,akebono-fpga
        description: FPGA compatible string
      reg:
        items:
          - description: FPGA registers location and length
    required:
      - compatible
      - reg

  "^avr@.*":
    description: AVR node
    type: object
    additionalProperties: false
    properties:
      compatible:
        items:
          - const: ibm,akebono-avr
        description: AVR compatible string
      reg:
        items:
          - description: I2C bus address for the AVR
    required:
      - compatible
      - reg

additionalProperties: false

examples:
  - |
    / {
      compatible = "ibm,akebono", "ibm,476gtr";
      model = "IBM Akebono board";

      sdhci@ff000000 {
        compatible = "ibm,476gtr-sdhci", "generic-sdhci";
        reg = <0xff000000 0x1000>;
        interrupts = <5>;
      };

      ahci@ff100000 {
        compatible = "ibm,476gtr-ahci";
        reg = <0xff100000 0x200>;
        interrupts = <6>;
      };

      fpga@ff200000 {
        compatible = "ibm,akebono-fpga";
        reg = <0xff200000 0x100>;
      };

      avr@20 {
        compatible = "ibm,akebono-avr";
        reg = <0x20>;
      };
    };
```

## Documentation/devicetree/bindings/powerpc/4xx/ibm,cpm.yaml
```yaml
# SPDX-License-Identifier: (GPL-2.0-only OR BSD-2-Clause)
# Copyright 2025 Grant Likely <grant.likely@secretlab.ca>
%YAML 1.2
---
$id: http://devicetree.org/schemas/powerpc/4xx/ibm,cpm.yaml#
$schema: http://devicetree.org/meta-schemas/core.yaml#

title: PPC4xx Clock Power Management (CPM) node

maintainers:
  - Grant Likely <grant.likely@secretlab.ca>

description: |
  PPC4xx Clock Power Management (CPM) node

properties:
  compatible:
    items:
      - const: ibm,cpm

  dcr-access-method:
    description: DCR access method. Only "native" is supported.
    $ref: /schemas/types.yaml#/definitions/string
    enum:
      - native

  dcr-reg:
    $ref: /schemas/types.yaml#/definitions/uint32-array
    items:
      - description: DCR register start address
      - description: DCR register count

  er-offset:
    description: >-
      All 4xx SoCs with a CPM controller have one of two different order for the
      CPM registers. Some have the CPM registers in the following order (ER,FR,SR).
      The others have them in the following order (SR,ER,FR). For the second case
      set er-offset = <1>.
    $ref: /schemas/types.yaml#/definitions/uint32-array
    items:
      - description: ER register sequence offset

  unused-units:
    description: >-
      Specifier consists of one cell. For each bit in the cell, the corresponding
      bit in CPM will be set to turn off unused devices.
    $ref: /schemas/types.yaml#/definitions/uint32-array
    items:
      - description: Unused units bitmask

  idle-doze:
    description: >-
      Specifier consists of one cell. For each bit in the cell, the corresponding
      bit in CPM will be set to turn off unused devices. This is usually just
      CPM[CPU].
    $ref: /schemas/types.yaml#/definitions/uint32-array
    items:
      - description: Idle and doze units bitmask

  standby:
    description: >-
      Specifier consists of one cell. For each bit in the cell, the corresponding
      bit in CPM will be set on standby and restored on resume.
    $ref: /schemas/types.yaml#/definitions/uint32-array
    items:
      - description: Standby units bitmask

  suspend:
    description: >-
      Specifier consists of one cell. For each bit in the cell, the corresponding
      bit in CPM will be set on suspend (mem) and restored on resume. Note: for
      standby and suspend the corresponding bits can be different or the same.
      Usually for standby only class 2 and 3 units are set. However, the
      interface does not care. If they are the same, the additional power saving
      will be seen if support is available to put the DDR in self refresh mode and
      any additional power saving techniques for the specific SoC.
    $ref: /schemas/types.yaml#/definitions/uint32-array
    items:
      - description: Suspend units bitmask

required:
  - compatible
  - dcr-access-method
  - dcr-reg

additionalProperties: false

examples:
  - |
    cpm0: cpm@160 {
        compatible = "ibm,cpm";
        dcr-access-method = "native";
        dcr-reg = <0x160 0x003>;
        er-offset = <0>;
        unused-units = <0x00000100>;
        idle-doze = <0x02000000>;
        standby = <0xfeff0000>;
        suspend = <0xfeff791d>;
    };
```

## Documentation/devicetree/bindings/powerpc/4xx/ppc440spe-adma.yaml
```yaml
# SPDX-License-Identifier: (GPL-2.0-only OR BSD-2-Clause)
---
$schema: http://devicetree.org/meta-schemas/core.yaml#
$id: http://devicetree.org/schemas/powerpc/4xx/ppc440spe-adma.yaml#
title: PPC440SPe DMA/XOR (DMA Controller and XOR Accelerator)
maintainers:
  - Grant Likely <grant.likely@secretlab.ca>
  - Rob Herring <robh@kernel.org>
description: |
  Device nodes needed for operation of the ppc440spe-adma driver
  are specified hereby. These are I2O/DMA, DMA and XOR nodes
  for DMA engines and Memory Queue Module node. The latter is used
  by ADMA driver for configuration of RAID-6 H/W capabilities of
  the PPC440SPe. In addition to the nodes and properties described
  below, the ranges property of PLB node must specify ranges for
  DMA devices.

properties:
  compatible:
    items:
      - enum:
          - ibm,i2o-440spe
          - ibm,dma-440spe
          - amcc,xor-accelerator
          - ibm,mq-440spe

  reg:
    maxItems: 1

  dcr-reg:
    $ref: /schemas/types.yaml#/definitions/uint32-array
    minItems: 2
    maxItems: 2
    description: DCR register base address and size.

  cell-index:
    $ref: /schemas/types.yaml#/definitions/uint32
    description: Hardware index of the DMA engine.

  interrupts:
    items:
      - description: FIFO needs service interrupt.
      - description: DMA error interrupt.

  '#interrupt-cells':
    const: 1

  '#address-cells':
    const: 0

  '#size-cells':
    const: 0

  interrupt-map: true

required:
  - compatible
  - reg
  - interrupts

additionalProperties: false

examples:
  - |
    i2o@400100000 {
        compatible = "ibm,i2o-440spe";
        reg = <0x00000004 0x00100000 0x100>;
        dcr-reg = <0x060 0x020>;
    };
  - |
    dma0@400100100 {
        compatible = "ibm,dma-440spe";
        cell-index = <0>;
        reg = <0x00000004 0x00100100 0x100>;
        dcr-reg = <0x060 0x020>;
        interrupts = <0 1>;
        #interrupt-cells = <1>;
        #address-cells = <0>;
        #size-cells = <0>;
        interrupt-map = <
            0 &UIC0 0x14 4
            1 &UIC1 0x16 4>;
    };
  - |
    xor-accel@400200000 {
        compatible = "amcc,xor-accelerator";
        reg = <0x00000004 0x00200000 0x400>;
        interrupts = <0x1f 4>;
    };
  - |
    mq {
        compatible = "ibm,mq-440spe";
        dcr-reg = <0x040 0x020>;
    };
```

## Documentation/devicetree/bindings/powerpc/fsl/fsl,corenet-cf.yaml
```yaml
# SPDX-License-Identifier: (GPL-2.0-only OR BSD-2-Clause)
# Copyright 2025 Freescale Semiconductor, Inc.

%YAML 1.2
---
$id: http://devicetree.org/schemas/powerpc/fsl/fsl,corenet-cf.yaml#
$schema: http://devicetree.org/meta-schemas/core.yaml#

title: Freescale CoreNet Coherency Fabric (CCF)

maintainers:
  - Diana Craciun <Diana.Craciun@freescale.com>

description: |
  The CoreNet coherency fabric is a fabric-oriented, connectivity infrastructure
  that enables the implementation of coherent, multicore systems.

properties:

  compatible:
    oneOf:
      - items:
          - enum:
              - fsl,corenet1-cf
              - fsl,corenet2-cf
          - const: fsl,corenet-cf
      - items:
          - const: fsl,corenet1-cf
      - items:
          - const: fsl,corenet2-cf

  reg:
    description: Address and size of the CoreNet Coherency Fabric registers.
    items:
      - description: CCF register region

  interrupts:
    description: Error interrupt mapping for the CCF.
    items:
      - description: CCF error interrupt specifier

  fsl,ccf-num-csdids:
    description: Number of Coherency Subdomain ID Port Mapping Registers supported by the CCF.
    $ref: /schemas/types.yaml#/definitions/uint32

  fsl,ccf-num-snoopids:
    description: Number of Snoop ID Port Mapping Registers supported by the CCF.
    $ref: /schemas/types.yaml#/definitions/uint32

required:
  - compatible
  - reg
  - interrupts
  - fsl,ccf-num-csdids
  - fsl,ccf-num-snoopids

additionalProperties: false

examples:
  - |
    corenet-cf@18000 {
      compatible = "fsl,corenet2-cf", "fsl,corenet-cf";
      reg = <0x18000 0x1000>;
      interrupts = <16 2 1 31>;
      fsl,ccf-num-csdids = <32>;
      fsl,ccf-num-snoopids = <32>;
    };
```
