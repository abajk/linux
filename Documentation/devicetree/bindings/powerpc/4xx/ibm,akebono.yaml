## Documentation/devicetree/bindings/powerpc/fsl/fsl,mpc512x-lpbfifo.yaml
```yaml
# SPDX-License-Identifier: (GPL-2.0-only OR BSD-2-Clause)
# Copyright 2025 Alexander Popov <alex.popov@linux.com>

%YAML 1.2
---
$id: http://devicetree.org/schemas/powerpc/fsl/fsl,mpc512x-lpbfifo.yaml#
$schema: http://devicetree.org/meta-schemas/core.yaml#

title: Freescale MPC512x LocalPlus Bus FIFO

maintainers:
  - Alexander Popov <alex.popov@linux.com>

description: |
  Freescale MPC512x LocalPlus Bus FIFO (called SCLPC in the Reference Manual)

properties:
  compatible:
    items:
      - const: fsl,mpc512x-lpbfifo
    description: Must be "fsl,mpc512x-lpbfifo"
  reg:
    items:
      - description: Offset of SCLPC register set
      - description: Length of SCLPC register set
    description: Register address and length of SCLPC
  interrupts:
    items:
      - description: Interrupt specifier for SCLPC
    description: Interrupt specifier for SCLPC
  dmas:
    items:
      - description: DMA specifier for SCLPC
    description: DMA specifier for SCLPC
  dma-names:
    items:
      - const: rx-tx
    description: DMA names for SCLPC

required:
  - compatible
  - reg
  - interrupts
  - dmas
  - dma-names

additionalProperties: false

examples:
  - |
    sclpc@10100 {
        compatible = "fsl,mpc512x-lpbfifo";
        reg = <0x10100 0x50>;
        interrupts = <7 0x8>;
        dmas = <&dma0 26>;
        dma-names = "rx-tx";
    };
```

## Documentation/devicetree/bindings/powerpc/fsl/fsl,mpc5200-immr.yaml
```yaml
# SPDX-License-Identifier: (GPL-2.0-only OR BSD-2-Clause)
# Copyright 2006-2009 Secret Lab Technologies Ltd

%YAML 1.2
---
$id: http://devicetree.org/schemas/powerpc/fsl/fsl,mpc5200-immr.yaml#
$schema: http://devicetree.org/meta-schemas/core.yaml#

title: MPC5200 SoC Internal Memory Map Register

maintainers:
  - Grant Likely <grant.likely@secretlab.ca>
  - Marc Kleine-Budde <mkl@pengutronix.de>
  - Randy Dunlap <rdunlap@infradead.org>

description: |
  MPC5200 Device Tree Bindings

  (c) 2006-2009 Secret Lab Technologies Ltd
  Grant Likely <grant.likely@secretlab.ca>

  Naming conventions
  ------------------
  For mpc5200 on-chip devices, the format for each compatible value is
  <chip>-<device>[-<mode>]. The OS should be able to match a device driver
  to the device based solely on the compatible value. If two drivers
  match on the compatible list, the 'most compatible' driver should be
  selected.

  The split between the MPC5200 and the MPC5200B leaves a bit of a
  conundrum. How should the compatible property be set up to provide
  maximum compatibility information, but still accurately describe the
  chip? For the MPC5200, the answer is easy. Most of the SoC devices
  originally appeared on the MPC5200. Since they didn't exist anywhere
  else, the 5200 compatible properties will contain only one item:
  fsl,mpc5200-<device>.

  The 5200B is almost the same as the 5200, but not quite. It fixes
  silicon bugs and it adds a small number of enhancements. Most of the
  devices either provide exactly the same interface as on the 5200. A few
  devices have extra functions but still have a backwards compatible mode.
  To express this information as completely as possible, 5200B device trees
  should have two items in the compatible list:
    fsl,mpc5200b-<device>, fsl,mpc5200-<device>.
  It is strongly recommended that 5200B device trees follow this convention
  (instead of only listing the base mpc5200 item).

  Modal devices, like PSCs, also append the configured function to the
  end of the compatible field. A PSC in i2s mode would specify
  fsl,mpc5200-psc-i2s, not fsl,mpc5200-i2s. This convention is chosen to
  avoid naming conflicts with non-psc devices providing the same function.
  For example, fsl,mpc5200-spi and fsl,mpc5200-psc-spi describe the mpc5200
  simple spi device and a PSC spi mode respectively.

  At the time of writing, exact chip may be either fsl,mpc5200 or
  fsl,mpc5200b.

  The soc node
  ------------
  This node describes the on chip SOC peripherals. Every mpc5200 based
  board will have this node, and as such there is a common naming
  convention for SOC devices.

properties:
  compatible:
    oneOf:
      - items:
          - const: fsl,mpc5200-immr
      - items:
          - enum:
              - fsl,mpc5200b-immr
              - fsl,mpc5200-immr

  reg:
    maxItems: 1

  ranges:
    maxItems: 1

  system-frequency:
    description: fsystem frequency in Hz. XLB, IPB, USB and PCI clocks are derived from the fsystem clock.
    $ref: /schemas/types.yaml#/definitions/uint32

  bus-frequency:
    description: IPB bus frequency in Hz.
    $ref: /schemas/types.yaml#/definitions/uint32

required:
  - compatible
  - reg
  - ranges
  - system-frequency
  - bus-frequency

additionalProperties: false

examples:
  - |
    soc@ffe00000 {
      compatible = "fsl,mpc5200-immr";
      reg = <0xffe00000 0xc000>;
      ranges = <0 0xffe00000 0xc000>;
      system-frequency = <200000000>;
      bus-frequency = <100000000>;
    };
```

## Documentation/devicetree/bindings/powerpc/fsl/fsl,mpc8272-localbus.yaml
```yaml
# SPDX-License-Identifier: (GPL-2.0-only OR BSD-2-Clause)
%YAML 1.2
---
$id: http://devicetree.org/schemas/powerpc/fsl/fsl,mpc8272-localbus.yaml#
$schema: http://devicetree.org/meta-schemas/core.yaml#

title: Freescale Local Bus Controller
maintainers:
  - Grant Likely <grant.likely@secretlab.ca>
  - John Ogness <john.ogness@linutronix.de>

description: |
  * Chipselect/Local Bus

properties:
  compatible:
    oneOf:
      - items:
          - const: fsl,mpc8272-localbus
          - const: fsl,pq2-localbus
      - items:
          - const: fsl,mpc8272-localbus
      - items:
          - const: fsl,pq2-localbus

  '#address-cells':
    description: >
      Number of cells for the chipselect and offset.
      The first cell is the chipselect number, and the remaining
      cells specify the offset.
    enum: [2, 3]

  '#size-cells':
    description: Number of cells for the size of the bus window.
    enum: [1, 2]

  reg:
    description: Base address and size of the local bus window.
    items:
      - description: Base address of the window
      - description: Size of the window

  ranges:
    description: >
      Translation from parent bus address to CPU address
      for each chipselect.
    items:
      - description: Chipselect number
      - description: Bus address
      - description: CPU physical address
      - description: Size of the range

additionalProperties: false

examples:
  - |
    localbus@f0010100 {
        compatible = "fsl,mpc8272-localbus", "fsl,pq2-localbus";
        #address-cells = <2>;
        #size-cells = <1>;
        reg = <0xf0010100 0x40>;
        ranges = <0x0 0x0 0xfe000000 0x02000000
                  0x1 0x0 0xf4500000 0x00008000
                  0x2 0x0 0xfd810000 0x00010000>;
    };
```

## Documentation/devicetree/bindings/powerpc/fsl/fsl,mpic-global-timer.yaml
```yaml
# SPDX-License-Identifier: (GPL-2.0-only OR BSD-2-Clause)
# Copyright 2025 Scott Wood <scottwood@freescale.com>
%YAML 1.2
---
$id: http://devicetree.org/schemas/fsl,mpic-global-timer.yaml#
$schema: http://devicetree.org/meta-schemas/core.yaml#

title: Freescale MPIC Global Timer

maintainers:
  - Scott Wood <scottwood@freescale.com>

description: |
  * Freescale MPIC timers

properties:
  compatible:
    items:
      - const: fsl,mpic-global-timer

  reg:
    description: |
      Contains two regions. The first is the main timer register bank
      (GTCCRxx, GTBCRxx, GTVPRxx, GTDRxx). The second is the timer control
      register (TCRx) for the group.
    items:
      - description: Main timer registers (GTCCRxx, GTBCRxx, GTVPRxx, GTDRxx)
      - description: Timer control register (TCRx)

  interrupts:
    description: |
      One interrupt specifier per timer in the group, in order, starting with
      timer zero. If fsl,available-ranges is present, only the interrupts that
      correspond to available timers shall be present.
    minItems: 1
    items:
      description: Interrupt specifier for a timer

  '#interrupt-cells':
    const: 4

  interrupt-controller: true

  fsl,available-ranges:
    description: |
      Defines which timer interrupts can be used as <start count> ranges. This
      property is optional; without it, all timers within the group can be used.
    $ref: /schemas/types.yaml#/definitions/uint32-array
    minItems: 2
    items:
      minimum: 0

additionalProperties: false

required:
  - compatible
  - reg
  - interrupts
  - '#interrupt-cells'
  - interrupt-controller

examples:
  - |
    timer0: timer@41100 {
        compatible = "fsl,mpic-global-timer";
        reg = <0x41100 0x100 0x41300 4>;

        /* Another AMP partition is using timers 0 and 1 */
        fsl,available-ranges = <2 2>;

        interrupts = <2 0 3 0
                      3 0 3 0>;
    };

    timer1: timer@42100 {
        compatible = "fsl,mpic-global-timer";
        reg = <0x42100 0x100 0x42300 4>;
        interrupts = <4 0 3 0
                      5 0 3 0
                      6 0 3 0
                      7 0 3 0>;
    };
```

## Documentation/devicetree/bindings/powerpc/fsl/fsl,mpic-v<version>-msgr.yaml
```yaml
# SPDX-License-Identifier: (GPL-2.0-only OR BSD-2-Clause)
# Copyright 2025 Freescale Semiconductor
%YAML 1.2
---
$id: http://devicetree.org/schemas/bindings/powerpc/fsl/fsl,mpic-v3.1-msgr.yaml#
# $schema is the meta-schema this schema should be validated with.
$schema: http://devicetree.org/meta-schemas/core.yaml#

title: FSL MPIC Message Registers

maintainers:
  - Jia Hongtao <B38951@freescale.com>

description: |
  FSL MPIC Message Registers

  This binding specifies what properties must be available in the device tree
  representation of the message register blocks found in some FSL MPIC
  implementations.

properties:
  compatible:
    description: >
      Compatibility list for the message register block.
      Must be of the form "fsl,mpic-v3.1-msgr".
    allOf:
      - $ref: /schemas/types.yaml#/definitions/string-array
      - items:
          - pattern: '^fsl,mpic-v[0-9]+(\.[0-9]+)?-msgr$'
  reg:
    maxItems: 1

  interrupts:
    maxItems: 1

  fsl,mpic-msgr-receive-mask:
    description: >
      Bit mask indicating which registers in the block can receive interrupts.
      Bit n corresponds to message register n.
    $ref: /schemas/types.yaml#/definitions/uint32

required:
  - compatible
  - reg
  - interrupts

additionalProperties: false

examples:
  - |
    aliases {
        mpic-msgr-block0 = &mpic_msgr_block0;
        mpic-msgr-block1 = &mpic_msgr_block1;
    };

    mpic_msgr_block0: mpic-msgr-block@41400 {
        compatible = "fsl,mpic-v3.1-msgr";
        reg = <0x41400 0x200>;
        # Message registers 0 and 2 in this block can receive interrupts on
        # sources 0xb0 and 0xb2, respectively.
        interrupts = <0xb0 2 0xb2 2>;
        fsl,mpic-msgr-receive-mask = <0x5>;
    };

    mpic_msgr_block1: mpic-msgr-block@42400 {
        compatible = "fsl,mpic-v3.1-msgr";
        reg = <0x42400 0x200>;
        # Message registers 0 and 2 in this block can receive interrupts on
        # sources 0xb4 and 0xb6, respectively.
        interrupts = <0xb4 2 0xb6 2>;
        fsl,mpic-msgr-receive-mask = <0x5>;
    };
```

## Documentation/devicetree/bindings/powerpc/fsl/fsl,mpic.yaml
```yaml
# SPDX-License-Identifier: (GPL-2.0-only OR BSD-2-Clause)
# Copyright (C) 2010,2011 Freescale Semiconductor Inc.
%YAML 1.2
---
$id: http://devicetree.org/schemas/powerpc/fsl/fsl,mpic.yaml#
$schema: http://devicetree.org/meta-schemas/core.yaml#

title: Freescale MPIC Interrupt Controller

maintainers:
  - Grant Likely <grant.likely@secretlab.ca>
  - Kyle Moffett <Kyle.D.Moffett@boeing.com>
  - Lucas De Marchi <lucas.demarchi@profusion.mobi>
  - Scott Wood <scottwood@freescale.com>
  - Stuart Yoder <stuart.yoder@freescale.com>

description: |
  Freescale MPIC Interrupt Controller Node
  Copyright (C) 2010,2011 Freescale Semiconductor Inc.

  The Freescale MPIC interrupt controller is found on all PowerQUICC
  and QorIQ processors and is compatible with the Open PIC. The
  notable difference from Open PIC binding is the addition of two
  additional cells in the interrupt specifier defining interrupt type
  information.

properties:
  compatible:
    description: >
      Shall include "fsl,mpic". Freescale MPIC controllers compatible
      with this binding have Block Revision Registers BRR1 and BRR2
      at offset 0x0 and 0x10 in the MPIC.
    const: fsl,mpic

  reg:
    maxItems: 1

  interrupt-controller: true

  "#interrupt-cells":
    description: Number of cells constituting each interrupt specifier.
    enum: [2, 4]

  "#address-cells":
    description: Must be 0 for MPIC nodes.
    const: 0

  pic-no-reset:
    description: >
      Presence of this property prevents the MPIC from being reset by
      the client program and mandates that only explicitly referenced
      interrupt sources shall be initialized.
    type: boolean

  big-endian:
    description: >
      If present, the MPIC will be treated as big-endian.
    type: boolean

  single-cpu-affinity:
    description: >
      If present, non-IPI interrupts will be routed to a single CPU
      at a time.
    type: boolean

  last-interrupt-source:
    description: >
      Some MPICs do not correctly report the number of hardware sources
      in the global feature registers. This value, if specified,
      overrides the value read from MPIC_GREG_FEATURE_LAST_SRC.
    $ref: /schemas/types.yaml#/definitions/uint32

  interrupts:
    description: >
      An array of interrupt specifiers for the MPIC. Each specifier is
      encoded as 4 cells: interrupt number, level-sense, interrupt type,
      and type-specific information.

required:
  - compatible
  - reg
  - interrupt-controller
  - "#interrupt-cells"
  - "#address-cells"

additionalProperties: false

examples:
  - |
    mpic: pic@40000 {
        compatible = "fsl,mpic";
        interrupt-controller;
        #interrupt-cells = <4>;
        #address-cells = <0>;
        reg = <0x40000 0x40000>;
    };
  - |
    i2c@3000 {
        #address-cells = <1>;
        #size-cells = <0>;
        cell-index = <0>;
        compatible = "fsl-i2c";
        reg = <0x3000 0x100>;
        interrupts = <43 2>;
        dfsrr;
    };
  - |
    ipi@410a0 {
        compatible = "fsl,mpic-ipi";
        reg = <0x40040 0x10>;
        interrupts = <0 0 2 0
                      1 0 2 0
                      2 0 2 0
                      3 0 2 0>;
    };
  - |
    timer0: timer@41100 {
        compatible = "fsl,mpic-global-timer";
        reg = <0x41100 0x100 0x41300 4>;
        interrupts = <0 0 3 0
                      1 0 3 0
                      2 0 3 0
                      3 0 3 0>;
    };
  - |
    memory-controller@8000 {
        compatible = "fsl,p4080-memory-controller";
        reg = <0x8000 0x1000>;
        interrupts = <16 2 1 23>;
    };
```
