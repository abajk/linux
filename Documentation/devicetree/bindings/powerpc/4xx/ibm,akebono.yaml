## Documentation/devicetree/bindings/powerpc/ibm,powerpc-cpu-features.yaml
```yaml
# SPDX-License-Identifier: (GPL-2.0-only OR BSD-2-Clause)
%YAML 1.2
---
$id: http://devicetree.org/schemas/powerpc/ibm,powerpc-cpu-features.yaml#
$schema: http://devicetree.org/meta-schemas/core.yaml#

title: IBM PowerPC CPU Features

maintainers:
  - Nicholas Piggin <npiggin@gmail.com>

description: |
  *** NOTE ***
  This document is copied from OPAL firmware
  (skiboot/doc/device-tree/ibm,powerpc-cpu-features/binding.txt)

  There is more complete overview and documentation of features in that
  source tree.  All patches and modifications should go there.

  ibm,powerpc-cpu-features binding
  =================================

  This device tree binding describes CPU features available to software, with
  enablement, privilege, and compatibility metadata.

  More general description of design and implementation of this binding is
  found in design.txt, which also points to documentation of specific features.

  /cpus/ibm,powerpc-cpu-features node binding
  -------------------------------------------

  Node: ibm,powerpc-cpu-features

  Description: Container of CPU feature nodes.

  The node name must be "ibm,powerpc-cpu-features".

  It is implemented as a child of the node "/cpus", but this must not be
  assumed by parsers.

  The node is optional but should be provided by new OPAL firmware.

  Each child node of cpu-features represents a CPU feature / capability.

  Node: A string describing an architected CPU feature, e.g., "floating-point".

  Description: A feature or capability supported by the CPUs.

  The name of the node is a human readable string that forms the interface
  used to describe features to software. Features are currently documented
  in the code where they are implemented in skiboot/core/cpufeatures.c

properties:
  compatible:
    $ref: /schemas/types.yaml#/definitions/string-array
    items:
      - const: ibm,powerpc-cpu-features
  isa:
    description: |
      Instruction set architecture version the CPU is currently running in;
      Power ISA version multiplied by 1000.
    $ref: /schemas/types.yaml#/definitions/uint32
  display-name:
    description: Human readable name for the CPU.
    $ref: /schemas/types.yaml#/definitions/string

required:
  - compatible
  - isa

patternProperties:
  ".*":
    description: CPU feature node.
    type: object
    additionalProperties: false
    properties:
      isa:
        description: First level of the Power ISA that the feature appears in.
        $ref: /schemas/types.yaml#/definitions/uint32
      usable-privilege:
        description: |
          Privilege levels and/or software components that can use the feature.
          Bit mask (LSB0: bit0=PR, bit1=OS, bit2=HV).
        $ref: /schemas/types.yaml#/definitions/uint32
      hv-support:
        description: |
          Hypervisor privilege support required to enable the feature.
          Bit mask (LSB0: bit0=HFSCR).
        $ref: /schemas/types.yaml#/definitions/uint32
      os-support:
        description: |
          Operating system privilege support required to enable the feature.
          Bit mask (LSB0: bit0=FSCR).
        $ref: /schemas/types.yaml#/definitions/uint32
      hfscr-bit-nr:
        description: HFSCR bit position (LSB0).
        $ref: /schemas/types.yaml#/definitions/uint32
      fscr-bit-nr:
        description: FSCR bit position (LSB0).
        $ref: /schemas/types.yaml#/definitions/uint32
      hwcap-bit-nr:
        description: Linux ELF AUX vector bit position (LSB0).
        $ref: /schemas/types.yaml#/definitions/uint32
      feature-dependencies:
        description: Phandles to CPU feature nodes that must be enabled for this feature.
        $ref: /schemas/types.yaml#/definitions/phandle-array
    required:
      - isa
      - usable-privilege

additionalProperties: false

examples:
  - |
    /cpus/ibm,powerpc-cpu-features {
        compatible = "ibm,powerpc-cpu-features";
        isa = <3020>;
        darn {
            isa = <3000>;
            usable-privilege = <1 | 2 | 4>;
            hwcap-bit-nr = <xx>;
        };
        scv {
            isa = <3000>;
            usable-privilege = <1 | 2>;
            os-support = <0>;
            hwcap-bit-nr = <xx>;
        };
        stop {
            isa = <3000>;
            usable-privilege = <2 | 4>;
            hv-support = <0>;
            os-support = <0>;
        };
        vsx2 (hypothetical) {
            isa = <3010>;
            usable-privilege = <1 | 2 | 4>;
            hv-support = <0>;
            os-support = <0>;
            hwcap-bit-nr = <xx>;
        };
        vsx2-newinsns {
            isa = <3020>;
            usable-privilege = <1 | 2 | 4>;
            os-support = <1>;
            fscr-bit-nr = <xx>;
            hwcap-bit-nr = <xx>;
            feature-dependencies = <&vsx2>;
        };
    };
```

## Documentation/devicetree/bindings/powerpc/ibm,vas.yaml
```yaml
# SPDX-License-Identifier: (GPL-2.0-only OR BSD-2-Clause)
# Copyright IBM Corp. 2025
%YAML 1.2
---
$id: http://devicetree.org/schemas/powerpc/ibm,vas.yaml#
$schema: http://devicetree.org/meta-schemas/core.yaml#

title: IBM Powerpc Virtual Accelerator Switchboard (VAS)

maintainers:
  - Sukadev Bhattiprolu <sukadev@linux.vnet.ibm.com>

description: |
  * IBM Powerpc Virtual Accelerator Switchboard (VAS)

  VAS is a hardware mechanism that allows kernel subsystems and user processes
  to directly submit compression and other requests to Nest accelerators (NX)
  or other coprocessors functions.

properties:
  compatible:
    description: Must be "ibm,vas" and optional "ibm,power9-vas".
    oneOf:
      - items:
          - const: ibm,vas
          - const: ibm,power9-vas
      - items:
          - const: ibm,vas

  reg:
    description: Register windows for VAS.
    items:
      - description: Hypervisor window context start and length
      - description: OS/User window context start and length
      - description: Paste address start and length
      - description: Paste window id start bit and number of bits

  name:
    description: Name of the VAS instance.

  ibm,vas-id:
    description: A unique identifier for each instance of VAS in the system.
    $ref: /schemas/types.yaml#/definitions/uint32

required:
  - compatible
  - reg
  - ibm,vas-id

additionalProperties: false

examples:
  - |
    vas@6019100000000 {
      compatible = "ibm,vas", "ibm,power9-vas";
      reg = <0x6019100000000 0x2000000 0x6019000000000 0x100000000 0x8000000000000 0x100000000 0x20 0x10>;
      ibm,vas-id = <0x1>;
    };
```

## Documentation/devicetree/bindings/powerpc/nintendo/nintendo,flipper.yaml
```yaml
# SPDX-License-Identifier: (GPL-2.0-only OR BSD-2-Clause)
# Copyright 2025 Bjorn Helgaas <bhelgaas@google.com>, Grant Likely <grant.likely@secretlab.ca>
%YAML 1.2
---
$id: http://devicetree.org/schemas/nintendo,flipper.yaml#
$schema: http://devicetree.org/meta-schemas/core.yaml#

title: Nintendo GameCube Flipper chip
maintainers:
  - Bjorn Helgaas <bhelgaas@google.com>
  - Grant Likely <grant.likely@secretlab.ca>

description: |
  Nintendo GameCube device tree

  The "flipper" node

    This node represents the multi-function "Flipper" chip, which packages
    many of the devices found in the Nintendo GameCube.

properties:
  compatible:
    description: Must be "nintendo,flipper"
    items:
      - const: nintendo,flipper

  interrupt-controller: true

required:
  - compatible
  - interrupt-controller

patternProperties:
  "^vi@.*":
    description: Video Interface (VI) node
    type: object
    properties:
      compatible:
        items:
          - const: nintendo,flipper-vi
      reg:
        description: VI registers region
        items:
          - description: VI registers base address
          - description: VI registers length
      interrupts:
        description: VI interrupt
        items:
          - description: interrupt number
    required:
      - compatible
      - reg
      - interrupts
    additionalProperties: false

  "^pi@.*":
    description: Processor Interface (PI) node
    type: object
    properties:
      compatible:
        items:
          - const: nintendo,flipper-pi
      reg:
        description: PI registers region
        items:
          - description: PI registers base address
          - description: PI registers length
    required:
      - compatible
      - reg
    additionalProperties: false
    patternProperties:
      "^pic@.*":
        description: Flipper interrupt controller (PIC) node
        type: object
        properties:
          compatible:
            items:
              - const: nintendo,flipper-pic
        required:
          - compatible
        additionalProperties: false

  "^dsp@.*":
    description: Digital Signal Processor (DSP) node
    type: object
    properties:
      compatible:
        items:
          - const: nintendo,flipper-dsp
      reg:
        description: DSP registers region
        items:
          - description: DSP registers base address
          - description: DSP registers length
      interrupts:
        description: DSP interrupt
        items:
          - description: interrupt number
    required:
      - compatible
      - reg
      - interrupts
    additionalProperties: false
    patternProperties:
      "^aram@.*":
        description: Auxiliary RAM (ARAM) node
        type: object
        properties:
          compatible:
            items:
              - const: nintendo,flipper-aram
          reg:
            description: ARAM region
            items:
              - description: ARAM start (zero-based)
              - description: ARAM length
        required:
          - compatible
          - reg
        additionalProperties: false

  "^di@.*":
    description: Disk Interface (DI) node
    type: object
    properties:
      compatible:
        items:
          - const: nintendo,flipper-di
      reg:
        description: DI registers region
        items:
          - description: DI registers base address
          - description: DI registers length
      interrupts:
        description: DI interrupt
        items:
          - description: interrupt number
    required:
      - compatible
      - reg
      - interrupts
    additionalProperties: false

  "^ai@.*":
    description: Audio Interface (AI) node
    type: object
    properties:
      compatible:
        items:
          - const: nintendo,flipper-ai
      reg:
        description: AI registers region
        items:
          - description: AI registers base address
          - description: AI registers length
      interrupts:
        description: AI interrupt
        items:
          - description: interrupt number
    required:
      - compatible
      - reg
      - interrupts
    additionalProperties: false

  "^si@.*":
    description: Serial Interface (SI) node
    type: object
    properties:
      compatible:
        items:
          - const: nintendo,flipper-si
      reg:
        description: SI registers region
        items:
          - description: SI registers base address
          - description: SI registers length
      interrupts:
        description: SI interrupt
        items:
          - description: interrupt number
    required:
      - compatible
      - reg
      - interrupts
    additionalProperties: false

  "^exi@.*":
    description: External Interface (EXI) node
    type: object
    properties:
      compatible:
        items:
          - const: nintendo,flipper-exi
      reg:
        description: EXI registers region
        items:
          - description: EXI registers base address
          - description: EXI registers length
      interrupts:
        description: EXI interrupt
        items:
          - description: interrupt number
    required:
      - compatible
      - reg
      - interrupts
    additionalProperties: false

additionalProperties: false

examples:
  - |
    flipper@<base> {
      compatible = "nintendo,flipper";
      interrupt-controller;
      vi@<addr> {
        compatible = "nintendo,flipper-vi";
        reg = <0x1000 0x20>;
        interrupts = <1>;
      };
      pi@<addr> {
        compatible = "nintendo,flipper-pi";
        reg = <0x2000 0x10>;
        pic@<addr> {
          compatible = "nintendo,flipper-pic";
        };
      };
      dsp@<addr> {
        compatible = "nintendo,flipper-dsp";
        reg = <0x3000 0x20>;
        interrupts = <2>;
        aram@<addr> {
          compatible = "nintendo,flipper-aram";
          reg = <0x0 0x80000>;
        };
      };
      di@<addr> {
        compatible = "nintendo,flipper-di";
        reg = <0x4000 0x10>;
        interrupts = <3>;
      };
      ai@<addr> {
        compatible = "nintendo,flipper-ai";
        reg = <0x5000 0x10>;
        interrupts = <4>;
      };
      si@<addr> {
        compatible = "nintendo,flipper-si";
        reg = <0x6000 0x10>;
        interrupts = <5>;
      };
      exi@<addr> {
        compatible = "nintendo,flipper-exi";
        reg = <0x7000 0x10>;
        interrupts = <6>;
      };
    };
```

## Documentation/devicetree/bindings/powerpc/opal/ibm,opal-oppanel.yaml
```yaml
# SPDX-License-Identifier: (GPL-2.0-only OR BSD-2-Clause)
# Copyright 2025 Suraj Jitindar Singh <sjitindarsingh@gmail.com>
%YAML 1.2
---
$id: http://devicetree.org/schemas/powerpc/opal/ibm,opal-oppanel.yaml#
$schema: http://devicetree.org/meta-schemas/core.yaml#

title: IBM OPAL Operator Panel

maintainers:
  - Suraj Jitindar Singh <sjitindarsingh@gmail.com>

description: |
  IBM OPAL Operator Panel Binding
  -------------------------------

properties:
  compatible:
    items:
      - const: ibm,opal-oppanel

  '#lines':
    description: Number of lines on the operator panel.

  '#length':
    description: Number of characters per line of the operator panel.

required:
  - compatible
  - '#lines'
  - '#length'

additionalProperties: false

examples:
  - |
    oppanel {
      compatible = "ibm,opal-oppanel";
      #lines = <0x2>;
      #length = <0x10>;
    };
```
