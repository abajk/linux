## Documentation/devicetree/bindings/powerpc/fsl/fsl,pamu-v1.0.yaml
```yaml
%YAML 1.2
---
$id: http://devicetree.org/schemas/fsl,pamu-v1.0.yaml#
$schema: http://devicetree.org/meta-schemas/core.yaml#

title: Freescale PAMU I/O MMU

maintainers:
  - Diana Craciun <Diana.Craciun@freescale.com>
  - Rob Herring <robh@kernel.org>
  - Timur Tabi <timur@freescale.com>

description: |
  The Freescale Peripheral Management Access Unit (PAMU) is an I/O MMU that
  provides device-to-memory access control and address translation capabilities.

properties:
  compatible:
    oneOf:
      - items:
          - enum:
              - fsl,pamu-v1.0
          - const: fsl,pamu
      - items:
          - const: fsl,pamu

  reg:
    items:
      - description: CCSR registers of all combined PAMU controllers

  ranges:
    description: Translation window definitions
    items:
      - description: Parent bus address
      - description: PAMU bus address
      - description: Size of the window

  fsl,portid-mapping:
    description: Bitmask to select bits in port mapping registers for snooping
    $ref: /schemas/types.yaml#/definitions/uint32

  '#address-cells':
    const: 1

  '#size-cells':
    const: 1

  interrupts:
    description: Interrupt mappings
    items:
      - description: PAMU access violation interrupt spec
      - description: PAMU hardware error interrupt spec

patternProperties:
  "^pamu@.*":
    type: object
    properties:
      reg:
        items:
          - description: Configuration registers of this PAMU controller
      fsl,primary-cache-geometry:
        description: Primary PAMU cache geometry (lines, ways)
        $ref: /schemas/types.yaml#/definitions/uint32-array
        items:
          - description: Number of cache lines
          - description: Number of ways
      fsl,secondary-cache-geometry:
        description: Secondary PAMU cache geometry (lines, ways)
        $ref: /schemas/types.yaml#/definitions/uint32-array
        items:
          - description: Number of cache lines
          - description: Number of ways
    required:
      - reg
      - fsl,primary-cache-geometry
      - fsl,secondary-cache-geometry
    additionalProperties: false

required:
  - compatible
  - ranges
  - interrupts

additionalProperties: false

examples:
  - |
    iommu@20000 {
        compatible = "fsl,pamu-v1.0", "fsl,pamu";
        reg = <0x20000 0x5000>;
        ranges = <0 0x20000 0x5000>;
        fsl,portid-mapping = <0xf80000>;
        #address-cells = <1>;
        #size-cells = <1>;
        interrupts = <
            24 2 0 0
            16 2 1 30>;
        pamu0: pamu@0 {
            reg = <0 0x1000>;
            fsl,primary-cache-geometry = <32 1>;
            fsl,secondary-cache-geometry = <128 2>;
        };
        pamu1: pamu@1000 {
            reg = <0x1000 0x1000>;
            fsl,primary-cache-geometry = <32 1>;
            fsl,secondary-cache-geometry = <128 2>;
        };
        /* ... additional pamu controllers ... */
    };
```

## Documentation/devicetree/bindings/powerpc/fsl/fsl,raideng-v1.0.yaml
```yaml
# SPDX-License-Identifier: (GPL-2.0-only OR BSD-2-Clause)
# Copyright 2025 Bjorn Helgaas <bhelgaas@google.com>
# Copyright 2025 Xuelin Shi <b29237@freescale.com>
%YAML 1.2
---
$id: http://devicetree.org/schemas/powerpc/fsl/fsl,raideng-v1.0.yaml#
$schema: http://devicetree.org/meta-schemas/core.yaml#

title: Freescale 85xx RAID Engine
maintainers:
  - Bjorn Helgaas <bhelgaas@google.com>
  - Xuelin Shi <b29237@freescale.com>
description: |
  Freescale 85xx RAID Engine nodes

  RAID Engine nodes are defined to describe on-chip RAID accelerators. Each RAID
  Engine should have a separate node.

  Supported chips:
  P5020, P5040

properties:
  compatible:
    enum:
      - fsl,raideng-v1.0
    description: Identifies RAID Engine hardware IP version
  reg:
    description: Offset and length of the register set for the RAID Engine
    items:
      - description: Base address
      - description: Size of register region
  ranges:
    description: Translation between child address space and parent address space
    items:
      - description: Child address
      - description: Parent address and size

required:
  - compatible
  - reg
  - ranges

definitions:
  raideng-job-queue:
    description: Job queue sub-node of RAID Engine
    type: object
    properties:
      compatible:
        enum:
          - fsl,raideng-v1.0-job-queue
        description: Identifies the job queue interface
      reg:
        description: Offset and length of the register set for job queue
        items:
          - description: Base address
          - description: Size of register region
      ranges:
        description: Translation between child address space and parent address space for job queue
        items:
          - description: Child address
          - description: Parent address and size
    required:
      - compatible
      - reg
      - ranges
    additionalProperties: false

  raideng-job-ring:
    description: Job ring sub-node of RAID Engine job queue
    type: object
    properties:
      compatible:
        enum:
          - fsl,raideng-v1.0-job-ring
          - fsl,raideng-v1.0-hp-ring
          - fsl,raideng-v1.0-lp-ring
        description: Identifies job ring and priority
      reg:
        description: Offset and length of the register set for job ring
        items:
          - description: Base address
          - description: Size of register region
      interrupts:
        description: Interrupt mapping for job ring IRQ
        items:
          - description: IRQ number and flags
      fsl,liodn:
        description: LIODN to be used for Job Ring
        $ref: /schemas/types.yaml#/definitions/uint32
    required:
      - compatible
      - reg
      - interrupts
    additionalProperties: false

patternProperties:
  "^[^/]+$":
    anyOf:
      - $ref: '#/definitions/raideng-job-queue'
      - $ref: '#/definitions/raideng-job-ring'

additionalProperties: false

examples:
  - |
    raideng: raideng@320000 {
        compatible = "fsl,raideng-v1.0";
        reg = <0x320000 0x10000>;
        ranges = <0 0x320000 0x10000>;
        raideng_jq0@1000 {
            compatible = "fsl,raideng-v1.0-job-queue";
            reg = <0x1000 0x1000>;
            ranges = <0x0 0x1000 0x1000>;
            raideng_jr0: jr@0 {
                compatible = "fsl,raideng-v1.0-job-ring", "fsl,raideng-v1.0-hp-ring";
                reg = <0x0 0x400>;
                interrupts = <139 2 0 0>;
                fsl,liodn = <0x41>;
            };
        };
    };
```

## Documentation/devicetree/bindings/powerpc/fsl/fsl,scfg.yaml
```yaml
# SPDX-License-Identifier: (GPL-2.0-only OR BSD-2-Clause)
%YAML 1.2
---
$id: http://devicetree.org/schemas/powerpc/fsl/fsl,scfg.yaml#
$schema: http://devicetree.org/meta-schemas/core.yaml#

title: Freescale Supplement configuration unit (SCFG)

maintainers:
  - Wang Dongsheng <dongsheng.wang@freescale.com>

description: |
  Freescale Supplement configuration unit (SCFG)

  SCFG is the supplemental configuration unit, that provides SoC specific
  configuration and status registers for the chip. Such as getting PEX port
  status.

properties:
  compatible:
    items:
      - pattern: '^fsl,[-a-z0-9]+-scfg$'

  reg:
    maxItems: 1

additionalProperties: false

examples:
  - |
    scfg: global-utilities@fc000 {
        compatible = "fsl,t1040-scfg";
        reg = <0xfc000 0x1000>;
    };
```

## Documentation/devicetree/bindings/powerpc/fsl/fsl,srio-rmu.yaml
```yaml
# SPDX-License-Identifier: (GPL-2.0-only OR BSD-2-Clause)
# Copyright 2025 Frank Rowand, Liu Gang
%YAML 1.2
---
$id: http://devicetree.org/schemas/powerpc/fsl/fsl,srio-rmu.yaml#
$schema: http://devicetree.org/meta-schemas/core.yaml#

title: Freescale SRIO RMU
maintainers:
  - Frank Rowand <frowand.list@gmail.com>
  - Liu Gang <Gang.Liu@freescale.com>
description: |
  Message unit node:

  For SRIO controllers that implement the message unit as part of the controller
  this node is required.  For devices with RMAN this node should NOT exist.  The
  node is composed of three types of sub-nodes ("fsl,srio-msg-unit",
  "fsl,srio-dbell-unit" and "fsl,srio-port-write-unit").

  See srio.txt for more details about generic SRIO controller details.

  Sub-Nodes for RMU:
  The RMU node is composed of multiple sub-nodes that correspond to the actual
  sub-controllers in the RMU.  The manual for a given SoC will detail which and
  how many of these sub-controllers are implemented.

properties:
  compatible:
    oneOf:
      - items:
          - pattern: "^fsl,srio-rmu-v[0-9]+\\.[0-9]+$"
          - const: fsl,srio-rmu
      - items:
          - const: fsl,srio-rmu

  reg:
    description: |
      Physical address and length of the SRIO configuration registers for
      message and doorbell units.
    items:
      - description: Base address
      - description: Length

  ranges:
    description: RMU address window mappings to parent bus.
    items:
      - description: Child address
      - description: Parent address
      - description: Size

  "fsl,liodn":
    description: Logical I/O device number for the PAMU.
    items:
      - description: LIODN

  # Sub-nodes for RMU
  "fsl,srio-msg-unit":
    description: SRIO message unit sub-node.
    type: boolean

  "fsl,srio-dbell-unit":
    description: SRIO doorbell unit sub-node.
    type: boolean

  "fsl,srio-port-write-unit":
    description: SRIO port-write unit sub-node.
    type: boolean

required:
  - compatible
  - reg

additionalProperties: false

examples:
  - |
    rmu: rmu@d3000 {
        compatible = "fsl,srio-rmu";
        reg = <0xd3000 0x400>;
        ranges = <0x0 0xd3000 0x400>;
        fsl,liodn = <0xc8>;

        message-unit@0 {
            compatible = "fsl,srio-msg-unit";
            reg = <0x0 0x100>;
            interrupts = <
                60 2 0 0  /* msg1_tx_irq */
                61 2 0 0>;/* msg1_rx_irq */
        };
        message-unit@100 {
            compatible = "fsl,srio-msg-unit";
            reg = <0x100 0x100>;
            interrupts = <
                62 2 0 0  /* msg2_tx_irq */
                63 2 0 0>;/* msg2_rx_irq */
        };
        doorbell-unit@400 {
            compatible = "fsl,srio-dbell-unit";
            reg = <0x400 0x80>;
            interrupts = <
                56 2 0 0  /* bell_outb_irq */
                57 2 0 0>;/* bell_inb_irq */
        };
        port-write-unit@4e0 {
            compatible = "fsl,srio-port-write-unit";
            reg = <0x4e0 0x20>;
            interrupts = <16 2 1 11>;
        };
    };
```

## Documentation/devicetree/bindings/powerpc/fsl/fsl,srio.yaml
```yaml
# SPDX-License-Identifier: (GPL-2.0-only OR BSD-2-Clause)
%YAML 1.2
---
$id: http://devicetree.org/schemas/powerpc/fsl/fsl,srio.yaml#
$schema: http://devicetree.org/meta-schemas/core.yaml#

title: Freescale Serial RapidIO (SRIO) Controller

maintainers:
  - Liu Gang <Gang.Liu@freescale.com>
  - Masanari Iida <standby24x7@gmail.com>

properties:
  compatible:
    description: >
      Must include "fsl,srio" for IP blocks with IP Block Revision Register
      (SRIO IPBRR1) Major ID equal to 0x01c0. Optionally, a compatible string
      of "fsl,srio-vX.Y" where X is Major version and Y is Minor version.
    oneOf:
      - items:
          - pattern: '^fsl,srio-v[0-9]+\.[0-9]+$'
          - const: fsl,srio
      - items:
          - const: fsl,srio

  reg:
    maxItems: 1

  interrupts:
    maxItems: 1

  fsl,srio-rmu-handle:
    description:
      A single phandle value that points to the RMU, required if the RMU node is
      defined.
    $ref: /schemas/types.yaml#/definitions/phandle

  "#address-cells":
    const: 2

  "#size-cells":
    const: 2

  ranges: true

patternProperties:
  "^port[0-9]+$":
    type: object
    description: SRIO port child node
    additionalProperties: false

    properties:
      cell-index:
        description: Matches the port id
        $ref: /schemas/types.yaml#/definitions/uint32

      "#address-cells":
        const: 2

      "#size-cells":
        const: 2

      fsl,liodn:
        description: >
          The logical I/O device number for the PAMU (IOMMU) to be correctly
          configured for SRIO accesses.
        $ref: /schemas/types.yaml#/definitions/uint32

      ranges:
        description: Memory mapped IO space utilized by this port

    required:
      - cell-index
      - "#address-cells"
      - "#size-cells"

additionalProperties: false

examples:
  - |
    rapidio: rapidio@ffe0c0000 {
      #address-cells = <2>;
      #size-cells = <2>;
      reg = <0xf 0xfe0c0000 0 0x11000>;
      compatible = "fsl,srio";
      interrupts = <16 2 1 11>;
      fsl,srio-rmu-handle = <&rmu>;
      ranges;

      port1 {
        cell-index = <1>;
        #address-cells = <2>;
        #size-cells = <2>;
        fsl,liodn = <34>;
        ranges = <0 0 0xc 0x20000000 0 0x10000000>;
      };

      port2 {
        cell-index = <2>;
        #address-cells = <2>;
        #size-cells = <2>;
        fsl,liodn = <48>;
        ranges = <0 0 0xc 0x30000000 0 0x10000000>;
      };
    };
```

## Documentation/devicetree/bindings/powerpc/fsl/mpc5121-psc.yaml
```yaml
# SPDX-License-Identifier: (GPL-2.0-only OR BSD-2-Clause)
%YAML 1.2
---
$id: http://devicetree.org/schemas/powerpc/fsl/mpc5121-psc.yaml#
$schema: http://devicetree.org/meta-schemas/core.yaml#

title: MPC5121 PSC
maintainers:
  - Grant Likely <grant.likely@secretlab.ca>
  - Rob Herring <robh@kernel.org>
  - Uwe Kleine-König <u.kleine-koenig@pengutronix.de>

description: |
  MPC5121 PSC Device Tree Bindings

  PSC in UART mode

  For PSC in UART mode the needed PSC serial devices
  are specified by fsl,mpc5121-psc-uart nodes in the
  fsl,mpc5121-immr SoC node. Additionally the PSC FIFO
  Controller node fsl,mpc5121-psc-fifo is required there:

  fsl,mpc512x-psc-uart nodes

  PSC in SPI mode

  Similar to the UART mode a PSC can be operated in SPI mode. The compatible used
  for that is fsl,mpc5121-psc-spi. It requires a fsl,mpc5121-psc-fifo as well.
  The required and recommended properties are identical to the
  fsl,mpc5121-psc-uart nodes, just use spi instead of uart in the compatible
  string.

  fsl,mpc512x-psc-fifo node

properties:
  compatible:
    oneOf:
      - items:
          - const: "fsl,mpc5121-psc-uart"
          - const: "fsl,mpc5121-psc"
      - items:
          - const: "fsl,mpc5121-psc-spi"
          - const: "fsl,mpc5121-psc"
      - items:
          - const: "fsl,mpc5121-psc-fifo"

  reg:
    items:
      - description: PSC register offset
      - description: PSC register block size

  interrupts:
    items:
      - description: PSC FIFO controller interrupt number
      - description: interrupt trigger encoding
    description: PSC FIFO controller interrupt number and trigger encoding

  fsl,rx-fifo-size:
    description: The size of the RX FIFO slice; a multiple of 4
    $ref: /schemas/types.yaml#/definitions/uint32

  fsl,tx-fifo-size:
    description: The size of the TX FIFO slice; a multiple of 4
    $ref: /schemas/types.yaml#/definitions/uint32

  clocks:
    maxItems: 1
    description: Clock input for the PSC FIFO controller

  clock-names:
    items:
      - const: bus

additionalProperties: false

required:
  - compatible
  - reg
  - interrupts

examples:
  - |
    serial@11000 {
        compatible = "fsl,mpc5121-psc-uart", "fsl,mpc5121-psc";
        cell-index = <0>;
        reg = <0x11000 0x100>;
        interrupts = <40 0x8>;
        fsl,rx-fifo-size = <16>;
        fsl,tx-fifo-size = <16>;
    };
  - |
    serial@11100 {
        compatible = "fsl,mpc5121-psc-uart", "fsl,mpc5121-psc";
        cell-index = <1>;
        reg = <0x11100 0x100>;
        interrupts = <40 0x8>;
        fsl,rx-fifo-size = <16>;
        fsl,tx-fifo-size = <16>;
    };
  - |
    pscfifo@11f00 {
        compatible = "fsl,mpc5121-psc-fifo";
        reg = <0x11f00 0x100>;
        interrupts = <40 0x8>;
    };
```
