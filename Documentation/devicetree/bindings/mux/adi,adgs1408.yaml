## Documentation/devicetree/bindings/mux/adi,adgs1408.yaml
```yaml
# SPDX-License-Identifier: (GPL-2.0-only OR BSD-2-Clause)
# Copyright 2025 Analog Devices, Inc.
%YAML 1.2
---
$id: http://devicetree.org/schemas/mux/adi,adgs1408.yaml#
$schema: http://devicetree.org/meta-schemas/core.yaml#

title: Analog Devices ADGS1408/1409 8:1/Dual 4:1 Mux Controller
maintainers:
  - Mircea Caprioru <mircea.caprioru@analog.com>
  - Rob Herring <robh@kernel.org>

description: |
  Bindings for Analog Devices ADGS1408/1409 8:1/Dual 4:1 Mux

  States 0 through 7 correspond to signals S1 through S8 in the datasheet.
  For ADGS1409 only states 0 to 3 are available.

properties:
  compatible:
    description: Compatible string identifying the device.
    items:
      - enum:
          - adi,adgs1408
          - adi,adgs1409

  reg:
    description: Register specifying the chip‐select index of the multiplexer.
    items:
      - description: Chip‐select index register offset.

  spi-max-frequency:
    description: Maximum supported SPI bus frequency.
    $ref: /schemas/types.yaml#/definitions/uint32

  '#mux-control-cells':
    const: 0
    description: Number of mux control cells (always zero).

  gpio-controller:
    description: Indicates that a GPIO child node is present for channel selection.
    type: boolean

  '#gpio-cells':
    description: GPIO specifier cells.
    $ref: /schemas/types.yaml#/definitions/uint32-array

  idle-state:
    description: Idle state for the mux controller when idle.
    enum:
      - MUX_IDLE_AS_IS
      - MUX_IDLE_DISCONNECT

required:
  - compatible

additionalProperties: false
```

## Documentation/devicetree/bindings/net/adaptrum,anarion-gmac.yaml
```yaml
# SPDX-License-Identifier: (GPL-2.0-only OR BSD-2-Clause)
%YAML 1.2
---
$id: http://devicetree.org/schemas/adaptrum,anarion-gmac.yaml#
$schema: http://devicetree.org/meta-schemas/core.yaml#

title: Adaptrum Anarion Ethernet Controller

maintainers:
  - Alexandru Gagniuc <alex.g@adaptrum.com>

description: |
  Adaptrum Anarion ethernet controller

  This device is a platform glue layer for stmmac.
  Please see stmmac.txt for the other unchanged properties.

properties:
  compatible:
    description: Device compatible string
    items:
      - const: adaptrum,anarion-gmac
      - const: snps,dwmac

  reg:
    description: Register blocks
    items:
      - description: core registers
      - description: aux registers

  interrupts:
    description: MAC interrupt
    items:
      - description: MAC interrupt line

  interrupt-names:
    items:
      - const: macirq

  clocks:
    maxItems: 1
    description: Bus clock for the MAC

  clock-names:
    items:
      - const: stmmaceth

  phy-mode:
    description: Physical interface mode
    enum:
      - rgmii

required:
  - compatible
  - reg
  - interrupts
  - phy-mode

additionalProperties: false

examples:
  - |
    ethernet@f2014000 {
        compatible = "adaptrum,anarion-gmac", "snps,dwmac";
        reg = <0xf2014000 0x4000>,
              <0xf2018100 8>;
        interrupts = <21>;
        interrupt-names = "macirq";
        clocks = <&core_clk>;
        clock-names = "stmmaceth";
        phy-mode = "rgmii";
    };
```

## Documentation/devicetree/bindings/net/amd,xgbe-seattle-v1a.yaml
```yaml
# SPDX-License-Identifier: (GPL-2.0-only OR BSD-2-Clause)
# Copyright 2025 AMD
%YAML 1.2
---
$id: http://devicetree.org/schemas/amd,xgbe-seattle-v1a.yaml#
$schema: http://devicetree.org/meta-schemas/core.yaml#

title: AMD XGBE Seattle v1a
maintainers:
  - Lendacky, Thomas <Thomas.Lendacky@amd.com>
  - Petr Štetiar <ynezz@true.cz>
  - Rob Herring <robh@kernel.org>

description: |
  AMD 10GbE driver (amd-xgbe)

  The MAC address will be determined using the optional properties defined in
  ethernet.txt.

  The following optional properties are represented by an array with each
  value corresponding to a particular speed. The first array value represents
  the setting for the 1GbE speed, the second value for the 2.5GbE speed and
  the third value for the 10GbE speed. All three values are required if the
  property is used.

properties:
  compatible:
    const: "amd,xgbe-seattle-v1a"

  reg:
    items:
      - description: MAC registers
      - description: PCS registers
      - description: SerDes Rx/Tx registers
      - description: SerDes integration registers (1/2)
      - description: SerDes integration registers (2/2)

  interrupts:
    description: Device interrupts. The first entry is the general device
      interrupt. If amd,per-channel-interrupt is specified, each DMA channel
      interrupt must be specified. The last entry is the PCS auto-negotiation
      interrupt.
    minItems: 1
    items:
      - description: General device interrupt
      - description: PCS auto-negotiation interrupt

  clocks:
    description: Clock phandles for the device.
    items:
      - description: DMA clock for the device
      - description: PTP clock for the device

  clock-names:
    items:
      - const: dma_clk
      - const: ptp_clk

  phy-mode:
    description: Physical interface mode. See ethernet.txt.

  dma-coherent: true

  mac-address:
    description: MAC address of the device in bytes.
    $ref: /schemas/types.yaml#/definitions/uint8-array
    minItems: 6
    maxItems: 6

  amd,per-channel-interrupt:
    description: Indicates that Rx and Tx complete will generate a unique
      interrupt for each DMA channel.
    type: boolean

  amd,speed-set:
    description: Speed capabilities of the device. 0 = 1GbE and 10GbE; 1 =
      2.5GbE and 10GbE.
    $ref: /schemas/types.yaml#/definitions/uint32
    enum: [0, 1]

  amd,serdes-blwc:
    description: Baseline wandering correction enablement for each speed.
    $ref: /schemas/types.yaml#/definitions/uint32-array
    items:
      - enum: [0, 1]
      - enum: [0, 1]
      - enum: [0, 1]

  amd,serdes-cdr-rate:
    description: CDR rate speed selection for each speed.
    $ref: /schemas/types.yaml#/definitions/uint32-array
    items:
      - description: CDR rate for 1GbE
      - description: CDR rate for 2.5GbE
      - description: CDR rate for 10GbE

  amd,serdes-pq-skew:
    description: PQ data sampling skew for each speed.
    $ref: /schemas/types.yaml#/definitions/uint32-array
    items:
      - description: PQ skew for 1GbE
      - description: PQ skew for 2.5GbE
      - description: PQ skew for 10GbE

  amd,serdes-tx-amp:
    description: TX amplitude boost for each speed.
    $ref: /schemas/types.yaml#/definitions/uint32-array
    items:
      - description: TX amplitude for 1GbE
      - description: TX amplitude for 2.5GbE
      - description: TX amplitude for 10GbE

  amd,serdes-dfe-tap-config:
    description: DFE taps available to run for each speed.
    $ref: /schemas/types.yaml#/definitions/uint32-array
    items:
      - description: DFE taps available for 1GbE
      - description: DFE taps available for 2.5GbE
      - description: DFE taps available for 10GbE

  amd,serdes-dfe-tap-enable:
    description: DFE taps to enable for each speed.
    $ref: /schemas/types.yaml#/definitions/uint32-array
    items:
      - description: DFE taps to enable for 1GbE
      - description: DFE taps to enable for 2.5GbE
      - description: DFE taps to enable for 10GbE

required:
  - compatible
  - reg
  - interrupts
  - clocks
  - clock-names
  - phy-mode

additionalProperties: false

examples:
  - |
    xgbe@e0700000 {
        compatible = "amd,xgbe-seattle-v1a";
        reg = <0 0xe0700000 0 0x80000>,
              <0 0xe0780000 0 0x80000>,
              <0 0xe1240800 0 0x00400>,
              <0 0xe1250000 0 0x00060>,
              <0 0xe1250080 0 0x00004>;
        interrupts = <0 325 4>,
                     <0 326 1>, <0 327 1>, <0 328 1>, <0 329 1>,
                     <0 323 4>;
        amd,per-channel-interrupt;
        clocks = <&xgbe_dma_clk>, <&xgbe_ptp_clk>;
        clock-names = "dma_clk", "ptp_clk";
        phy-mode = "xgmii";
        mac-address = [ 02 a1 a2 a3 a4 a5 ];
        amd,speed-set = <0>;
        amd,serdes-blwc = <1>, <1>, <0>;
        amd,serdes-cdr-rate = <2>, <2>, <7>;
        amd,serdes-pq-skew = <10>, <10>, <30>;
        amd,serdes-tx-amp = <15>, <15>, <10>;
        amd,serdes-dfe-tap-config = <3>, <3>, <1>;
        amd,serdes-dfe-tap-enable = <0>, <0>, <127>;
    };
```

## Documentation/devicetree/bindings/net/apm,xgene-mdio-rgmii.yaml
```yaml
# SPDX-License-Identifier: (GPL-2.0-only OR BSD-2-Clause)
%YAML 1.2
---
$id: http://devicetree.org/schemas/apm,xgene-mdio-rgmii.yaml#
$schema: http://devicetree.org/meta-schemas/core.yaml#

title: APM X-Gene SoC MDIO node

maintainers:
  - Iyappan Subramanian <isubramanian@apm.com>

properties:
  compatible:
    enum:
      - apm,xgene-mdio-rgmii
      - apm,xgene-mdio-xfi

  '#address-cells':
    const: 1

  '#size-cells':
    const: 0

  reg:
    maxItems: 1

  clocks:
    maxItems: 1

additionalProperties: false

required:
  - compatible
  - '#address-cells'
  - '#size-cells'
  - reg
  - clocks

examples:
  - |
    mdio: mdio@17020000 {
        compatible = "apm,xgene-mdio-rgmii";
        #address-cells = <1>;
        #size-cells = <0>;
        reg = <0x0 0x17020000 0x0 0xd100>;
        clocks = <&menetclk 0>;
    };

    &mdio {
        menetphy: phy@3 {
            reg = <0x3>;
        };
        sgenet0phy: phy@4 {
            reg = <0x4>;
        };
        sgenet1phy: phy@5 {
            reg = <0x5>;
        };
    };
```

## Documentation/devicetree/bindings/net/apm-xgene-enet.yaml
```yaml
# SPDX-License-Identifier: (GPL-2.0-only OR BSD-2-Clause)
%YAML 1.2
---
$id: http://devicetree.org/schemas/net/apm-xgene-enet.yaml#
$schema: http://devicetree.org/meta-schemas/core.yaml#

title: APM X-Gene SoC Ethernet nodes

maintainers:
  - Iyappan Subramanian <isubramanian@apm.com>
  - Keyur Chudgar <kchudgar@apm.com>

allOf:
 - $ref: ethernet-controller.yaml#

properties:
  compatible:
    enum:
      - apm,xgene-enet
      - apm,xgene1-sgenet
      - apm,xgene1-xgenet

  reg:
    maxItems: 3

  reg-names:
    items:
      - const: enet_csr
      - const: ring_csr
      - const: ring_cmd

  interrupts:
    items:
      - description: Rx interrupt
      - description: Tx completion interrupt

  interrupt-controller: true

  interrupt-names:
    items:
      - const: rx irq
      - const: tx irq

  channel:
    description: Ethernet to CPU start channel number
    $ref: /schemas/types.yaml#/definitions/uint32

  port-id:
    description: Port number
    $ref: /schemas/types.yaml#/definitions/uint32

  clocks:
    # Cases that have only a single entry just need to express that with maxItems
    maxItems: 1
    description: Reference to the clock entry

  phy-connection-type:
    description: Interface type between ethernet device and PHY
    $ref: /schemas/types.yaml#/definitions/string

  phy-handle:
    description: Reference to an external PHY device
    $ref: /schemas/types.yaml#/definitions/phandle

  mdio:
    description: MDIO bus subnode
    type: object
    properties:
      compatible:
        const: apm,xgene-mdio

    additionalProperties: true

  tx-delay:
    description: Delay value for RGMII bridge TX clock
    $ref: /schemas/types.yaml#/definitions/uint32
    enum: [0, 1, 2, 3, 4, 5, 6, 7]
    default: 4

  rx-delay:
    description: Delay value for RGMII bridge RX clock
    $ref: /schemas/types.yaml#/definitions/uint32
    enum: [0, 1, 2, 3, 4, 5, 6, 7]
    default: 2

  rxlos-gpios:
    description: Input GPIO from SFP+ module indicating incoming signal
    maxItems: 1

required:
  - compatible
  - reg
  - reg-names
  - interrupts
  - interrupt-controller

additionalProperties: false

examples:
  - |
    ethernet@17020000 {
      compatible = "apm,xgene-enet";
      reg = <0x17020000 0xd100>,
            <0x17030000 0x400>,
            <0x10000000 0x200>;
      reg-names = "enet_csr", "ring_csr", "ring_cmd";
      interrupts = <3>, <4>;
      interrupt-controller;
      interrupt-names = "rx irq", "tx irq";
      channel = <0>;
      port-id = <0>;
      clocks = <&menetclk 0>;
      local-mac-address = [00 01 73 00 00 01];
      phy-connection-type = "rgmii";
      phy-handle = <&menetphy>;
      mdio {
        compatible = "apm,xgene-mdio";
        #address-cells = <1>;
        #size-cells = <0>;
        menetphy: ethernet-phy-id001c.c915@3 {
          compatible = "ethernet-phy-id001c.c915";
          reg = <3>;
        };
      };
      tx-delay = <4>;
      rx-delay = <2>;
    };
```

## Documentation/devicetree/bindings/net/bluetooth/mediatek,mt7663u-bluetooth.yaml
```yaml
# SPDX-License-Identifier: (GPL-2.0-only OR BSD-2-Clause)
# Copyright 2025 Linaro Ltd.
%YAML 1.2
---
$id: http://devicetree.org/schemas/net/bluetooth/mediatek,mt7663u-bluetooth.yaml#
$schema: http://devicetree.org/meta-schemas/core.yaml#

title: MediaTek UART based Bluetooth Devices

maintainers:
  - Krzysztof Kozlowski <krzysztof.kozlowski@linaro.org>

description: |
  MediaTek UART based Bluetooth Devices

  This device is a serial attached device to UART device and thus it must be a
  child node of the serial node with UART.

  Please refer to the following documents for generic properties:
    Documentation/devicetree/bindings/serial/serial.yaml

properties:
  compatible:
    items:
      - enum:
          - mediatek,mt7663u-bluetooth
          - mediatek,mt7668u-bluetooth

  vcc-supply: true

  pinctrl-names:
    oneOf:
      - items:
          - enum: [default]
      - items:
          - enum:
              - default
              - runtime

  pinctrl-0:
    description: Bootstrap UART RXD pinmux configuration
    $ref: /schemas/types.yaml#/definitions/phandle-array

  pinctrl-1:
    description: Runtime UART pinmux configuration
    $ref: /schemas/types.yaml#/definitions/phandle-array

  boot-gpios:
    description: GPIO holding UART RXD low to enter bootstrap mode
    $ref: /schemas/types.yaml#/definitions/phandle-array

  reset-gpios:
    description: GPIO used to reset the device
    $ref: /schemas/types.yaml#/definitions/phandle-array

  clocks:
    description: Clock specifiers for the device
    $ref: /schemas/types.yaml#/definitions/phandle-array

  clock-names:
    items:
      - const: osc

  current-speed:
    description: Baud rate of the device
    $ref: /schemas/types.yaml#/definitions/uint32
    default: 921600

additionalProperties: false

examples:
  - |
    bluetooth {
      compatible = "mediatek,mt7663u-bluetooth";
      vcc-supply = <&reg_5v>;
      reset-gpios = <&pio 24 GPIO_ACTIVE_LOW>;
      pinctrl-names = "default", "runtime";
      pinctrl-0 = <&uart1_pins_boot>;
      pinctrl-1 = <&uart1_pins_runtime>;
      current-speed = <921600>;
    };
```
