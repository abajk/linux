## Documentation/devicetree/bindings/net/cavium,octeon-3860-mdio.yaml
```yaml
# SPDX-License-Identifier: (GPL-2.0-only OR BSD-2-Clause)
%YAML 1.2
---
$id: http://devicetree.org/schemas/net/cavium,octeon-3860-mdio.yaml#
$schema: http://devicetree.org/meta-schemas/core.yaml#

title: System Management Interface (SMI) / MDIO
maintainers:
  - David Daney <david.daney@cavium.com>

description: |
  * System Management Interface (SMI) / MDIO

  Typically an MDIO bus might have several children.

  * System Management Interface (SMI) / MDIO Nexus

    Several mdio buses may be gathered as children of a single PCI device,
    this PCI device is the nexus of the buses.

properties:
  compatible:
    oneOf:
      - items:
          - enum: ["cavium,octeon-3860-mdio"]
      - items:
          - enum: ["cavium,thunder-8890-mdio"]
      - items:
          - enum: ["cavium,thunder-8890-mdio-nexus"]

  reg:
    maxItems: 1
    description: |
      The base address of the MDIO bus controller register bank, or
      the PCI device and function numbers of the nexus device.

  '#address-cells':
    description: Must be 1 for MDIO buses, 2 for the MDIO nexus.

  '#size-cells':
    description: Must be 0 for MDIO buses, 2 for the MDIO nexus.

  ranges:
    description: As needed for mapping of the MDIO bus device registers.

  assigned-addresses:
    description: As needed for mapping of the MDIO bus device registers.
    $ref: /schemas/types.yaml#/definitions/uint32-array

required:
  - compatible
  - reg
  - '#address-cells'
  - '#size-cells'

allOf:
  - if:
      properties:
        compatible:
          contains:
            const: "cavium,thunder-8890-mdio-nexus"
    then:
      properties:
        '#address-cells':
          const: 2
        '#size-cells':
          const: 2
      required:
        - ranges
        - assigned-addresses
    else:
      properties:
        '#address-cells':
          const: 1
        '#size-cells':
          const: 0

additionalProperties: false
```

## Documentation/devicetree/bindings/net/cavium,octeon-3860-pip.yaml
```yaml
# SPDX-License-Identifier: (GPL-2.0-only OR BSD-2-Clause)
%YAML 1.2
---
$id: http://devicetree.org/schemas/net/cavium,octeon-3860-pip.yaml#
$schema: http://devicetree.org/meta-schemas/core.yaml#

title: Cavium Octeon PIP Ethernet nexus

maintainers:
  - Aaro Koskinen <aaro.koskinen@iki.fi>
  - David Daney <david.daney@cavium.com>
  - Sergei Shtylyov <sergei.shtylyov@cogentembedded.com>

description: |
  * PIP Ethernet nexus.

  The PIP Ethernet nexus can control several data packet input/output
  devices.  The devices have a two level grouping scheme.  There may be
  several interfaces, and each interface may have several ports.  These
  ports might be an individual Ethernet PHY.

properties:
  compatible:
    items:
      - const: cavium,octeon-3860-pip
    description: PIP Ethernet nexus compatible identifier
  reg:
    description: Base address of the PIP's register bank.
  '#address-cells':
    const: 1
    description: Number of address cells for child nodes. Must be 1.
  '#size-cells':
    const: 0
    description: Number of size cells for child nodes. Must be 0.

patternProperties:
  '^interface@.*$':
    description: Child nodes which are PIP interfaces
    type: object
    properties:
      compatible:
        items:
          - const: cavium,octeon-3860-pip-interface

      reg:
        maxItems: 1
      '#address-cells':
        const: 1
        description: Number of address cells for child ports. Must be 1.
      '#size-cells':
        const: 0
        description: Number of size cells for child ports. Must be 0.
    required:
      - compatible
      - reg
    additionalProperties: true

  '^ethernet@.*$':
    description: Child nodes which are PIP ports
    type: object
    properties:
      compatible:
        items:
          - const: cavium,octeon-3860-pip-port
        description: PIP port compatible identifier
      reg:
        description: Port number within the interface group.

      phy-handle:
        $ref: /schemas/types.yaml#/definitions/phandle
        description: Optional PHY phandle.
      rx-delay:
        $ref: /schemas/types.yaml#/definitions/uint32
        description: |
          Delay value for RGMII receive clock. Disabled if 0. Range 1–31; actual mapping
          varies with hardware.
      tx-delay:
        $ref: /schemas/types.yaml#/definitions/uint32
        description: |
          Delay value for RGMII transmit clock. Disabled if 0. Range 1–31; actual mapping
          varies with hardware.
    required:
      - compatible
      - reg
    additionalProperties: true

required:
  - compatible
  - reg
  - '#address-cells'
  - '#size-cells'

additionalProperties: false

examples:
  - |
    pip@11800a0000000 {
        compatible = "cavium,octeon-3860-pip";
        #address-cells = <1>;
        #size-cells = <0>;
        reg = <0x11800 0xa0000000 0x0 0x2000>;

        interface@0 {
            compatible = "cavium,octeon-3860-pip-interface";
            #address-cells = <1>;
            #size-cells = <0>;
            reg = <0>; /* interface */

            ethernet@0 {
                compatible = "cavium,octeon-3860-pip-port";
                reg = <0x0>; /* Port */
                local-mac-address = [ 00 0f b7 10 63 60 ];
                phy-handle = <&phy2>;
            };
            ethernet@1 {
                compatible = "cavium,octeon-3860-pip-port";
                reg = <0x1>; /* Port */
                local-mac-address = [ 00 0f b7 10 63 61 ];
                phy-handle = <&phy3>;
            };
            ethernet@2 {
                compatible = "cavium,octeon-3860-pip-port";
                reg = <0x2>; /* Port */
                local-mac-address = [ 00 0f b7 10 63 62 ];
                phy-handle = <&phy4>;
            };
            ethernet@3 {
                compatible = "cavium,octeon-3860-pip-port";
                reg = <0x3>; /* Port */
                local-mac-address = [ 00 0f b7 10 63 63 ];
                phy-handle = <&phy5>;
            };
        };

        interface@1 {
            compatible = "cavium,octeon-3860-pip-interface";
            #address-cells = <1>;
            #size-cells = <0>;
            reg = <1>; /* interface */

            ethernet@0 {
                compatible = "cavium,octeon-3860-pip-port";
                reg = <0x0>; /* Port */
                local-mac-address = [ 00 0f b7 10 63 64 ];
                phy-handle = <&phy6>;
            };
        };
    };
```

## Documentation/devicetree/bindings/net/cavium,octeon-5750-mix.yaml
```yaml
# SPDX-License-Identifier: (GPL-2.0-only OR BSD-2-Clause)
# Copyright 2025 Cavium, Inc.
%YAML 1.2
---
$id: http://devicetree.org/schemas/cavium,octeon-5750-mix.yaml#
$schema: http://devicetree.org/meta-schemas/core.yaml#

title: MIX Ethernet controller

maintainers:
  - David Daney <david.daney@cavium.com>
  - Sergei Shtylyov <sergei.shtylyov@cogentembedded.com>

description: |
  MIX Ethernet controller.

  Compatibility with all cn5XXX and cn6XXX SoCs populated with MIX
  devices.

properties:
  compatible:
    items:
      - const: cavium,octeon-5750-mix

  reg:
    description: |
      Base addresses of four separate register banks.
      The first bank contains the MIX registers.
      The second bank the corresponding AGL registers.
      The third bank are the AGL registers shared by all MIX devices present.
      The fourth bank is the AGL_PRT_CTL shared by all MIX devices present.
    items:
      - description: MIX registers
      - description: AGL registers
      - description: AGL_SHARED registers
      - description: AGL_PRT_CTL registers

  cell-index:
    description: >
      Specifies which portion of the shared register banks
      corresponds to this MIX device.
    $ref: /schemas/types.yaml#/definitions/uint32

  interrupts:
    description: |
      Two interrupt specifiers.
      The first is the MIX interrupt routing.
      The second is the AGL interrupt routing.
    items:
      - description: MIX interrupt routing
      - description: AGL interrupt routing

  interrupt-names:
    description: Interrupt names corresponding to the entries in 'interrupts'.
    items:
      - const: mix-irq
      - const: agl-irq

  local-mac-address:
    description: MAC address of the Ethernet port.
    $ref: /schemas/types.yaml#/definitions/string-array
    items:
      - minimum: 0
        maximum: 255
      - minimum: 0
        maximum: 255
      - minimum: 0
        maximum: 255
      - minimum: 0
        maximum: 255
      - minimum: 0
        maximum: 255
      - minimum: 0
        maximum: 255

  phy-handle:
    description: Handle to the PHY device.
    $ref: /schemas/types.yaml#/definitions/phandle

required:
  - compatible
  - reg
  - cell-index
  - interrupts

additionalProperties: false

examples:
  - |
    ethernet@1070000100800 {
        compatible = "cavium,octeon-5750-mix";
        reg = <0x10700 0x00100800 0x0 0x100>, /* MIX */
              <0x11800 0xE0000800 0x0 0x300>, /* AGL */
              <0x11800 0xE0000400 0x0 0x400>, /* AGL_SHARED  */
              <0x11800 0xE0002008 0x0 0x8>;   /* AGL_PRT_CTL */
        cell-index = <1>;
        interrupts = <1 18>, <1 46>;
        local-mac-address = [00 0f b7 10 63 54];
        phy-handle = <&phy1>;
    };
```

## Documentation/devicetree/bindings/net/cirrus,cs89x0.yaml
```yaml
# SPDX-License-Identifier: (GPL-2.0-only OR BSD-2-Clause)
# Copyright 2025 Alexander Shiyan
%YAML 1.2
---
$id: http://devicetree.org/schemas/net/cirrus,cs89x0.yaml#
$schema: http://devicetree.org/meta-schemas/core.yaml#

title: Cirrus Logic CS8900/CS8920 Network Controller

maintainers:
  - Alexander Shiyan <shc_work@mail.ru>

description: |
  Cirrus Logic CS8900/CS8920 Network Controller

properties:
  compatible:
    items:
      - const: cirrus,cs8900
      - const: cirrus,cs8920

  reg:
    description: Address and length of the IO space
    items:
      - description: Address of the IO space
      - description: Length of the IO space

  interrupts:
    description: Controller interrupt line
    items:
      - description: Interrupt line

required:
  - compatible
  - reg
  - interrupts

additionalProperties: false

examples:
  - |
    eth0: eth@10000000 {
        compatible = "cirrus,cs8900";
        reg = <0x10000000 0x400>;
        interrupts = <10>;
    };
```

## Documentation/devicetree/bindings/net/dsa/smsc,lan9303.yaml
```yaml
# SPDX-License-Identifier: (GPL-2.0-only OR BSD-2-Clause)
# Copyright EGIL Hjelmeland <privat@egil-hjelmeland.no>
#               Juergen Beisert <jbe@pengutronix.de>
#               Rob Herring <robh@kernel.org>
#               Vladimir Oltean <vladimir.oltean@nxp.com>
%YAML 1.2
---
$id: http://devicetree.org/schemas/net/dsa/smsc,lan9303.yaml#
$schema: http://devicetree.org/meta-schemas/core.yaml#

title: SMSC/MicroChip LAN9303 three port ethernet switch

maintainers:
  - Egil Hjelmeland <privat@egil-hjelmeland.no>
  - Juergen Beisert <jbe@pengutronix.de>
  - Rob Herring <robh@kernel.org>
  - Vladimir Oltean <vladimir.oltean@nxp.com>

description: |
  SMSC/MicroChip LAN9303 three port ethernet switch

  Subnodes:

  The integrated switch subnode should be specified according to the binding
  described in dsa/dsa.txt. The CPU port of this switch is always port 0.

  Note: always use 'reg = <0/1/2>;' for the three DSA ports, even if the device is
  configured to use 1/2/3 instead. This hardware configuration will be
  auto-detected and mapped accordingly.

properties:
  compatible:
    items:
      - enum:
          - smsc,lan9303-i2c
          - smsc,lan9303-mdio

  reg:
    items:
      - description: switch instance address on the bus

  reset-gpios:
    maxItems: 1
    description: GPIO to be used to reset the whole device

  reset-duration:
    $ref: /schemas/types.yaml#/definitions/uint32
    description: reset duration in milliseconds
    default: 200

required:
  - compatible
  - reg

additionalProperties: false

examples:
  - |
    master: masterdevice@X {
        fixed-link { /* RMII fixed link to LAN9303 */
            speed = <100>;
            full-duplex;
        };
    };

    switch: switch@a {
        compatible = "smsc,lan9303-i2c";
        reg = <0xa>;
        reset-gpios = <&gpio7 6 GPIO_ACTIVE_LOW>;
        reset-duration = <200>;

        ports {
            #address-cells = <1>;
            #size-cells = <0>;

            port@0 { /* RMII fixed link to master */
                reg = <0>;
                ethernet = <&master>;
            };

            port@1 { /* external port 1 */
                reg = <1>;
                label = "lan1";
            };

            port@2 { /* external port 2 */
                reg = <2>;
                label = "lan2";
            };
        };
    };
  - |
    master: masterdevice@X {
        phy-handle = <&switch>;

        mdio {
            #address-cells = <1>;
            #size-cells = <0>;

            switch: switch-phy@0 {
                compatible = "smsc,lan9303-mdio";
                reg = <0>;
                reset-gpios = <&gpio7 6 GPIO_ACTIVE_LOW>;
                reset-duration = <100>;

                ports {
                    #address-cells = <1>;
                    #size-cells = <0>;

                    port@0 {
                        reg = <0>;
                        ethernet = <&master>;
                    };

                    port@1 { /* external port 1 */
                        reg = <1>;
                        label = "lan1";
                    };

                    port@2 { /* external port 2 */
                        reg = <2>;
                        label = "lan2";
                    };
                };
            };
        };
    };
```
