## Documentation/devicetree/bindings/net/bluetooth/nokia,h4p-bluetooth.yaml
```yaml
# SPDX-License-Identifier: (GPL-2.0-only OR BSD-2-Clause)
# Copyright 2025 Krzysztof Kozlowski <krzysztof.kozlowski@linaro.org>
%YAML 1.2
---
$id: http://devicetree.org/schemas/nokia,h4p-bluetooth.yaml#
$schema: http://devicetree.org/meta-schemas/core.yaml#

title: Nokia H4P Bluetooth
maintainers:
  - Krzysztof Kozlowski <krzysztof.kozlowski@linaro.org>

description: |
  Nokia Bluetooth Chips

  Nokia phones often come with UART connected bluetooth chips from different
  vendors and modified device API. Those devices speak a protocol named H4+
  (also known as h4p) by Nokia, which is similar to the H4 protocol from the
  Bluetooth standard. In addition to the H4 protocol it specifies two more
  UART status lines for wakeup of UART transceivers to improve power management
  and a few new packet types used to negotiate uart speed.

properties:
  compatible:
    oneOf:
      - items:
          - enum:
              - brcm,bcm2048-nokia
              - ti,wl1271-bluetooth-nokia
          - const: nokia,h4p-bluetooth
      - items:
          - const: nokia,h4p-bluetooth

  clocks:
    description: System clock for the Bluetooth module.
    maxItems: 1

  clock-names:
    items:
      - const: sysclk

  reset-gpios:
    description: Controls the reset of the Bluetooth module (active low).
    maxItems: 1

  host-wakeup-gpios:
    description: Controls the host wakeup signal (active high).
    maxItems: 1

  bluetooth-wakeup-gpios:
    description: Controls the Bluetooth wakeup signal (active high).
    maxItems: 1

required:
  - compatible
  - clocks
  - clock-names
  - reset-gpios
  - host-wakeup-gpios
  - bluetooth-wakeup-gpios

additionalProperties: false

examples:
  - |
    &uart2 {
      bluetooth {
        compatible = "ti,wl1271-bluetooth-nokia", "nokia,h4p-bluetooth";
        clocks = <&bluetooth_clk>;
        clock-names = "sysclk";
        reset-gpios = <&gpio1 26 GPIO_ACTIVE_LOW>;
        host-wakeup-gpios = <&gpio4 5 GPIO_ACTIVE_HIGH>;
        bluetooth-wakeup-gpios = <&gpio2 5 GPIO_ACTIVE_HIGH>;
      };
    };
```

## Documentation/devicetree/bindings/net/brcm,bcm7445-switch-v4.0.yaml
```yaml
# SPDX-License-Identifier: (GPL-2.0-only OR BSD-2-Clause)
%YAML 1.2
---
$id: http://devicetree.org/schemas/brcm,bcm7445-switch-v4.0.yaml#
$schema: http://devicetree.org/meta-schemas/core.yaml#

title: Broadcom Starfighter 2 integrated switch

maintainers:
  - Bjorn Helgaas <bhelgaas@google.com>
  - Florian Fainelli <f.fainelli@gmail.com>
  - Mauro Carvalho Chehab <mchehab+huawei@kernel.org>
  - Rafał Miłecki <rafal@milecki.pl>
  - Scott Branden <sbranden@broadcom.com>

description: |
  Broadcom Starfighter 2 integrated switch

  See dsa/brcm,bcm7445-switch-v4.0.yaml for the documentation.

properties:
  compatible:
    const: brcm,bcm7445-switch-v4.0

  '#size-cells':
    const: 0

  '#address-cells':
    const: 2

  reg:
    description: Register blocks for the switch core and modules
    items:
      - description: Switch core registers
      - description: Switch control registers
      - description: Switch port 0 registers
      - description: Switch port 1 registers
      - description: Switch MAC control registers
      - description: Switch QoS/statistics registers

  interrupts:
    description: Switch interrupt numbers
    items:
      - description: Combined switch interrupt
      - description: Per-port status interrupt

  interrupt-controller: true

  dsa,mii-bus:
    description: Phandle to the MDIO bus controller
    $ref: /schemas/types.yaml#/definitions/phandle

  dsa,ethernet:
    description: Phandle to the CPU Ethernet interface controller
    $ref: /schemas/types.yaml#/definitions/phandle

  brcm,num-gphy:
    description: Number of internal GPHY ports
    $ref: /schemas/types.yaml#/definitions/uint32

  brcm,num-rgmii-ports:
    description: Number of RGMII ports
    $ref: /schemas/types.yaml#/definitions/uint32

  brcm,fcb-pause-override:
    description: Enable fast control frame pause override
    type: boolean

  brcm,acb-packets-inflight:
    description: Enable ACB packets in-flight tracking
    type: boolean

additionalProperties: false

examples:
  - |
    ethernet_switch@0 {
        compatible = "brcm,bcm7445-switch-v4.0";
        #size-cells = <0>;
        #address-cells = <2>;
        reg = <0x0 0x40000
               0x40000 0x110
               0x40340 0x30
               0x40380 0x30
               0x40400 0x34
               0x40600 0x208>;
        interrupts = <0 0x18 0
                      0 0x19 0>;
        interrupt-controller;
        dsa,mii-bus = <&mdio>;
        dsa,ethernet = <&eth0>;
        brcm,num-gphy = <1>;
        brcm,num-rgmii-ports = <2>;
        brcm,fcb-pause-override;
        brcm,acb-packets-inflight;
    };
```

## Documentation/devicetree/bindings/net/broadcom-bcm87xx.yaml
```yaml
# SPDX-License-Identifier: (GPL-2.0-only OR BSD-2-Clause)
# Copyright 2025 David Daney
---
$id: http://devicetree.org/schemas/broadcom-bcm87xx.yaml#
$schema: http://devicetree.org/meta-schemas/core.yaml#

title: Broadcom BCM87XX PHY
maintainers:
  - David Daney <david.daney@cavium.com>

description: |
  The Broadcom BCM87XX devices are a family of 10G Ethernet PHYs.  They
  have these bindings in addition to the standard PHY bindings.

  Compatible: Should contain "broadcom,bcm8706" or "broadcom,bcm8727" and
  "ethernet-phy-ieee802.3-c45"

properties:
  compatible:
    oneOf:
      - items:
          - const: broadcom,bcm8706
          - const: ethernet-phy-ieee802.3-c45
      - items:
          - const: broadcom,bcm8727
          - const: ethernet-phy-ieee802.3-c45

  reg:
    maxItems: 1
    description: MDIO PHY device address.

  interrupts:
    minItems: 1
    description: Interrupts from the PHY.
    items:
      - description: tx or combined interrupt
      - description: rx interrupt

  broadcom,c45-reg-init:
    description: One or more sets of MDIO C45 register initialization tuples.
    $ref: /schemas/types.yaml#/definitions/uint32-array
    minItems: 4

additionalProperties: false

examples:
  - |
    ethernet-phy@5 {
        compatible = "broadcom,bcm8706", "ethernet-phy-ieee802.3-c45";
        reg = <5>;
        interrupts = <12 8>;
        broadcom,c45-reg-init = <1 0xc808 0xff8f 0x70>;
    };
```

## Documentation/devicetree/bindings/net/can/bosch,cc770.yaml
```yaml
# SPDX-License-Identifier: (GPL-2.0-only OR BSD-2-Clause)
# Copyright 2025 Bjorn Helgaas
%YAML 1.2
---
$id: http://devicetree.org/schemas/net/can/bosch,cc770.yaml#
$schema: http://devicetree.org/meta-schemas/core.yaml#

title: Bosch CC770 and Intel AN82527 CAN controller

maintainers:
  - Bjorn Helgaas <bhelgaas@google.com>
  - Wolfgang Grandegger <wg@grandegger.com>

description: |
  Memory mapped Bosch CC770 and Intel AN82527 CAN controller

  Note: The CC770 is a CAN controller from Bosch, which is 100%
  compatible with the old AN82527 from Intel, but with "bugs" being fixed.

  For further information, please have a look to the CC770 or AN82527.

properties:
  compatible:
    oneOf:
      - items:
          - enum:
              - bosch,cc770
      - items:
          - enum:
              - intc,82527

  reg:
    items:
      - description: Chip select
      - description: Address offset
      - description: Register block size

  interrupts:
    description: Interrupt source (number and sensitivity) required for the controller
    items:
      - description: Interrupt specification

  bosch,clock-out-frequency:
    description: Clock frequency in Hz on the CLKOUT pin. If not specified or 0, the CLKOUT pin is disabled.
    $ref: /schemas/types.yaml#/definitions/uint32
    default: 0

  bosch,disconnect-rx0-input:
    description: Disconnect RX0 input (see data sheet).
    type: boolean

  bosch,disconnect-rx1-input:
    description: Disconnect RX1 input (see data sheet).
    type: boolean

  bosch,disconnect-tx1-output:
    description: Disconnect TX1 output (see data sheet).
    type: boolean

  bosch,divide-memory-clock:
    description: Divide memory clock (see data sheet).
    type: boolean

  bosch,external-clock-frequency:
    description: Frequency of the external oscillator clock in Hz. The internal clock is half this value.
    $ref: /schemas/types.yaml#/definitions/uint32
    default: 16000000

  bosch,iso-low-speed-mux:
    description: ISOLATED low speed MUX (see data sheet).
    type: boolean

  bosch,polarity-dominant:
    description: Polarity dominant (see data sheet).
    type: boolean

  bosch,slew-rate:
    description: Slew rate of the CLKOUT signal. If not specified, a reasonable value is calculated.
    $ref: /schemas/types.yaml#/definitions/uint32

required:
  - compatible
  - reg
  - interrupts

additionalProperties: false

examples:
  - |
    can@3,100 {
        compatible = "bosch,cc770";
        reg = <3 0x100 0x80>;
        interrupts = <2 0>;
        bosch,external-clock-frequency = <16000000>;
    };
```

## Documentation/devicetree/bindings/net/can/fsl,mpc5xxx-mscan.yaml
```yaml
# SPDX-License-Identifier: (GPL-2.0-only OR BSD-2-Clause)
# Copyright 2006-2009 Secret Lab Technologies Ltd
%YAML 1.2
---
$id: http://devicetree.org/schemas/net/can/fsl,mpc5xxx-mscan.yaml#
$schema: http://devicetree.org/meta-schemas/core.yaml#

title: Freescale MPC5xxx MSCAN controller

maintainers:
  - Grant Likely <grant.likely@secretlab.ca>

description: |
  CAN Device Tree Bindings

  (c) 2006-2009 Secret Lab Technologies Ltd
  Grant Likely <grant.likely@secretlab.ca>

  fsl,mpc5200-mscan nodes
  -----------------------
  In addition to the required compatible-, reg- and interrupt-properties, you can
  also specify which clock source shall be used for the controller:

  fsl,mpc5121-mscan nodes
  -----------------------
  In addition to the required compatible-, reg- and interrupt-properties, you can
  also specify which clock source and divider shall be used for the controller:

  Note that the MPC5121 Rev. 1 processor is not supported.

properties:
  compatible:
    items:
      - enum:
          - fsl,mpc5200-mscan
          - fsl,mpc5121-mscan

  reg:
    items:
      - description: Base address and size of the MSCAN controller registers

  interrupts:
    description: Interrupt specifier for the MSCAN controller
    items:
      - description: Interrupt number
      - description: Interrupt flags

  fsl,mscan-clock-source:
    description: Clock source for the MSCAN controller
    $ref: /schemas/types.yaml#/definitions/string
    enum:
      - ip
      - ref

  fsl,mscan-clock-divider:
    description: Clock divider for reference and system clocks
    $ref: /schemas/types.yaml#/definitions/uint32
    default: 1

required:
  - compatible
  - reg
  - interrupts

additionalProperties: false

examples:
  - |
    can@1300 {
        compatible = "fsl,mpc5121-mscan";
        interrupts = <12 0x8>;
        reg = <0x1300 0x80>;
    };
  - |
    can@1380 {
        compatible = "fsl,mpc5121-mscan";
        interrupts = <13 0x8>;
        reg = <0x1380 0x80>;
        fsl,mscan-clock-source = "ref";
        fsl,mscan-clock-divider = <3>;
    };
```

## Documentation/devicetree/bindings/net/can/holt,hi3110.yaml
```yaml
# SPDX-License-Identifier: (GPL-2.0-only OR BSD-2-Clause)
%YAML 1.2
---
$id: http://devicetree.org/schemas/net/can/holt,hi3110.yaml#
$schema: http://devicetree.org/meta-schemas/core.yaml#

title: Holt HI-311X stand-alone CAN controller
maintainers:
  - Akshay Bhat <akshay.bhat@timesys.com>
  - Lukas Wunner <lukas@wunner.de>
  - Rob Herring <robh@kernel.org>

description: |
  Holt HI-311X stand-alone CAN controller device tree bindings

properties:
  compatible:
    items:
      - const: holt,hi3110
  reg:
    items:
      - description: SPI chip select
  clocks:
    maxItems: 1
    description: The clock feeding the CAN controller
  interrupts:
    items:
      - description: CAN controller interrupt
  vdd-supply: true
  xceiver-supply: true

required:
  - compatible
  - reg
  - clocks
  - interrupts

additionalProperties: false

examples:
  - |
    can0: can@1 {
        compatible = "holt,hi3110";
        reg = <1>;
        clocks = <&clk32m>;
        interrupts = <13 IRQ_TYPE_LEVEL_HIGH>;
        vdd-supply = <&reg5v0>;
        xceiver-supply = <&reg5v0>;
    };
```

## Documentation/devicetree/bindings/net/can/ifi,canfd-1.0.yaml
```yaml
# SPDX-License-Identifier: (GPL-2.0-only OR BSD-2-Clause)
%YAML 1.2
---
$id: http://devicetree.org/schemas/net/can/ifi,canfd-1.0.yaml#
$schema: http://devicetree.org/meta-schemas/core.yaml#

title: IFI CANFD controller

maintainers:
  - Marek Vasut <marex@denx.de>

description: |
  IFI CANFD controller

properties:
  compatible:
    items:
      - const: ifi,canfd-1.0
    description: |
      Must be "ifi,canfd-1.0".
  reg:
    description: |
      CAN controller registers location and length.
    items:
      - description: Register base address.
      - description: Register length.
  interrupts:
    description: |
      IRQ line and flags for the CAN controller.
    items:
      - description: Interrupt specifier number.
      - description: Interrupt flags.

required:
  - compatible
  - reg
  - interrupts

additionalProperties: false

examples:
  - |
    canfd0: canfd@ff220000 {
        compatible = "ifi,canfd-1.0";
        reg = <0xff220000 0x00001000>;
        interrupts = <0 43 0>;
    };
```

## Documentation/devicetree/bindings/net/can/ti,am3517-hecc.yaml
```yaml
# SPDX-License-Identifier: (GPL-2.0-only OR BSD-2-Clause)
# Copyright 2018 Linaro Ltd.
%YAML 1.2
---
$id: http://devicetree.org/schemas/ti,am3517-hecc.yaml#
$schema: http://devicetree.org/meta-schemas/core.yaml#

title: Texas Instruments High End CAN Controller (HECC)

maintainers:
  - Yegor Yefremov <yegorslists@googlemail.com>

description: |
  Texas Instruments High End CAN Controller (HECC)

  This file provides information, what the device node
  for the hecc interface contains.

properties:
  compatible:
    items:
      - const: ti,am3517-hecc
  reg:
    items:
      - description: HECC control registers
      - description: HECC shared RAM
      - description: mailbox registers
  reg-names:
    items:
      - const: hecc
      - const: hecc-ram
      - const: mbx
  interrupts:
    items:
      - description: HECC interrupt
  clocks:
    items:
      - description: HECC clock
  ti,use-hecc1int:
    description: Switches HECC to produce interrupts on the HECC1INT line rather than the default HECC0INT.
    type: boolean
  xceiver-supply: true

required:
  - compatible
  - reg
  - reg-names
  - interrupts
  - clocks

additionalProperties: false

examples:
  - |
    hecc: can@5c050000 {
        compatible = "ti,am3517-hecc";
        reg = <0x5c050000 0x80>,
              <0x5c053000 0x180>,
              <0x5c052000 0x200>;
        reg-names = "hecc", "hecc-ram", "mbx";
        interrupts = <24>;
        clocks = <&hecc_ck>;
    };
```
