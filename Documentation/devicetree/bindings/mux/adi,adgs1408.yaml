## Documentation/devicetree/bindings/net/ethernet-phy-id0007.0570.yaml
```yaml
# SPDX-License-Identifier: (GPL-2.0-only OR BSD-2-Clause)
# Copyright 2025 Microsemi
%YAML 1.2
---
$id: http://devicetree.org/schemas/net/ethernet-phy-id0007.0570.yaml#
$schema: http://devicetree.org/meta-schemas/core.yaml#

title: Microsemi vsc8531 Gigabit Ethernet PHY

maintainers:
  - Allan W. Nielsen <allan.nielsen@microsemi.co‌​m>
  - Antoine Tenart <atenart@kernel.org>
  - Baisheng Gao <gaobaisheng@bonc.com.cn>
  - Quentin Schulz <quentin.schulz@bootlin.com>
  - Raju Lakkaraju <Raju.Lakkaraju@microsemi.com>

description: |
  * Microsemi - vsc8531 Giga bit ethernet phy

  Table: 1 - Edge rate change
  ----------------------------------------------------------------|
  | 		Edge Rate Change (VDDMAC)			|
  |
  | 3300 mV	2500 mV		1800 mV		1500 mV		|
  |---------------------------------------------------------------|
  | 0%		0%		0%		0%		|
  | (Fastest)			(recommended)	(recommended)	|
  |---------------------------------------------------------------|
  | 2%		3%		5%		6%		|
  |---------------------------------------------------------------|
  | 4%		6%		9%		14%		|
  |---------------------------------------------------------------|
  | 7%		10%		16%		21%		|
  |(recommended)	(recommended)					|
  |---------------------------------------------------------------|
  | 10%		14%		23%		29%		|
  |---------------------------------------------------------------|
  | 17%		23%		35%		42%		|
  |---------------------------------------------------------------|
  | 29%		37%		52%		58%		|
  |---------------------------------------------------------------|
  | 53%		63%		76%		77%		|
  | (slowest)							|
  |---------------------------------------------------------------|

properties:
  compatible:
    items:
      - const: ethernet-phy-id0007.0570

  vsc8531,vddmac:
    description: >
      The vddmac in mV. Allowed values are listed in the first row of Table 1
      (above). This property is only used in combination with the
      'edge-slowdown' property.
    $ref: /schemas/types.yaml#/definitions/uint32
    default: 3300

  vsc8531,edge-slowdown:
    description: >
      The edge should be slowed down relative to the fastest possible edge
      time. Edge rate sets the drive strength of the MAC interface output
      signals. Changing the drive strength will affect the edge rate of the
      output signal. To adjust the edge-slowdown, the 'vddmac' must be
      specified. Values supported for a given vddmac are listed in Table 1
      (above).
    $ref: /schemas/types.yaml#/definitions/uint32
    default: 0

  load-save-gpios:
    description: >
      GPIO used for the load/save operation of the PTP hardware clock (PHC).
    maxItems: 1

patternProperties:
  "^vsc8531,led-[0-9]+-mode$":
    description: >
      LED mode. Specify how the LED[N] should behave. N depends on the
      number of LEDs supported by a PHY. Allowed values are defined in
      include/dt-bindings/net/mscc-phy-vsc8531.h. Default values are
      VSC8531_LINK_1000_ACTIVITY (1), VSC8531_LINK_100_ACTIVITY (2),
      VSC8531_LINK_ACTIVITY (0) and VSC8531_DUPLEX_COLLISION (8).
    $ref: /schemas/types.yaml#/definitions/uint32

required:
  - compatible

additionalProperties: false

examples:
  - |
    vsc8531_0: ethernet-phy@0 {
        compatible = "ethernet-phy-id0007.0570";
        vsc8531,vddmac = <3300>;
        vsc8531,edge-slowdown = <7>;
        vsc8531,led-0-mode = <VSC8531_LINK_1000_ACTIVITY>;
        vsc8531,led-1-mode = <VSC8531_LINK_100_ACTIVITY>;
        load-save-gpios = <&gpio 10 GPIO_ACTIVE_HIGH>;
    };
```

## Documentation/devicetree/bindings/net/ethernet-phy-id13e5.1002.yaml
```yaml
# SPDX-License-Identifier: (GPL-2.0-only OR BSD-2-Clause)
# Copyright 2025 NXP
%YAML 1.2
---
$id: http://devicetree.org/schemas/net/ethernet-phy-id13e5.1002.yaml#
$schema: http://devicetree.org/meta-schemas/core.yaml#

title: Cortina EDC PHY
maintainers:
  - Bogdan Purcareata <bogdan.purcareata@nxp.com>

description: |
  Cortina Phy Driver Device Tree Bindings
  ---------------------------------------

  CORTINA is a registered trademark of Cortina Systems, Inc.

  The driver supports the Cortina Electronic Dispersion Compensation (EDC)
  devices, equipped with clock and data recovery (CDR) circuits. These
  devices make use of registers that are not compatible with Clause 45 or
  Clause 22, therefore they need to be described using the
  "ethernet-phy-id13e5.1002" compatible.

  Since the driver only implements polling mode support, interrupts info
  can be skipped.

properties:
  compatible:
    items:
      - const: ethernet-phy-id13e5.1002

  reg:
    items:
      - description: MDIO PHY address

additionalProperties: false

required:
  - compatible
  - reg

examples:
  - |
    mdio {
        cs4340_phy@10 {
            compatible = "ethernet-phy-id13e5.1002";
            reg = <0x10>;
        };
    };
```

## Documentation/devicetree/bindings/net/ezchip,nps-mgt-enet.yaml
```yaml
# SPDX-License-Identifier: (GPL-2.0-only OR BSD-2-Clause)
# Copyright 2025 Ezchip Ltd.
%YAML 1.2
---
$id: http://devicetree.org/schemas/ezchip,nps-mgt-enet.yaml#
$schema: http://devicetree.org/meta-schemas/core.yaml#

title: EZchip NPS Management Ethernet port driver

maintainers:
  - Noam Camus <noamc@ezchip.com>

description: |
  * EZchip NPS Management Ethernet port driver

properties:
  compatible:
    $ref: /schemas/types.yaml#/definitions/string-array
    items:
      - const: ezchip,nps-mgt-enet

  reg:
    items:
      - description: Address and length of the register set for the device

  interrupts:
    items:
      - description: ENET interrupt

  mac-address:
    description: MAC address for the interface
    $ref: /schemas/types.yaml#/definitions/string-array
    items:
      - pattern: ^([0-9A-Fa-f]{2}\s?){6}$

required:
  - compatible
  - reg
  - interrupts

additionalProperties: false

examples:
  - |
    ethernet@f0003000 {
        compatible = "ezchip,nps-mgt-enet";
        reg = <0xf0003000 0x44>;
        interrupts = <7>;
        mac-address = [ 00 11 22 33 44 55 ];
    };
```

## Documentation/devicetree/bindings/net/faraday,ftmac.yaml
```yaml
# SPDX-License-Identifier: (GPL-2.0-only OR BSD-2-Clause)
%YAML 1.2
---
$id: http://devicetree.org/schemas/faraday,ftmac.yaml#
$schema: http://devicetree.org/meta-schemas/core.yaml#

title: Faraday Ethernet Controller
maintainers:
  - Greentime Hu <green.hu@gmail.com>
description: |
  Faraday Ethernet Controller

properties:
  compatible:
    description: Must contain "faraday,ftmac" and one SoC-specific identifier.
    oneOf:
      - items:
          - const: faraday,ftmac
          - enum:
              - andestech,atmac100
              - moxa,moxart-mac
      - items:
          - enum:
              - andestech,atmac100
              - moxa,moxart-mac
          - const: faraday,ftmac

  reg:
    description: Register location and length.
    items:
      - description: Register location
      - description: Length

  interrupts:
    description: The MAC interrupt number.
    items:
      - description: Interrupt number

required:
  - compatible
  - reg
  - interrupts

additionalProperties: false

examples:
  - |
    mac0: mac@90900000 {
        compatible = "faraday,ftmac", "moxa,moxart-mac";
        reg = <0x90900000 0x100>;
        interrupts = <25>;
    };
    mac1: mac@92000000 {
        compatible = "faraday,ftmac", "moxa,moxart-mac";
        reg = <0x92000000 0x100>;
        interrupts = <27>;
    };
```

## Documentation/devicetree/bindings/net/fsl,tsec-phy.yaml
```yaml
# SPDX-License-Identifier: (GPL-2.0-only OR BSD-2-Clause)
%YAML 1.2
---
$id: http://devicetree.org/schemas/net/fsl,tsec-phy.yaml#
$schema: http://devicetree.org/meta-schemas/core.yaml#

title: Freescale TSEC PHY
maintainers:
  - Aida Mynzhasova <aida.mynzhasova@skitlab.ru>
  - Claudiu Manoil <claudiu.manoil@freescale.com>
  - David S. Miller <davem@davemloft.net>
  - Esben Haabendal <eha@deif.com>
  - Florian Fainelli <f.fainelli@gmail.com>
  - Frank Li <Frank.Li@nxp.com>
  - Grant Likely <grant.likely@secretlab.ca>
  - J. Neuschäfer <j.ne@posteo.net>
  - Richard Cochran <richardcochran@gmail.com>
  - Rob Herring <robh@kernel.org>
  - Sergei Shtylyov <sergei.shtylyov@cogentembedded.com>
  - Shruti Kanetkar <Kanetkar.Shruti@gmail.com>
  - Yangbo Lu <yangbo.lu@nxp.com>

description: |
  * MDIO IO device

  Refer to Documentation/devicetree/bindings/net/fsl,gianfar-mdio.yaml

  * TBI Internal MDIO bus

  Refer to Documentation/devicetree/bindings/net/fsl,gianfar-mdio.yaml

  * Gianfar-compatible ethernet nodes

  Refer to Documentation/devicetree/bindings/net/fsl,gianfar.yaml

  * Gianfar PTP clock nodes

  Refer to Documentation/devicetree/bindings/ptp/fsl,ptp.yaml

properties:
  compatible:
    items:
      - const: fsl,tsec-phy

allOf:
  - $ref: /schemas/net/fsl,gianfar-mdio.yaml#
  - $ref: /schemas/net/fsl,gianfar.yaml#
  - $ref: /schemas/ptp/fsl,ptp.yaml#

additionalProperties: false
```

## Documentation/devicetree/bindings/net/hisilicon,hi3516cv300-femac.yaml
```yaml
%YAML 1.2
---
$id: http://devicetree.org/schemas/net/hisilicon,hi3516cv300-femac.yaml#
$schema: http://devicetree.org/meta-schemas/core.yaml#

title: Hisilicon Fast Ethernet MAC controller

maintainers:
  - Dongpo Li <lidongpo@hisilicon.com>
  - Petr Štetiar <ynezz@true.cz>

description: |
  Hisilicon Fast Ethernet MAC controller

  The MAC address will be determined using the optional properties
  defined in ethernet.txt[1].

  [1] Documentation/devicetree/bindings/net/ethernet.txt

properties:
  compatible:
    description: Must contain one of the version strings and the SOC string.
    oneOf:
      - items:
          - enum:
              - hisilicon
              - hisi-femac-v1
              - hisi-femac-v2
          - const: hisilicon,hi3516cv300-femac
      - items:
          - const: hisilicon,hi3516cv300-femac

  reg:
    description: Base physical addresses and sizes for device registers.
    items:
      - description: MAC core register base and size
      - description: Global MAC control register base and size

  interrupts:
    description: MAC interrupt
    maxItems: 1

  clocks:
    description: A phandle to the MAC main clock.
    maxItems: 1

  resets:
    description: Reset phandles.
    minItems: 1
    items:
      - description: MAC reset signal
      - description: PHY reset signal

  reset-names:
    description: Names for reset signals.
    minItems: 1
    items:
      - const: mac
      - const: phy

  mac-address:
    description: Hardware MAC address.
    items:
      minimum: 0
      maximum: 255
    minItems: 6
    maxItems: 6

  phy-mode:
    description: PHY interface mode.
    $ref: /schemas/types.yaml#/definitions/string

  phy-handle:
    description: Phandle to the physical PHY device.
    $ref: /schemas/types.yaml#/definitions/phandle

  hisilicon,phy-reset-delays-us:
    description: "Triplet of PHY reset delays in microseconds: pre-delay, pulse, post-delay."
    items:
      - description: Reset pre-delay in microseconds
        minimum: 0
      - description: Reset pulse in microseconds
        minimum: 0
      - description: Reset post-delay in microseconds
        minimum: 0

required:
  - compatible
  - reg
  - interrupts
  - clocks
  - resets
  - reset-names

additionalProperties: false

examples:
  - |
    hisi_femac: ethernet@10090000 {
        compatible = "hisilicon,hi3516cv300-femac", "hisilicon,hisi-femac-v2";
        reg = <0x10090000 0x1000>, <0x10091300 0x200>;
        interrupts = <12>;
        clocks = <&crg HI3518EV200_ETH_CLK>;
        resets = <&crg 0xec 0>, <&crg 0xec 3>;
        reset-names = "mac", "phy";
        mac-address = [00 00 00 00 00 00];
        phy-mode = "mii";
        phy-handle = <&phy0>;
        hisilicon,phy-reset-delays-us = <10000 20000 20000>;
    };
```
