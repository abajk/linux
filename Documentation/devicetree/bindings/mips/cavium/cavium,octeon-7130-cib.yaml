## Documentation/devicetree/bindings/mips/mscc,ocelot.yaml
```yaml
# SPDX-License-Identifier: (GPL-2.0-only OR BSD-2-Clause)
%YAML 1.2
---
$id: http://devicetree.org/schemas/mips/mscc,ocelot.yaml#
$schema: http://devicetree.org/meta-schemas/core.yaml#

title: Microsemi MIPS CPUs

maintainers:
  - Alexandre Belloni <alexandre.belloni@bootlin.com>
  - Gregory CLEMENT <gregory.clement@bootlin.com>
  - Quentin Schulz <quentin.schulz@bootlin.com>

description: |
  * Microsemi MIPS CPUs

  Boards with a SoC of the Microsemi MIPS family shall have the following
  properties:

  * Other peripherals:

  o CPU chip regs:

  The SoC has a few registers (DEVCPU_GCB:CHIP_REGS) handling miscellaneous
  functionalities: chip ID, general purpose register for software use, reset
  controller, hardware status and configuration, efuses.

  o HSIO regs:

  The SoC has a few registers (HSIO) handling miscellaneous functionalities:
  configuration and status of PLL5, RCOMP, SyncE, SerDes configurations and
  status, SerDes muxing and a thermal sensor.

properties:
  compatible:
    description: Hardware compatible string for the Microsemi MIPS SoC.
    items:
      - enum:
          - mscc,ocelot
          - mscc,luton
          - mscc,serval
          - mscc,jr2

patternProperties:
  "^syscon@[0-9a-fA-F]+$":
    description: CPU chip or HSIO registers subnode.
    anyOf:
      - description: CPU chip registers
        allOf:
          - properties:
              compatible:
                items:
                  - enum:
                      - mscc,ocelot-chip-regs
                      - simple-mfd
                      - syscon
              reg:
                items:
                  - description: Register location and length
            required:
              - compatible
              - reg
      - description: HSIO registers
        allOf:
          - properties:
              compatible:
                items:
                  - enum:
                      - mscc,ocelot-hsio
                      - simple-mfd
                      - syscon
              reg:
                items:
                  - description: Register location and length
            required:
              - compatible
              - reg

additionalProperties: false

examples:
  - |
    node@0 {
        compatible = "mscc,ocelot";
        syscon@71070000 {
            compatible = "mscc,ocelot-chip-regs", "simple-mfd", "syscon";
            reg = <0x71070000 0x1c>;
        };
        syscon@10d0000 {
            compatible = "mscc,ocelot-hsio", "simple-mfd", "syscon";
            reg = <0x10d0000 0x10000>;
        };
    };
```

## Documentation/devicetree/bindings/mips/ni,169445.yaml
```yaml
# SPDX-License-Identifier: (GPL-2.0-only OR BSD-2-Clause)
# Copyright 2025 National Instruments
%YAML 1.2
---
$id: http://devicetree.org/schemas/mips/ni,169445.yaml#
$schema: http://devicetree.org/meta-schemas/core.yaml#

title: National Instruments MIPS platforms

maintainers:
  - Nathan Sullivan <nathan.sullivan@ni.com>

description: |
  National Instruments MIPS platforms

  required root node properties:

  CPU Nodes

properties:
  compatible:
    items:
      - const: ni,169445

patternProperties:
  "^cpu@.*$":
    description: CPU nodes
    type: object
    additionalProperties: false
    required:
      - compatible
    properties:
      compatible:
        items:
          - const: mti,mips14KEc

additionalProperties: false
```

## Documentation/devicetree/bindings/mips/pic32/microchip,pic32mzda.yaml
```yaml
# SPDX-License-Identifier: (GPL-2.0-only OR BSD-2-Clause)
# Copyright 2025 Microchip Technology Inc.
%YAML 1.2
---
$id: http://devicetree.org/schemas/mips/pic32/microchip,pic32mzda.yaml#
$schema: http://devicetree.org/meta-schemas/core.yaml#

title: Microchip PIC32MZDA

maintainers:
  - Joshua Henderson <joshua.henderson@microchip.com>

description: |
  * Microchip PIC32MZDA Platforms

  PIC32MZDA Starter Kit

  CPU nodes:
  A "cpus" node is required.
  A CPU sub-node is also required.

  Boot protocol
  --------------
  In accordance with Unified Hosting Interface Reference Manual (MD01069), the
  bootloader must pass the following arguments to the kernel:
   - $a0: -2.
   - $a1: KSEG0 address of the flattened device-tree blob.

properties:
  compatible:
    # Primary and fallback compatible strings
    items:
      - const: microchip,pic32mzda-sk
      - const: microchip,pic32mzda

  cpus:
    description: CPU container node
    type: object
    properties:
      "#address-cells":
        description: Number of address cells for CPUs node
        const: 1
      "#size-cells":
        description: Number of size cells for CPUs node
        const: 0
    required:
      - "#address-cells"
      - "#size-cells"
    additionalProperties:
      description: CPU core sub-nodes
      type: object
      properties:
        device_type:
          const: cpu
        compatible:
          items:
            - const: mti,mips14KEc
      required:
        - device_type
        - compatible
      additionalProperties: false

required:
  - compatible
  - cpus

additionalProperties: false
```

## Documentation/devicetree/bindings/mips/qca,ar7130.yaml
```yaml
# SPDX-License-Identifier: (GPL-2.0-only OR BSD-2-Clause)
%YAML 1.2
---
$id: http://devicetree.org/schemas/mips/qca,ar7130.yaml#
$schema: http://devicetree.org/meta-schemas/core.yaml#

title: Qualcomm Atheros AR7xxx/AR9xxx SoC

maintainers:
  - Alban Bedel <albeu@free.fr>

description: |
  Binding for Qualcomm Atheros AR7xxx/AR9XXX SoC

  Each device tree must specify a compatible value for the AR SoC
  it uses in the compatible property of the root node. The compatible
  value must be one of the following values:

  - qca,ar7130
  - qca,ar7141
  - qca,ar7161
  - qca,ar7240
  - qca,ar7241
  - qca,ar7242
  - qca,ar9130
  - qca,ar9132
  - qca,ar9330
  - qca,ar9331
  - qca,ar9341
  - qca,ar9342
  - qca,ar9344
  - qca,qca9556
  - qca,qca9558

properties:
  compatible:
    description: SOC compatible strings for Qualcomm Atheros AR7xxx/AR9xxx series.
    items:
      - enum:
          - qca,ar7130
          - qca,ar7141
          - qca,ar7161
          - qca,ar7240
          - qca,ar7241
          - qca,ar7242
          - qca,ar9130
          - qca,ar9132
          - qca,ar9330
          - qca,ar9331
          - qca,ar9341
          - qca,ar9342
          - qca,ar9344
          - qca,qca9556
          - qca,qca9558
    additionalItems: false

required:
  - compatible

additionalProperties: false

examples:
  - |
    / {
        compatible = "qca,ar7130";
    };
```

## Documentation/devicetree/bindings/misc/aspeed,ast2400-p2a-ctrl.yaml
```yaml
# SPDX-License-Identifier: (GPL-2.0-only OR BSD-2-Clause)
# Copyright 2025 Andrew Jeffery <andrew@aj.id.au>
# Copyright 2025 Patrick Venture <venture@google.com>
%YAML 1.2
---
$id: http://devicetree.org/schemas/aspeed,ast2400-p2a-ctrl.yaml#
$schema: http://devicetree.org/meta-schemas/core.yaml#

title: Aspeed AST2400/AST2500 PCI-to-AHB Bridge Control
maintainers:
  - Andrew Jeffery <andrew@aj.id.au>
  - Patrick Venture <venture@google.com>

description: |
  Device tree bindings for Aspeed AST2400/AST2500 PCI-to-AHB Bridge Control Driver

  The bridge is available on platforms with the VGA enabled on the Aspeed device.
  In this case, the host has access to a 64KiB window into all of the BMC's
  memory.  The BMC can disable this bridge.  If the bridge is enabled, the host
  has read access to all the regions of memory, however the host only has read
  and write access depending on a register controlled by the BMC.

properties:
  compatible:
    items:
      - enum:
          - aspeed,ast2400-p2a-ctrl
          - aspeed,ast2500-p2a-ctrl
  reg:
    description: A hint for the memory regions associated with the P2A controller
  memory-region:
    description: A phandle to a reserved_memory region to be used for the PCI to AHB mapping

required:
  - compatible

additionalProperties: false

examples:
  - |
    syscon: scu@1e6e2000 {
        compatible = "aspeed,ast2400-scu", "syscon", "simple-mfd";
        reg = <0x1e6e2000 0x1a8>;

        p2a: p2a-control {
            compatible = "aspeed,ast2400-p2a-ctrl";
            memory-region = <&reserved_memory>;
        };
    };
```

## Documentation/devicetree/bindings/misc/ifm,o2d-csi.yaml
```yaml
# SPDX-License-Identifier: (GPL-2.0-only OR BSD-2-Clause)
%YAML 1.2
---
$id: http://devicetree.org/schemas/ifm,o2d-csi.yaml#
# $schema is the meta-schema this schema should be validated with.
$schema: http://devicetree.org/meta-schemas/core.yaml#

title: IFM camera sensor interface on mpc5200 LocalPlus bus

maintainers:
  - Anatolij Gustschin <agust@denx.de>

description: |
  IFM camera sensor interface on mpc5200 LocalPlus bus.

  The base address of the used chip select is specified in the
  ranges property of the parent localbus node.

properties:
  compatible:
    items:
      - const: ifm,o2d-csi
  reg:
    description: Sensor chip select number, address offset, and range size.
    items:
      - description: chip select number.
      - description: address offset.
      - description: range size.
  interrupts:
    description: External interrupt line number and interrupt sense mode of the frame valid event.
    items:
      - description: interrupt specifier (interrupt-parent, line number, flags).
  gpios:
    description: GPIO specifiers for capture, reset, and master enable.
    items:
      - description: capture GPIO.
      - description: reset GPIO.
      - description: master enable GPIO.
  ifm,csi-clk-handle:
    description: Phandle to the sensor clock generator.
    $ref: /schemas/types.yaml#/definitions/phandle
  ifm,csi-addr-bus-width:
    description: Address bus width.
    $ref: /schemas/types.yaml#/definitions/uint32
    enum: [16, 24, 25]
  ifm,csi-data-bus-width:
    description: Data bus width.
    $ref: /schemas/types.yaml#/definitions/uint32
    enum: [8, 16]
  ifm,csi-wait-cycles:
    description: Sensor bus wait cycles.
    $ref: /schemas/types.yaml#/definitions/uint32
  ifm,csi-byte-swap:
    description: Enable byte swapping on the bus.
    type: boolean

required:
  - compatible
  - reg
  - interrupts
  - gpios
  - ifm,csi-clk-handle
  - ifm,csi-addr-bus-width
  - ifm,csi-data-bus-width
  - ifm,csi-wait-cycles

additionalProperties: false

examples:
  - |
    csi@3,0 {
        compatible = "ifm,o2d-csi";
        reg = <3 0 0x00100000>;
        interrupts = <1 1 2>;
        gpios = <&gpio_simple 23 0 &gpio_simple 26 0 &gpio_simple 29 0>;
        ifm,csi-clk-handle = <&timer7>;
        ifm,csi-addr-bus-width = <24>;
        ifm,csi-data-bus-width = <8>;
        ifm,csi-wait-cycles = <0>;
    };
```

## Documentation/devicetree/bindings/misc/qemu,pvpanic-mmio.yaml
```yaml
# SPDX-License-Identifier: (GPL-2.0-only OR BSD-2-Clause)
# Copyright 2025 ZTE Corporation
%YAML 1.2
---
$id: http://devicetree.org/schemas/qemu,pvpanic-mmio.yaml#
$schema: http://devicetree.org/meta-schemas/core.yaml#

title: QEMU PV Panic MMIO interface

maintainers:
  - Peng Hao <peng.hao2@zte.com.cn>

description: |
  QEMU's emulation / virtualization targets provide the following PVPANIC
  MMIO Configuration interface on the "virt" machine.
  type:

  - a read-write, 16-bit wide data register.

  QEMU exposes the data register to guests as memory mapped registers.

properties:
  compatible:
    const: qemu,pvpanic-mmio

  reg:
    description: MMIO region for the panic data register.
    items:
      - description: Panic data register region.

required:
  - compatible
  - reg

additionalProperties: false

examples:
  - |
    / {
        #size-cells = <0x2>;
        #address-cells = <0x2>;

        pvpanic-mmio@9060000 {
            compatible = "qemu,pvpanic-mmio";
            reg = <0x0 0x9060000 0x0 0x2>;
        };
    };
```

## Documentation/devicetree/bindings/mmc/cavium,octeon-6130-mmc.yaml
```yaml
# SPDX-License-Identifier: (GPL-2.0-only OR BSD-2-Clause)
# Copyright 2018 Linaro Ltd.
%YAML 1.2
---
$id: http://devicetree.org/schemas/mmc/cavium,octeon-6130-mmc.yaml#
$schema: http://devicetree.org/meta-schemas/core.yaml#

title: Cavium MMC controller

maintainers:
  - Jan Glauber <jan.glauber@gmail.com>

description: |
  The highspeed MMC host controller on Cavium's SoCs provides an interface
  for MMC and SD types of memory cards.

  Supported maximum speeds are the ones of the eMMC standard 4.41 as well
  as the speed of SD standard 4.0. Only 3.3 V is supported.

properties:
  compatible:
    items:
      - enum:
          - cavium,octeon-6130-mmc
          - cavium,octeon-7890-mmc
          - cavium,thunder-8190-mmc
          - cavium,thunder-8390-mmc

  reg:
    items:
      - description: MMC controller base registers

  clocks:
    maxItems: 1
    description: phandle to bus clock

  mmc-slot:
    description: MMC slot child node
    type: object
    additionalProperties: false
    properties:
      compatible:
        items:
          - enum:
              - mmc-slot
      reg:
        items:
          - description: slot index
      vmmc-supply:
        description: regulator supply for the MMC slot
      max-frequency:
        description: max. data clock frequency for the slot in Hz
      bus-width:
        description: data bus width for the slot in bits
      cap-sd-highspeed:
        description: indicates SD high-speed capability
        type: boolean
      cap-mmc-highspeed:
        description: indicates MMC high-speed capability
        type: boolean
      non-removable:
        description: slot is non-removable
        type: boolean
    required:
      - compatible
      - reg
      - vmmc-supply
      - max-frequency
      - bus-width

  cavium,cmd-clk-skew:
    description: number of coprocessor clocks before sampling command
    $ref: /schemas/types.yaml#/definitions/uint32

  cavium,dat-clk-skew:
    description: number of coprocessor clocks before sampling data
    $ref: /schemas/types.yaml#/definitions/uint32

  spi-max-frequency:
    description: deprecated, use max-frequency instead
    deprecated: true

  max-frequency:
    description: maximum data clock frequency in Hz

  bus-width:
    description: data bus width in bits

  power-gpios:
    description: deprecated, use vmmc-supply instead
    deprecated: true

  vmmc-supply:
    description: regulator supply for the MMC slot

  cavium,bus-max-width:
    description: deprecated, use bus-width instead
    deprecated: true

required:
  - compatible
  - reg
  - clocks

additionalProperties: false

examples:
  - |
    mmc_1_4: mmc@1,4 {
        compatible = "cavium,thunder-8390-mmc";
        reg = <0x0c00 0 0 0 0>;
        #address-cells = <1>;
        #size-cells = <0>;
        clocks = <&sclk>;

        mmc-slot@0 {
            compatible = "mmc-slot";
            reg = <0>;
            vmmc-supply = <&mmc_supply_3v3>;
            max-frequency = <42000000>;
            bus-width = <4>;
            cap-sd-highspeed;
        };

        mmc-slot@1 {
            compatible = "mmc-slot";
            reg = <1>;
            vmmc-supply = <&mmc_supply_3v3>;
            max-frequency = <42000000>;
            bus-width = <8>;
            cap-mmc-highspeed;
            non-removable;
        };
    };
```
