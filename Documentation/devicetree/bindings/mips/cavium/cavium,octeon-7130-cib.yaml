## Documentation/devicetree/bindings/mmc/sdhci-omap.yaml
```yaml
# SPDX-License-Identifier: (GPL-2.0-only OR BSD-2-Clause)
# Copyright 2025 Linaro Ltd.
%YAML 1.2
---
$id: http://devicetree.org/schemas/mmc/sdhci-omap.yaml#
$schema: http://devicetree.org/meta-schemas/core.yaml#

title: TI OMAP SDHCI Controller

maintainers:
  - Chunyan Zhang <zhang.chunyan@linaro.org>
  - Faiz Abbas <faiz_abbas@ti.com>
  - Kishon Vijay Abraham I <kishon@kernel.org>
  - Tony Lindgren <tony@atomide.com>

description: |
  TI OMAP SDHCI Controller

  Refer to mmc.txt for standard MMC bindings.

  For UHS devices which require tuning, the device tree should have a "cpu_thermal" node
  which maps to the appropriate thermal zone. This is used to get the temperature of the zone during tuning.

properties:
  compatible:
    items:
      - enum:
          - "ti,omap2430-sdhci"
          - "ti,omap3-sdhci"
          - "ti,omap4-sdhci"
          - "ti,omap5-sdhci"
          - "ti,dra7-sdhci"
          - "ti,k2g-sdhci"
          - "ti,am335-sdhci"
          - "ti,am437-sdhci"

  reg:
    description: Base address and size of the controller register region.
    items:
      - description: Register base address
      - description: Register region length

  ti,hwmods:
    description: >
      Must be "mmc<n>", where <n> is the controller instance number starting from 1.
    pattern: '^mmc[1-9][0-9]*$'

  pinctrl-names:
    description: >
      Pinctrl state names. Allowed values include "default", "hs", "sdr12",
      "sdr25", "sdr50", "ddr50-rev11", "sdr104-rev11", "ddr50", "sdr104",
      "ddr_1_8v-rev11", "ddr_1_8v", "ddr_3_3v", "hs200_1_8v-rev11", "hs200_1_8v".
    $ref: /schemas/types.yaml#/definitions/string-array
    items:
      - enum:
          - default
          - hs
          - sdr12
          - sdr25
          - sdr50
          - ddr50-rev11
          - sdr104-rev11
          - ddr50
          - sdr104
          - ddr_1_8v-rev11
          - ddr_1_8v
          - ddr_3_3v
          - hs200_1_8v-rev11
          - hs200_1_8v

  dmas:
    description: DMA specifiers for TX and RX.
    $ref: /schemas/types.yaml#/definitions/phandle-array

  dma-names:
    description: DMA request names corresponding to "dmas".
    $ref: /schemas/types.yaml#/definitions/string-array
    items:
      - const: tx
      - const: rx

  bus-width:
    description: Data bus width.
    $ref: /schemas/types.yaml#/definitions/uint32

  vmmc-supply: true

  ti,non-removable:
    description: Deprecated alias for the generic "non-removable" property.
    type: boolean

patternProperties:
  "^pinctrl-[0-9]+$":
    description: >
      Pinctrl phandle-array for a given state as defined by "pinctrl-names".
    $ref: /schemas/types.yaml#/definitions/phandle-array

allOf:
  - if:
      properties:
        compatible:
          contains:
            const: "ti,k2g-sdhci"
    then:
      # ti,hwmods not required for K2G
      properties:
        ti,hwmods: {}
    else:
      required:
        - ti,hwmods

required:
  - compatible
  - reg

additionalProperties: false

examples:
  - |
    mmc1: mmc@4809c000 {
        compatible = "ti,dra7-sdhci";
        reg = <0x4809c000 0x400>;
        ti,hwmods = "mmc1";
        bus-width = <4>;
        vmmc-supply = <&vmmc>;
        dmas = <&sdma 61 &sdma 62>;
        dma-names = "tx", "rx";
    };
```

## Documentation/devicetree/bindings/mmc/socionext,milbeaut-m10v-sdhci-3.0.yaml
```yaml
# SPDX-License-Identifier: (GPL-2.0-only OR BSD-2-Clause)
%YAML 1.2
---
$id: http://devicetree.org/schemas/mmc/socionext,milbeaut-m10v-sdhci-3.0.yaml#
$schema: http://devicetree.org/meta-schemas/core.yaml#

title: Socionext Milbeaut M10V SDHCI 3.0 Controller

maintainers:
  - Takao Orito <orito.takao@socionext.com>

properties:
  compatible:
    items:
      - const: socionext,milbeaut-m10v-sdhci-3.0
  reg:
    maxItems: 1

  interrupts:
    maxItems: 1

  clock-names:
    items:
      - const: core
      - const: iface

  clocks:
    maxItems: 2

  bus-width:
    $ref: /schemas/types.yaml#/definitions/uint32
    description: Width of the data bus in bits.
  voltage-ranges:
    description: Supported voltage range in millivolts.
    items:
      - description: Minimum voltage.
      - description: Maximum voltage.
  cap-sdio-irq:
    type: boolean
    description: Indicates support for SDIO IRQ.
  fujitsu,cmd-dat-delay-select:
    type: boolean
    description: Requires CMD_DAT_DELAY control.

required:
  - compatible
  - reg
  - interrupts
  - interrupt-controller
  - clocks
  - clock-names

additionalProperties: false

examples:
  - |
    sdhci3: mmc@1b010000 {
        compatible = "socionext,milbeaut-m10v-sdhci-3.0";
        reg = <0x1b010000 0x10000>;
        interrupts = <0 265 0x4>;
        voltage-ranges = <3300 3300>;
        bus-width = <4>;
        clocks = <&clk 7>, <&ahb_clk>;
        clock-names = "core", "iface";
        cap-sdio-irq;
        fujitsu,cmd-dat-delay-select;
    };
```

## Documentation/devicetree/bindings/mmc/st,sdhci.yaml
```yaml
---
$id: http://devicetree.org/schemas/mmc/st,sdhci.yaml#
$schema: http://devicetree.org/meta-schemas/core.yaml#

title: STMicroelectronics sdhci-st MMC/SD controller
maintainers:
  - Lee Jones <lee@kernel.org>
  - Marco Franchi <marco.franchi@nxp.com>
  - Masanari Iida <standby24x7@gmail.com>
  - Mauro Carvalho Chehab <mchehab+samsung@kernel.org>
  - Peter Griffin <peter.griffin@linaro.org>
  - Rob Herring <robh@kernel.org>
  - Simon Horman <horms+renesas@verge.net.au>
description: |
  STMicroelectronics sdhci-st MMC/SD controller

  This file documents the differences between the core properties in
  Documentation/devicetree/bindings/mmc/mmc.txt and the properties
  used by the sdhci-st driver.
properties:
  compatible:
    oneOf:
      - items:
          - enum: [st, sdhci-stih407]
          - const: st, sdhci
      - items:
          - const: st,sdhci
  reg:
    items:
      - description: host controller base address
      - description: FlashSS Top register for TX/RX delay used by the driver to configure DLL inside FlashSS
  reg-names:
    items:
      - const: mmc
      - const: top-mmc-delay
  interrupts:
    items:
      - description: MMC interrupt
  interrupt-names:
    items:
      - const: mmcirq
  clocks:
    items:
      - description: MMC bus clock
      - description: internal clock (icn)
  clock-names:
    items:
      - const: mmc
      - const: icn
  resets:
    description: softreset line of host controller IP
    maxItems: 1
  vqmmc-supply:
    description: regulator supply for MMC I/O
  pinctrl-names:
    items:
      - const: default
  pinctrl-0:
    allOf:
      - $ref: /schemas/types.yaml#/definitions/phandle
    description: default pinctrl state for data pins
  bus-width:
    allOf:
      - $ref: /schemas/types.yaml#/definitions/uint32
    description: number of data lines
  max-frequency:
    allOf:
      - $ref: /schemas/types.yaml#/definitions/uint32
    description: maximum bus frequency
    enum: [200000000, 100000000, 50000000]
  non-removable:
    type: boolean
    description: slot is non-removable
  sd-uhs-sdr50:
    type: boolean
    description: enable SDR50 in mmcss
  sd-uhs-sdr104:
    type: boolean
    description: enable SDR104 in mmcss
  sd-uhs-ddr50:
    type: boolean
    description: enable DDR50 in mmcss
required:
  - compatible
  - reg
  - interrupts
  - interrupt-names
  - pinctrl-names
  - pinctrl-0
  - clocks
  - clock-names
additionalProperties: false
examples:
  - |
    mmc0: sdhci@fe81e000 {
      compatible = "st,sdhci";
      reg = <0xfe81e000 0x1000>;
      interrupts = <GIC_SPI 127 IRQ_TYPE_NONE>;
      interrupt-names = "mmcirq";
      pinctrl-names = "default";
      pinctrl-0 = <&pinctrl_mmc0>;
      clock-names = "mmc";
      clocks = <&clk_s_a1_ls 1>;
      bus-width = <8>;
    };
  - |
    mmc1: sdhci@9080000 {
      compatible = "st,sdhci-stih407", "st,sdhci";
      reg = <0x09080000 0x7ff>;
      reg-names = "mmc";
      interrupts = <GIC_SPI 90 IRQ_TYPE_NONE>;
      interrupt-names = "mmcirq";
      pinctrl-names = "default";
      pinctrl-0 = <&pinctrl_sd1>;
      clock-names = "mmc";
      clocks = <&clk_s_c0_flexgen CLK_MMC_1>;
      resets = <&softreset STIH407_MMC1_SOFTRESET>;
      bus-width = <4>;
    };
  - |
    mmc0: sdhci@9060000 {
      compatible = "st,sdhci-stih407", "st,sdhci";
      reg = <0x09060000 0x7ff>, <0x9061008 0x20>;
      reg-names = "mmc", "top-mmc-delay";
      interrupts = <GIC_SPI 92 IRQ_TYPE_NONE>;
      interrupt-names = "mmcirq";
      pinctrl-names = "default";
      pinctrl-0 = <&pinctrl_mmc0>;
      clock-names = "mmc";
      clocks = <&clk_s_c0_flexgen CLK_MMC_0>;
      vqmmc-supply = <&vmmc_reg>;
      max-frequency = <200000000>;
      bus-width = <8>;
      non-removable;
      sd-uhs-sdr50;
      sd-uhs-sdr104;
      sd-uhs-ddr50;
    };
```
