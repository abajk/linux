## Documentation/devicetree/bindings/mips/cavium/cavium,octeon-7130-cib.yaml
```yaml
# SPDX-License-Identifier: (GPL-2.0-only OR BSD-2-Clause)
# Copyright 2025 Cavium Inc.
%YAML 1.2
---
$id: http://devicetree.org/schemas/mips/cavium/cavium,octeon-7130-cib.yaml#
$schema: http://devicetree.org/meta-schemas/core.yaml#

title: Cavium Interrupt Bus widget

maintainers:
  - David Daney <david.daney@cavium.com>

properties:
  compatible:
    items:
      - enum:
          - cavium,octeon-7130-cib

  reg:
    description: Two elements consisting of the addresses of the RAW and EN registers of the CIB block.
    items:
      - description: RAW register address and size
      - description: EN register address and size

  interrupts:
    description: |
      The CIU line to which the CIB block is connected. Interrupts are specified by
      two parts: 1) Bit number in the CIB* registers, 2) Triggering semantics of the
      line.
    items:
      - description: Bit number in the CIB* registers
      - description: |
          Triggering semantics: 1 - edge rising, 2 - edge falling, 4 - level active high,
          8 - level active low

  interrupt-controller: true

  '#interrupt-cells':
    const: 2

  cavium,max-bits:
    description: The index (zero based) of the highest numbered bit in the CIB block.

required:
  - compatible
  - reg
  - interrupts
  - interrupt-controller

additionalProperties: false

examples:
  - |
    interrupt-controller@107000000e000 {
        compatible = "cavium,octeon-7130-cib";
        reg = <0x10700 0x0000e000 0x0 0x8>,
              <0x10700 0x0000e100 0x0 0x8>;
        interrupts = <1 24>;
        interrupt-controller;
        #interrupt-cells = <2>;
        cavium,max-bits = <23>;
    };
```

## Documentation/devicetree/bindings/mips/cavium/cavium,octeon-7130-sata-uctl.yaml
```yaml
# SPDX-License-Identifier: (GPL-2.0-only OR BSD-2-Clause)
# Copyright 2025 Cavium Networks
%YAML 1.2
---
$id: http://devicetree.org/schemas/mips/cavium/cavium,octeon-7130-sata-uctl.yaml#
$schema: http://devicetree.org/meta-schemas/core.yaml#

title: UCTL SATA controller glue

maintainers:
  - Aleksey Makarov <aleksey.makarov@caviumnetworks.com>

description: |
  UCTL is the bridge unit between the I/O interconnect (an internal bus)
  and the SATA AHCI host controller (UAHC). It performs the following functions:
    - provides interfaces for the applications to access the UAHC AHCI
      registers on the CN71XX I/O space.
    - provides a bridge for UAHC to fetch AHCI command table entries and data
      buffers from Level 2 Cache.
    - posts interrupts to the CIU.
    - contains registers that:
        - control the behavior of the UAHC
        - control the clock/reset generation to UAHC
        - control endian swapping for all UAHC registers and DMA accesses

properties:
  compatible:
    items:
      - const: cavium,octeon-7130-sata-uctl

  reg:
    description: The base address of the UCTL register bank.
    maxItems: 1

  '#address-cells':
    description: Number of address cells used by child nodes.
    const: 2

  '#size-cells':
    description: Number of size cells used by child nodes.
    const: 2

  ranges:
    description: Direct mapping of child address space.

  dma-ranges:
    description: Direct mapping of DMA address space.

additionalProperties: false

examples:
  - |
    uctl@118006c000000 {
        compatible = "cavium,octeon-7130-sata-uctl";
        reg = <0x11800 0x6c000000 0x0 0x100>;
        ranges;
        dma-ranges;
        #address-cells = <2>;
        #size-cells = <2>;

        sata: sata@16c0000000000 {
            compatible = "cavium,octeon-7130-ahci";
            reg = <0x16c00 0x00000000 0x0 0x200>;
            interrupts = <2 4>; /* Bit: 2, level */
        };
    };
```

## Documentation/devicetree/bindings/mips/cavium/cavium,octeon-7890-ciu3.yaml
```yaml
# SPDX-License-Identifier: (GPL-2.0-only OR BSD-2-Clause)
# Copyright 2025 Cavium
%YAML 1.2
---
$id: http://devicetree.org/schemas/mips/cavium/cavium,octeon-7890-ciu3.yaml#
$schema: http://devicetree.org/meta-schemas/core.yaml#

title: Cavium Octeon 7890 CIU3 Interrupt Controller

maintainers:
  - David Daney <david.daney@cavium.com>

description: |
  * Central Interrupt Unit v3

properties:
  compatible:
    items:
      - const: cavium,octeon-7890-ciu3

  interrupt-controller: true

  reg:
    maxItems: 1

  '#interrupt-cells':
    const: 2

required:
  - compatible
  - interrupt-controller
  - reg
  - '#interrupt-cells'

additionalProperties: false

examples:
  - |
    interrupt-controller@1010000000000 {
        compatible = "cavium,octeon-7890-ciu3";
        interrupt-controller;
        #address-cells = <0>;
        #interrupt-cells = <2>;
        reg = <0x10100 0x00000000 0x0 0xb0000000>;
    };
```

## Documentation/devicetree/bindings/mips/img/img,xilfpga.yaml
```yaml
# SPDX-License-Identifier: (GPL-2.0-only OR BSD-2-Clause)
# Copyright 2025 Imagination University Program
%YAML 1.2
---
$id: http://devicetree.org/schemas/img,xilfpga.yaml#
$schema: http://devicetree.org/meta-schemas/core.yaml#

title: Imagination University Program MIPSfpga

maintainers:
  - Zubair Lutfullah Kakakakhel <Zubair.Kakakhel@imgtec.com>

description: |
  Imagination University Program MIPSfpga

  Under the Imagination University Program, a microAptiv UP core has been
  released for academic usage.

  As we are dealing with a MIPS core instantiated on an FPGA, specifications
  are fluid and can be varied in RTL.

  This binding document is provided as baseline guidance for the example
  project provided by IMG.

  The example project runs on the Nexys4DDR board by Digilent powered by
  the ARTIX-7 FPGA by Xilinx.

  Boot protocol:

  The BootRAM is a writeable "RAM" in FPGA at 0x1FC0_0000.
  This is for easy reprogrammibility via JTAG.

  The BootRAM initializes the cache and the axi_uart peripheral.

  DDR initialization is already handled by a HW IP block.

  When the example project bitstream is loaded, the cpu_reset button
  needs to be pressed.

  The bootram initializes the cache and axi_uart.
  Then outputs MIPSFPGA\n\r on the serial port on the Nexys4DDR board.

  At this point, the board is ready to load the Linux kernel
  vmlinux file via JTAG.

properties:
  compatible:
    description: Must include both the IMG FPGA SoC and board identifiers.
    oneOf:
      - items:
          - const: img,xilfpga
          - const: digilent,nexys4ddr
      - items:
          - const: digilent,nexys4ddr
          - const: img,xilfpga

  cpus:
    description: CPU nodes container.
    type: object
    additionalProperties: false
    properties:
      "#address-cells":
        const: 1
      "#size-cells":
        const: 0
    patternProperties:
      "^cpu@[0-9]+$":
        description: CPU core node.
        type: object
        additionalProperties: false
        properties:
          device_type:
            const: cpu
          compatible:
            items:
              - const: mips,m14Kc
          reg:
            items:
              - description: CPU index.
          clocks:
            items:
              - $ref: /schemas/types.yaml#/definitions/phandle
        required:
          - device_type
          - compatible
          - reg
          - clocks

  ext:
    description: External fixed clock source for the CPU core.
    type: object
    additionalProperties: false
    properties:
      compatible:
        enum: [fixed-clock]
      "#clock-cells":
        const: 0
      clock-frequency:
        description: Frequency of the external clock in Hz.
        $ref: /schemas/types.yaml#/definitions/uint32

additionalProperties: false

examples:
  - |
    soc@0 {
        compatible = "img,xilfpga", "digilent,nexys4ddr";
        cpus {
            #address-cells = <1>;
            #size-cells = <0>;

            cpu0: cpu@0 {
                device_type = "cpu";
                compatible = "mips,m14Kc";
                reg = <0>;
                clocks = <&ext>;
            };
        };

        ext: ext {
            compatible = "fixed-clock";
            #clock-cells = <0>;
            clock-frequency = <50000000>;
        };
    };
```

## Documentation/devicetree/bindings/mips/img/img-pistachio.yaml
```yaml
# SPDX-License-Identifier: (GPL-2.0-only OR BSD-2-Clause)
# Copyright 2025 Andrew Bresticker <abrestic@chromium.org>

%YAML 1.2
---
$id: http://devicetree.org/schemas/img-pistachio.yaml#
$schema: http://devicetree.org/meta-schemas/core.yaml#

title: Imagination Pistachio SoC

maintainers:
  - Andrew Bresticker <abrestic@chromium.org>

description: |
  Imagination Pistachio SoC

  CPU nodes:
  ----------
  A "cpus" node is required.  Required properties:
   - #address-cells: Must be 1.
   - #size-cells: Must be 0.
  A CPU sub-node is also required for at least CPU 0.  Since the topology may
  be probed via CPS, it is not necessary to specify secondary CPUs.  Required
  properties:
   - device_type: Must be "cpu".
   - compatible: Must be "mti,interaptiv".
   - reg: CPU number.
   - clocks: Must include the CPU clock.  See ../../clock/clock-bindings.txt for
     details on clock bindings.

  Boot protocol:
  --------------
  In accordance with the MIPS UHI specification[1], the bootloader must pass the
  following arguments to the kernel:
   - $a0: -2.
   - $a1: KSEG0 address of the flattened device-tree blob.

  [1] http://prplfoundation.org/wiki/MIPS_documentation

properties:
  compatible:
    items:
      - const: img,pistachio
    description: Must include "img,pistachio".

  cpus:
    type: object
    description: CPU node list.
    properties:
      "#address-cells":
        const: 1
        description: Must be 1.
      "#size-cells":
        const: 0
        description: Must be 0.
    additionalProperties: false
    required:
      - "#address-cells"
      - "#size-cells"
    patternProperties:
      "^cpu@\\d+$":
        type: object
        required:
          - device_type
          - compatible
          - reg
          - clocks
        properties:
          device_type:
            const: cpu
            description: Must be "cpu".
          compatible:
            items:
              - const: mti,interaptiv
            description: Must be "mti,interaptiv".
          reg:
            items:
              - description: CPU number.
          clocks:
            maxItems: 1
            description: Must include the CPU clock.
        additionalProperties: false

required:
  - compatible
  - cpus

additionalProperties: false
```

## Documentation/devicetree/bindings/mips/lantiq.yaml
```yaml
# SPDX-License-Identifier: (GPL-2.0-only OR BSD-2-Clause)
%YAML 1.2
---
$id: http://devicetree.org/schemas/mips/lantiq.yaml#
$schema: http://devicetree.org/meta-schemas/core.yaml#

title: Lantiq device tree bindings

maintainers:
  - John Crispin <john@phrozen.org>

properties:
  $nodename:
    const: "/"
  compatible:
    oneOf:
      - items:
          - enum:
              - lantiq,ar9
              - lantiq,ase
              - lantiq,danube
              - lantiq,gr9
              - lantiq,twinpass
              - lantiq,xrx200
              - lantiq,xrx300
              - lantiq,xrx330
          - const: lantiq,xway

      - items:
          - enum:
              - lantiq,falcon

additionalProperties: true

...
```

## Documentation/devicetree/bindings/mips/lantiq/lantiq,icu.yaml
```yaml
# SPDX-License-Identifier: (GPL-2.0-only OR BSD-2-Clause)
%YAML 1.2
---
$id: http://devicetree.org/schemas/mips/lantiq/lantiq,icu.yaml#
$schema: http://devicetree.org/meta-schemas/core.yaml#

title: Lantiq SoCs Interrupt Controller Unit (ICU)

maintainers:
  - John Crispin <john@phrozen.org>

allOf:
  - $ref: /schemas/interrupt-controller.yaml#

properties:
  compatible:
    oneOf:
      - enum:
          - lantiq,icu

  reg:
    minItems: 1
    maxItems: 2

  interrupt-controller: true

  "#interrupt-cells":
    const: 1

required:
  - compatible
  - reg
  - interrupts
  - "#interrupt-cells"
  - interrupt-controller

additionalProperties: false

examples:
  - |
    interrupt-controller@80200 {
        compatible = "lantiq,icu";
        reg = <0x80200 0xc8>;
        interrupt-parent = <&cpu_irqc>;
        interrupts = <2>, <3>, <4>, <5>, <6>;
        #interrupt-cells = <1>;
        interrupt-controller;
    };
```

## Documentation/devicetree/bindings/mips/lantiq/lantiq,xrx200-fpi.yaml
```yaml
# SPDX-License-Identifier: (GPL-2.0-only OR BSD-2-Clause)
# Copyright 2025 Linaro Ltd.

%YAML 1.2
---
$id: http://devicetree.org/schemas/lantiq,xrx200-fpi.yaml#
$schema: http://devicetree.org/meta-schemas/core.yaml#

title: Lantiq XWAY SoC FPI bus

maintainers:
  - Hauke Mehrtens <hauke@hauke-m.de>

description: |
  Lantiq XWAY SoC FPI BUS binding
  ============================

properties:
  compatible:
    items:
      - const: lantiq,xrx200-fpi
    description: |
      Compatible string for the Lantiq XWAY SoC FPI bus.
  reg:
    description: |
      The address and length of the XBAR configuration register (first entry),
      and the FPI bus itself (second entry).
    items:
      - description: XBAR configuration register
      - description: FPI bus window
  ranges:
    description: |
      A mapping from child bus addresses to parent addresses.
      Each tuple is: <child address> <parent address> <size>.
    items:
      - description: child bus address
      - description: parent bus address
      - description: range length
  lantiq,rcu:
    description: |
      A phandle to the RCU syscon.
    $ref: /schemas/types.yaml#/definitions/phandle
  lantiq,offset-endianness:
    description: |
      Offset of the endianness configuration register.
    $ref: /schemas/types.yaml#/definitions/uint32
  '#address-cells':
    const: 1
    description: |
      Number of address cells.
  '#size-cells':
    const: 1
    description: |
      Number of size cells.

required:
  - compatible
  - reg
  - lantiq,rcu
  - lantiq,offset-endianness

additionalProperties: false

examples:
  - |
    fpi@10000000 {
      compatible = "lantiq,xrx200-fpi";
      ranges = <0x0 0x10000000 0xf000000>;
      reg = <0x1f400000 0x1000>,
            <0x10000000 0xf000000>;
      lantiq,rcu = <&rcu0>;
      lantiq,offset-endianness = <0x4c>;
      #address-cells = <1>;
      #size-cells = <1>;

      gptu@e100a00 { /* ... */ };
    };
```

## Documentation/devicetree/bindings/mips/lantiq/soc.yaml
```yaml
# SPDX-License-Identifier: (GPL-2.0-only OR BSD-2-Clause)
%YAML 1.2
---
$id: http://devicetree.org/schemas/mips/lantiq/soc.yaml#
$schema: http://devicetree.org/meta-schemas/core.yaml#

title: Lantiq SoC based Platform

maintainers:
  - Aleksander Jan Bajkowski <olek2@wp.pl>

description:
  Devices with a Lantiq CPU shall have the following properties.

properties:
  $nodename:
    const: "/"
  compatible:
    oneOf:
      - description: Boards with Lantiq xRX200 SoC
        items:
          - enum:
              - bt,homehub-v5a
          - const: lantiq,vr9

additionalProperties: true

...
```
