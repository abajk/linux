## Documentation/devicetree/bindings/mmc/hisilicon,hi3660-dw-mshc.yaml
```yaml
# SPDX-License-Identifier: (GPL-2.0-only OR BSD-2-Clause)
# Copyright 2025 Linaro Ltd.
%YAML 1.2
---
$id: http://devicetree.org/schemas/mmc/hisilicon,hi3660-dw-mshc.yaml#
$schema: http://devicetree.org/meta-schemas/core.yaml#

title: Hisilicon Designware Mobile Storage Host Controller

maintainers:
  - Carlos Garcia <carlos@cgarcia.org>
  - Guodong Xu <guodong.xu@linaro.org>
  - Jaehoon Chung <jh80.chung@samsung.com>
  - Manivannan Sadhasivam <manivannan.sadhasivam@linaro.org>
  - Shawn Lin <shawn.lin@rock-chips.com>
  - Zhangfei Gao <zhangfei.gao@linaro.org>

description: |
  * Hisilicon specific extensions to the Synopsys Designware Mobile
    Storage Host Controller

  Read synopsys-dw-mshc.txt for more details

  The Synopsys designware mobile storage host controller is used to interface
  a SoC with storage medium such as eMMC or SD/MMC cards. This file documents
  differences between the core Synopsys dw mshc controller properties described
  by synopsys-dw-mshc.txt and the properties used by the Hisilicon specific
  extensions to the Synopsys Designware Mobile Storage Host Controller.

properties:
  compatible:
    description: The compatible string for this controller, indicating the SoC-specific extension.
    $ref: /schemas/types.yaml#/definitions/string-array
    items:
      enum:
        - hisilicon,hi3660-dw-mshc
        - hisilicon,hi3670-dw-mshc
        - hisilicon,hi4511-dw-mshc
        - hisilicon,hi6220-dw-mshc
    minItems: 1
    maxItems: 1

  reg:
    description: Register address and size for the controller.
    items:
      - description: Controller registers

  interrupts:
    description: Interrupt specifier for this controller.
    items:
      - description: Interrupt parent phandle
      - description: Interrupt specifier
      - description: Interrupt flags

  clocks:
    description: Phandle(s) to clocks required by the controller.
    items:
      - description: CIU clock
      - description: BIU clock

  clock-names:
    description: Names for the clocks.
    items:
      - const: ciu
      - const: biu

  bus-width:
    description: Data bus width in bits.
    $ref: /schemas/types.yaml#/definitions/uint32

  disable-wp:
    description: Disable write protection feature.
    type: boolean

  cap-mmc-highspeed:
    description: Support for MMC high-speed mode.
    type: boolean

  cap-sd-highspeed:
    description: Support for SD high-speed mode.
    type: boolean

  sd-uhs-sdr12:
    description: Support for SD UHS SDR12 mode.
    type: boolean

  sd-uhs-sdr25:
    description: Support for SD UHS SDR25 mode.
    type: boolean

  card-detect-delay:
    description: Delay in milliseconds before card detection.
    $ref: /schemas/types.yaml#/definitions/uint32

  hisilicon,peripheral-syscon:
    description: Phandle of syscon used to control peripheral.
    $ref: /schemas/types.yaml#/definitions/phandle

  vqmmc-supply: true

  vmmc-supply: true

  fifo-depth:
    description: FIFO depth in bytes.
    $ref: /schemas/types.yaml#/definitions/uint32

  pinctrl-names:
    description: Pin control state names.
    $ref: /schemas/types.yaml#/definitions/string-array
    items:
      enum:
        - default
        - idle
    minItems: 1
    maxItems: 2

  pinctrl-0:
    description: default pinctrl phandle and flags.
    items:
      - $ref: /schemas/types.yaml#/definitions/phandle
      - description: Pin configuration flags

  pinctrl-1:
    description: idle pinctrl phandle and flags.
    items:
      - $ref: /schemas/types.yaml#/definitions/phandle
      - description: Pin configuration flags

  cd-gpios:
    description: Card detect GPIO phandle.
    maxItems: 1

required:
  - compatible

additionalProperties: false

examples:
  - |
    # Example for hi4511 SoC portion
    dwmmc_0: dwmmc0@fcd03000 {
        compatible = "hisilicon,hi4511-dw-mshc";
        reg = <0xfcd03000 0x1000>;
        interrupts = <0 16 4>;
        #address-cells = <1>;
        #size-cells = <0>;
        clocks = <&mmc_clock HI3620_SD_CIUCLK>, <&clock HI3620_DDRC_PER_CLK>;
        clock-names = "ciu", "biu";
    };

    # Board portion
    dwmmc0@fcd03000 {
        vmmc-supply = <&ldo12>;
        fifo-depth = <0x100>;
        pinctrl-names = "default";
        pinctrl-0 = <&sd_pmx_pins &sd_cfg_func1 &sd_cfg_func2>;
        bus-width = <4>;
        disable-wp;
        cd-gpios = <&gpio10 3 0>;
        cap-mmc-highspeed;
        cap-sd-highspeed;
    };

  - |
    # Example for hi6220
    dwmmc_1: dwmmc1@f723e000 {
        compatible = "hisilicon,hi6220-dw-mshc";
        bus-width = <0x4>;
        disable-wp;
        cap-sd-highspeed;
        sd-uhs-sdr12;
        sd-uhs-sdr25;
        card-detect-delay = <200>;
        hisilicon,peripheral-syscon = <&ao_ctrl>;
        reg = <0x0 0xf723e000 0x0 0x1000>;
        interrupts = <0x0 0x49 0x4>;
        clocks = <&clock_sys HI6220_MMC1_CIUCLK>, <&clock_sys HI6220_MMC1_CLK>;
        clock-names = "ciu", "biu";
        cd-gpios = <&gpio1 0 1>;
        pinctrl-names = "default", "idle";
        pinctrl-0 = <&sd_pmx_func &sd_clk_cfg_func &sd_cfg_func>;
        pinctrl-1 = <&sd_pmx_idle &sd_clk_cfg_idle &sd_cfg_idle>;
        vqmmc-supply = <&ldo7>;
        vmmc-supply = <&ldo10>;
    };
```

## Documentation/devicetree/bindings/mmc/marvell,pxa-mmc.yaml
```yaml
# SPDX-License-Identifier: (GPL-2.0-only OR BSD-2-Clause)
%YAML 1.2
---
$id: http://devicetree.org/schemas/mmc/marvell,pxa-mmc.yaml#
# $schema is the meta-schema this schema should be validated with.
$schema: http://devicetree.org/meta-schemas/core.yaml#

title: PXA MMC

maintainers:
  - Bjorn Helgaas <bhelgaas@google.com>
  - Daniel Mack <daniel@zonque.org>
  - Daniel Mack <daniel@gmail.com>

description: |
  * PXA MMC drivers

  Driver bindings for the PXA MCI (MMC/SDIO) interfaces

  In addition to the properties described in this document, the details
  described in mmc.txt are supported.

properties:
  compatible:
    items:
      - const: marvell,pxa-mmc

  reg:
    description: MMC controller register space
    items:
      - description: Register block

  interrupts:
    description: Controller interrupt
    items:
      - description: MMC interrupt

  vmmc-supply: true

  cd-gpios:
    maxItems: 1
    description: Card detect GPIO

  wp-gpios:
    maxItems: 1
    description: Write-protect GPIO

  marvell,detect-delay-ms:
    description: Detection delay timeout in milliseconds

required:
  - compatible
  - reg
  - interrupts
  - vmmc-supply

additionalProperties: false

examples:
  - |
    mmc@41100000 {
        compatible = "marvell,pxa-mmc";
        reg = <0x41100000 0x1000>;
        interrupts = <23>;
        vmmc-supply = <&mmc_regulator>;
        cd-gpios = <&gpio 23 0>;
        wp-gpios = <&gpio 24 0>;
    };
```

## Documentation/devicetree/bindings/mmc/mellanox,bluefield-dw-mshc.yaml
```yaml
# SPDX-License-Identifier: (GPL-2.0-only OR BSD-2-Clause)
# Copyright 2025 Mellanox Technologies
%YAML 1.2
---
$id: http://devicetree.org/schemas/mmc/mellanox,bluefield-dw-mshc.yaml#
$schema: http://devicetree.org/meta-schemas/core.yaml#

title: Mellanox Bluefield SoC DW MSHC
maintainers:
  - Liming Sun <lsun@mellanox.com>

description: |
  Mellanox Bluefield SoC specific extensions to the Synopsys Designware
  Mobile Storage Host Controller

  Read synopsys-dw-mshc.txt for more details

  The Synopsys designware mobile storage host controller is used to interface
  a SoC with storage medium such as eMMC or SD/MMC cards. This file documents
  differences between the core Synopsys dw mshc controller properties described
  by synopsys-dw-mshc.txt and the properties used by the Mellanox Bluefield SoC
  specific extensions to the Synopsys Designware Mobile Storage Host Controller.

properties:
  compatible:
    items:
      - const: "mellanox,bluefield-dw-mshc"
  reg:
    description: 'Controller registers: base address and size.'
    items:
      - description: Controller registers
  interrupts:
    description: Controller interrupt
    items:
      - description: Controller interrupt
  fifo-depth:
    description: Depth of the FIFO in bytes.
    $ref: /schemas/types.yaml#/definitions/uint32
  clock-frequency:
    description: MMC bus clock frequency in Hz.
  bus-width:
    description: Width of the MMC bus in bits.
    $ref: /schemas/types.yaml#/definitions/uint32
  cap-mmc-highspeed:
    description: Controller supports MMC high-speed mode.
    type: boolean

required:
  - compatible
  - reg
  - interrupts

additionalProperties: false

examples:
  - |
    mmc@6008000 {
        compatible = "mellanox,bluefield-dw-mshc";
        reg = <0x6008000 0x400>;
        interrupts = <32>;
        fifo-depth = <0x100>;
        clock-frequency = <24000000>;
        bus-width = <8>;
        cap-mmc-highspeed;
    };
```

## Documentation/devicetree/bindings/mmc/moxa,moxart-mmc.yaml
```yaml
# SPDX-License-Identifier: (GPL-2.0-only OR BSD-2-Clause)
%YAML 1.2
---
$id: http://devicetree.org/schemas/moxa,moxart-mmc.yaml#
$schema: http://devicetree.org/meta-schemas/core.yaml#

title: MOXA ART MMC Host Controller Interface

maintainers:
  - Jonas Jensen <jonas.jensen@gmail.com>

description: |
  MOXA ART MMC Host Controller Interface

  Inherits from mmc binding[1].

  [1] Documentation/devicetree/bindings/mmc/mmc.txt

properties:
  compatible:
    items:
      - enum: [moxa, moxart-mmc, faraday, ftsdc010]

  reg:
    description: Register base address and size.
    items:
      - description: register base address
      - description: register size

  interrupts:
    description: Interrupt specifier.
    items:
      - description: interrupt number
      - description: interrupt flags

  interrupt-controller: true

  clocks:
    maxItems: 1
    description: Clock feeding the MMC controller.

  dmas:
    description: DMA channels specifier. Two entries for TX and RX channels, both requesting line number 5.
    items:
      - description: TX DMA channel specifier
      - description: RX DMA channel specifier

  dma-names:
    description: Names for the DMA channels.
    $ref: /schemas/types.yaml#/definitions/string-array
    items:
      - enum: [tx]
      - enum: [rx]

required:
  - compatible
  - reg
  - interrupts
  - interrupt-controller
  - clocks

additionalProperties: false

examples:
  - |
    mmc: mmc@98e00000 {
        compatible = "moxa,moxart-mmc";
        reg = <0x98e00000 0x5C>;
        interrupts = <5 0>;
        clocks = <&clk_apb>;
        dmas =  <&dma 5>,
            <&dma 5>;
        dma-names = "tx", "rx";
    };
```

## Documentation/devicetree/bindings/mmc/renesas,usdhi6rol0.yaml
```yaml
# SPDX-License-Identifier: (GPL-2.0-only OR BSD-2-Clause)
# Copyright 2025 Guennadi Liakhovetski <g.liakhovetski@gmx.de>
%YAML 1.2
---
$id: http://devicetree.org/schemas/mmc/renesas,usdhi6rol0.yaml#
$schema: http://devicetree.org/meta-schemas/core.yaml#

title: Renesas USDHI6ROL0 SD/SDIO host controller

maintainers:
  - Guennadi Liakhovetski <g.liakhovetski@gmx.de>
  - Lars Persson <lars.persson@axis.com>

description: |
  Renesas usdhi6rol0 SD/SDIO host controller.

  Additionally, any standard MMC bindings from mmc.txt can be used.

properties:
  compatible:
    items:
      - enum:
          - renesas,usdhi6rol0

  reg:
    items:
      - description: register address
      - description: register size

  interrupts:
    description: Interrupts for card detect, data, and SDIO
    items:
      - description: card detect interrupt
      - description: data interrupt
      - description: SDIO interrupt

  interrupt-names:
    description: Names for the interrupts
    items:
      - const: card detect
      - const: data
      - const: SDIO

  clocks:
    description: Clock for the IMCLK input
    maxItems: 1

  clock-names:
    items:
      - const: imclk

  bus-width:
    description: width of the SD bus in bits
    $ref: /schemas/types.yaml#/definitions/uint32

  max-frequency:
    description: maximum bus frequency in Hz
    $ref: /schemas/types.yaml#/definitions/uint32

  cap-power-off-card:
    type: boolean
    description: indicates that the host can power off the card

  vmmc-supply:
    description: regulator supplying Vcc to the card

  vqmmc-supply:
    description: regulator supplying VccQ to the card

  pinctrl-names:
    description: names for pinctrl states
    $ref: /schemas/types.yaml#/definitions/string-array
    items:
      - enum: [default]
      - enum: [state_uhs]

  pinctrl-0:
    description: pin control for 'default' state
    $ref: /schemas/types.yaml#/definitions/phandle

  pinctrl-state_uhs:
    description: pin control for 'state_uhs' state
    $ref: /schemas/types.yaml#/definitions/phandle

additionalProperties: false

examples:
  - |
    sd0: sd@ab000000 {
        compatible = "renesas,usdhi6rol0";
        reg = <0xab000000 0x200>;
        interrupts = <0 23 0x4
                      0 24 0x4
                      0 25 0x4>;
        interrupt-names = "card detect", "data", "SDIO";
        bus-width = <4>;
        max-frequency = <50000000>;
        cap-power-off-card;
        clocks = <&imclk>;
        vmmc-supply = <&vcc_sd0>;
        vqmmc-supply = <&vccq_sd0>;
    };
```
