## Documentation/devicetree/bindings/w1/w1-gpio.yaml
```yaml
# SPDX-License-Identifier: (GPL-2.0-only OR BSD-2-Clause)
%YAML 1.2
---
$id: http://devicetree.org/schemas/w1/w1-gpio.yaml#
$schema: http://devicetree.org/meta-schemas/core.yaml#

title: Generic one-wire bus controller (w1-gpio)

maintainers:
  - Daniel Mack <daniel@zonque.org>

description: |
  Generic devicetree bindings for onewire (w1) busses

  Onewire busses are described through nodes of their master bus controller.
  Slave devices are listed as sub-nodes of such master devices. For now, only
  one slave is allowed per bus master.

properties:
  compatible:
    # Single compatible string identifying the bus controller driver
    items:
      - enum:
          - w1-gpio

  gpios:
    description: GPIOs used to bit-bang the 1-Wire bus
    $ref: /schemas/types.yaml#/definitions/phandle-array

patternProperties:
  ".*":
    description: Slave device sub-nodes on the 1-Wire bus
    type: object
    additionalProperties: false
    properties:
      compatible:
        items:
          - enum:
              - maxim,ds2760
      power-supplies:
        description: Power supply phandles for the slave device
        $ref: /schemas/types.yaml#/definitions/phandle-array
    required:
      - compatible

additionalProperties: false

examples:
  - |
    charger: charger {
      compatible = "gpio-charger";
      charger-type = "mains";
      gpios = <&gpio 1 GPIO_ACTIVE_LOW>;
    };

    onewire {
      compatible = "w1-gpio";
      gpios = <&gpio 100 0>, <&gpio 101 0>;

      battery {
        compatible = "maxim,ds2760";
        power-supplies = <&charger>;
      };
    };
```

## Documentation/devicetree/bindings/watchdog/lantiq,wdt.yaml
```yaml
# SPDX-License-Identifier: (GPL-2.0-only OR BSD-2-Clause)
# Copyright 2025 Hauke Mehrtens
%YAML 1.2
---
$id: http://devicetree.org/schemas/watchdog/lantiq,wdt.yaml#
$schema: http://devicetree.org/meta-schemas/core.yaml#

title: Lantiq WDT Watchdog
maintainers:
  - Hauke Mehrtens <hauke@hauke-m.de>

description: |
  Lantiq WDT watchdog binding

  This describes the binding of the Lantiq watchdog driver.

properties:
  compatible:
    oneOf:
      - items:
          - enum: [ "lantiq,xrx200-wdt" ]
          - const: "lantiq,xrx100-wdt"
      - items:
          - const: "lantiq,wdt"
      - items:
          - const: "lantiq,xrx100-wdt"
      - items:
          - const: "lantiq,falcon-wdt"

  reg:
    description: Register block for the watchdog
    items:
      - description: Watchdog register base address
      - description: Watchdog register size

  lantiq,rcu:
    description: A phandle to the RCU syscon
    $ref: /schemas/types.yaml#/definitions/phandle

required:
  - compatible
  - reg

allOf:
  - if:
      properties:
        compatible:
          contains:
            const: "lantiq,xrx100-wdt"
    then:
      required:
        - lantiq,rcu
  - if:
      properties:
        compatible:
          contains:
            const: "lantiq,falcon-wdt"
    then:
      required:
        - lantiq,rcu

additionalProperties: false

examples:
  - |
    watchdog@803f0 {
        compatible = "lantiq,xrx200-wdt", "lantiq,xrx100-wdt";
        reg = <0x803f0 0x10>;
        lantiq,rcu = <&rcu0>;
    };
```

## Documentation/devicetree/bindings/watchdog/marvell,armada-3700-wdt.yaml
```yaml
# SPDX-License-Identifier: (GPL-2.0-only OR BSD-2-Clause)
# Copyright 2025 Marek Behún

%YAML 1.2
---
$id: http://devicetree.org/schemas/watchdog/marvell,armada-3700-wdt.yaml#
$schema: http://devicetree.org/meta-schemas/core.yaml#

title: Armada 37xx CPU Watchdog Timer Controller

maintainers:
  - Marek Behún <kabel@kernel.org>

description: |
  * Armada 37xx CPU Watchdog Timer Controller

properties:
  compatible:
    items:
      - const: marvell,armada-3700-wdt

  reg:
    items:
      - description: base physical address of the controller
      - description: length of memory mapped region

  clocks:
    maxItems: 1
    description: clock feeding the watchdog timer. See clock-bindings.txt

  marvell,system-controller:
    description: reference to syscon node for the CPU Miscellaneous Registers
    $ref: /schemas/types.yaml#/definitions/phandle

required:
  - compatible
  - reg
  - clocks
  - marvell,system-controller

additionalProperties: false

examples:
  - |
    cpu_misc: system-controller@d000 {
        compatible = "marvell,armada-3700-cpu-misc", "syscon";
        reg = <0xd000 0x1000>;
    };

    wdt: watchdog@8300 {
        compatible = "marvell,armada-3700-wdt";
        reg = <0x8300 0x40>;
        marvell,system-controller = <&cpu_misc>;
        clocks = <&xtalclk>;
    };
```

## Documentation/devicetree/bindings/watchdog/marvell,orion-wdt.yaml
```yaml
%YAML 1.2
---
$id: http://devicetree.org/schemas/watchdog/marvell,orion-wdt.yaml#
$schema: http://devicetree.org/meta-schemas/core.yaml#

title: Marvell Orion Watchdog Time

maintainers:
  - Andrew Lunn <andrew@lunn.ch>
  - Ezequiel Garcia <ezequiel.garcia@free-electrons.com>
  - Fabio Porcedda <fabio.porcedda@gmail.com>
  - Rob Herring <robh@kernel.org>

description: |
  * Marvell Orion Watchdog Time

properties:
  compatible:
    items:
      - enum:
          - "marvell,orion-wdt"
          - "marvell,armada-370-wdt"
          - "marvell,armada-xp-wdt"
          - "marvell,armada-375-wdt"
          - "marvell,armada-380-wdt"

  reg:
    description: Register addresses for watchdog operations.
    items:
      - description: Timer control register address.
      - description: RSTOUT enable register address.

  clocks:
    description: Input clock for watchdog.
    items:
      - description: Primary clock input.

  clock-names:
    items:
      - const: fixed
      - const: nbclk

  interrupts:
    description: IRQ for watchdog expiration.
    items:
      - description: Interrupt number.

  timeout-sec:
    description: Watchdog timeout in seconds.

allOf:
  - if:
      properties:
        compatible:
          contains:
            enum:
              - "marvell,armada-375-wdt"
              - "marvell,armada-380-wdt"
    then:
      properties:
        reg:
          items:
            - description: Timer control register address.
            - description: RSTOUT enable register address.
            - description: Shared mask/unmask RSTOUT register address.
    else:
      properties:
        reg:
          maxItems: 2

  - if:
      properties:
        compatible:
          contains:
            enum:
              - "marvell,armada-xp-wdt"
              - "marvell,armada-375-wdt"
              - "marvell,armada-380-wdt"
    then:
      properties:
        clocks:
          items:
            - description: Reference 25 MHz fixed-clock supply.
            - description: L2/coherency fabric clock input ("nbclk").
        clock-names:
          items:
            - const: fixed
            - const: nbclk
      required:
        - clock-names

required:
  - compatible
  - reg
  - clocks

additionalProperties: false

examples:
  - |
    wdt@20300 {
        compatible = "marvell,orion-wdt";
        reg = <0x20300 0x28>, <0x20108 0x4>;
        interrupts = <3>;
        timeout-sec = <10>;
        clocks = <&gate_clk 7>;
    };
```

## Documentation/devicetree/bindings/watchdog/men,a021-wdt.yaml
```yaml
# SPDX-License-Identifier: (GPL-2.0-only OR BSD-2-Clause)
# Copyright 2025 MEN Micro
%YAML 1.2
---
$id: http://devicetree.org/schemas/men,a021-wdt.yaml#
$schema: http://devicetree.org/meta-schemas/core.yaml#

title: MEN A021 Watchdog
maintainers:
  - Johannes Thumshirn <johannes.thumshirn@men.de>

description: |
  Bindings for MEN A21 Watchdog device connected to GPIO lines

properties:
  compatible:
    oneOf:
      - items:
          - enum:
              - men,a021-wdt

  gpios:
    description: Specifies the pins that control the Watchdog, in order
    items:
      - description: Watchdog enable
      - description: Watchdog fast-mode
      - description: Watchdog trigger
      - description: Watchdog reset cause bit 0
      - description: Watchdog reset cause bit 1
      - description: Watchdog reset cause bit 2

required:
  - compatible
  - gpios

additionalProperties: false

examples:
  - |
    watchdog {
        compatible = "men,a021-wdt";
        gpios = <&gpio3 9 1 /* WD_EN */
                  &gpio3 10 1 /* WD_FAST */
                  &gpio3 11 1 /* WD_TRIG */
                  &gpio3 6 1 /* RST_CAUSE[0] */
                  &gpio3 7 1 /* RST_CAUSE[1] */
                  &gpio3 8 1 /* RST_CAUSE[2] */>;
    };
```

## Documentation/devicetree/bindings/watchdog/microchip,pic32mzda-dmt.yaml
```yaml
# SPDX-License-Identifier: (GPL-2.0-only OR BSD-2-Clause)
# Copyright 2025 Microchip Technology
%YAML 1.2
---
$id: http://devicetree.org/schemas/watchdog/microchip,pic32mzda-dmt.yaml#
$schema: http://devicetree.org/meta-schemas/core.yaml#

title: Microchip PIC32 Deadman Timer

maintainers:
  - Purna Chandra Mandal <purna.mandal@microchip.com>

description: |
  * Microchip PIC32 Deadman Timer

  The deadman timer is used to reset the processor in the event of a software
  malfunction. It is a free-running instruction fetch timer, which is clocked
  whenever an instruction fetch occurs until a count match occurs.

properties:
  compatible:
    const: microchip,pic32mzda-dmt

  reg:
    items:
      - description: physical base address of the controller
      - description: length of memory mapped region

  clocks:
    maxItems: 1
    description: phandle of source clock for the deadman timer

required:
  - compatible
  - reg
  - clocks

additionalProperties: false

examples:
  - |
    watchdog@1f800a00 {
        compatible = "microchip,pic32mzda-dmt";
        reg = <0x1f800a00 0x80>;
        clocks = <&rootclk PB7CLK>;
    };
```
