## Documentation/devicetree/bindings/usb/ti,da830-musb.yaml
```yaml
# SPDX-License-Identifier: (GPL-2.0-only OR BSD-2-Clause)
# Copyright 2025 BayLibre Ltd.
%YAML 1.2
---
$id: http://devicetree.org/schemas/ti,da830-musb.yaml#
$schema: http://devicetree.org/meta-schemas/core.yaml#

title: TI DA8xx MUSB

maintainers:
  - Alexandre Bailon <abailon@baylibre.com>
  - Krzysztof Kozlowski <krzysztof.kozlowski@linaro.org>
  - Petr Kulhavy <petr@barix.com>
  - Rob Herring <robh@kernel.org>

description: |
  TI DA8xx MUSB

  For DA8xx/OMAP-L1x/AM17xx/AM18xx platforms.

  DMA
  ~~~
  - compatible: ti,da830-cppi41
  - reg: offset and length of the following register spaces: CPPI DMA Controller,
    CPPI DMA Scheduler, Queue Manager
  - reg-names: "controller", "scheduler", "queuemgr"
  - #dma-cells: should be set to 2. The first number represents the
    channel number (0 … 3 for endpoints 1 … 4).
    The second number is 0 for RX and 1 for TX transfers.
  - dma-channels: should be set to 4 representing the 4 endpoints.
  - #dma-channels: deprecated

properties:
  compatible:
    items:
      - const: ti,da830-musb

  reg:
    items:
      - description: USB controller register base address
      - description: size of register space

  interrupts:
    items:
      - description: USB interrupt

  interrupt-names:
    items:
      - const: mc

  interrupt-controller: true

  dr_mode:
    description: USB operation mode
    $ref: /schemas/types.yaml#/definitions/string
    enum:
      - host
      - peripheral
      - otg

  vbus-supply: true

  phys:
    description: PHY device phandle
    $ref: /schemas/types.yaml#/definitions/phandle-array

  phy-names:
    items:
      - const: usb-phy

  dmas:
    description: DMA channel phandles and stream IDs
    $ref: /schemas/types.yaml#/definitions/phandle-array

  dma-names:
    items:
      - const: rx1
      - const: rx2
      - const: rx3
      - const: rx4
      - const: tx1
      - const: tx2
      - const: tx3
      - const: tx4

  # Child node for the DMA controller
  cppi41dma:
    description: CPPI41 DMA controller
    type: object
    properties:
      compatible:
        items:
          - const: ti,da830-cppi41
      reg:
        items:
          - description: controller registers base
          - description: scheduler registers base
          - description: queuemgr registers base
      reg-names:
        items:
          - const: controller
          - const: scheduler
          - const: queuemgr
      interrupts:
        items:
          - description: DMA interrupt
      '#dma-cells':
        const: 2
      dma-channels:
        description: Number of DMA channels
    required:
      - compatible
      - reg
      - reg-names
      - interrupts
      - '#dma-cells'
      - dma-channels
    additionalProperties: false

required:
  - compatible
  - reg
  - interrupts
  - interrupt-controller

additionalProperties: false

examples:
  - |
    usb_phy: usb-phy {
      compatible = "ti,da830-usb-phy";
      #phy-cells = <0>;
    };
    usb0: usb@200000 {
      compatible = "ti,da830-musb";
      reg = <0x00200000 0x1000>;
      ranges;
      #address-cells = <1>;
      #size-cells = <1>;
      interrupts = <58>;
      interrupt-names = "mc";
      dr_mode = "host";
      vbus-supply = <&usb_vbus>;
      phys = <&usb_phy 0>;
      phy-names = "usb-phy";
      dmas = <&cppi41dma 0 0 &cppi41dma 1 0
        &cppi41dma 2 0 &cppi41dma 3 0
        &cppi41dma 0 1 &cppi41dma 1 1
        &cppi41dma 2 1 &cppi41dma 3 1>;
      dma-names =
        "rx1", "rx2", "rx3", "rx4",
        "tx1", "tx2", "tx3", "tx4";
      cppi41dma: dma-controller@201000 {
        compatible = "ti,da830-cppi41";
        reg =  <0x201000 0x1000
          0x202000 0x1000
          0x204000 0x4000>;
        reg-names = "controller", "scheduler", "queuemgr";
        interrupts = <58>;
        #dma-cells = <2>;
        dma-channels = <4>;
      };
    };
```

## Documentation/devicetree/bindings/usb/ti,da830-ohci.yaml
```yaml
# SPDX-License-Identifier: (GPL-2.0-only OR BSD-2-Clause)
# Copyright 2025 BayLibre
%YAML 1.2
---
$id: http://devicetree.org/schemas/ti,da830-ohci.yaml#
$schema: http://devicetree.org/meta-schemas/core.yaml#

title: TI DA830 OHCI USB controller

maintainers:
  - Axel Haslam <ahaslam@baylibre.com>
  - Marco Franchi <marco.franchi@nxp.com>

description: |
  DA8XX USB OHCI controller

  Required properties:
    - compatible: Should be "ti,da830-ohci"
    - reg: Should contain one register range (start and length)
    - interrupts: Description of the interrupt line
    - phys: Phandle for the PHY device
    - phy-names: Should be "usb-phy"

  Optional properties:
    - vbus-supply: phandle of regulator that controls VBUS power/over-current

properties:
  compatible:
    const: ti,da830-ohci

  reg:
    items:
      - description: Register address and length

  interrupts:
    items:
      - description: USB OHCI interrupt line

  phys:
    description: Phandle and argument for the USB PHY instance
    items:
      - description: Phandle to USB PHY
      - description: PHY index

  phy-names:
    items:
      - const: usb-phy

  vbus-supply:
    description: Phandle of regulator controlling VBUS power/over-current

required:
  - compatible
  - reg
  - interrupts
  - phys
  - phy-names

additionalProperties: false

examples:
  - |
    usb@225000 {
        compatible = "ti,da830-ohci";
        reg = <0x225000 0x1000>;
        interrupts = <59>;
        phys = <&usb_phy 1>;
        phy-names = "usb-phy";
        vbus-supply = <&reg_usb_ohci>;
    };
```

## Documentation/devicetree/bindings/usb/ti,dwc3.yaml
```yaml
# SPDX-License-Identifier: (GPL-2.0-only OR BSD-2-Clause)
%YAML 1.2
---
$id: http://devicetree.org/schemas/usb/ti,dwc3.yaml#
$schema: http://devicetree.org/meta-schemas/core.yaml#

title: TI OMAP DWC3 Glue

maintainers:
  - Anatol Pomozov <anatol.pomozov@gmail.com>
  - George Cherian <george.cherian@ti.com>
  - Kishon Vijay Abraham I <kishon@kernel.org>
  - Mauro Carvalho Chehab <mchehab+huawei@kernel.org>
  - Roger Quadros <rogerq@ti.com>

description: |
  OMAP GLUE AND OTHER OMAP SPECIFIC COMPONENTS

  OMAP DWC3 GLUE

  Sub-nodes:
    The dwc3 core should be added as subnode to omap dwc3 glue. The binding details
    of dwc3 can be found in:
    Documentation/devicetree/bindings/usb/snps,dwc3.yaml

properties:
  compatible:
    oneOf:
      - items:
          - const: ti,dwc3
          - const: ti,am437x-dwc3

  ti,hwmods:
    description: Hardware modules used by the glue driver
    $ref: /schemas/types.yaml#/definitions/string

  reg:
    items:
      - description: Address of the register set for the device
      - description: Length of the register set for the device

  interrupts:
    items:
      - description: The IRQ number used to interrupt the MPU

  "#address-cells":
    const: 1

  "#size-cells":
    const: 1

  utmi-mode:
    description: Controls the source of UTMI/PIPE status for VBUS and OTG ID (1=HW mode,2=SW mode)
    $ref: /schemas/types.yaml#/definitions/uint32
    enum:
      - 1
      - 2

  ranges:
    description: Child address space mapped 1:1 onto the parent address space
    maxItems: 1

  extcon:
    description: Phandle for the extcon device used to detect connect/disconnect events
    $ref: /schemas/types.yaml#/definitions/phandle

  vbus-supply:
    description: Phandle to the regulator device node if needed

  dwc3:
    description: DWC3 core subnode
    $ref: /schemas/usb/snps,dwc3.yaml

required:
  - compatible
  - ti,hwmods
  - reg
  - interrupts

additionalProperties: false

examples:
  - |
    omap_dwc3 {
        compatible = "ti,dwc3";
        ti,hwmods = "usb_otg_ss";
        reg = <0x4a020000 0x1ff>;
        interrupts = <0 93 4>;
        #address-cells = <1>;
        #size-cells = <1>;
        utmi-mode = <2>;
        ranges;
    };
```

## Documentation/devicetree/bindings/usb/ti,omap4-musb.yaml
```yaml
# SPDX-License-Identifier: (GPL-2.0-only OR BSD-2-Clause)
%YAML 1.2
---
$id: http://devicetree.org/schemas/ti,omap4-musb.yaml#
$schema: http://devicetree.org/meta-schemas/core.yaml#

title: TI OMAP MUSB Glue

maintainers:
  - Anatol Pomozov <anatol.pomozov@gmail.com>
  - George Cherian <george.cherian@ti.com>
  - Kishon Vijay Abraham I <kishon@kernel.org>
  - Mauro Carvalho Chehab <mchehab+huawei@kernel.org>
  - Roger Quadros <rogerq@ti.com>

properties:
  compatible:
    enum:
      - ti,omap4-musb
      - ti,omap3-musb

  ti,hwmods:
    description: Hardware modules used by the glue driver
    type: string

  multipoint:
    description: Indicates the musb controller supports multipoint
    const: 1

  num-eps:
    description: Specifies the number of endpoints
    $ref: /schemas/types.yaml#/definitions/uint32
    const: 16

  ram-bits:
    description: Specifies the RAM address size
    const: 12

  ctrl-module:
    description: Phandle of the control module this glue uses to write to mailbox
    $ref: /schemas/types.yaml#/definitions/phandle

  interface-type:
    description: Type of interface between the controller and the PHY (0=ULPI,1=UTMI)
    $ref: /schemas/types.yaml#/definitions/uint32
    enum:
      - 0
      - 1

  mode:
    description: Operating mode (1=HOST,2=PERIPHERAL,3=OTG)
    $ref: /schemas/types.yaml#/definitions/uint32
    enum:
      - 1
      - 2
      - 3

  power:
    description: Maximum current (in mA) the controller can supply in host mode
    $ref: /schemas/types.yaml#/definitions/uint32
    const: 50

  usb-phy:
    description: Phandle for the PHY device
    $ref: /schemas/types.yaml#/definitions/phandle

  phys:
    description: Phandle for the PHY device (used by generic PHY framework)
    maxItems: 1

  phy-names:
    items:
      - const: usb2-phy

required:
  - compatible
  - ti,hwmods
  - multipoint
  - num-eps
  - ram-bits
  - phys
  - phy-names

additionalProperties: false

examples:
  - |
    usb_otg_hs: usb_otg_hs@4a0ab000 {
        compatible = "ti,omap4-musb";
        ti,hwmods = "usb_otg_hs";
        multipoint = <1>;
        num-eps = <16>;
        ram-bits = <12>;
        ctrl-module = <&omap_control_usb>;
        phys = <&usb2_phy>;
        phy-names = "usb2-phy";
    };
```

## Documentation/devicetree/bindings/usb/ti,twl4030-usb.yaml
```yaml
# SPDX-License-Identifier: (GPL-2.0-only OR BSD-2-Clause)
%YAML 1.2
---
$id: http://devicetree.org/schemas/ti,twl4030-usb.yaml#
$schema: http://devicetree.org/meta-schemas/core.yaml#

title: TI TWL4030 USB PHY and comparator

maintainers:
  - Graeme Gregory <gg@slimlogic.co.uk>
  - Kishon Vijay Abraham I <kishon@kernel.org>
  - NeilBrown <neilb@suse.de>

description: |
  USB COMPARATOR OF TWL CHIPS

  TWL4030 USB PHY AND COMPARATOR

properties:
  compatible:
    items:
      - const: ti,twl4030-usb

  interrupts:
    description: >-
      The interrupt numbers to the cpu. First interrupt number raises ID and
      VBUS interrupts. Second interrupt number is optional for RX interrupts.
    minItems: 1
    items:
      - description: OTG and VBUS interrupt
      - description: RX interrupt

  usb1v5-supply:
    description: Phandle to the regulator device tree node for 1.5V USB supply.

  usb1v8-supply:
    description: Phandle to the regulator device tree node for 1.8V USB supply.

  usb3v1-supply:
    description: Phandle to the regulator device tree node for 3.1V USB supply.

  usb_mode:
    description: >-
      The mode used by the phy to connect to the controller. 1 specifies ULPI mode;
      2 specifies CEA2011_3PIN mode.
    $ref: /schemas/types.yaml#/definitions/uint32

additionalProperties: false

examples:
  - |
    twl4030-usb {
        compatible = "ti,twl4030-usb";
        interrupts = <10 4>;
        usb1v5-supply = <&vusb1v5>;
        usb1v8-supply = <&vusb1v8>;
        usb3v1-supply = <&vusb3v1>;
        usb_mode = <1>;
    };
```

## Documentation/devicetree/bindings/usb/ti,twl6030-usb.yaml
```yaml
# SPDX-License-Identifier: (GPL-2.0-only OR BSD-2-Clause)
%YAML 1.2
---
$id: http://devicetree.org/schemas/ti,twl6030-usb.yaml#
$schema: http://devicetree.org/meta-schemas/core.yaml#

title: TI TWL6030 USB comparator

maintainers:
  - Graeme Gregory <gg@slimlogic.co.uk>
  - Kishon Vijay Abraham I <kishon@kernel.org>
  - NeilBrown <neilb@suse.de>

properties:
  compatible:
    items:
      - const: ti,twl6030-usb

  interrupts:
    description:
      Two interrupt numbers to the cpu. First interrupt number is the OTG
      interrupt number that raises ID interrupts when the controller has to act
      as host. Second interrupt number is the USB interrupt number that raises
      VBUS interrupts when the controller has to act as device.
    items:
      - description: OTG and ID interrupt
      - description: USB VBUS interrupt

  usb-supply:
    $ref: /schemas/types.yaml#/definitions/phandle
    description: Phandle to the regulator device tree node. It should be &vusb for TWL6030.

additionalProperties: false

examples:
  - |
    twl6030-usb {
        compatible = "ti,twl6030-usb";
        interrupts = <4 10>;
        usb-supply = <&vusb>;
    };
```

## Documentation/devicetree/bindings/usb/vendor,usb-controller.yaml
```yaml
# SPDX-License-Identifier: (GPL-2.0-only OR BSD-2-Clause)
# Copyright 2025 Linaro Ltd.
%YAML 1.2
---
$id: http://devicetree.org/schemas/vendor,usb-controller.yaml#
$schema: http://devicetree.org/meta-schemas/core.yaml#

title: ULPI bus controller

maintainers:
  - Stephen Boyd <stephen.boyd@linaro.org>

description: |
  Phys that are behind a ULPI connection can be described with the following
  binding. The host controller shall have a "ulpi" named node as a child, and
  that node shall have one enabled node underneath it representing the ulpi
  device on the bus.

properties:
  compatible:
    items:
      - enum: ["vendor,usb-controller"]
    description: Bus controller compatible with ULPI protocol.

  ulpi:
    description: ULPI bus child node providing interface to PHY devices.
    type: object
    properties:
      phy:
        description: PHY device node on the ULPI bus.
        type: object
        properties:
          compatible:
            items:
              - enum: ["vendor,phy"]
            description: PHY device compatible string.
        required:
          - compatible
        additionalProperties: false
    required:
      - phy
    additionalProperties: false

required:
  - compatible

additionalProperties: false

examples:
  - |
    usb {
        compatible = "vendor,usb-controller";

        ulpi {
            phy {
                compatible = "vendor,phy";
            };
        };
    };
```

## Documentation/devicetree/bindings/w1/ti,omap3-1w.yaml
```yaml
# SPDX-License-Identifier: (GPL-2.0-only OR BSD-2-Clause)
# Copyright 2025 NeilBrown <neilb@suse.de>
# Copyright 2025 Vignesh R <vigneshr@ti.com>
%YAML 1.2
---
$id: http://devicetree.org/schemas/w1/ti,omap3-1w.yaml#
$schema: http://devicetree.org/meta-schemas/core.yaml#

title: OMAP HDQ One wire bus master controller

maintainers:
  - NeilBrown <neilb@suse.de>
  - Vignesh R <vigneshr@ti.com>

description: |
  * OMAP HDQ One wire bus master controller

properties:
  compatible:
    description: Device compatibility string.
    items:
      - enum: ["ti,omap3-1w", "ti,am4372-hdq"]

  reg:
    description: Register region location and size.
    items:
      - description: Base address
      - description: Register region size

  interrupts:
    description: Interrupt line for HDQ transactions.
    items:
      - description: Interrupt number

  ti,hwmods:
    description: Hardware module name for the HDQ controller.
    $ref: /schemas/types.yaml#/definitions/string-array
    items:
      - const: hdq1w

  ti,mode:
    description: Operation mode of the controller.
    enum: [hdq, 1w]

additionalProperties: false

examples:
  - |
      hdqw1w: 1w@480b2000 {
          compatible = "ti,omap3-1w";
          reg = <0x480b2000 0x1000>;
          interrupts = <58>;
          ti,hwmods = "hdq1w";
          ti,mode = "hdq";
      };
```
