## Documentation/devicetree/bindings/usb/marvell,pxa270-udc.yaml
```yaml
# SPDX-License-Identifier: (GPL-2.0-only OR BSD-2-Clause)
$id: http://devicetree.org/schemas/usb/marvell,pxa270-udc.yaml#
$schema: http://devicetree.org/meta-schemas/core.yaml#

title: PXA USB controllers UDC
maintainers:
  - Daniel Mack <zonque@gmail.com>
  - Robert Jarzmik <robert.jarzmik@free.fr>
  - Rob Herring <robh@kernel.org>
description: |
  PXA USB controllers

  UDC

properties:
  compatible:
    items:
      - const: marvell,pxa270-udc
    description: Compatible string for the PXA270 UDC USB controller.
  reg:
    maxItems: 1

  interrupts:
    maxItems: 1

  clocks:
    maxItems: 1

  gpios:
    maxItems: 1
    description: GPIO used to control the USB D+ pull-up.

required:
  - compatible
  - reg
  - interrupts
  - clocks

additionalProperties: false

examples:
  - |
    pxa27x_udc: udc@40600000 {
        compatible = "marvell,pxa270-udc";
        reg = <0x40600000 0x10000>;
        interrupts = <11>;
        clocks = <&pxa2xx_clks 11>;
        gpios = <&gpio 22 GPIO_ACTIVE_LOW>;
    };
```

## Documentation/devicetree/bindings/usb/maxim,max3421.yaml
```yaml
# SPDX-License-Identifier: (GPL-2.0-only OR BSD-2-Clause)
# Copyright 2025 Jules Maselbas <jules.maselbas@grenoble-inp.org>
# Copyright 2025 Rob Herring <robh@kernel.org>
%YAML 1.2
---
$id: http://devicetree.org/schemas/usb/maxim,max3421.yaml#
$schema: http://devicetree.org/meta-schemas/core.yaml#

title: Maxim MAX3421E USB 2.0 host controller

maintainers:
  - Jules Maselbas <jules.maselbas@grenoble-inp.org>
  - Rob Herring <robh@kernel.org>

description: |
  Maxim Integrated SPI-based USB 2.0 host controller MAX3421E

properties:
  compatible:
    items:
      - const: maxim,max3421

  reg:
    description: Chip select number to which this device is connected.
    items:
      - description: Chip select

  spi-max-frequency:
    description: Maximum SPI clock frequency for this device in Hz, must not exceed 26 MHz.
    $ref: /schemas/types.yaml#/definitions/uint32
    maximum: 26000000

  maxim,vbus-en-pin:
    description: GPOUT pin number and active level to drive Vbus.
    $ref: /schemas/types.yaml#/definitions/phandle-array
    items:
      - description: "GPOUTx: pin number (1–8)"
        minimum: 1
        maximum: 8
      - description: "ACTIVE_LEVEL: level (0=inactive, 1=active)"
        enum: [0, 1]

  interrupts:
    description: Interrupt line for this controller (active low level).
    maxItems: 1

required:
  - compatible
  - reg
  - spi-max-frequency
  - maxim,vbus-en-pin
  - interrupts

additionalProperties: false

examples:
  - |
    usb@0 {
        compatible = "maxim,max3421";
        reg = <0>;
        spi-max-frequency = <26000000>;
        maxim,vbus-en-pin = <3 1>;
        interrupts = <42>;
    };
```

## Documentation/devicetree/bindings/usb/nvidia,tegra20-ehci.yaml
```yaml
# SPDX-License-Identifier: (GPL-2.0-only OR BSD-2-Clause)
%YAML 1.2
---
$id: http://devicetree.org/schemas/usb/nvidia,tegra20-ehci.yaml#
$schema: http://devicetree.org/meta-schemas/core.yaml#

title: NVIDIA Tegra20 EHCI USB controller
maintainers:
  - Paul Walmsley <paul@pwsan.com>
  - Stephen Warren <swarren@nvidia.com>
  - Venu Byravarasu <vbyravarasu@nvidia.com>

description: |
  Tegra SOC USB controllers

  The device node for a USB controller that is part of a Tegra
  SOC is as described in the document "Open Firmware Recommended
  Practice : Universal Serial Bus" with the following modifications
  and additions :

properties:
  compatible:
    oneOf:
      - items:
          - const: "nvidia,tegra20-ehci"
      - items:
          - const: "nvidia,tegra30-ehci"
      - items:
          - enum:
              - "nvidia,tegra20-ehci"
              - "nvidia,tegra30-ehci"
          - enum:
              - "nvidia,tegra114-ehci"
              - "nvidia,tegra124-ehci"
              - "nvidia,tegra132-ehci"
              - "nvidia,tegra210-ehci"

  nvidia,phy:
    description: Phandle of the PHY that the controller is connected to.
    $ref: /schemas/types.yaml#/definitions/phandle

  clocks:
    description: Module clock.
    maxItems: 1

  resets:
    description: Reset phandles for each entry in reset-names.

  reset-names:
    items:
      - const: usb

  nvidia,needs-double-reset:
    description: Set for some Tegra20 USB ports which need reset twice due to hardware issues.
    type: boolean

required:
  - compatible
  - nvidia,phy
  - clocks
  - resets
  - reset-names

additionalProperties: false

examples:
  - |
    usb@7000c000 {
      compatible = "nvidia,tegra20-ehci";
      nvidia,phy = <&usb2_hsphy>;
      clocks = <&usb2_module_clk>;
      resets = <&usb2_rst>;
      reset-names = "usb";
    };
```

## Documentation/devicetree/bindings/usb/richtek,rt1711h.yaml
```yaml
# SPDX-License-Identifier: (GPL-2.0-only OR BSD-2-Clause)
# Copyright 2025 Linaro Ltd.
%YAML 1.2
---
$id: http://devicetree.org/schemas/usb/richtek,rt1711h.yaml#
# $schema is the meta-schema this schema should be validated with.
$schema: http://devicetree.org/meta-schemas/core.yaml#

title: Richtek RT1711H Type-C PD Controller
maintainers:
  - John Stultz <john.stultz@linaro.org>
  - Prashant Malani <pmalani@chromium.org>
  - Rob Herring <robh@kernel.org>
  - ShuFan Lee <shufan_lee@richtek.com>

description: |
  Richtek RT1711H TypeC PD Controller.

  Required sub-node:
  - connector: The "usb-c-connector" attached to the tcpci chip, the bindings
    of connector node are specified in
    Documentation/devicetree/bindings/connector/usb-connector.yaml

properties:
  compatible:
    items:
      - const: richtek,rt1711h

  reg:
    items:
      - description: I2C slave address of the RT1711H

  interrupts:
    description: Interrupt number and type for the controller.
    items:
      - description: IRQ number
      - description: Sense and level encoding

  connector:
    description: USB Type-C connector node.
    $ref: /schemas/connector/usb-connector.yaml

required:
  - compatible
  - reg
  - interrupts

additionalProperties: false

examples:
  - |
    rt1711h@4e {
        compatible = "richtek,rt1711h";
        reg = <0x4e>;
        interrupts = <0 IRQ_TYPE_LEVEL_LOW>;

        usb_con: connector {
            compatible = "usb-c-connector";
            label = "USB-C";
            data-role = "dual";
            power-role = "dual";
            try-power-role = "sink";
            source-pdos = <PDO_FIXED(5000, 2000, PDO_FIXED_USB_COMM)>;
            sink-pdos = <PDO_FIXED(5000, 2000, PDO_FIXED_USB_COMM)
                         PDO_VAR(5000, 12000, 2000)>;
            op-sink-microwatt = <10000000>;

            ports {
                #address-cells = <1>;
                #size-cells = <0>;

                port@1 {
                    reg = <1>;
                    usb_con_ss: endpoint {
                        remote-endpoint = <&usb3_data_ss>;
                    };
                };
            };
        };
    };
```

## Documentation/devicetree/bindings/usb/samsung,s3c2410-ohci.yaml
```yaml
# SPDX-License-Identifier: (GPL-2.0-only OR BSD-2-Clause)
# Copyright 2025 Sergio Prado
%YAML 1.2
---
$id: http://devicetree.org/schemas/usb/samsung,s3c2410-ohci.yaml#
$schema: http://devicetree.org/meta-schemas/core.yaml#

title: Samsung S3C2410 OHCI USB controller
maintainers:
  - Sergio Prado <sergio.prado@e-labworks.com>
  - Weitao Hou <houweitaoo@gmail.com>

properties:
  compatible:
    items:
      - const: samsung,s3c2410-ohci

  reg:
    maxItems: 1

  interrupts:
    maxItems: 1

  clocks:
    items:
      - description: USB bus clock.
      - description: USB host clock.

  clock-names:
    items:
      - const: usb-bus-host
      - const: usb-host

required:
  - compatible
  - reg
  - interrupts

examples:
  - |
    usb0: usb@49000000 {
        compatible = "samsung,s3c2410-ohci";
        reg = <0x49000000 0x100>;
        interrupts = <0 0 26 3>;
        clocks = <&clocks UCLK>, <&clocks HCLK_USBH>;
        clock-names = "usb-bus-host", "usb-host";
    };

additionalProperties: false
```

## Documentation/devicetree/bindings/usb/smsc,usb4604.yaml
```yaml
# SPDX-License-Identifier: (GPL-2.0-only OR BSD-2-Clause)
# Copyright 2025 Stephen Boyd
%YAML 1.2
---
$id: http://devicetree.org/schemas/usb/smsc,usb4604.yaml#
$schema: http://devicetree.org/meta-schemas/core.yaml#

title: smsc,usb4604

maintainers:
  - Stephen Boyd <stephen.boyd@linaro.org>

description: |
  SMSC USB4604 High-Speed Hub Controller

properties:
  compatible:
    items:
      - const: smsc,usb4604
    description: Compatible string identifying the controller.

  reg:
    description: I2C slave address of the hub.
    items:
      - description: I2C slave address (7-bit address).

  reset-gpios:
    maxItems: 1
    description: GPIO used to reset the hub.

  initial-mode:
    description: Initial mode of the hub (1=HUB mode, 2=STANDBY mode).
    $ref: /schemas/types.yaml#/definitions/uint32
    enum: [1, 2]

required:
  - compatible

additionalProperties: false

examples:
  - |
    usb-hub@2d {
        compatible = "smsc,usb4604";
        reg = <0x2d>;
        reset-gpios = <&gpx3 5 1>;
        initial-mode = <1>;
    };
```

## Documentation/devicetree/bindings/usb/st,st-ehci-300x.yaml
```yaml
---
$id: http://devicetree.org/schemas/st,st-ehci-300x.yaml#
$schema: http://devicetree.org/meta-schemas/core.yaml#

title: ST USB EHCI controller

maintainers:
  - Mathieu Malaterre <malat@debian.org>
  - Mauro Carvalho Chehab <mchehab@kernel.org>
  - Peter Griffin <peter.griffin@linaro.org>
  - Rob Herring <robh@kernel.org>
  - Yegor Yefremov <yegorslists@googlemail.com>

description: |
  ST USB EHCI controller

properties:
  compatible:
    items:
      - const: "st,st-ehci-300x"

  reg:
    description: Physical base address and size of the memory-mapped EHCI registers.
    items:
      - description: register start address
      - description: register region length

  interrupts:
    description: Interrupt specifier for the EHCI controller.
    items:
      - description: interrupt specifier (GIC SPI <irq> IRQ_TYPE_NONE)

  pinctrl-names:
    items:
      - const: default

  pinctrl-0:
    description: Phandle to pin configuration for the USB controller.
    $ref: /schemas/types.yaml#/definitions/phandle-array

  clocks:
    description: USB clocks.
    items:
      - description: interconnect clock
      - description: 48 MHz clock

  clock-names:
    items:
      - const: ic
      - const: clk48

  phys:
    description: Phandle to the USB PHY.
    $ref: /schemas/types.yaml#/definitions/phandle-array

  phy-names:
    items:
      - const: usb

  resets:
    description: Reset controls for the USB IP.
    items:
      - description: powerdown line
      - description: softreset line

  reset-names:
    items:
      - const: power
      - const: softreset

additionalProperties: false

examples:
  - |
    ehci1: usb@fe203e00 {
        compatible = "st,st-ehci-300x";
        reg = <0xfe203e00 0x100>;
        interrupts = <GIC_SPI 148 IRQ_TYPE_NONE>;
        pinctrl-names = "default";
        pinctrl-0 = <&pinctrl_usb1>;
        clocks = <&clk_s_a1_ls 0>;
        phys = <&usb2_phy>;
        phy-names = "usb";
        resets = <&powerdown STIH416_USB1_POWERDOWN>,
                 <&softreset STIH416_USB1_SOFTRESET>;
        reset-names = "power", "softreset";
    };
```

## Documentation/devicetree/bindings/usb/st,st-ohci-300x.yaml
```yaml
# SPDX-License-Identifier: (GPL-2.0-only OR BSD-2-Clause)
%YAML 1.2
---
$id: http://devicetree.org/schemas/usb/st,st-ohci-300x.yaml#
$schema: http://devicetree.org/meta-schemas/core.yaml#

title: ST USB OHCI controller

maintainers:
  - Mathieu Malaterre <malat@debian.org>
  - Mauro Carvalho Chehab <mchehab@kernel.org>
  - Peter Griffin <peter.griffin@linaro.org>
  - Rob Herring <robh@kernel.org>

description: |
  ST USB OHCI controller

  Required properties:

   - compatible       : must be "st,st-ohci-300x"
   - reg              : physical base addresses of the controller and length of memory mapped
                       region
   - interrupts       : one OHCI controller interrupt should be described here
   - clocks           : phandle list of usb clocks
   - clock-names      : should be "ic" for interconnect clock and "clk48"
  See: Documentation/devicetree/bindings/clock/clock-bindings.txt

   - phys             : phandle for the PHY device
   - phy-names        : should be "usb"

   - resets           : phandle to the powerdown and reset controller for the USB IP
   - reset-names      : should be "power" and "softreset"
  See: Documentation/devicetree/bindings/reset/st,stih407-powerdown.yaml
  See: Documentation/devicetree/bindings/reset/reset.txt

properties:
  compatible:
    const: st,st-ohci-300x

  reg:
    items:
      - description: physical base address and length of memory mapped region

  interrupts:
    maxItems: 1
    description: OHCI controller interrupt

  clocks:
    items:
      - description: interconnect clock phandle
      - description: 48MHz clock phandle

  clock-names:
    items:
      - const: ic
      - const: clk48

  phys:
    maxItems: 1
    description: phandle for the PHY device

  phy-names:
    items:
      - const: usb

  resets:
    minItems: 2
    maxItems: 2
    description: phandles for the powerdown and softreset controllers

  reset-names:
    items:
      - const: power
      - const: softreset

required:
  - compatible
  - reg
  - interrupts
  - clocks
  - clock-names
  - phys
  - phy-names
  - resets
  - reset-names

additionalProperties: false

examples:
  - |
    ohci0: usb@fe1ffc00 {
        compatible = "st,st-ohci-300x";
        reg = <0xfe1ffc00 0x100>;
        interrupts = <GIC_SPI 149 IRQ_TYPE_NONE>;
        clocks = <&clk_s_a1_ls 0>,
                 <&clockgen_b0 0>;
        clock-names = "ic", "clk48";
        phys = <&usb2_phy>;
        phy-names = "usb";

        resets = <&powerdown STIH416_USB0_POWERDOWN>,
                 <&softreset STIH416_USB0_SOFTRESET>;
        reset-names = "power", "softreset";
    };
```
