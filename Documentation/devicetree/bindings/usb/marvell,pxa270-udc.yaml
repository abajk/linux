## Documentation/devicetree/bindings/usb/st,stih407-dwc3.yaml
```yaml
# SPDX-License-Identifier: (GPL-2.0-only OR BSD-2-Clause)
# Copyright 2025 Linaro Ltd.
%YAML 1.2
---
$id: http://devicetree.org/schemas/usb/st,stih407-dwc3.yaml#
$schema: http://devicetree.org/meta-schemas/core.yaml#

title: ST DWC3 glue logic

maintainers:
  - Mauro Carvalho Chehab <mchehab+huawei@kernel.org>
  - Mauro Carvalho Chehab <mchehab@kernel.org>
  - Peter Griffin <peter.griffin@linaro.org>
  - Rob Herring <robh@kernel.org>
  - Yegor Yefremov <yegorslists@googlemail.com>

description: |
  ST DWC3 glue logic

  This file documents the parameters for the dwc3-st driver.
  This driver controls the glue logic used to configure the dwc3 core on
  STiH407 based platforms.

  Sub-nodes:
  The dwc3 core should be added as subnode to ST DWC3 glue as shown in the
  example below. The DT binding details of dwc3 can be found in:
  Documentation/devicetree/bindings/usb/snps,dwc3.yaml

  NB: The dr_mode property described in [1] is NOT optional for this driver, as the default value
  is "otg", which isn't supported by this SoC. Valid dr_mode values for dwc3-st are either "host"
  or "device".

  [1] Documentation/devicetree/bindings/usb/usb-drd.yaml

properties:
  compatible:
    items:
      - const: st,stih407-dwc3

  reg:
    items:
      - description: glue logic base address
      - description: syscfg control register offset
    description: Base addresses for glue logic and syscfg control registers.

  reg-names:
    items:
      - const: reg-glue
      - const: syscfg-reg
    description: Names of the reg entries.

  st,syscon:
    $ref: /schemas/types.yaml#/definitions/phandle
    description: Phandle to the system configuration node for glue registers.

  resets:
    maxItems: 2
    description: Reset lines for powerdown and softreset.

  reset-names:
    items:
      - const: powerdown
      - const: softreset
    description: Names of the reset lines.

  '#address-cells':
    const: 1
    description: Number of address cells for child nodes.

  '#size-cells':
    const: 1
    description: Number of size cells for child nodes.

  pinctrl-names:
    items:
      - const: default
    description: Name of the default pinctrl state.

  pinctrl-0:
    $ref: /schemas/types.yaml#/definitions/phandle
    description: Pin control group for the default state.

  ranges:
    description: Enables 1:1 address translation for child nodes.

  dwc3:
    $ref: /schemas/usb/snps,dwc3.yaml#
    description: Subnode containing the DWC3 core.

required:
  - compatible
  - reg
  - reg-names
  - 'st,syscon'
  - resets
  - reset-names
  - '#address-cells'
  - '#size-cells'
  - pinctrl-names
  - pinctrl-0
  - ranges

additionalProperties: false

examples:
  - |
    st_dwc3: dwc3@8f94000 {
        compatible    = "st,stih407-dwc3";
        reg           = <0x08f94000 0x1000>, <0x110 0x4>;
        reg-names     = "reg-glue", "syscfg-reg";
        st,syscon     = <&syscfg_core>;
        resets        = <&powerdown STIH407_USB3_POWERDOWN>,
                        <&softreset STIH407_MIPHY2_SOFTRESET>;
        reset-names   = "powerdown", "softreset";
        #address-cells = <1>;
        #size-cells    = <1>;
        pinctrl-names = "default";
        pinctrl-0      = <&pinctrl_usb3>;
        ranges;

        dwc3: dwc3@9900000 {
            compatible   = "snps,dwc3";
            reg          = <0x09900000 0x100000>;
            interrupts   = <GIC_SPI 155 IRQ_TYPE_NONE>;
            dr_mode      = "host";
            phy-names    = "usb2-phy", "usb3-phy";
            phys         = <&usb2_picophy2>, <&phy_port2 PHY_TYPE_USB3>;
        };
    };
```

## Documentation/devicetree/bindings/usb/stericsson,db8500-musb.yaml
```yaml
# SPDX-License-Identifier: (GPL-2.0-only OR BSD-2-Clause)
%YAML 1.2
---
$id: http://devicetree.org/schemas/usb/stericsson,db8500-musb.yaml#
$schema: http://devicetree.org/meta-schemas/core.yaml#

title: Ux500 MUSB

maintainers:
  - Lee Jones <lee@kernel.org>
  - Sebastian Andrzej Siewior <bigeasy@linutronix.de>

description: |
  Ux500 MUSB

properties:
  compatible:
    description: Device compatible string
    items:
      - const: "stericsson,db8500-musb"

  reg:
    description: Offset and length of registers
    items:
      - description: Register base address
      - description: Register size

  interrupts:
    description: Interrupt; mode, number and trigger
    items:
      - description: Interrupt controller phandle
      - description: Interrupt number
      - description: Interrupt trigger flags

  interrupt-names:
    description: Name of the interrupt
    items:
      - const: mc

  dr_mode:
    description: Dual-role; host, peripheral or otg
    enum:
      - host
      - peripheral
      - otg

  dmas:
    description: A list of DMA channel specifiers; dma-controller, event-line, fixed-channel, flags
    maxItems: 4

  dma-names:
    description: Ordered list of channel names corresponding to 'dmas'
    $ref: /schemas/types.yaml#/definitions/string-array
    items:
      - const: iep_1_9
      - const: oep_1_9
      - const: iep_2_10
      - const: oep_2_10
      - const: iep_3_11
      - const: oep_3_11
      - const: iep_4_12
      - const: oep_4_12
      - const: iep_5_13
      - const: oep_5_13
      - const: iep_6_14
      - const: oep_6_14
      - const: iep_7_15
      - const: oep_7_15
      - const: iep_8
      - const: oep_8

required:
  - compatible
  - reg
  - interrupts
  - dr_mode

additionalProperties: false

examples:
  - |
    usb_per5@a03e0000 {
        compatible = "stericsson,db8500-musb";
        reg = <0xa03e0000 0x10000>;
        interrupts = <0 23 0x4>;
        interrupt-names = "mc";
        dr_mode = "otg";
        dmas = <&dma 38 0 0x2>, /* Logical - DevToMem */
               <&dma 38 0 0x0>, /* Logical - MemToDev */
               <&dma 37 0 0x2>, /* Logical - DevToMem */
               <&dma 37 0x0>, /* Logical - MemToDev */
               <&dma 36 0x2>, /* Logical - DevToMem */
               <&dma 36 0x0>, /* Logical - MemToDev */
               <&dma 19 0x2>, /* Logical - DevToMem */
               <&dma 19 0x0>, /* Logical - MemToDev */
               <&dma 18 0x2>, /* Logical - DevToMem */
               <&dma 18 0x0>, /* Logical - MemToDev */
               <&dma 17 0x2>, /* Logical - DevToMem */
               <&dma 17 0x0>, /* Logical - MemToDev */
               <&dma 16 0x2>, /* Logical - DevToMem */
               <&dma 16 0x0>, /* Logical - MemToDev */
               <&dma 39 0x2>, /* Logical - DevToMem */
               <&dma 39 0x0>; /* Logical - MemToDev */
        dma-names = "iep_1_9", "oep_1_9",
                    "iep_2_10", "oep_2_10",
                    "iep_3_11", "oep_3_11",
                    "iep_4_12", "oep_4_12",
                    "iep_5_13", "oep_5_13",
                    "iep_6_14", "oep_6_14",
                    "iep_7_15", "oep_7_15",
                    "iep_8", "oep_8";
    };
```

## Documentation/devicetree/bindings/usb/ti,am33xx-usb.yaml
```yaml
# SPDX-License-Identifier: (GPL-2.0-only OR BSD-2-Clause)
# Copyright 2025 Texas Instruments Incorporated
%YAML 1.2
---
$id: http://devicetree.org/schemas/ti,am33xx-usb.yaml#
$schema: http://devicetree.org/meta-schemas/core.yaml#

title: TI AM33xx MUSB

maintainers:
  - Afzal Mohammed <afzal@ti.com>
  - Ajay Kumar Gupta <ajay.gupta@ti.com>
  - Anatol Pomozov <anatol.pomozov@gmail.com>
  - Geert Uytterhoeven <geert+renesas@glider.be>
  - Krzysztof Kozlowski <krzysztof.kozlowski@linaro.org>
  - Marco Franchi <marco.franchi@nxp.com>
  - Rob Herring <robh@kernel.org>
  - Sebastian Andrzej Siewior <bigeasy@linutronix.de>

description: |
  AM33xx MUSB

  The glue layer contains multiple child nodes. It is required to have
  at least a control module node, USB node and a PHY node. The second USB
  node and its PHY node are optional. The DMA node is also optional.

  The PHY should have a "phy" alias numbered properly in the alias
  node.

  The controller should have an "usb" alias numbered properly in the alias
  node.

properties:
  compatible:
    const: ti,am33xx-usb

  reg:
    items:
      - description: Offset and length of the USBSS register sets

  ti,hwmods:
    description: Hardware module to enable
    type: string
    enum:
      - usb_otg_hs

  ranges:
    description: Empty ranges for USB controller
    type: array
    maxItems: 0

  #address-cells:
    const: 1

  #size-cells:
    const: 1

  ctrl_mod:
    description: Reset module node
    type: object
    properties:
      compatible:
        const: ti,am335x-usb-ctrl-module
      reg:
        items:
          - description: USB control registers
          - description: USB wake up control registers
      reg-names:
        items:
          - const: phy_ctrl
          - const: wakeup
    required:
      - compatible
      - reg
      - reg-names
    additionalProperties: false

  usb_phy:
    description: USB PHY node
    type: object
    properties:
      compatible:
        const: ti,am335x-usb-phy
      reg:
        items:
          - description: USB PHY register space
      reg-names:
        items:
          - const: phy
      ti,ctrl_mod:
        description: Reference to the reset module node
        type: phandle
      #phy-cells:
        const: 0
    required:
      - compatible
      - reg
      - reg-names
      - ti,ctrl_mod
    additionalProperties: false

  usb:
    description: USB controller node
    type: object
    properties:
      compatible:
        const: ti,musb-am33xx
      reg:
        items:
          - description: USB Controller Registers
          - description: USB Core register space
      reg-names:
        items:
          - const: mc
          - const: control
      interrupts:
        items:
          - description: USB interrupt number
      interrupt-names:
        items:
          - const: mc
      dr_mode:
        description: USB controller mode
        enum: [host, peripheral, otg]
      mentor,multipoint:
        description: MUSB multipoint support
        const: 1
      mentor,num-eps:
        description: Number of endpoints
        const: 16
      mentor,ram-bits:
        description: RAM address size
        const: 12
      mentor,power:
        description: Supply current in mA
        const: 500
      phys:
        description: Reference to the USB PHY node
        type: phandle
      dmas:
        description: DMA channels
        items:
          minimum: 0
          maximum: 30
      dma-names:
        description: Names for DMA channels
        items:
          - enum: [rx1, rx2, rx3, rx4, rx5, rx6, rx7, rx8, rx9, rx10, rx11, rx12, rx13, rx14, rx15]
          - enum: [tx1, tx2, tx3, tx4, tx5, tx6, tx7, tx8, tx9, tx10, tx11, tx12, tx13, tx14, tx15]
    required:
      - compatible
      - reg
      - reg-names
      - interrupts
      - interrupt-names
      - dr_mode
      - mentor,multipoint
      - mentor,num-eps
      - mentor,ram-bits
      - mentor,power
      - phys
      - dmas
      - dma-names
    additionalProperties: false

  cppi41dma:
    description: DMA controller node
    type: object
    properties:
      compatible:
        const: ti,am3359-cppi41
      reg:
        items:
          - description: USBSS register space
          - description: USB CPPI DMA Controller register space
          - description: USB CPPI DMA Scheduler register space
          - description: USB Queue Manager register space
      reg-names:
        items:
          - const: glue
          - const: controller
          - const: scheduler
          - const: queuemgr
      interrupts:
        items:
          - description: DMA interrupt
      interrupt-names:
        items:
          - const: glue
      #dma-cells:
        const: 2
      dma-channels:
        description: Number of DMA channels
        const: 30
      dma-requests:
        description: Number of DMA requests
        const: 256
    required:
      - compatible
      - reg
      - reg-names
      - interrupts
      - interrupt-names
      - #dma-cells
      - dma-channels
    additionalProperties: false

required:
  - compatible
  - reg
  - ti,hwmods

additionalProperties: false

examples:
  - |
    aliases {
    	usb0 = &usb0;
    	usb1 = &usb1;
    	phy0 = &usb0_phy;
    	phy1 = &usb1_phy;
    };

    usb: usb@47400000 {
    	compatible = "ti,am33xx-usb";
    	reg = <0x47400000 0x1000>;
    	ranges;
    	#address-cells = <1>;
    	#size-cells = <1>;
    	ti,hwmods = "usb_otg_hs";

    	ctrl_mod: control@44e10000 {
    		compatible = "ti,am335x-usb-ctrl-module";
    		reg = <0x44e10620 0x10
    			0x44e10648 0x4>;
    		reg-names = "phy_ctrl", "wakeup";
    	};

    	usb0_phy: usb-phy@47401300 {
    		compatible = "ti,am335x-usb-phy";
    		reg = <0x47401300 0x100>;
    		reg-names = "phy";
    		ti,ctrl_mod = <&ctrl_mod>;
    		#phy-cells = <0>;
    	};

    	usb0: usb@47401000 {
    		compatible = "ti,musb-am33xx";
    		reg = <0x47401400 0x400
    			0x47401000 0x200>;
    		reg-names = "mc", "control";

    		interrupts = <18>;
    		interrupt-names = "mc";
    		dr_mode = "otg";
    		mentor,multipoint = <1>;
    		mentor,num-eps = <16>;
    		mentor,ram-bits = <12>;
    		mentor,power = <500>;
    		phys = <&usb0_phy>;

    		dmas = <&cppi41dma  0 0 &cppi41dma  1 0
    			&cppi41dma  2 0 &cppi41dma  3 0
    			&cppi41dma  4 0 &cppi41dma  5 0
    			&cppi41dma  6 0 &cppi41dma  7 0
    			&cppi41dma  8 0 &cppi41dma  9 0
    			&cppi41dma 10 0 &cppi41dma 11 0
    			&cppi41dma 12 0 &cppi41dma 13 0
    			&cppi41dma 14 0 &cppi41dma  0 1
    			&cppi41dma  1 1 &cppi41dma  2 1
    			&cppi41dma  3 1 &cppi41dma  4 1
    			&cppi41dma  5 1 &cppi41dma  6 1
    			&cppi41dma  7 1 &cppi41dma  8 1
    			&cppi41dma  9 1 &cppi41dma 10 1
    			&cppi41dma 11 1 &cppi41dma 12 1
    			&cppi41dma 13 1 &cppi41dma 14 1>;
    		dma-names =
    			"rx1", "rx2", "rx3", "rx4", "rx5", "rx6", "rx7",
    			"rx8", "rx9", "rx10", "rx11", "rx12", "rx13",
    			"rx14", "rx15",
    			"tx1", "tx2", "tx3", "tx4", "tx5", "tx6", "tx7",
    			"tx8", "tx9", "tx10", "tx11", "tx12", "tx13",
    			"tx14", "tx15";
    	};

    	usb1_phy: usb-phy@47401b00 {
    		compatible = "ti,am335x-usb-phy";
    		reg = <0x47401b00 0x100>;
    		reg-names = "phy";
    		ti,ctrl_mod = <&ctrl_mod>;
    		#phy-cells = <0>;
    	};

    	usb1: usb@47401800 {
    		compatible = "ti,musb-am33xx";
    		reg = <0x47401c00 0x400
    			0x47401800 0x200>;
    		reg-names = "mc", "control";
    		interrupts = <19>;
    		interrupt-names = "mc";
    		dr_mode = "host";
    		mentor,multipoint = <1>;
    		mentor,num-eps = <16>;
    		mentor,ram-bits = <12>;
    		mentor,power = <500>;
    		phys = <&usb1_phy>;

    		dmas = <&cppi41dma 15 0 &cppi41dma 16 0
    			&cppi41dma 17 0 &cppi41dma 18 0
    			&cppi41dma 19 0 &cppi41dma 20 0
    			&cppi41dma 21 0 &cppi41dma 22 0
    			&cppi41dma 23 0 &cppi41dma 24 0
    			&cppi41dma 25 0 &cppi41dma 26 0
    			&cppi41dma 27 0 &cppi41dma 28 0
    			&cppi41dma 29 0 &cppi41dma 15 1
    			&cppi41dma 16 1 &cppi41dma 17 1
    			&cppi41dma 18 1 &cppi41dma 19 1
    			&cppi41dma 20 1 &cppi41dma 21 1
    			&cppi41dma 22 1 &cppi41dma 23 1
    			&cppi41dma 24 1 &cppi41dma 25 1
    			&cppi41dma 26 1 &cppi41dma 27 1
    			&cppi41dma 28 1 &cppi41dma 29 1>;
    		dma-names =
    			"rx1", "rx2", "rx3", "rx4", "rx5", "rx6", "rx7",
    			"rx8", "rx9", "rx10", "rx11", "rx12", "rx13",
    			"rx14", "rx15",
    			"tx1", "tx2", "tx3", "tx4", "tx5", "tx6", "tx7",
    			"tx8", "tx9", "tx10", "tx11", "tx12", "tx13",
    			"tx14", "tx15";
    	};

    	cppi41dma: dma-controller@7402000 {
    		compatible = "ti,am3359-cppi41";
    		reg =  <0x47400000 0x1000
    			0x47402000 0x1000
    			0x47403000 0x1000
    			0x47404000 0x4000>;
    		reg-names = "glue", "controller", "scheduler", "queuemgr";
    		interrupts = <17>;
    		interrupt-names = "glue";
    		#dma-cells = <2>;
    		dma-channels = <30>;
    		dma-requests = <256>;
    	};
    };
```
