## Documentation/devicetree/bindings/mfd/toshiba,tc3589x.yaml
```yaml
# SPDX-License-Identifier: (GPL-2.0-only OR BSD-2-Clause)
%YAML 1.2
---
$id: http://devicetree.org/schemas/mfd/toshiba,tc3589x.yaml#
$schema: http://devicetree.org/meta-schemas/core.yaml#

title: Toshiba TC3589x multi-purpose expander

maintainers:
  - Dmitry Torokhov <dmitry.torokhov@gmail.com>
  - Linus Walleij <linus.walleij@linaro.org>
  - Rob Herring <robh@kernel.org>
  - Sudeep Holla <sudeep.holla@arm.com>

description: |
  Toshiba TC3589x multi-purpose expander

  The Toshiba TC3589x series are I2C-based MFD devices which may expose the
  following built-in devices: gpio, keypad, rotator (vibrator), PWM (for
  e.g. LEDs or vibrators).

  The included models are:
    - TC35890
    - TC35892
    - TC35893
    - TC35894
    - TC35895
    - TC35896

properties:
  compatible:
    items:
      - enum:
          - "toshiba,tc35890"
          - "toshiba,tc35892"
          - "toshiba,tc35893"
          - "toshiba,tc35894"
          - "toshiba,tc35895"
          - "toshiba,tc35896"
    description: Device compatibility list

  reg:
    description: I2C address of the device
    items:
      - description: I2C bus address

  interrupts:
    description: Interrupt on the parent the controller is connected to
    items:
      - description: Interrupt specifier (IRQ number and type)

  interrupt-controller: true

  '#interrupt-cells':
    const: 1

  tc3589x_gpio:
    description: GPIO controller inside the TC3589x
    type: object
    additionalProperties: false
    properties:
      compatible:
        items:
          - const: "toshiba,tc3589x-gpio"
      interrupts:
        description: Interrupt on the parent, which must be the TC3589x MFD device
        items:
          - description: Interrupt specifier (IRQ number and type)
      interrupt-controller: true
      '#interrupt-cells':
        # A simple case where the value must always be '2'.
        const: 2
      gpio-controller: true
      '#gpio-cells':
        # A simple case where the value must always be '2'.
        const: 2
    required:
      - compatible
      - interrupts
      - interrupt-controller
      - '#interrupt-cells'
      - gpio-controller
      - '#gpio-cells'

  tc3589x_keypad:
    description: Keypad controller inside the TC3589x
    type: object
    additionalProperties: false
    properties:
      compatible:
        items:
          - const: "toshiba,tc3589x-keypad"
      interrupts:
        description: Interrupt on the parent, which must be the TC3589x MFD device
        items:
          - description: Interrupt specifier (IRQ number and type)
      debounce-delay-ms:
        description: Debounce interval in milliseconds
      keypad,num-columns:
        description: Number of columns in the matrix
        $ref: /schemas/types.yaml#/definitions/uint32
      keypad,num-rows:
        description: Number of rows in the matrix
        $ref: /schemas/types.yaml#/definitions/uint32
      linux,no-autorepeat: true
      linux,keymap:
        description: Keymap definition, see bindings/input/matrix-keymap.txt
        $ref: /schemas/types.yaml#/definitions/uint32-array
      wakeup-source: true
    required:
      - compatible
      - interrupts

required:
  - compatible
  - reg
  - interrupts
  - interrupt-controller
  - '#interrupt-cells'

additionalProperties: false

examples:
  - |
    tc35893@44 {
      compatible = "toshiba,tc35893";
      reg = <0x44>;
      interrupts = <26 IRQ_TYPE_EDGE_RISING>;
      interrupt-controller;
      #interrupt-cells = <1>;
      tc3589x_gpio {
        compatible = "toshiba,tc3589x-gpio";
        interrupts = <0>;
        interrupt-controller;
        #interrupt-cells = <2>;
        gpio-controller;
        #gpio-cells = <2>;
      };
      tc3589x_keypad {
        compatible = "toshiba,tc3589x-keypad";
        interrupts = <6>;
        debounce-delay-ms = <4>;
        keypad,num-columns = <8>;
        keypad,num-rows = <8>;
        linux,no-autorepeat;
        linux,keymap = <
          0x0301006b 0x04010066 0x06040072 0x040200d7 0x0303006a 0x0205000e 0x0607008b
          0x0500001c 0x0403000b 0x03040034 0x05020067 0x0305006c 0x040500e7 0x0005009e
          0x06020073 0x01030039 0x07060069 0x050500d9
        >;
        wakeup-source;
      };
    };
```

## Documentation/devicetree/bindings/mfd/wlf,wm831x.yaml
```yaml
%YAML 1.2
---
$id: http://devicetree.org/schemas/wlf,wm831x.yaml#
$schema: http://devicetree.org/meta-schemas/core.yaml#

title: wm831x PMICs

maintainers:
  - Baolin Wang <baolin.wang@linux.alibaba.com>
  - Charles Keepax <ckeepax@opensource.wolfsonmicro.com>
  - Rob Herring <robh@kernel.org>

description: |
  Cirrus Logic/Wolfson Microelectronics wm831x PMICs

  System PMICs with a wide range of additional features.

properties:
  compatible:
    items:
      - enum: [wlf, wm8310]
      - enum: [wlf, wm8311]
      - enum: [wlf, wm8312]
      - enum: [wlf, wm8320]
      - enum: [wlf, wm8321]
      - enum: [wlf, wm8325]
      - enum: [wlf, wm8326]
    description: Identify the PMIC variant.

  reg:
    items:
      - description: I2C slave address or SPI chip select.
    description: Register bus address specifier.

  gpio-controller: true

  '#gpio-cells':
    const: 2

  interrupts:
    items:
      - description: Interrupt line specifier (IRQ number and flags).
    description: List of interrupt specifiers.

  interrupt-controller: true

  '#interrupt-cells':
    const: 2

  phys:
    description: USB PHY phandle.
    $ref: /schemas/types.yaml#/definitions/phandle

  regulators:
    type: object
    description: Sub-nodes for configuring PMIC regulators.
    additionalProperties: false
    patternProperties:
      '^[a-z0-9]+$':
        type: object
        additionalProperties: false
        properties:
          regulator-name:
            enum:
              - DCDC1
              - DCDC2
              - DCDC3
              - DCDC4
              - ISINK1
              - ISINK2
              - LDO1
              - LDO2
              - LDO3
              - LDO4
              - LDO5
              - LDO7
              - LDO11
            description: Human-readable regulator name.
          regulator-min-microvolt:
            description: Minimum output voltage in microvolts.
          regulator-max-microvolt:
            description: Maximum output voltage in microvolts.
        required:
          - regulator-name
          - regulator-min-microvolt
          - regulator-max-microvolt

required:
  - compatible
  - reg
  - gpio-controller
  - '#gpio-cells'
  - interrupts
  - interrupt-controller
  - '#interrupt-cells'

additionalProperties: false

examples:
  - |
    wm8310: pmic@36 {
        compatible = "wlf,wm8310";
        reg = <0x36>;
        gpio-controller;
        #gpio-cells = <2>;
        interrupts = <347>;
        interrupt-controller;
        #interrupt-cells = <2>;
        regulators {
            dcdc1: dcdc1 {
                regulator-name = "DCDC1";
                regulator-min-microvolt = <600000>;
                regulator-max-microvolt = <600000>;
            };
            ldo1: ldo1 {
                regulator-name = "LDO1";
                regulator-min-microvolt = <1700000>;
                regulator-max-microvolt = <1700000>;
            };
        };
    };
```

## Documentation/devicetree/bindings/mips/brcm/brcm,bcm3368.yaml
```yaml
# SPDX-License-Identifier: (GPL-2.0-only OR BSD-2-Clause)
---
$id: http://devicetree.org/schemas/mips/brcm/brcm,bcm3368.yaml#
$schema: http://devicetree.org/meta-schemas/core.yaml#

title: Broadcom STB SoC

maintainers:
  - Álvaro Fernández Rojas <noltari@gmail.com>
  - Florian Fainelli <f.fainelli@gmail.com>
  - Jonathan Neuschäfer <j.neuschaefer@gmx.net>
  - Kevin Cernekee <cernekee@gmail.com>

description: |
  * Broadcom cable/DSL/settop platforms

  The experimental -viper variants are for running Linux on the 3384's
  BMIPS4355 cable modem CPU instead of the BMIPS5000 application processor.

  Power management
  ----------------

  For power management (particularly, S2/S3/S5 system suspend), the following SoC
  components are needed:

  Always-On control block (AON CTRL)

  This hardware provides control registers for the "always-on" (even in low-power
  modes) hardware, such as the Power Management State Machine (PMSM).

  Memory controllers

  A Broadcom STB SoC typically has a number of independent memory controllers,
  each of which may have several associated hardware blocks, which are versioned
  independently (control registers, DDR PHYs, etc.). One might consider
  describing these controllers as a parent "memory controllers" block, which
  contains N sub-nodes (one for each controller in the system), each of which is
  associated with a number of hardware register resources (e.g., its PHY.

  DDR PHY control

  Control registers for this memory controller's DDR PHY.

  DDR memory controller sequencer

  Control registers for this memory controller's DDR memory sequencer

  MEMC Arbiter

  The memory controller arbiter is responsible for memory clients allocation
  (bandwidth, priorities etc.) and needs to have its contents restored during
  deep sleep states (S3).

  Timers

  The Broadcom STB chips contain a timer block with several general purpose
  timers that can be used.

properties:
  compatible:
    description: A list of compatible strings for Broadcom STB SoCs.
    items:
      - enum:
          - brcm,bcm3368
          - brcm,bcm3384
          - brcm,bcm33843
          - brcm,bcm3384-viper
          - brcm,bcm33843-viper
          - brcm,bcm6328
          - brcm,bcm6358
          - brcm,bcm6362
          - brcm,bcm6368
          - brcm,bcm63168
          - brcm,bcm63268
          - brcm,bcm7125
          - brcm,bcm7346
          - brcm,bcm7358
          - brcm,bcm7360
          - brcm,bcm7362
          - brcm,bcm7420
          - brcm,bcm7425

required:
  - compatible

additionalProperties: false

examples:
  - |
    soc {
      compatible = "brcm,bcm3368";
    };
```

## Documentation/devicetree/bindings/mips/cavium/cavium,octeon-3860-bootbus.yaml
```yaml
# SPDX-License-Identifier: (GPL-2.0-only OR BSD-2-Clause)
# Copyright 2025 David Daney <david.daney@cavium.com>
%YAML 1.2
---
$id: http://devicetree.org/schemas/mips/cavium/cavium,octeon-3860-bootbus.yaml#
$schema: http://devicetree.org/meta-schemas/core.yaml#

title: Octeon Boot Bus
maintainers:
  - David Daney <david.daney@cavium.com>
description: |
  * Boot Bus

  The Octeon Boot Bus is a configurable parallel bus with 8 chip
  selects.  Each chip select is independently configurable.

  Compatibility with all cn3XXX, cn5XXX and cn6XXX SOCs.

properties:
  compatible:
    items:
      - const: cavium,octeon-3860-bootbus
  reg:
    description: The base address of the Boot Bus' register bank
    items:
      - description: hi bits of base address
      - description: lo bits of base address
      - description: register bank offset
      - description: register bank size
  "#address-cells":
    const: 2
    description: >
      The first cell is the chip select within the bootbus;
      the second is the offset from the chip select
  "#size-cells":
    const: 1
    description: The size of the chip select region
  ranges:
    description: Triplets of (child-bus-address, parent-bus-address, length) for each active chip select
    items:
      - description: child-bus address
      - description: parent-bus address
      - description: length

patternProperties:
  "^cavium,cs-config@":
    description: Configuration parameters for each chip select
    type: object
    properties:
      compatible:
        items:
          - const: cavium,octeon-3860-bootbus-config
      cavium,cs-index:
        $ref: /schemas/types.yaml#/definitions/uint32
        description: A cell indicating the chip select index
      cavium,t-adr:
        $ref: /schemas/types.yaml#/definitions/uint32
        description: ADR timing (in nS)
      cavium,t-ce:
        $ref: /schemas/types.yaml#/definitions/uint32
        description: CE timing (in nS)
      cavium,t-oe:
        $ref: /schemas/types.yaml#/definitions/uint32
        description: OE timing (in nS)
      cavium,t-we:
        $ref: /schemas/types.yaml#/definitions/uint32
        description: WE timing (in nS)
      cavium,t-rd-hld:
        $ref: /schemas/types.yaml#/definitions/uint32
        description: RD_HLD timing (in nS)
      cavium,t-wr-hld:
        $ref: /schemas/types.yaml#/definitions/uint32
        description: WR_HLD timing (in nS)
      cavium,t-pause:
        $ref: /schemas/types.yaml#/definitions/uint32
        description: PAUSE timing (in nS)
      cavium,t-wait:
        $ref: /schemas/types.yaml#/definitions/uint32
        description: WAIT timing (in nS)
      cavium,t-page:
        $ref: /schemas/types.yaml#/definitions/uint32
        description: PAGE timing (in nS)
      cavium,t-rd-dly:
        $ref: /schemas/types.yaml#/definitions/uint32
        description: RD_DLY timing (in nS)
      cavium,pages:
        $ref: /schemas/types.yaml#/definitions/uint32
        description: Parameter selecting page size (0 = 8 bytes, 1 = 2 bytes, 2 = 4 bytes, 3 = 8 bytes)
      cavium,wait-mode:
        type: boolean
        description: If present, wait mode (WAITM) is selected
      cavium,page-mode:
        type: boolean
        description: If present, page mode (PAGEM) is selected
      cavium,bus-width:
        $ref: /schemas/types.yaml#/definitions/uint32
        description: Width of the bus in bits for this chip select
      cavium,ale-mode:
        type: boolean
        description: If present, ALE mode is selected
      cavium,sam-mode:
        type: boolean
        description: If present, SAM mode is selected
      cavium,or-mode:
        type: boolean
        description: If present, OR mode is selected
    required:
      - compatible
      - cavium,cs-index
      - cavium,t-adr
      - cavium,t-ce
      - cavium,t-oe
      - cavium,t-we
      - cavium,t-rd-hld
      - cavium,t-wr-hld
      - cavium,t-pause
      - cavium,t-wait
      - cavium,t-page
      - cavium,t-rd-dly
      - cavium,pages
      - cavium,bus-width
    additionalProperties: false

required:
  - compatible
  - reg
  - "#address-cells"
  - "#size-cells"
  - ranges

additionalProperties: false

examples:
  - |
    bootbus: bootbus@1180000000000 {
      compatible = "cavium,octeon-3860-bootbus";
      reg = <0x11800 0x00000000 0x0 0x200>;
      #address-cells = <2>;
      #size-cells = <1>;
      ranges = <0 0  0x0 0x1f400000  0xc00000>,
               <1 0  0x10000 0x30000000  0>,
               <2 0  0x10000 0x40000000  0>,
               <3 0  0x10000 0x50000000  0>,
               <4 0  0x0 0x1d020000  0x10000>,
               <5 0  0x0 0x1d040000  0x10000>,
               <6 0  0x0 0x1d050000  0x10000>,
               <7 0  0x10000 0x90000000  0>;
      cavium,cs-config@0 {
        compatible = "cavium,octeon-3860-bootbus-config";
        cavium,cs-index = <0>;
        cavium,t-adr  = <20>;
        cavium,t-ce   = <60>;
        cavium,t-oe   = <60>;
        cavium,t-we   = <45>;
        cavium,t-rd-hld = <35>;
        cavium,t-wr-hld = <45>;
        cavium,t-pause  = <0>;
        cavium,t-wait   = <0>;
        cavium,t-page   = <35>;
        cavium,t-rd-dly = <0>;
        cavium,pages     = <0>;
        cavium,bus-width = <8>;
      };
      .
      .
      .
      cavium,cs-config@6 {
        compatible = "cavium,octeon-3860-bootbus-config";
        cavium,cs-index = <6>;
        cavium,t-adr  = <5>;
        cavium,t-ce   = <300>;
        cavium,t-oe   = <270>;
        cavium,t-we   = <150>;
        cavium,t-rd-hld = <100>;
        cavium,t-wr-hld = <70>;
        cavium,t-pause  = <0>;
        cavium,t-wait   = <0>;
        cavium,t-page   = <320>;
        cavium,t-rd-dly = <0>;
        cavium,pages     = <0>;
        cavium,wait-mode;
        cavium,bus-width = <16>;
      };
    };
```
