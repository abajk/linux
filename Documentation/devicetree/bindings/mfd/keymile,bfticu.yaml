## Documentation/devicetree/bindings/mfd/keymile,bfticu.yaml
```yaml
# SPDX-License-Identifier: (GPL-2.0-only OR BSD-2-Clause)
# Copyright 2018 Linaro Ltd.
%YAML 1.2
---
$id: http://devicetree.org/schemas/mfd/keymile,bfticu.yaml#
$schema: http://devicetree.org/meta-schemas/core.yaml#

title: KEYMILE bfticu Chassis Management FPGA

maintainers:
  - Rob Herring <robh@kernel.org>
  - Valentin Longchamp <valentin.longchamp@keymile.com>

description: |
  KEYMILE bfticu Chassis Management FPGA

  The bfticu is a multifunction device that manages the whole chassis.
  Its main functionality is to collect IRQs from the whole chassis and signals
  them to a single controller.

properties:
  compatible:
    items:
      - const: keymile,bfticu

  reg:
    description: Access on the parent local bus (chip select, offset in chip select, size)
    items:
      - description: chip select
      - description: offset in chip select
      - description: size

  interrupts:
    description: The main IRQ line to signal the collected IRQs
    items:
      - description: interrupt number
      - description: interrupt flags

  interrupt-controller: true

  '#interrupt-cells':
    const: 2

required:
  - compatible
  - reg
  - interrupts
  - interrupt-controller
  - '#interrupt-cells'

additionalProperties: false

examples:
  - |
    chassis-mgmt@3,0 {
        compatible = "keymile,bfticu";
        reg = <3 0 0x100>;
        interrupts = <6 1>;
        interrupt-controller;
        #interrupt-cells = <2>;
    };
```

## Documentation/devicetree/bindings/mfd/keymile,qriox.yaml
```yaml
# SPDX-License-Identifier: (GPL-2.0-only OR BSD-2-Clause)
---
$id: http://devicetree.org/schemas/keymile,qriox.yaml#
$schema: http://devicetree.org/meta-schemas/core.yaml#

title: KEYMILE qrio Board Control CPLD

maintainers:
  - Valentin Longchamp <valentin.longchamp@keymile.com>

description: |
  The qrio is a multifunction device that controls the KEYMILE boards based on
  the kmp204x design. It consists of a reset controller, watchdog timer, LEDs,
  and 2 IRQ capable GPIO blocks.

properties:
  compatible:
    items:
      - const: keymile,qriox

  reg:
    description: access on the parent local bus (chip select, offset in chip select, size)
    items:
      - description: chip select index
      - description: offset within chip select
      - description: size of the region

required:
  - compatible
  - reg

additionalProperties: false

examples:
  - |
    board-control@1,0 {
      compatible = "keymile,qriox";
      reg = <1 0 0x80>;
    };
```

## Documentation/devicetree/bindings/mfd/marvell,88pm860x.yaml
```yaml
# SPDX-License-Identifier: (GPL-2.0-only OR BSD-2-Clause)
%YAML 1.2
---
$id: http://devicetree.org/schemas/mfd/marvell,88pm860x.yaml#
$schema: http://devicetree.org/meta-schemas/core.yaml#

title: Marvell 88PM860x Power Management IC

maintainers:
  - Haojian Zhuang <haojian.zhuang@gmail.com>

description: |
  * Marvell 88PM860x Power Management IC

  Required parent device properties:
  - compatible : "marvell,88pm860x"
  - reg : the I2C slave address for the 88pm860x chip
  - interrupts : IRQ line for the 88pm860x chip
  - interrupt-controller : describes the 88pm860x as an interrupt controller
    (has its own domain)
  - "#interrupt-cells" : should be 1. The cell is the 88pm860x local IRQ number

  Optional parent device properties:
  - marvell,88pm860x-irq-read-clr : indicates whether interrupt status
    is cleared by read
  - marvell,88pm860x-slave-addr : 88pm860x are two‐chip solution. <reg>
    stores one chip’s I2C address; this property stores the other chip’s address.

  88pm860x consists of a large and varied group of sub-devices:

  Device                 Supply Names   Description
  ------                 ------------   -----------
  88pm860x-onkey                          On key
  88pm860x-rtc                            RTC
  88pm8607                                Regulators
  88pm860x-backlight                      Backlight
  88pm860x-led                            Led
  88pm860x-touch                          Touchscreen

properties:
  compatible:
    description: Compatible string for the Marvell 88PM860x device.
    items:
      - enum: [ "marvell,88pm860x" ]
  reg:
    description: I2C slave address of the 88pm860x chip.
    items:
      - description: Slave address
  interrupts:
    description: IRQ line for the 88pm860x chip.
    items:
      - description: IRQ number
  interrupt-controller: true
  '#interrupt-cells':
    const: 1

  marvell,88pm860x-irq-read-clr:
    description: Indicates whether interrupt status is cleared by read.
    type: boolean
  marvell,88pm860x-slave-addr:
    description: I2C address of the second 88pm860x chip.
    $ref: /schemas/types.yaml#/definitions/uint32

  regulators:
    description: Regulator subnodes.
    type: object
    additionalProperties: false
    patternProperties:
      ".*":
        type: object
        description: A voltage regulator subnode.
        additionalProperties: false
        properties:
          regulator-min-microvolt:
            description: Minimum regulator voltage in microvolts.
          regulator-max-microvolt:
            description: Maximum regulator voltage in microvolts.
          regulator-boot-on:
            description: Enable regulator at boot.
            type: boolean
          regulator-always-on:
            description: Keep regulator always on.
            type: boolean
        required:
          - regulator-min-microvolt
          - regulator-max-microvolt

  rtc:
    description: Real-time clock subnode.
    type: object
    additionalProperties: false
    properties:
      marvell,88pm860x-vrtc:
        description: VRTC voltage regulator selection.
        $ref: /schemas/types.yaml#/definitions/uint32
    required:
      - "marvell,88pm860x-vrtc"

  touch:
    description: Touchscreen subnode.
    type: object
    additionalProperties: false
    properties:
      marvell,88pm860x-gpadc-prebias:
        description: GP ADC prebias setting.
        $ref: /schemas/types.yaml#/definitions/uint32
      marvell,88pm860x-gpadc-slot-cycle:
        description: GP ADC slot cycle length.
        $ref: /schemas/types.yaml#/definitions/uint32
      marvell,88pm860x-tsi-prebias:
        description: TSI prebias setting.
        $ref: /schemas/types.yaml#/definitions/uint32
      marvell,88pm860x-pen-prebias:
        description: Pen prebias setting.
        $ref: /schemas/types.yaml#/definitions/uint32
      marvell,88pm860x-pen-prechg:
        description: Pen precharge setting.
        $ref: /schemas/types.yaml#/definitions/uint32
      marvell,88pm860x-resistor-X:
        description: Resistive calibration value.
        $ref: /schemas/types.yaml#/definitions/uint32
    required:
      - marvell,88pm860x-gpadc-prebias
      - marvell,88pm860x-gpadc-slot-cycle
      - marvell,88pm860x-tsi-prebias
      - marvell,88pm860x-pen-prebias
      - marvell,88pm860x-pen-prechg
      - marvell,88pm860x-resistor-X

  backlights:
    description: Backlight subnodes.
    type: object
    additionalProperties: false
    patternProperties:
      ".*":
        type: object
        description: A backlight subnode.
        additionalProperties: false
        properties:
          marvell,88pm860x-iset:
            description: LED current setting.
            $ref: /schemas/types.yaml#/definitions/uint32
          marvell,88pm860x-pwm:
            description: PWM channel selection.
            $ref: /schemas/types.yaml#/definitions/uint32

  leds:
    description: LED subnodes.
    type: object
    additionalProperties: false
    patternProperties:
      ".*":
        type: object
        description: An LED subnode.
        additionalProperties: false
        properties:
          marvell,88pm860x-iset:
            description: LED current setting.
            $ref: /schemas/types.yaml#/definitions/uint32

additionalProperties: false

examples:
  - |
    pmic: 88pm860x@34 {
        compatible = "marvell,88pm860x";
        reg = <0x34>;
        interrupts = <4>;
        interrupt-controller;
        #interrupt-cells = <1>;
        marvell,88pm860x-irq-read-clr;
        marvell,88pm860x-slave-addr = <0x11>;
        regulators {
            BUCK1 {
                regulator-min-microvolt = <1000000>;
                regulator-max-microvolt = <1500000>;
                regulator-boot-on;
                regulator-always-on;
            };
            LDO1 {
                regulator-min-microvolt = <1200000>;
                regulator-max-microvolt = <2800000>;
                regulator-boot-on;
                regulator-always-on;
            };
        };
        rtc {
            marvell,88pm860x-vrtc = <1>;
        };
        touch {
            marvell,88pm860x-gpadc-prebias = <1>;
            marvell,88pm860x-gpadc-slot-cycle = <1>;
            marvell,88pm860x-tsi-prebias = <6>;
            marvell,88pm860x-pen-prebias = <16>;
            marvell,88pm860x-pen-prechg = <2>;
            marvell,88pm860x-resistor-X = <300>;
        };
        backlights {
            backlight-0 {
                marvell,88pm860x-iset = <4>;
                marvell,88pm860x-pwm = <3>;
            };
            backlight-2 {
            };
        };
        leds {
            led0-red {
                marvell,88pm860x-iset = <12>;
            };
            led0-green {
                marvell,88pm860x-iset = <12>;
            };
            led0-blue {
                marvell,88pm860x-iset = <12>;
            };
        };
    };
```

## Documentation/devicetree/bindings/mfd/maxim,max77620.yaml
```yaml
# SPDX-License-Identifier: (GPL-2.0-only OR BSD-2-Clause)
%YAML 1.2
---
$id: http://devicetree.org/schemas/mfd/maxim,max77620.yaml#
$schema: http://devicetree.org/meta-schemas/core.yaml#

title: MAX77620 Power management IC from Maxim Semiconductor

maintainers:
  - Dmitry Osipenko <digetx@gmail.com>
  - Laxman Dewangan <ldewangan@nvidia.com>
  - Venkat Reddy Talla <vreddytalla@nvidia.com>

description: |
  MAX77620 Power management IC from Maxim Semiconductor.

  The Flexible Power Sequencer (FPS) allows each regulator to power up under
  hardware or software control. Additionally, each regulator can power on
  independently or among a group of other regulators with an adjustable power-up
  and power-down delays (sequencing). GPIO1, GPIO2, and GPIO3 can be programmed
  to be part of a sequence allowing external regulators to be sequenced along
  with internal regulators. The 32 kHz clock can also be included in a sequence.

  The FPS architecture consists of two hardware enable inputs (EN0, EN1) and
  three master sequencing timers (FPS0, FPS1, FPS2). Each timer can use a hardware
  input (EN0 or EN1) or a software-controlled source (SW). Upon enabling or
  disabling, the timer generates eight sequential events ("slots") at programmable
  intervals. Regulators, GPIOs, and the 32 kHz clock have dedicated configuration
  registers to select the source and timing for power-up and power-down events.

  By default, when an FPS event is cleared (set to LOW), the target enters:
    • Sleep state: the output is disabled.
    • Low-power state: the output enters a reduced power mode.

  FPS configuration is provided via the "fps" sub-node and its children "fps0",
  "fps1", and "fps2". Each child node corresponds to one master timer and
  supports vendor-specific timing and source control properties.

properties:
  compatible:
    items:
      - enum:
          - "maxim,max77620"
          - "maxim,max20024"
          - "maxim,max77663"

  reg:
    items:
      - description: I²C device address

  interrupts:
    maxItems: 1

  interrupt-controller: true

  '#interrupt-cells':
    const: 2

  system-power-controller:
    type: boolean
    description: Indicates this PMIC controls the system power; see
      Documentation/devicetree/bindings/power/power-controller.txt

  fps:
    description: Flexible Power Sequencer master timers configuration
    type: object
    additionalProperties: false
    properties:
      fps0:
        description: Configuration for FPS0
        type: object
        additionalProperties: false
        properties:
          maxim,shutdown-fps-time-period-us:
            description: Slot period in microseconds when entering shutdown
          maxim,fps-event-source:
            description: Source for FPS events (EN0, EN1, or SW)
            $ref: /schemas/types.yaml#/definitions/uint32
      fps1:
        description: Configuration for FPS1
        type: object
        additionalProperties: false
        properties:
          maxim,shutdown-fps-time-period-us:
            description: Slot period in microseconds when entering shutdown
          maxim,fps-event-source:
            description: Source for FPS events (EN0, EN1, or SW)
            $ref: /schemas/types.yaml#/definitions/uint32
      fps2:
        description: Configuration for FPS2
        type: object
        additionalProperties: false
        properties:
          maxim,shutdown-fps-time-period-us:
            description: Slot period in microseconds when entering shutdown
          maxim,fps-event-source:
            description: Source for FPS events (EN0, EN1, or SW)
            $ref: /schemas/types.yaml#/definitions/uint32

additionalProperties: false

examples:
  - |
    max77620@3c {
      compatible = "maxim,max77620";
      reg = <0x3c>;
      interrupts = <0 86 IRQ_TYPE_NONE>;
      interrupt-controller;
      #interrupt-cells = <2>;

      fps {
        fps0 {
          maxim,shutdown-fps-time-period-us = <1280>;
          maxim,fps-event-source = <MAX77620_FPS_EVENT_SRC_EN1>;
        };
        fps1 {
          maxim,shutdown-fps-time-period-us = <1280>;
          maxim,fps-event-source = <MAX77620_FPS_EVENT_SRC_EN0>;
        };
        fps2 {
          maxim,shutdown-fps-time-period-us = <1280>;
          maxim,fps-event-source = <MAX77620_FPS_EVENT_SRC_SW>;
        };
      };
    };
```

## Documentation/devicetree/bindings/mfd/nokia,retu.yaml
```yaml
# SPDX-License-Identifier: (GPL-2.0-only OR BSD-2-Clause)
%YAML 1.2
---
$id: http://devicetree.org/schemas/mfd/nokia,retu.yaml#
$schema: http://devicetree.org/meta-schemas/core.yaml#

title: Nokia Retu and Tahvo multi-function device

maintainers:
  - Javier Martinez Canillas <javier@dowhile0.org>
  - Rob Herring <robh@kernel.org>

description: |
  Device tree bindings for Nokia Retu and Tahvo multi-function device

  Retu and Tahvo are a multi-function devices found on Nokia Internet
  Tablets (770, N800 and N810). The Retu chip provides watchdog timer
  and power button control functionalities while Tahvo chip provides
  USB transceiver functionality.

properties:
  compatible:
    items:
      - enum: ["nokia,retu", "nokia,tahvo"]

  reg:
    description: Specifies the CBUS slave address of the ASIC chip.
    items:
      - description: CBUS slave address

  interrupts:
    description: The interrupt line the device is connected to.
    items:
      - description: Interrupt number and trigger type

required:
  - compatible
  - reg
  - interrupts

additionalProperties: false

examples:
  - |
    cbus0 {
        compatible = "i2c-cbus-gpio";
        ...
        retu: retu@1 {
            compatible = "nokia,retu";
            interrupts = <12 IRQ_TYPE_EDGE_RISING>;
            reg = <0x1>;
        };
    };
```
