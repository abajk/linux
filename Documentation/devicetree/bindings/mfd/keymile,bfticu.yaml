## Documentation/devicetree/bindings/mfd/ti,twl6040.yaml
```yaml
# SPDX-License-Identifier: (GPL-2.0-only OR BSD-2-Clause)
%YAML 1.2
---
$id: http://devicetree.org/schemas/ti,twl6040.yaml#
$schema: http://devicetree.org/meta-schemas/core.yaml#

title: Texas Instruments TWL6040 family

maintainers:
  - Peter Ujfalusi <peter.ujfalusi@ti.com>
  - Rob Herring <robh@kernel.org>
  - Yu-Chun Lin <eleanor15x@gmail.com>

description: |
  The TWL6040s are 8-channel high quality low-power audio codecs providing audio,
  vibra and GPO functionality on OMAP4+ platforms.
  They are connected to the host processor via i2c for commands, McPDM for audio
  data and commands.

properties:
  compatible:
    items:
      - enum:
          - ti,twl6040
          - ti,twl6041

  reg:
    items:
      - const: 0x4b
    description: I2C bus address for the TWL6040
  interrupts:
    items:
      - description: Interrupt line to the main SoC
    description: Interrupt line
  gpio-controller: true
  '#gpio-cells':
    const: 1

  '#clock-cells':
    const: 0

  twl6040,audpwron-gpio:
    maxItems: 1
    description: Power-on GPIO line for the TWL6040

  vio-supply: true
  v2v1-supply: true

  enable-active-high:
    type: boolean
    description: Power on the TWL6040 during boot when present

  clocks:
    maxItems: 1

  clock-names:
    items:
      - const: clk32k
      - const: mclk
    description: Names for the clk32k and MCLK clocks
  vddvibl-supply: true
  vddvibr-supply: true
  vibra:
    type: object
    additionalProperties: false
    description: Configuration for vibra parameters
    properties:
      ti,vibldrv-res:
        $ref: /schemas/types.yaml#/definitions/uint32
        description: Resistance parameter for left vibra driver
      ti,vibrdrv-res:
        $ref: /schemas/types.yaml#/definitions/uint32
        description: Resistance parameter for right vibra driver
      ti,viblmotor-res:
        $ref: /schemas/types.yaml#/definitions/uint32
        description: Resistance parameter for left vibra motor
      ti,vibrmotor-res:
        $ref: /schemas/types.yaml#/definitions/uint32
        description: Resistance parameter for right vibra motor
      vddvibl-uV:
        $ref: /schemas/types.yaml#/definitions/uint32
        description: Adjust default left vibra voltage in microvolts
      vddvibr-uV:
        $ref: /schemas/types.yaml#/definitions/uint32
        description: Adjust default right vibra voltage in microvolts
    required:
      - ti,vibldrv-res
      - ti,vibrdrv-res
      - ti,viblmotor-res
      - ti,vibrmotor-res

required:
  - compatible
  - reg
  - interrupts
  - gpio-controller
  - '#gpio-cells'
  - '#clock-cells'
  - twl6040,audpwron-gpio
  - vio-supply
  - v2v1-supply
  - vddvibl-supply
  - vddvibr-supply
  - vibra

additionalProperties: false

examples:
  - |
    &i2c1 {
        twl6040: twl@4b {
            compatible = "ti,twl6040";
            interrupts = <0 119 4>;
            twl6040,audpwron-gpio = <&gpio4 31 0>;
            vio-supply = <&v1v8>;
            v2v1-supply = <&v2v1>;
            enable-active-high;
            vddvibl-supply = <&vbat>;
            vddvibr-supply = <&vbat>;
            vibra {
                ti,vibldrv-res = <8>;
                ti,vibrdrv-res = <3>;
                ti,viblmotor-res = <10>;
                ti,vibrmotor-res = <10>;
            };
        };
    };
```

## Documentation/devicetree/bindings/mfd/ti,usbhs-host.yaml
```yaml
# SPDX-License-Identifier: (GPL-2.0-only OR BSD-2-Clause)
---
$id: http://devicetree.org/schemas/mfd/ti,usbhs-host.yaml#
$schema: http://devicetree.org/meta-schemas/core.yaml#

title: OMAP HS USB Host

maintainers:
  - Rob Herring <robh@kernel.org>
  - Roger Quadros <rogerq@ti.com>
  - Yegor Yefremov <yegorslists@googlemail.com>

description: |
  OMAP HS USB Host

  The OMAP HS USB Host subsystem contains EHCI and OHCI controllers.
  See Documentation/devicetree/bindings/usb/generic-ehci.yaml and
  Documentation/devicetree/bindings/usb/generic-ohci.yaml.

properties:
  compatible:
    items:
      - const: "ti,usbhs-host"
  reg:
    description: Register region for the USB host controller (base address and length).
    items:
      - description: "Register block: start and length"
  ti,hwmods:
    description: Hardware module names required by the controller.
    $ref: /schemas/types.yaml#/definitions/string-array
    items:
      - enum: [usb_host_hs]
  '#address-cells':
    const: 1
    description: Number of address cells for child nodes.
  '#size-cells':
    const: 1
    description: Number of size cells for child nodes.
  ranges:
    description: Empty ranges property for child address mapping.
  clocks:
    description: Phandles and clock specifiers for controller clocks.
    $ref: /schemas/types.yaml#/definitions/phandle-array
  clock-names:
    description: Names of clocks listed in the 'clocks' property.
    $ref: /schemas/types.yaml#/definitions/string-array
    items:
      - const: usbhost_120m_fck
      - const: refclk_60m_int
      - const: refclk_60m_ext_p1
      - const: refclk_60m_ext_p2
      - const: utmi_p1_gfclk
      - const: utmi_p2_gfclk
      - const: usb_host_hs_utmi_p1_clk
      - const: usb_host_hs_utmi_p2_clk
      - const: usb_host_hs_utmi_p3_clk
      - const: usb_host_hs_hsic480m_p1_clk
      - const: usb_host_hs_hsic480m_p2_clk
      - const: usb_host_hs_hsic480m_p3_clk
      - const: usb_host_hs_hsic60m_p1_clk
      - const: usb_host_hs_hsic60m_p2_clk
      - const: usb_host_hs_hsic60m_p3_clk
  num-ports:
    description: Number of USB ports; defaults to hardware detection, maximum is 3.
    $ref: /schemas/types.yaml#/definitions/uint32
  port1-mode:
    description: Port 1 mode.
    enum:
      - ehci-phy
      - ehci-tll
      - ehci-hsic
      - ohci-phy-6pin-datse0
      - ohci-phy-6pin-dpdm
      - ohci-phy-3pin-datse0
      - ohci-phy-4pin-dpdm
      - ohci-tll-6pin-datse0
      - ohci-tll-6pin-dpdm
      - ohci-tll-3pin-datse0
      - ohci-tll-4pin-dpdm
      - ohci-tll-2pin-datse0
      - ohci-tll-2pin-dpdm
  port2-mode:
    description: Port 2 mode.
    enum:
      - ehci-phy
      - ehci-tll
      - ehci-hsic
      - ohci-phy-6pin-datse0
      - ohci-phy-6pin-dpdm
      - ohci-phy-3pin-datse0
      - ohci-phy-4pin-dpdm
      - ohci-tll-6pin-datse0
      - ohci-tll-6pin-dpdm
      - ohci-tll-3pin-datse0
      - ohci-tll-4pin-dpdm
      - ohci-tll-2pin-datse0
      - ohci-tll-2pin-dpdm
  port3-mode:
    description: Port 3 mode.
    enum:
      - ehci-phy
      - ehci-tll
      - ehci-hsic
      - ohci-phy-6pin-datse0
      - ohci-phy-6pin-dpdm
      - ohci-phy-3pin-datse0
      - ohci-phy-4pin-dpdm
      - ohci-tll-6pin-datse0
      - ohci-tll-6pin-dpdm
      - ohci-tll-3pin-datse0
      - ohci-tll-4pin-dpdm
      - ohci-tll-2pin-datse0
      - ohci-tll-2pin-dpdm
  single-ulpi-bypass:
    description: Enables ULPI bypass when only a single control bit is present.
    type: boolean

patternProperties:
  "^.+$":
    anyOf:
      - $ref: /schemas/usb/generic-ohci.yaml#
      - $ref: /schemas/usb/generic-ehci.yaml#

required:
  - compatible
  - reg
  - ti,hwmods

additionalProperties: false

examples:
  - |
    usbhshost: usbhshost@4a064000 {
      compatible = "ti,usbhs-host";
      reg = <0x4a064000 0x800>;
      ti,hwmods = "usb_host_hs";
      #address-cells = <1>;
      #size-cells = <1>;
      ranges;

      usbhsohci: ohci@4a064800 {
        compatible = "ti,ohci-omap3";
        reg = <0x4a064800 0x400>;
        interrupts = <0 76 0x4>;
      };

      usbhsehci: ehci@4a064c00 {
        compatible = "ti,ehci-omap";
        reg = <0x4a064c00 0x400>;
        interrupts = <0 77 0x4>;
      };
    };
  - |
    &usbhshost {
      port1-mode = "ehci-phy";
      port2-mode = "ehci-tll";
      port3-mode = "ehci-phy";
    };
  - |
    &usbhsehci {
      phys = <&hsusb1_phy 0 &hsusb3_phy>;
    };
```

## Documentation/devicetree/bindings/mfd/ti,usbhs-tll.yaml
```yaml
# SPDX-License-Identifier: (GPL-2.0-only OR BSD-2-Clause)
# Copyright 2025 Texas Instruments
%YAML 1.2
---
$id: http://devicetree.org/schemas/ti,usbhs-tll.yaml#
$schema: http://devicetree.org/meta-schemas/core.yaml#

title: OMAP HS USB Host TLL

maintainers:
  - Roger Quadros <rogerq@ti.com>

description: |
  OMAP HS USB Host TLL (Transceiver-Less Interface)

properties:
  compatible:
    items:
      - const: ti,usbhs-tll

  reg:
    items:
      - description: Controller register base address and size

  interrupts:
    items:
      - description: TLL module interrupt

  ti,hwmods:
    description: Hardware modules associated with USB TLL
    $ref: /schemas/types.yaml#/definitions/string-array
    items:
      - enum: [usb_tll_hs]

  clocks:
    description: Phandles and specifiers for USB TLL channel clocks
    items:
      - description: USB TLL channel 0 clock
      - description: USB TLL channel 1 clock
      - description: USB TLL channel 2 clock

  clock-names:
    description: Names for USB TLL channel clocks
    items:
      - const: usb_tll_hs_usb_ch0_clk
      - const: usb_tll_hs_usb_ch1_clk
      - const: usb_tll_hs_usb_ch2_clk

required:
  - compatible
  - reg
  - interrupts
  - ti,hwmods

additionalProperties: false

examples:
  - |
    usbhstll: usbhstll@4a062000 {
        compatible = "ti,usbhs-tll";
        reg = <0x4a062000 0x1000>;
        interrupts = <78>;
        ti,hwmods = "usb_tll_hs";
    };
```

## Documentation/devicetree/bindings/mfd/ti-keystone-devctrl.yaml
```yaml
# SPDX-License-Identifier: (GPL-2.0-only OR BSD-2-Clause)
# Copyright (C) 2025 Texas Instruments, Inc.
%YAML 1.2
---
$id: http://devicetree.org/schemas/ti-keystone-devctrl.yaml#
$schema: http://devicetree.org/meta-schemas/core.yaml#

title: TI Keystone Device State Control

maintainers:
  - Ivan Khoronzhuk <ivan.khoronzhuk@ti.com>
  - Mathieu Malaterre <malat@debian.org>

description: |
  * Device tree bindings for Texas Instruments keystone device state control

  The Keystone II devices have a set of registers that are used to control
  the status of its peripherals. This node is intended to allow access to
  this functionality.

properties:
  compatible:
    items:
      - const: ti,keystone-devctrl
      - const: syscon

  reg:
    items:
      - description: Offset and length of device state control registers.

required:
  - compatible
  - reg

additionalProperties: false

examples:
  - |
    device-state-control@02620000 {
        compatible = "ti,keystone-devctrl", "syscon";
        reg = <0x02620000 0x1000>;
    };
```

## Documentation/devicetree/bindings/mfd/ti-lmu.yaml
```yaml
# SPDX-License-Identifier: (GPL-2.0-only OR BSD-2-Clause)
%YAML 1.2
---
$id: http://devicetree.org/schemas/mfd/ti-lmu.yaml#
$schema: http://devicetree.org/meta-schemas/core.yaml#

title: TI LMU (Lighting Management Unit)

maintainers:
  - Dan Murphy <dmurphy@ti.com>
  - Milo Kim <milo.kim@ti.com>

description: |
  TI LMU (Lighting Management Unit) device tree bindings

  TI LMU driver supports lighting devices below.

     Name                  Child nodes
    ------      ---------------------------------
    LM3631       Backlight and regulator
    LM3632       Backlight and regulator
    LM3633       Backlight, LED and fault monitor
    LM3695       Backlight
    LM36274      Backlight and regulator

  For details on child nodes:
    - Backlight        (see ../leds/backlight/ti-lmu-backlight.yaml)
    - LEDs (LM3633)    (see ../leds/leds-lm3633.yaml)
    - Regulators       (see ../regulator/lm363x-regulator.yaml)
    - LEDs (LM36274)   (see ../leds/leds-lm36274.yaml)

properties:
  compatible:
    description: Device compatible string
    items:
      - enum:
          - ti,lm3631
          - ti,lm3632
          - ti,lm3633
          - ti,lm3695
          - ti,lm36274

  reg:
    description: I2C slave address
    items:
      - description: Slave address

  enable-gpios:
    description: GPIO specifier for hardware enable pin
    maxItems: 1

  pwms:
    description: PWM specifier for backlight control

  pwm-names:
    description: Name of the PWM specifier for backlight

  ramp-up-us:
    description: Current ramp-up time in microseconds (2048–117440000)

  ramp-down-us:
    description: Current ramp-down time in microseconds (2048–117440000)

  ti,brightness-resolution:
    description: Brightness resolution; 255 (8-bit) or 2047 (11-bit)
    enum:
      - 255
      - 2047

  '#address-cells':
    description: Number of address cells for child nodes

  '#size-cells':
    description: Number of size cells for child nodes

  backlight:
    description: LMU backlight child node
    type: object

  regulators:
    description: LMU regulators child node
    type: object

  leds:
    description: LMU LEDs child node
    type: object

  fault-monitor:
    description: LMU fault-monitor child node
    type: object

required:
  - compatible
  - reg

additionalProperties: false

examples:
  - |
    lm3631@29 {
      compatible = "ti,lm3631";
      reg = <0x29>;

      regulators {
        compatible = "ti,lm363x-regulator";
        vboost {
          regulator-name = "lcd_boost";
          regulator-min-microvolt = <4500000>;
          regulator-max-microvolt = <6350000>;
          regulator-always-on;
        };
        /* … */
      };

      backlight {
        compatible = "ti,lm3631-backlight";
        lcd_bl {
          led-sources = <0 1>;
          ramp-up-us = <300000>;
        };
      };
    };
```
