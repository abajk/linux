## Documentation/devicetree/bindings/mfd/skyworks,sky81452.yaml
```yaml
# SPDX-License-Identifier: (GPL-2.0-only OR BSD-2-Clause)
# Copyright 2025 Skyworks Solutions Inc.
%YAML 1.2
---
$id: http://devicetree.org/schemas/mfd/skyworks,sky81452.yaml#
$schema: http://devicetree.org/meta-schemas/core.yaml#

title: SKY81452 multi-function backlight and regulator
maintainers:
  - Gyungoh Yoo <jack.yoo@skyworksinc.com>
  - Rob Herring <robh@kernel.org>

description: |
  SKY81452 bindings

properties:
  compatible:
    items:
      - enum: [ skyworks, sky81452 ]

  reg:
    maxItems: 1

  backlight:
    description: Backlight controller sub-node
    $ref: /schemas/leds/backlight/skyworks,sky81452-backlight.yaml#

  regulator:
    type: object
    additionalProperties: false
    properties:
      lout:
        $ref: /schemas/regulator/regulator.yaml#
        unevaluatedProperties: false

required:
  - compatible
  - reg
  - backlight
  - regulator

additionalProperties: false

examples:
  - |
    sky81452@2c {
      compatible = "skyworks,sky81452";
      reg = <0x2c>;

      backlight {
        compatible = "skyworks,sky81452-backlight";
        name = "pwm-backlight";
        led-sources = <0 1 2 3 6>;
        skyworks,ignore-pwm;
        skyworks,phase-shift;
        skyworks,current-limit = <2300>;
      };

      regulator {
        lout {
          regulator-name = "sky81452-lout";
          regulator-min-microvolt = <4500000>;
          regulator-max-microvolt = <8000000>;
        };
      };
    };
```

## Documentation/devicetree/bindings/mfd/ti,palmas.yaml
```yaml
# SPDX-License-Identifier: (GPL-2.0-only OR BSD-2-Clause)
# Copyright 2025 Texas Instruments Inc.
%YAML 1.2
---
$id: http://devicetree.org/schemas/ti,palmas.yaml#
$schema: http://devicetree.org/meta-schemas/core.yaml#

title: TI Palmas PMIC Family

maintainers:
  - Andrew F. Davis <afd@ti.com>
  - J Keerthy <j-keerthy@ti.com>
  - Keerthy <j-keerthy@ti.com>
  - Rob Herring <robh@kernel.org>

description: |
  * palmas device tree bindings

  The TI palmas family current members :-
  twl6035 (palmas)
  twl6037 (palmas)
  tps65913 (palmas)
  tps65914 (palmas)
  tps659038
  tps65917

properties:
  compatible:
    description: >
      Device compatible strings for TI palmas PMIC devices.
    oneOf:
      - items:
          # Specific PMIC device followed by generic
          - enum:
              - ti,twl6035
              - ti,twl6036
              - ti,twl6037
              - ti,tps65913
              - ti,tps65914
              - ti,tps80036
              - ti,tps659038
              - ti,tps65917
          - const: ti,palmas
      - items:
          - const: ti,palmas

  interrupt-controller: true

  '#interrupt-cells':
    const: 2

  reg:
    items:
      - description: I2C bus register address of the device

  ti,mux-pad1:
    description: >
      Pad multiplexing setting for pad1.
    $ref: /schemas/types.yaml#/definitions/uint32-array
    items:
      - description: Multiplexing value for pad1

  ti,mux-pad2:
    description: >
      Pad multiplexing setting for pad2.
    $ref: /schemas/types.yaml#/definitions/uint32-array
    items:
      - description: Multiplexing value for pad2

  '#address-cells':
    const: 1

  '#size-cells':
    const: 0

  pmic:
    description: PMIC subnode for additional configuration
    type: object
    properties:
      compatible:
        description: >
          Compatible strings for the palmas PMIC subnode.
        oneOf:
          - items:
              - enum:
                  - ti,twl6035-pmic
                  - ti,twl6037-pmic
                  - ti,tps65913-pmic
                  - ti,tps65914-pmic
                  - ti,tps80036-pmic
                  - ti,tps659038-pmic
                  - ti,tps65917-pmic
              - const: ti,palmas-pmic
          - items:
              - const: ti,palmas-pmic
    additionalProperties: true

required:
  - compatible
  - interrupt-controller
  - '#interrupt-cells'

additionalProperties: false

examples:
  - |
    palmas@48 {
        compatible = "ti,twl6035", "ti,palmas";
        reg = <0x48>;
        interrupt-controller;
        #interrupt-cells = <2>;

        ti,mux-pad1 = <0>;
        ti,mux-pad2 = <0>;

        #address-cells = <1>;
        #size-cells = <0>;

        pmic {
            compatible = "ti,twl6035-pmic", "ti,palmas-pmic";
            /* ... */
        };
    };
```

## Documentation/devicetree/bindings/mfd/ti,tps61050.yaml
```yaml
# SPDX-License-Identifier: (GPL-2.0-only OR BSD-2-Clause)
%YAML 1.2
---
$id: http://devicetree.org/schemas/mfd/ti,tps61050.yaml#
$schema: http://devicetree.org/meta-schemas/core.yaml#

title: TI TPS61050/TPS61052 Boost Converters

maintainers:
  - Javier Martinez Canillas <javier@dowhile0.org>
  - Sven Van Asbroeck <thesven73@gmail.com>

description: |
  * Device tree bindings for TI TPS61050/61052 Boost Converters

  The TP61050/TPS61052 is a high-power "white LED driver". The
  device provides LED, GPIO and regulator functionalities.

  Optional sub-node:

  This subnode selects the chip's operational mode.
  There can be at most one single available subnode.

properties:
  compatible:
    description: Must be "ti,tps61050" or "ti,tps61052" for this device.
    enum:
      - ti,tps61050
      - ti,tps61052

  reg:
    description: I2C slave address of the device.
    items:
      - description: I2C slave address

  regulator:
    description: Presence of this sub-node puts the chip in regulator mode.
    $ref: /schemas/regulator/regulator.yaml
    unevaluatedProperties: false

  led:
    description: Presence of this sub-node puts the chip in LED mode.
    $ref: /schemas/leds/common.yaml#

additionalProperties: false

examples:
  - |
    i2c0 {
        tps61052@33 {
            compatible = "ti,tps61052";
            reg = <0x33>;
        };
    };
  - |
    i2c0 {
        tps61052@33 {
            compatible = "ti,tps61052";
            reg = <0x33>;

            regulator {
                regulator-min-microvolt = <5000000>;
                regulator-max-microvolt = <5000000>;
                regulator-always-on;
            };
        };
    };
  - |
    #include <dt-bindings/leds/common.h>

    i2c0 {
        tps61052@33 {
            compatible = "ti,tps61052";
            reg = <0x33>;

            led {
                color = <LED_COLOR_ID_WHITE>;
            };
        };
    };
```

## Documentation/devicetree/bindings/mfd/ti,tps6507x.yaml
```yaml
# SPDX-License-Identifier: (GPL-2.0-only OR BSD-2-Clause)
%YAML 1.2
---
$id: http://devicetree.org/schemas/mfd/ti,tps6507x.yaml#
$schema: http://devicetree.org/meta-schemas/core.yaml#

title: TI TPS6507x Power Management IC

maintainers:
  - Joe Perches <joe@perches.com>
  - Vishwanathrao Badarkhe, Manish <manishv.b@ti.com>

description: |
  TPS6507x Power Management Integrated Circuit

properties:
  compatible:
    const: ti,tps6507x

  reg:
    description: I2C slave address
    items:
      - description: I2C slave address

  vindcdc1_2-supply:
    description: VDCDC1 and VDCDC2 input supply

  vindcdc3-supply:
    description: VDCDC3 input supply

  vldo1_2-supply:
    description: VLDO1 and VLDO2 input supply

  regulators:
    description: Regulator initialization data subnodes
    type: object
    additionalProperties: false
    patternProperties:
      "^[^/]+$":
        $ref: /schemas/regulator/regulator.yaml

required:
  - compatible
  - reg

additionalProperties: false

examples:
  - |
    pmu: tps6507x@48 {
        compatible = "ti,tps6507x";
        reg = <0x48>;

        vindcdc1_2-supply = <&vbat>;
        vindcdc3-supply = <...>;
        vldo1_2-supply = <...>;

        regulators {
            #address-cells = <1>;
            #size-cells = <0>;

            vdcdc1_reg: regulator@0 {
                regulator-compatible = "VDCDC1";
                reg = <0>;
                regulator-min-microvolt = <3150000>;
                regulator-max-microvolt = <3450000>;
                regulator-always-on;
                regulator-boot-on;
            };
            vdcdc2_reg: regulator@1 {
                regulator-compatible = "VDCDC2";
                reg = <1>;
                regulator-min-microvolt = <1710000>;
                regulator-max-microvolt = <3450000>;
                regulator-always-on;
                regulator-boot-on;
                defdcdc_default = <1>;
            };
            vdcdc3_reg: regulator@2 {
                regulator-compatible = "VDCDC3";
                reg = <2>;
                regulator-min-microvolt = <9500000>;
                regulator-max-microvolt = <1350000>;
                regulator-always-on;
                regulator-boot-on;
                defdcdc_default = <1>;
            };
            ldo1_reg: regulator@3 {
                regulator-compatible = "LDO1";
                reg = <3>;
                regulator-min-microvolt = <1710000>;
                regulator-max-microvolt = <1890000>;
                regulator-always-on;
                regulator-boot-on;
            };
            ldo2_reg: regulator@4 {
                regulator-compatible = "LDO2";
                reg = <4>;
                regulator-min-microvolt = <1140000>;
                regulator-max-microvolt = <1320000>;
                regulator-always-on;
                regulator-boot-on;
            };
        };

    };
```

## Documentation/devicetree/bindings/mfd/ti,tps65912.yaml
```yaml
# SPDX-License-Identifier: (GPL-2.0-only OR BSD-2-Clause)
%YAML 1.2
---
$id: http://devicetree.org/schemas/mfd/ti,tps65912.yaml#
$schema: http://devicetree.org/meta-schemas/core.yaml#

title: TI TPS65912 Power Management Integrated Circuit

maintainers:
  - Andrew F. Davis <afd@ti.com>

description: |
  TPS65912 Power Management Integrated Circuit bindings

  Required properties:
    - compatible: Must be "ti,tps65912".
    - reg: Slave address or chip select number (I2C/SPI).
    - interrupts: A two-cell array describing the IRQ number and flags.
    - interrupt-controller: Marks the device node as an interrupt controller.
    - #interrupt-cells: Must be 2.
    - gpio-controller: Marks the node as a GPIO controller.
    - #gpio-cells: Must be 2.
    - regulators: List of child nodes specifying regulator initialization data.

properties:
  compatible:
    items:
      - const: ti,tps65912

  reg:
    maxItems: 1

  interrupts:
    maxItems: 1

  interrupt-controller:
    description: Marks the node as an interrupt controller

  '#interrupt-cells':
    const: 2

  gpio-controller:
    description: Marks the node as a GPIO controller

  '#gpio-cells':
    const: 2

  regulators:
    description: >-
      List of child nodes specifying regulator initialization data.
      Child nodes must be named dcdc1–dcdc4 and ldo1–ldo10.
    type: object
    additionalProperties:
        $ref: /schemas/regulator/regulator.yaml#
        unevaluatedProperties: false

required:
  - compatible
  - reg
  - interrupts
  - interrupt-controller
  - '#interrupt-cells'
  - gpio-controller
  - '#gpio-cells'
  - regulators

additionalProperties: false

examples:
  - |
    pmic: tps65912@2d {
        compatible = "ti,tps65912";
        reg = <0x2d>;
        interrupts = <28 IRQ_TYPE_LEVEL_LOW>;
        interrupt-controller;
        #interrupt-cells = <2>;
        gpio-controller;
        #gpio-cells = <2>;

        regulators {
            dcdc1 {
                regulator-name = "vdd_core";
                regulator-min-microvolt = <912000>;
                regulator-max-microvolt = <1144000>;
                regulator-boot-on;
                regulator-always-on;
            };

            ldo1 {
                regulator-name = "ldo1";
                regulator-min-microvolt = <1900000>;
                regulator-max-microvolt = <1900000>;
            };
        };
    };
```

## Documentation/devicetree/bindings/mfd/ti,twl4030-audio.yaml
```yaml
# SPDX-License-Identifier: (GPL-2.0-only OR BSD-2-Clause)
%YAML 1.2
---
$id: http://devicetree.org/schemas/mfd/ti,twl4030-audio.yaml#
$schema: http://devicetree.org/meta-schemas/core.yaml#

title: TI TWL4030 audio
maintainers:
  - Peter Ujfalusi <peter.ujfalusi@ti.com>

description: |
  Texas Instruments TWL family (twl4030) audio module

  The audio module inside the TWL family consist of an audio codec and a vibra
  driver.

properties:
  compatible:
    const: "ti,twl4030-audio"

  ti,enable-vibra:
    type: boolean
    description: Enable the vibra functionality.

  codec:
    description: Codec subnode.
    type: object
    properties:
      ti,digimic_delay:
        $ref: /schemas/types.yaml#/definitions/uint32
        description: Delay after enabling the digimic to reduce artifacts (ms).
      ti,ramp_delay_value:
        $ref: /schemas/types.yaml#/definitions/uint32
        description: HS ramp delay configuration to reduce pop noise.
      ti,hs_extmute:
        type: boolean
        description: Use external mute for HS pop reduction.
      ti,hs_extmute_gpio:
        $ref: /schemas/types.yaml#/definitions/phandle-array
        description: External GPIO to control the external mute.
      ti,offset_cncl_path:
        $ref: /schemas/types.yaml#/definitions/uint32
        description: Offset cancellation path selection.
    additionalProperties: false

required:
  - compatible

additionalProperties: false

examples:
  - |
    &i2c1 {
        clock-frequency = <2600000>;

        twl: twl@48 {
            reg = <0x48>;
            interrupts = <7>;
            interrupt-controller;

            twl_audio: audio {
                compatible = "ti,twl4030-audio";
                ti,enable-vibra;

                codec {
                    ti,ramp_delay_value = <3>;
                };
            };
        };
    };
```

## Documentation/devicetree/bindings/mfd/ti,twl4030-power.yaml
```yaml
# SPDX-License-Identifier: (GPL-2.0-only OR BSD-2-Clause)
%YAML 1.2
---
$id: http://devicetree.org/schemas/mfd/ti,twl4030-power.yaml#
$schema: http://devicetree.org/meta-schemas/core.yaml#
title: TI TWL4030 power management
maintainers:
  - Florian Vaussard <florian.vaussard@epfl.ch>
  - Nishanth Menon <nm@ti.com>
  - Tony Lindgren <tony@atomide.com>
description: |
  Texas Instruments TWL family (twl4030) reset and power management module

  The power management module inside the TWL family provides several facilities
  to control the power resources, including power scripts. For now, the
  binding only supports the complete shutdown of the system after poweroff.

properties:
  compatible:
    description: Device compatible string. Must be one of the following values.
    items:
      - enum:
          - ti,twl4030-power
          - ti,twl4030-power-reset
          - ti,twl4030-power-idle
          - ti,twl4030-power-idle-osc-off

  ti,system-power-controller:
    description: Indicates that TWL4030 is the power supply master of the system.
    type: boolean

  ti,use_poweroff:
    description: Deprecated alias for ti,system-power-controller.
    type: boolean

additionalProperties: false

examples:
  - |
    power {
        compatible = "ti,twl4030-power";
        ti,system-power-controller;
    };
```
