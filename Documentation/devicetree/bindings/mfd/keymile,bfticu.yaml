## Documentation/devicetree/bindings/mips/cavium/cavium,octeon-3860-ciu.yaml
```yaml
# SPDX-License-Identifier: (GPL-2.0-only OR BSD-2-Clause)
%YAML 1.2
---
$id: http://devicetree.org/schemas/mips/cavium/cavium,octeon-3860-ciu.yaml#
$schema: http://devicetree.org/meta-schemas/core.yaml#

title: Cavium Octeon-3860 Central Interrupt Unit

maintainers:
  - David Daney <david.daney@cavium.com>

description: |
  Central Interrupt Unit.

  Compatibility with all cn3XXX, cn5XXX and cn63XX SOCs.

  This controller has two interrupt banks, each with up to 64 lines.

properties:
  compatible:
    items:
      - const: cavium,octeon-3860-ciu
  reg:
    maxItems: 1

  "#interrupt-cells":
    description:
      The first cell is the bank index (0 or 1); the second cell is the bit
      index (0..63).
    const: 2

  interrupt-controller: true

required:
  - compatible
  - reg
  - "#interrupt-cells"
  - interrupt-controller

additionalProperties: false

examples:
  - |
    interrupt-controller@1070000000000 {
        compatible = "cavium,octeon-3860-ciu";
        interrupt-controller;
        #interrupt-cells = <2>;
        reg = <0x10700 0x00000000 0x0 0x7000>;
    };
```

## Documentation/devicetree/bindings/mips/cavium/cavium,octeon-5750-bootbus-dma.yaml
```yaml
# SPDX-License-Identifier: (GPL-2.0-only OR BSD-2-Clause)
# Copyright 2025 Cavium Inc.
%YAML 1.2
---
$id: http://devicetree.org/schemas/mips/cavium/cavium,octeon-5750-bootbus-dma.yaml#
$schema: http://devicetree.org/meta-schemas/core.yaml#

title: Cavium Octeon 5750 BootBus DMA Engine

maintainers:
  - David Daney <david.daney@cavium.com>
  - Masanari Iida <standby24x7@gmail.com>

description: |
  DMA Engine.

  The Octeon DMA Engine transfers between the Boot Bus and main memory.
  The DMA Engine will be referred to by phandle by any device that is
  connected to it.

properties:
  compatible:
    description: Compatibility with all cn52XX, cn56XX and cn6XXX SOCs.
    items:
      - const: cavium,octeon-5750-bootbus-dma

  reg:
    description: The base address of the DMA Engine’s register bank.
    maxItems: 1

  interrupts:
    description: A single interrupt specifier.
    maxItems: 1

required:
  - compatible
  - reg
  - interrupts

additionalProperties: false

examples:
  - |
    dma0: dma-engine@1180000000100 {
        compatible = "cavium,octeon-5750-bootbus-dma";
        reg = <0x11800 0x00000100 0x0 0x8>;
        interrupts = <0 63>;
    };
```

## Documentation/devicetree/bindings/mips/cavium/cavium,octeon-6335-uctl.yaml
```yaml
%YAML 1.2
---
$id: http://devicetree.org/schemas/cavium,octeon-6335-uctl.yaml#
$schema: http://devicetree.org/meta-schemas/core.yaml#

title: UCTL USB controller glue

maintainers:
  - David Daney <david.daney@cavium.com>

description: |
  * UCTL USB controller glue

properties:
  compatible:
    items:
      - const: "cavium,octeon-6335-uctl"
    description: Device compatible with UCTL USB controller glue
  reg:
    items:
      - description: Base address and size of the UCTL register bank
    description: UCTL register bank address and size
  '#address-cells':
    const: 2
    description: Must be <2>
  '#size-cells':
    const: 2
    description: Must be <2>
  ranges: true
    # Empty to signify direct mapping of the children
  refclk-frequency:
    description: Reference clock frequency in Hz
  refclk-type:
    enum:
      - crystal
      - external
    description: Reference clock connection type

required:
  - compatible
  - reg
  - '#address-cells'
  - '#size-cells'
  - ranges
  - refclk-frequency
  - refclk-type

additionalProperties: false

examples:
  - |
    uctl@118006f000000 {
        compatible = "cavium,octeon-6335-uctl";
        reg = <0x11800 0x6f000000 0x0 0x100>;
        ranges; /* Direct mapping */
        #address-cells = <2>;
        #size-cells = <2>;
        /* 12MHz, 24MHz and 48MHz allowed */
        refclk-frequency = <24000000>;
        /* Either "crystal" or "external" */
        refclk-type = "crystal";

        ehci@16f0000000000 {
            compatible = "cavium,octeon-6335-ehci", "usb-ehci";
            reg = <0x16f00 0x00000000 0x0 0x100>;
            interrupts = <0 56>;
            big-endian-regs;
        };
        ohci@16f0000000400 {
            compatible = "cavium,octeon-6335-ohci", "usb-ohci";
            reg = <0x16f00 0x00000400 0x0 0x100>;
            interrupts = <0 56>;
            big-endian-regs;
        };
    };
```

## Documentation/devicetree/bindings/mips/cavium/cavium,octeon-6880-ciu2.yaml
```yaml
# SPDX-License-Identifier: (GPL-2.0-only OR BSD-2-Clause)
%YAML 1.2
---
$id: http://devicetree.org/schemas/cavium,octeon-6880-ciu2.yaml#
$schema: http://devicetree.org/meta-schemas/core.yaml#

title: Cavium Octeon 6880 CIU2
maintainers:
  - David Daney <david.daney@cavium.com>

description: |
  * Central Interrupt Unit

properties:
  compatible:
    description: Compatibility with 68XX SOCs.
    items:
      - const: cavium,octeon-6880-ciu2

  interrupt-controller: true
    # The core checks this is a boolean, so just have to list it here to be
    # valid for this binding.

  reg:
    description: The base address of the CIU's register bank.
    items:
      - description: high 32 bits of register bank base address
      - description: low 32 bits of register bank base address
      - description: reserved, must be zero
      - description: size of register bank

  '#interrupt-cells':
    description: |
      Must be <2>.  The first cell is the bank within the CIU and may have a value between 0 and 63.
      The second cell is the bit within the bank and may also have a value between 0 and 63.
    const: 2

required:
  - compatible
  - interrupt-controller
  - reg
  - '#interrupt-cells'

additionalProperties: false

examples:
  - |
    interrupt-controller@1070100000000 {
        compatible = "cavium,octeon-6880-ciu2";
        interrupt-controller;
        /* Interrupts are specified by two parts:
         * 1) Controller register (0..63)
         * 2) Bit within the register (0..63)
         */
        #interrupt-cells = <2>;
        reg = <0x10701 0x00000000 0x0 0x4000000>;
    };
```
