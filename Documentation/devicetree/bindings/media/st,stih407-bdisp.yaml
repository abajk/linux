## Documentation/devicetree/bindings/memory-controllers/marvell,mvebu-devbus.yaml
```yaml
# SPDX-License-Identifier: (GPL-2.0-only OR BSD-2-Clause)
%YAML 1.2
---
$id: http://devicetree.org/schemas/memory-controllers/marvell,mvebu-devbus.yaml#
$schema: http://devicetree.org/meta-schemas/core.yaml#

title: Marvell Device Bus Controller

maintainers:
  - Ezequiel Garcia <ezequiel.garcia@free-electrons.com>
  - Rob Herring <robh@kernel.org>
  - Thomas Petazzoni <thomas.petazzoni@free-electrons.com>

description: |
  Device tree bindings for MVEBU Device Bus controllers

  The Device Bus controller available in some Marvell's SoC allows to control
  different types of standard memory and I/O devices such as NOR, NAND, and FPGA.
  The actual devices are instantiated from the child nodes of a Device Bus node.

properties:
  compatible:
    items:
      - const: marvell,mvebu-devbus
      - const: marvell,orion-devbus

  reg:
    description: A resource specifier for the register space. This is the base
      address of a chip select within the controller's register space.
    items:
      - description: Base address of a chip select register block

  '#address-cells':
    description: Must be set to 1.
    const: 1

  '#size-cells':
    description: Must be set to 1.
    const: 1

  ranges:
    description: |
      Must be set up to reflect the memory layout with four integer values
      for each chip-select line in use: 0 <physical address of mapping> <size>.
    items:
      - description: Mapping tuple element
      - description: Mapping tuple element
      - description: Mapping tuple element

  devbus,keep-config:
    description: Keep using the timing parameters set by the bootloader,
      making all timing properties below unused.
    type: boolean

  devbus,bus-width:
    description: Defines the bus width in bits.
    items:
      - description: Bus width in bits

  devbus,turn-off-ps:
    description: Time during which the controller does not drive the AD bus
      after completing a device read.
    items:
      - description: Turn-off period in picoseconds

  devbus,badr-skew-ps:
    description: Time delay from A[2:0] toggle to read data sample.
    items:
      - description: Badr skew in picoseconds

  devbus,acc-first-ps:
    description: Time delay from ALE[0] negation to first read data sample.
    items:
      - description: Access-first delay in picoseconds

  devbus,acc-next-ps:
    description: Time delay between successive data samples in burst reads.
    items:
      - description: Access-next delay in picoseconds

  devbus,rd-setup-ps:
    description: Time between DEV_CSn assertion and DEV_OEn assertion.
      Set to less than acc-first-ps for proper timing.
    items:
      - description: Read-setup delay in picoseconds

  devbus,rd-hold-ps:
    description: Time between the last data sample and de-assertion of DEV_CSn.
    items:
      - description: Read-hold delay in picoseconds

  devbus,ale-wr-ps:
    description: Time delay from ALE[0] negation to DEV_WEn assertion.
    items:
      - description: ALE-write delay in picoseconds

  devbus,wr-low-ps:
    description: Duration for which DEV_WEn is active.
    items:
      - description: Write-low period in picoseconds

  devbus,wr-high-ps:
    description: Duration for which DEV_WEn is inactive between bursts.
    items:
      - description: Write-high period in picoseconds

  devbus,sync-enable:
    description: Synchronous device enable (0 or 1).
    type: boolean

required:
  - compatible
  - reg
  - "#address-cells"
  - "#size-cells"
  - ranges

additionalProperties: false

examples:
  - |
    devbus-bootcs@d0010400 {
      ranges = <0 0xf0000000 0x1000000>; /* @addr 0xf0000000, size 0x1000000 */
      #address-cells = <1>;
      #size-cells = <1>;

      /* Device Bus parameters are required */

      /* Read parameters */
      devbus,bus-width    = <8>;
      devbus,turn-off-ps  = <60000>;
      devbus,badr-skew-ps = <0>;
      devbus,acc-first-ps = <124000>;
      devbus,acc-next-ps  = <248000>;
      devbus,rd-setup-ps  = <0>;
      devbus,rd-hold-ps   = <0>;

      /* Write parameters */
      devbus,sync-enable = <0>;
      devbus,wr-high-ps  = <60000>;
      devbus,wr-low-ps   = <60000>;
      devbus,ale-wr-ps   = <60000>;

      flash@0 {
        compatible = "cfi-flash";

        /* 16 MiB */
        reg = <0 0x1000000>;
        bank-width = <2>;
        #address-cells = <1>;
        #size-cells = <1>;

        /*
         * We split the 16 MiB in two partitions,
         * just as an example.
         */
        partition@0 {
          label = "First";
          reg = <0 0x800000>;
        };

        partition@800000 {
          label = "Second";
          reg = <0x800000 0x800000>;
        };
      };
    };
```

## Documentation/devicetree/bindings/memory-controllers/ti,davinci-aemif.yaml
```yaml
# SPDX-License-Identifier: (GPL-2.0-only OR BSD-2-Clause)
# Copyright 2025 Texas Instruments
%YAML 1.2
---
$id: http://devicetree.org/schemas/memory-controllers/ti,davinci-aemif.yaml#
$schema: http://devicetree.org/meta-schemas/core.yaml#

title: Texas Instruments AEMIF Controller

maintainers:
  - Ivan Khoronzhuk <ivan.khoronzhuk@ti.com>
  - Rob Herring <robh@kernel.org>

description: |
  * Device tree bindings for Texas instruments AEMIF controller

  The Async External Memory Interface (EMIF16/AEMIF) controller is intended to
  provide a glue-less interface to a variety of asynchronous memory devices like
  ASRA M, NOR and NAND memory. A total of 256M bytes of any of these memories
  can be accessed at any given time via four chip selects with 64M byte access
  per chip select. Synchronous memories such as DDR1 SD RAM, SDR SDRAM
  and Mobile SDR are not supported.

  Documentation:
  Davinci DM646x - http://www.ti.com/lit/ug/sprueq7c/sprueq7c.pdf
  OMAP-L138 (DA850) - http://www.ti.com/lit/ug/spruh77a/spruh77a.pdf
  Kestone - http://www.ti.com/lit/ug/sprugz3a/sprugz3a.pdf

properties:
  compatible:
    items:
      - enum:
          - ti,davinci-aemif
          - ti,keystone-aemif
          - ti,da850-aemif
    description: List of compatible strings for the AEMIF controller.
  reg:
    description: Contains offset and length values for the AEMIF control registers space.
    items:
      - description: Control registers region
  "#address-cells":
    const: 2
    description: Number of address cells for child nodes.
  "#size-cells":
    const: 1
    description: Number of size cells for child nodes.
  ranges:
    description: |
      Memory regions mapped by the AEMIF controller, including CS-specific
      partitions and the control partition.
  clocks:
    maxItems: 1
    description: The clock feeding the AEMIF controller; required if clock tree data is present.
  clock-names:
    items:
      - const: aemif
    description: Name for the AEMIF controller clock.
  clock-ranges:
    type: boolean
    description: Empty property indicating that child nodes can inherit named clocks.

required:
  - compatible
  - reg
  - "#address-cells"
  - "#size-cells"
  - ranges

additionalProperties: false

examples:
  - |
    memory-controller@21000a00 {
      compatible = "ti,davinci-aemif";
      #address-cells = <2>;
      #size-cells = <1>;
      clocks = <&clkaemif 0>;
      clock-names = "aemif";
      clock-ranges;
      reg = <0x21000A00 0x00000100>;
      ranges = <0 0 0x70000000 0x10000000
                1 0 0x21000A00 0x00000100>;
    };
```

## Documentation/devicetree/bindings/memory-controllers/ti/ti,emif.yaml
```yaml
%YAML 1.2
---
$id: http://devicetree.org/schemas/ti,emif.yaml#
$schema: http://devicetree.org/meta-schemas/core.yaml#

title: TI EMIF SDRAM Controller

maintainers:
  - Aneesh V <aneesh@ti.com>
  - Dave Gerlach <d-gerlach@ti.com>
  - Mathieu Malaterre <malat@debian.org>
  - Mauro Carvalho Chehab <mchehab+huawei@kernel.org>
  - Tero Kristo <t-kristo@ti.com>
  - Tony Lindgren <tony@atomide.com>

description: |
  * EMIF family of TI SDRAM controllers

  EMIF - External Memory Interface - is an SDRAM controller used in
  TI SoCs. EMIF supports, based on the IP revision, one or more of
  DDR2/DDR3/LPDDR2 protocols. This binding describes a given instance
  of the EMIF IP and memory parts attached to it. Certain revisions
  of the EMIF controller also contain optional ECC support, which
  corrects one bit errors and detects two bit errors.

properties:
  compatible:
    description: EMIF compatible string
    items:
      - enum:
          - ti,emif-4d
          - ti,emif-am3352
          - ti,emif-am4372
          - ti,emif-dra7xx
          - ti,emif-keystone

  interrupts:
    description: Interrupt used by the controller
    items:
      - description: EMIF controller interrupt specifier

  phy-type:
    description: DDR PHY type (1 = Attila, 2 = Intelli)
    $ref: /schemas/types.yaml#/definitions/uint32
    enum: [1, 2]

  device-handle:
    description: Phandle to an lpddr2 memory part
    $ref: /schemas/types.yaml#/definitions/phandle

  ti,hwmods:
    description: TI hwmods identifier for omap device creation
    $ref: /schemas/types.yaml#/definitions/string

  sram:
    description: "Phandles for SRAM nodes: first for code, second for data"
    items:
      - $ref: /schemas/types.yaml#/definitions/phandle
      - $ref: /schemas/types.yaml#/definitions/phandle

  cs1-used:
    description: Whether chip-select 1 has an attached memory part
    type: boolean

  cal-resistor-per-cs:
    description: Board has one calibration resistor per chip-select
    type: boolean

  hw-caps-read-idle-ctrl:
    description: Controller supports read idle window programming
    type: boolean

  hw-caps-dll-calib-ctrl:
    description: Controller supports DLL calibration control
    type: boolean

  hw-caps-ll-interface:
    description: Controller has a low-latency interface and interrupts
    type: boolean

  hw-caps-temp-alert:
    description: Controller can generate SDRAM temperature alerts
    type: boolean

required:
  - compatible
  - interrupts
  - phy-type
  - device-handle
  - ti,hwmods

allOf:
  - if:
      properties:
        compatible:
          contains:
            const: ti,emif-am3352
    then:
      required:
        - sram

  - if:
      properties:
        compatible:
          contains:
            const: ti,emif-am4372
    then:
      required:
        - sram

additionalProperties: false

examples:
  - |
    emif1: emif@4c000000 {
        compatible = "ti,emif-4d";
        ti,hwmods = "emif2";
        phy-type = <1>;
        device-handle = <&elpida_ECB240ABACN>;
        cs1-used;
        hw-caps-read-idle-ctrl;
        hw-caps-ll-interface;
        hw-caps-temp-alert;
    };
  - |
    /* From am33xx.dtsi */
    emif: emif@4c000000 {
        compatible = "ti,emif-am3352";
        reg = <0x4C000000 0x1000>;
        sram = <&pm_sram_code &pm_sram_data>;
    };
  - |
    emif1: emif@4c000000 {
        compatible = "ti,emif-dra7xx";
        reg = <0x4c000000 0x200>;
        interrupts = <GIC_SPI 105 IRQ_TYPE_LEVEL_HIGH>;
    };
```

## Documentation/devicetree/bindings/mfd/active-semi,act8945a.yaml
```yaml
# SPDX-License-Identifier: (GPL-2.0-only OR BSD-2-Clause)
%YAML 1.2
---
$id: http://devicetree.org/schemas/mfd/active-semi,act8945a.yaml#
$schema: http://devicetree.org/meta-schemas/core.yaml#

title: Active-semi ACT8945A MFD PMIC

maintainers:
  - Krzysztof Kozlowski <krzk@kernel.org>
  - Rob Herring <robh@kernel.org>
  - Wenyou Yang <wenyou.yang@atmel.com>

description: |
  Device-Tree bindings for Active-semi ACT8945A MFD driver

  The chip exposes two subdevices:
   - a regulators: see ../regulator/act8945a-regulator.yaml
   - a charger: see ../power/act8945a-charger.yaml

properties:
  compatible:
    items:
      - const: active-semi,act8945a

  reg:
    description: I2C slave address for the ACT8945A chip
    items:
      - description: I2C slave address

  active-semi,vsel-high:
    description: Select high-voltage selection mode
    type: boolean

  regulators:
    description: Node containing regulator subnodes (see act8945a-regulator.yaml)
    type: object
    additionalProperties: true

  charger:
    description: Node containing charger subnode (see act8945a-charger.yaml)
    type: object
    additionalProperties: true

additionalProperties: false

examples:
  - |
    pmic@5b {
      compatible = "active-semi,act8945a";
      reg = <0x5b>;
      active-semi,vsel-high;

      regulators {
        /* regulator nodes defined in act8945a-regulator.yaml */
      };

      charger {
        compatible = "active-semi,act8945a-charger";
        pinctrl-names = "default";
        pinctrl-0 = <&pinctrl_charger_chglev &pinctrl_charger_lbo &pinctrl_charger_irq>;
        interrupts = <45 IRQ_TYPE_LEVEL_LOW>;
        active-semi,chglev-gpios = <&pioA 12 GPIO_ACTIVE_HIGH>;
        active-semi,lbo-gpios = <&pioA 72 GPIO_ACTIVE_LOW>;
        active-semi,input-voltage-threshold-microvolt = <6600>;
        active-semi,precondition-timeout = <40>;
        active-semi,total-timeout = <3>;
      };
    };
```

## Documentation/devicetree/bindings/mfd/altr,a10sr.yaml
```yaml
# SPDX-License-Identifier: (GPL-2.0-only OR BSD-2-Clause)
# Copyright 2025 Intel Corporation
%YAML 1.2
---
$id: http://devicetree.org/schemas/mfd/altr,a10sr.yaml#
$schema: http://devicetree.org/meta-schemas/core.yaml#

title: Altera Arria10 System Resource Chip

maintainers:
  - Rob Herring <robh@kernel.org>
  - Thor Thayer <thor.thayer@linux.intel.com>
  - Thor Thayer <tthayer@opensource.altera.com>

description: |
  * Altera Arria10 Development Kit System Resource Chip

  The A10SR consists of these sub-devices:

  Device                   Description
  ------                   ----------
  a10sr_gpio               GPIO Controller
  a10sr_rst                Reset Controller

  Arria10 GPIO

  Arria10 Peripheral PHY Reset

properties:
  compatible:
    items:
      - enum:
          - altr,a10sr

  spi-max-frequency:
    description: Maximum SPI frequency.
    $ref: /schemas/types.yaml#/definitions/uint32

  reg:
    items:
      - description: SPI Chip Select address for the Arria10 System Resource chip

  interrupts:
    items:
      - description: Interrupt line the device is connected to.

  interrupt-controller: true

  '#interrupt-cells':
    const: 2
    description:
      The number of cells to describe an IRQ.
      The first cell is the IRQ number.
      The second cell is the flags, encoded as trigger masks from
      ../interrupt-controller/interrupts.txt.

  a10sr_gpio:
    description: GPIO Controller sub-node.
    type: object
    additionalProperties: false
    properties:
      compatible:
        items:
          - enum:
              - altr,a10sr-gpio
      gpio-controller: true
      '#gpio-cells':
        const: 2
    required:
      - compatible
      - gpio-controller
      - '#gpio-cells'

  a10sr_rst:
    description: Peripheral PHY Reset sub-node.
    type: object
    additionalProperties: false
    properties:
      compatible:
        items:
          - enum:
              - altr,a10sr-reset
      '#reset-cells':
        const: 1
    required:
      - compatible
      - '#reset-cells'

required:
  - compatible
  - spi-max-frequency
  - reg
  - interrupts
  - interrupt-controller
  - '#interrupt-cells'

additionalProperties: false

examples:
  - |
    resource-manager@0 {
        compatible = "altr,a10sr";
        reg = <0>;
        spi-max-frequency = <100000>;
        interrupts = <5 IRQ_TYPE_LEVEL_LOW>;
        interrupt-controller;
        #interrupt-cells = <2>;

        a10sr_gpio: gpio-controller {
            compatible = "altr,a10sr-gpio";
            gpio-controller;
            #gpio-cells = <2>;
        };

        a10sr_rst: reset-controller {
            compatible = "altr,a10sr-reset";
            #reset-cells = <1>;
        };
    };
```
