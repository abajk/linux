## Documentation/devicetree/bindings/mfd/fsl,imx25-tsadc.yaml
```yaml
# SPDX-License-Identifier: (GPL-2.0-only OR BSD-2-Clause)
%YAML 1.2
---
$id: http://devicetree.org/schemas/mfd/fsl,imx25-tsadc.yaml#
$schema: http://devicetree.org/meta-schemas/core.yaml#

title: Freescale MX25 ADC/TSC MultiFunction Device (MFD)

maintainers:
  - Markus Schneider-Pargmann <msp@baylibre.com>

description: |
  Freescale MX25 ADC/TSC MultiFunction Device (MFD)

  This device combines two general purpose conversion queues one used for general
  ADC and the other used for touchscreens.

  This device includes two conversion queues which can be added as subnodes.
  The first queue is for the touchscreen, the second for general purpose ADC.

properties:
  compatible:
    description: Compatible string for this device.
    items:
      - const: fsl,imx25-tsadc

  reg:
    maxItems: 1

  interrupts:
    maxItems: 1

  interrupt-controller: true

  '#interrupt-cells':
    const: 1

  '#address-cells':
    const: 1

  '#size-cells':
    const: 1

  ranges: true

  clocks:
    description: Bus clock for this device.
    maxItems: 1

  clock-names:
    items:
      - const: ipg

required:
  - compatible
  - reg
  - interrupts
  - interrupt-controller

additionalProperties: false

examples:
  - |
    tscadc: tscadc@50030000 {
        compatible = "fsl,imx25-tsadc";
        reg = <0x50030000 0xc>;
        interrupts = <46>;
        clocks = <&clks 119>;
        clock-names = "ipg";
        interrupt-controller;
        #interrupt-cells = <1>;
        #address-cells = <1>;
        #size-cells = <1>;
        ranges;

        tsc: tcq@50030400 {
            compatible = "fsl,imx25-tcq";
            reg = <0x50030400 0x60>;
            ...
        };

        adc: gcq@50030800 {
            compatible = "fsl,imx25-gcq";
            reg = <0x50030800 0x60>;
            ...
        };
    };
```

## Documentation/devicetree/bindings/mfd/fsl,mc13783.yaml
```yaml
# SPDX-License-Identifier: (GPL-2.0-only OR BSD-2-Clause)
# Copyright 2018 Linaro Ltd.
%YAML 1.2
---
$id: http://devicetree.org/schemas/mfd/fsl,mc13783.yaml#
$schema: http://devicetree.org/meta-schemas/core.yaml#

title: Freescale MC13783/MC13892 Power Management IC (PMIC)

maintainers:
  - Alexander Shiyan <shc_work@mail.ru>
  - Fabio Estevam <fabio.estevam@freescale.com>
  - Fabio Estevam <fabio.estevam@nxp.com>
  - Rob Herring <robh@kernel.org>
  - Shawn Guo <shawn.guo@linaro.org>

description: |
  * Freescale MC13783/MC13892 Power Management Integrated Circuit (PMIC)

  Sub-nodes:
  - codec: Contain the Audio Codec node.
    - adc-port: Contain PMIC SSI port number used for ADC.
    - dac-port: Contain PMIC SSI port number used for DAC.
  - leds: Contain the LED nodes and initial register values in property
    "led-control". Number of registers depends on IC: MC13783=6, MC13892=4,
    MC34708=1.
  - regulators: Contain the regulator nodes. The regulators are bound using
    their names as listed below with their registers and bits for enabling.

properties:
  compatible:
    description: Hardware identifiers for the PMIC.
    items:
      - enum:
          - fsl,mc13783
          - fsl,mc13892

  reg:
    description: Base register offset within the parent bus (chip select).
    maxItems: 1

  spi-max-frequency:
    description: Maximum SPI clock frequency supported by the PMIC, in Hz.
    $ref: /schemas/types.yaml#/definitions/uint32

  interrupts:
    description: GPIO interrupt number connected to PMIC interrupt pin.
    maxItems: 1

  fsl,mc13xxx-uses-adc:
    description: Indicate the ADC is being used.
    type: boolean

  fsl,mc13xxx-uses-codec:
    description: Indicate the Audio Codec is being used.
    type: boolean

  fsl,mc13xxx-uses-rtc:
    description: Indicate the RTC is being used.
    type: boolean

  fsl,mc13xxx-uses-touch:
    description: Indicate the touchscreen controller is being used.
    type: boolean

  codec:
    description: Audio Codec sub-node.
    type: object
    additionalProperties: false
    properties:
      adc-port:
        description: PMIC SSI port node for ADC.
        type: object
        additionalProperties: false
      dac-port:
        description: PMIC SSI port node for DAC.
        type: object
        additionalProperties: false

  leds:
    description: LED sub-node container.
    type: object
    additionalProperties: false
    properties:
      "#address-cells":
        const: 1
      "#size-cells":
        const: 0
      led-control:
        description: Initial register values for the LEDs.
        $ref: /schemas/types.yaml#/definitions/uint32-array
        oneOf:
          - items:
              - description: Register value for LED 0.
              - description: Register value for LED 1.
              - description: Register value for LED 2.
              - description: Register value for LED 3.
              - description: Register value for LED 4.
              - description: Register value for LED 5.
          - items:
              - description: Register value for LED 0.
              - description: Register value for LED 1.
              - description: Register value for LED 2.
              - description: Register value for LED 3.
          - items:
              - description: Register value for LED 0.

  regulators:
    description: Regulator sub-nodes for the PMIC.
    type: object
    additionalProperties:
      $ref: /schemas/regulator/regulator.yaml#
      unevaluatedProperties: false

required:
  - compatible
  - reg

additionalProperties: false

examples:
  - |
    ecspi@70010000 { /* ECSPI1 */
        cs-gpios = <&gpio4 24 0>, /* GPIO4_24 */
                   <&gpio4 25 0>; /* GPIO4_25 */

        pmic: mc13892@0 {
            #address-cells = <1>;
            #size-cells = <0>;
            compatible = "fsl,mc13892";
            spi-max-frequency = <6000000>;
            reg = <0>;
            interrupts = <8>;

            codec: codec {
                adc-port;
                dac-port;
            };

            leds {
                #address-cells = <1>;
                #size-cells = <0>;
                led-control = <0x000 0x000 0x0e0 0x000>;

                sysled@3 {
                    reg = <3>;
                    label = "system:red:live";
                    linux,default-trigger = "heartbeat";
                };
            };

            regulators {
                sw1_reg: mc13892__sw1 {
                    regulator-min-microvolt = <600000>;
                    regulator-max-microvolt = <1375000>;
                    regulator-boot-on;
                    regulator-always-on;
                };

                sw2_reg: mc13892__sw2 {
                    regulator-min-microvolt = <900000>;
                    regulator-max-microvolt = <1850000>;
                    regulator-boot-on;
                    regulator-always-on;
                };
            };
        };
    };
```

## Documentation/devicetree/bindings/mfd/hisilicon,hi6421-pmic.yaml
```yaml
# SPDX-License-Identifier: (GPL-2.0-only OR BSD-2-Clause)
# Copyright 2025 Linaro Ltd.
%YAML 1.2
---
$id: http://devicetree.org/schemas/mfd/hisilicon,hi6421-pmic.yaml#
$schema: http://devicetree.org/meta-schemas/core.yaml#

title: HI6421 Multi-Functional Device PMIC

maintainers:
  - Guodong Xu <guodong.xu@linaro.org>

description: |
  HI6421 Multi-Functional Device (MFD), by HiSilicon Ltd.

properties:
  compatible:
    enum:
      - hisilicon,hi6421-pmic
      - hisilicon,hi6421v530-pmic

  reg:
    maxItems: 1

  regulators:
    description: Container for regulator child nodes.
    type: object
    additionalProperties: false
    patternProperties:
      ".*":
        $ref: /schemas/regulator/regulator.yaml#

required:
  - compatible
  - reg

additionalProperties: false

examples:
  - |
    hi6421 {
        compatible = "hisilicon,hi6421-pmic";
        reg = <0xfcc00000 0x0180>;
        regulators {
            hi6421_vout0_reg: hi6421_vout0 {
                regulator-name = "VOUT0";
                regulator-min-microvolt = <2850000>;
                regulator-max-microvolt = <2850000>;
            };
            hi6421_vout1_reg: hi6421_vout1 {
                regulator-name = "VOUT1";
                regulator-min-microvolt = <1700000>;
                regulator-max-microvolt = <2000000>;
                regulator-boot-on;
                regulator-always-on;
            };
        };
    };
```

## Documentation/devicetree/bindings/mfd/hisilicon,hi655x-pmic.yaml
```yaml
# SPDX-License-Identifier: (GPL-2.0-only OR BSD-2-Clause)
%YAML 1.2
---
$id: http://devicetree.org/schemas/hisilicon,hi655x-pmic.yaml#
$schema: http://devicetree.org/meta-schemas/core.yaml#

title: Hisilicon Hi655x PMIC
maintainers:
  - Chen Feng <puck.chen@hisilicon.com>
  - Daniel Lezcano <daniel.lezcano@linaro.org>

description: |
  Hisilicon Hi655x Power Management Integrated Circuit (PMIC)

  The hardware layout for access PMIC Hi655x from AP SoC Hi6220.
  Between PMIC Hi655x and Hi6220, the physical signal channel is SSI.
  We can use memory-mapped I/O to communicate.

  +----------------+             +-------------+
  |                |             |             |
  |    Hi6220      |   SSI bus   |   Hi655x    |
  |                |-------------|             |
  |                |(REGMAP_MMIO)|             |
  +----------------+             +-------------+

properties:
  compatible:
    items:
      - const: hisilicon,hi655x-pmic
    description: Name of the device compatible with the Hi655x PMIC driver.

  reg:
    items:
      - description: PMIC register space (base address and size)
    description: Base address and size of the PMIC register range on the SoC.

  interrupt-controller: true

  '#interrupt-cells':
    const: 2

  pmic-gpios:
    description: GPIO used by the PMIC for its interrupt line.
    items:
      - description: GPIO controller phandle, pin number, and active level specifier

  '#clock-cells':
    const: 0

  clock-output-names:
    description: Override default PMIC clock output names.

required:
  - compatible
  - reg
  - interrupt-controller
  - '#interrupt-cells'
  - pmic-gpios
  - '#clock-cells'

examples:
  - |
    pmic: pmic@f8000000 {
        compatible = "hisilicon,hi655x-pmic";
        reg = <0x0 0xf8000000 0x0 0x1000>;
        interrupt-controller;
        #interrupt-cells = <2>;
        pmic-gpios = <&gpio1 2 GPIO_ACTIVE_HIGH>;
        #clock-cells = <0>;
    };

additionalProperties: false
```
