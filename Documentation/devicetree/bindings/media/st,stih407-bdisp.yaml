## Documentation/devicetree/bindings/mfd/ams,as3722.yaml
```yaml
# SPDX-License-Identifier: (GPL-2.0-only OR BSD-2-Clause)
%YAML 1.2
---
$id: http://devicetree.org/schemas/mfd/ams,as3722.yaml#
$schema: http://devicetree.org/meta-schemas/core.yaml#

title: ams,as3722 Power management IC.

maintainers:
  - Guenter Roeck <linux@roeck-us.net>
  - Laxman Dewangan <ldewangan@nvidia.com>
  - Marcel Ziswiler <marcel.ziswiler@toradex.com>
  - Mauro Carvalho Chehab <mchehab+samsung@kernel.org>

description: |
  * ams AS3722 Power management IC.

  Pinmux and GPIO:
  ==============
  Device has 8 GPIO pins which can be configured as GPIO as well as the special IO functions.

  Please refer to pinctrl-bindings.txt in this directory for details of the common pinctrl
  bindings used by client devices, including the meaning of the phrase "pin configuration node".

  Following are properties which are needed if GPIO and pinmux functionality is required:
    Required properties:
    -------------------
    - gpio-controller: Marks the device node as a GPIO controller.
    - #gpio-cells: Number of GPIO cells. Refer to binding document gpio/gpio.txt

    Optional properties:
    --------------------
    - pinctrl-names: A pinctrl state named "default" be defined,
      using the bindings in pinctrl/pinctrl-bindings.txt.
    - pinctrl[0...n]: Properties to contain the phandle that refer to different nodes of pin control settings.
      These nodes represent the pin control setting of state 0 to state n.
      Each of these nodes contains different subnodes to represents some desired configuration for a list
      of pins.
      This configuration can include the mux function to select on those pin(s),
      and various pin configuration parameters, such as pull-up, open drain.

    Each subnode have following properties:
    Required properties:
      - pins: List of pins.
        Valid values of pins properties are: gpio0, gpio1, gpio2, gpio3, gpio4, gpio5, gpio6, gpio7

    Optional properties:
      function, bias-disable, bias-pull-up, bias-pull-down, bias-high-impedance, drive-open-drain.
      Valid values for function properties are: gpio, interrupt-out, gpio-in-interrupt,
        vsup-vbat-low-undebounce-out, vsup-vbat-low-debounce-out, voltage-in-standby,
        oc-pg-sd0, oc-pg-sd6, powergood-out, pwm-in, pwm-out, clk32k-out, watchdog-in,
        soft-reset-in

  Regulators:
  ==========
  Device has multiple DCDC and LDOs. The node "regulators" is required if regulator functionality is needed.

  Following are properties of regulator subnode.

    Optional properties:
    -------------------
    The input supply of regulators are the optional properties on the regulator node.
    The input supply of these regulators are provided through following properties:
      vsup-sd2-supply: Input supply for SD2.
      vsup-sd3-supply: Input supply for SD3.
      vsup-sd4-supply: Input supply for SD4.
      vsup-sd5-supply: Input supply for SD5.
      vin-ldo0-supply: Input supply for LDO0.
      vin-ldo1-6-supply: Input supply for LDO1 and LDO6.
      vin-ldo2-5-7-supply: Input supply for LDO2, LDO5 and LDO7.
      vin-ldo3-4-supply: Input supply for LDO3 and LDO4.
      vin-ldo9-10-supply: Input supply for LDO9 and LDO10.
      vin-ldo11-supply: Input supply for LDO11.

    Optional sub nodes for regulators:
    ---------------------------------
    The subnodes name is the name of regulator and it must be one of: sd[0-6], ldo[0-7], ldo[9-11]

    Each sub-node should contain the constraints and initialization information for that regulator.
    See regulator.txt for a description of standard properties for these sub-nodes.
    Additional optional custom properties are listed below.
      - ams,ext-control: External control of the rail.
        The option of this properties will tell which external input is controlling this rail.
        Valid values are 0, 1, 2 and 3.
        0: There is no external control of this rail.
        1: Rail is controlled by ENABLE1 input pin.
        2: Rail is controlled by ENABLE2 input pin.
        3: Rail is controlled by ENABLE3 input pin.
        Missing this property on DT will be assumed as no external control.
        The external control pin macros are defined @dt-bindings/mfd/as3722.h
      - ams,enable-tracking: Enable tracking with SD1, only supported by LDO3.

  Power-off:

properties: {}
additionalProperties: false
```

## Documentation/devicetree/bindings/mfd/aspeed,ast2500-gfx.yaml
```yaml
# SPDX-License-Identifier: (GPL-2.0-only OR BSD-2-Clause)
%YAML 1.2
---
$id: http://devicetree.org/schemas/aspeed,ast2500-gfx.yaml#
$schema: http://devicetree.org/meta-schemas/core.yaml#

title: Aspeed SoC Display Controller (GFX)

maintainers:
  - Andrew Jeffery <andrew@aj.id.au>

description: |
  * Device tree bindings for Aspeed SoC Display Controller (GFX)

  The Aspeed SoC Display Controller primarily does as its name suggests, but also
  participates in pinmux requests on the g5 SoCs. It is therefore considered a
  syscon device.

properties:
  compatible:
    items:
      - const: aspeed,ast2500-gfx
      - const: syscon
  reg:
    description: Offset and length of the GFX memory region
    items:
      - description: GFX memory region offset
      - description: GFX memory region length

required:
  - compatible
  - reg

additionalProperties: false

examples:
  - |
    gfx: display@1e6e6000 {
        compatible = "aspeed,ast2500-gfx", "syscon";
        reg = <0x1e6e6000 0x1000>;
    };
```

## Documentation/devicetree/bindings/mfd/atmel,at91sam9260-smc.yaml
```yaml
# SPDX-License-Identifier: (GPL-2.0-only OR BSD-2-Clause)
# Copyright 2025 Microchip
%YAML 1.2
---
$id: http://devicetree.org/schemas/mfd/atmel,at91sam9260-smc.yaml#
$schema: http://devicetree.org/meta-schemas/core.yaml#

title: Atmel SMC Static Memory Controller
maintainers:
  - Boris Brezillon <bbrezillon@kernel.org>
  - Claudiu Beznea <claudiu.beznea@tuxon.dev>
  - Ludovic Desroches <ludovic.desroches@microchip.com>
  - Varshini Rajendran <varshini.rajendran@microchip.com>

description: |
  Device tree bindings for Atmel SMC (Static Memory Controller)

  The SMC registers are used to configure Atmel EBI (External Bus Interface)
  to interface with standard memory devices (NAND, NOR, SRAM or specialized
  devices like FPGAs).

properties:
  compatible:
    description: List of compatible strings for the SMC controller.
    items:
      - enum:
          - atmel,at91sam9260-smc
          - syscon
          - atmel,sama5d3-smc
          - atmel,sama5d2-smc
          - microchip,sam9x60-smc
          - microchip,sam9x7-smc

  reg:
    description: Contains offset/length value of the SMC memory region.
    items:
      - description: Memory region offset and length.

required:
  - compatible
  - reg

additionalProperties: false

examples:
  - |
    smc: smc@ffffc000 {
        compatible = "atmel,sama5d3-smc", "syscon";
        reg = <0xffffc000 0x1000>;
    };
```

## Documentation/devicetree/bindings/mfd/dlg,da9052.yaml
```yaml
# SPDX-License-Identifier: (GPL-2.0-only OR BSD-2-Clause)
# Copyright 2018 Linaro Ltd.
%YAML 1.2
---
$id: http://devicetree.org/schemas/mfd/dlg,da9052.yaml#
$schema: http://devicetree.org/meta-schemas/core.yaml#

title: Dialog DA9052/53 Power Management Integrated Circuit (PMIC)

maintainers:
  - Rob Herring <robh@kernel.org>
  - Sebastian Reichel <sre@kernel.org>
  - Steve Twiss <stwiss.opensource@diasemi.com>
  - Ying-Chun Liu (PaulLiu) <paul.liu@linaro.org>

description: |
  Dialog DA9052/53 Power Management Integrated Circuit (PMIC)

properties:
  compatible:
    items:
      - enum: ["dlg,da9052", "dlg,da9053-aa", "dlg,da9053-ab", "dlg,da9053-bb"]

  reg:
    description: I2C address of the PMIC.
    items:
      - description: Slave I2C address of the PMIC

  dlg,tsi-as-adc:
    description: If true, touchscreen X+, X-, Y+, Y- lines are used as ADC inputs.
    type: boolean

  tsiref-supply:
    description: Regulator providing reference voltage for the TSIREF pin.

  regulators:
    description: Container for regulator sub-nodes.
    type: object
    additionalProperties: false
    patternProperties:
      "^buck[1-4]$|^ldo([1-9]|10)$":
        $ref: /schemas/regulator/regulator.yaml#

required:
  - compatible
  - reg

additionalProperties: false

examples:
  - |
    i2c@63fc8000 { /* I2C1 */
        pmic: dialog@48 {
            compatible = "dlg,da9053-aa";
            reg = <0x48>;

            regulators {
                buck1 {
                    regulator-min-microvolt = <500000>;
                    regulator-max-microvolt = <2075000>;
                };

                buck2 {
                    regulator-min-microvolt = <500000>;
                    regulator-max-microvolt = <2075000>;
                };

                buck3 {
                    regulator-min-microvolt = <925000>;
                    regulator-max-microvolt = <2500000>;
                };

                buck4 {
                    regulator-min-microvolt = <925000>;
                    regulator-max-microvolt = <2500000>;
                };
            };
        };
    };
```

## Documentation/devicetree/bindings/mfd/dlg,da9055-pmic.yaml
```yaml
# SPDX-License-Identifier: (GPL-2.0-only OR BSD-2-Clause)
%YAML 1.2
---
$id: http://devicetree.org/schemas/mfd/dlg,da9055-pmic.yaml#
$schema: http://devicetree.org/meta-schemas/core.yaml#

title: Dialog DA9055 Power Management Integrated Circuit (PMIC)

maintainers:
  - Adam Thomson <Adam.Thomson.Opensource@diasemi.com>
  - Rob Herring <robh@kernel.org>

description: |
  * Dialog DA9055 Power Management Integrated Circuit (PMIC)

  DA9055 consists of a large and varied group of sub-devices (I2C Only):

  Device                Supply Names  Description
  ------                ------------  -----------
  da9055-gpio                           GPIOs
  da9055-regulator                      Regulators
  da9055-onkey                          On key
  da9055-rtc                            RTC
  da9055-hwmon                          ADC
  da9055-watchdog                       Watchdog

  The CODEC device in DA9055 has a separate, configurable I2C address and so
  is instantiated separately from the PMIC.

  For details on accompanying CODEC I2C device, see the following:
  Documentation/devicetree/bindings/sound/da9055.txt

properties:
  compatible:
    enum:
      - dlg,da9055-pmic

  reg:
    maxItems: 1

  interrupts:
    maxItems: 1

  interrupt-controller: true

  '#interrupt-cells':
    const: 1

  regulators:
    description: Sub-node containing the DA9055 regulator child nodes.
    type: object
    additionalProperties: false
    properties:
      buck1:
        $ref: /schemas/regulator/regulator.yaml#
        description: Regulator BUCK1
      buck2:
        $ref: /schemas/regulator/regulator.yaml#
        description: Regulator BUCK2
      ldo1:
        $ref: /schemas/regulator/regulator.yaml#
        description: Regulator LDO1
      ldo2:
        $ref: /schemas/regulator/regulator.yaml#
        description: Regulator LDO2
      ldo3:
        $ref: /schemas/regulator/regulator.yaml#
        description: Regulator LDO3
      ldo4:
        $ref: /schemas/regulator/regulator.yaml#
        description: Regulator LDO4
      ldo5:
        $ref: /schemas/regulator/regulator.yaml#
        description: Regulator LDO5
      ldo6:
        $ref: /schemas/regulator/regulator.yaml#
        description: Regulator LDO6

required:
  - compatible
  - reg
  - interrupts
  - interrupt-controller
  - '#interrupt-cells'

additionalProperties: false

examples:
  - |
    pmic: da9055-pmic@5a {
        compatible = "dlg,da9055-pmic";
        reg = <0x5a>;
        interrupts = <5 IRQ_TYPE_LEVEL_LOW>;
        interrupt-controller;
        #interrupt-cells = <1>;

        regulators {
            buck1: BUCK1 {
                regulator-min-microvolt = <725000>;
                regulator-max-microvolt = <2075000>;
            };
            buck2: BUCK2 {
                regulator-min-microvolt = <925000>;
                regulator-max-microvolt = <2500000>;
            };
            ldo1: LDO1 {
                regulator-min-microvolt = <900000>;
                regulator-max-microvolt = <3300000>;
            };
        };
    };
```

## Documentation/devicetree/bindings/mfd/dlg,da9150.yaml
```yaml
%YAML 1.2
---
$id: http://devicetree.org/schemas/mfd/dlg,da9150.yaml#
$schema: http://devicetree.org/meta-schemas/core.yaml#

title: Dialog Semiconductor DA9150 Combined Charger/Fuel-Gauge MFD

maintainers:
  - Adam Thomson <Adam.Thomson.Opensource@diasemi.com>
  - Rob Herring <robh@kernel.org>

description: |
  Dialog Semiconductor DA9150 Combined Charger/Fuel-Gauge MFD bindings

  DA9150 consists of a group of sub-devices:

  Device             Description
  ------             -----------
  da9150-gpadc       : General Purpose ADC
  da9150-charger     : Battery Charger
  da9150-fg          : Battery Fuel-Gauge

properties:
  compatible:
    items:
      - const: dlg,da9150
    description: Must be "dlg,da9150"
  reg:
    items:
      - description: I2C slave address of the DA9150 chip
  interrupts:
    maxItems: 1
    description: IRQ line info for the DA9150 chip
  interrupt-controller: true

additionalProperties: false

required:
  - compatible
  - reg
  - interrupts
  - interrupt-controller

examples:
  - |
    charger_fg: da9150@58 {
      compatible = "dlg,da9150";
      reg = <0x58>;
      interrupts = <11 IRQ_TYPE_LEVEL_LOW>;
      interrupt-controller;

      gpadc: da9150-gpadc {
        compatible = "dlg,da9150-gpadc";
        #io-channel-cells = <1>;
      };

      charger {
        compatible = "dlg,da9150-charger";

        io-channels = <&gpadc 0>,
                      <&gpadc 2>,
                      <&gpadc 8>,
                      <&gpadc 5>;
        io-channel-names = "CHAN_IBUS",
                           "CHAN_VBUS",
                           "CHAN_TJUNC",
                           "CHAN_VBAT";
      };

      fuel-gauge {
        compatible = "dlg,da9150-fuel-gauge";

        dlg,update-interval = <10000>;
        dlg,warn-soc-level = /bits/ 8 <15>;
        dlg,crit-soc-level = /bits/ 8 <5>;
      };
    };
```
