## Documentation/devicetree/bindings/media/st,stih407-bdisp.yaml
```yaml
# SPDX-License-Identifier: (GPL-2.0-only OR BSD-2-Clause)
---
$id: http://devicetree.org/schemas/st,stih407-bdisp.yaml#
$schema: http://devicetree.org/meta-schemas/core.yaml#

title: STMicroelectronics stih4xx bdisp

maintainers:
  - Fabien Dessenne <fabien.dessenne@st.com>

description: |
  STMicroelectronics stih4xx platforms

  bdisp: 2D blitter for STMicroelectronics SoC.

  Aliases:
  Each BDISP should have a numbered alias in the aliases node, in the form of
  bdispN, N = 0 or 1.

properties:
  compatible:
    const: "st,stih407-bdisp"

  reg:
    items:
      - description: Physical address and length of the BDISP register block

  interrupts:
    items:
      - description: BDISP interrupt number

  clocks:
    description: Hardware IP needed clocks; see common clock binding for details

  clock-names:
    items:
      - const: bdisp

required:
  - compatible
  - reg
  - interrupts
  - clocks
  - clock-names


additionalProperties: false

examples:
  - |
    bdisp0:bdisp@9f10000 {
      compatible = "st,stih407-bdisp";
      reg = <0x9f10000 0x1000>;
      interrupts = <GIC_SPI 38 IRQ_TYPE_NONE>;
      clocks = <&clk_s_c0_flexgen CLK_IC_BDISP_0>;
      clock-names = "bdisp";
    };
```

## Documentation/devicetree/bindings/media/st,stih407-c8sectpfe.yaml
```yaml
# SPDX-License-Identifier: (GPL-2.0-only OR BSD-2-Clause)
%YAML 1.2
---
$id: http://devicetree.org/schemas/media/st,stih407-c8sectpfe.yaml#
$schema: http://devicetree.org/meta-schemas/core.yaml#

title: STMicroelectronics STi c8sectpfe device

maintainers:
  - Marco Franchi <marco.franchi@nxp.com>
  - Mauro Carvalho Chehab <mchehab+samsung@kernel.org>
  - Peter Griffin <peter.griffin@linaro.org>
  - Rob Herring <robh@kernel.org>

description: |
  This document describes the c8sectpfe device bindings that is used to get transport
  stream data into the SoC on the TS pins, and into DDR for further processing.

  It is typically used in conjunction with one or more demodulator and tuner devices
  which converts from the RF to digital domain. Demodulators and tuners are usually
  located on an external DVB frontend card connected to SoC TS input pins.

  Currently 7 TS input (tsin) channels are supported on the stih407 family SoC.

properties:
  compatible:
    items:
      - const: "st,stih407-c8sectpfe"
  reg:
    items:
      - description: c8sectpfe registers
      - description: c8sectpfe internal sram
  reg-names:
    items:
      - const: c8sectpfe
      - const: c8sectpfe-ram
  interrupts:
    minItems: 1
    maxItems: 2
    description: Interrupts for error and idle conditions

  interrupt-names:
    items:
      - const: stfe-error-irq
      - const: stfe-idle-irq

  clocks:
    maxItems: 1

  clock-names:
    items:
      - const: c8sectpfe

patternProperties:
  "^pinctrl-[0-9]+$":
    $ref: /schemas/types.yaml#/definitions/phandle
  "^tsin\\d+$":
    type: object
    description: tsin child node
    required:
      - tsin-num
      - i2c-bus
      - reset-gpios
    properties:
      tsin-num:
        $ref: /schemas/types.yaml#/definitions/uint32
        enum: [0, 1, 2, 3, 4, 5, 6]
        description: tsin id of the input block
      i2c-bus:
        $ref: /schemas/types.yaml#/definitions/phandle
        description: phandle to the I2C bus DT node
      reset-gpios:
        maxItems: 1
        description: reset GPIO for this tsin channel
      invert-ts-clk:
        type: boolean
        description: invert sense of TS clock
      serial-not-parallel:
        type: boolean
        description: use serial rather than parallel bus
      async-not-sync:
        type: boolean
        description: asynchronous (not sync) data reception
      dvb-card:
        $ref: /schemas/types.yaml#/definitions/phandle
        description: NIM card connected to this tsin channel
    additionalProperties: false

additionalProperties: false

examples:
  - |
    c8sectpfe@8a20000 {
      compatible = "st,stih407-c8sectpfe";
      reg = <0x08a20000 0x10000>, <0x08a00000 0x4000>;
      reg-names = "stfe", "stfe-ram";
      interrupts = <GIC_SPI 34 IRQ_TYPE_NONE>, <GIC_SPI 35 IRQ_TYPE_NONE>;
      interrupt-names = "stfe-error-irq", "stfe-idle-irq";
      clocks = <&clk_s_c0_flexgen CLK_PROC_STFE>;
      clock-names = "c8sectpfe";
      pinctrl-0 = <&pinctrl_tsin0_serial>;
      pinctrl-1 = <&pinctrl_tsin0_parallel>;
      pinctrl-2 = <&pinctrl_tsin3_serial>;
      pinctrl-3 = <&pinctrl_tsin4_serial_alt3>;
      pinctrl-4 = <&pinctrl_tsin5_serial_alt1>;
      pinctrl-names = "tsin0-serial",
                    "tsin0-parallel",
                    "tsin3-serial",
                    "tsin4-serial",
                    "tsin5-serial";
      tsin0: port@0 {
        tsin-num = <0>;
        serial-not-parallel;
        i2c-bus = <&ssc2>;
        reset-gpios = <&pio15 4 GPIO_ACTIVE_HIGH>;
        dvb-card = <STV0367_TDA18212_NIMA_1>;
      };
      tsin3: port@3 {
        tsin-num = <3>;
        serial-not-parallel;
        i2c-bus = <&ssc3>;
        reset-gpios = <&pio15 7 GPIO_ACTIVE_HIGH>;
        dvb-card = <STV0367_TDA18212_NIMB_1>;
      };
    };
```

## Documentation/devicetree/bindings/media/st/st,st-hva.yaml
```yaml
# SPDX-License-Identifier: (GPL-2.0-only OR BSD-2-Clause)
# Copyright 2025 STMicroelectronics
%YAML 1.2
---
$id: http://devicetree.org/schemas/media/st/st,st-hva.yaml#
$schema: http://devicetree.org/meta-schemas/core.yaml#

title: ST HVA

maintainers:
  - Jean-Christophe Trotin <jean-christophe.trotin@st.com>

description: |
  multi-format video encoder for STMicroelectronics SoC.

properties:
  compatible:
    items:
      - const: st,st-hva

  reg:
    items:
      - description: HVA physical address location and length
      - description: esram physical address location and length

  reg-names:
    items:
      - const: hva_registers
      - const: hva_esram

  interrupts:
    description: HVA interrupt lines
    items:
      - description: HVA interrupt line
      - description: esram interrupt line

  clocks:
    description: Hardware IP needed clocks. The number of clocks may depend on the SoC type.
      See ../clock/clock-bindings.txt for details.

  clock-names:
    items:
      - const: clk_hva

required:
  - compatible
  - reg
  - reg-names
  - interrupts
  - clocks
  - clock-names

additionalProperties: false

examples:
  - |
    hva@8c85000 {
        compatible = "st,st-hva";
        reg = <0x8c85000 0x400>, <0x6000000 0x40000>;
        reg-names = "hva_registers", "hva_esram";
        interrupts = <GIC_SPI 58 IRQ_TYPE_NONE>,
                     <GIC_SPI 59 IRQ_TYPE_NONE>;
        clock-names = "clk_hva";
        clocks = <&clk_s_c0_flexgen CLK_HVA>;
    };
```

## Documentation/devicetree/bindings/media/ti,da850-vpif.yaml
```yaml
# SPDX-License-Identifier: (GPL-2.0-only OR BSD-2-Clause)
# Copyright 2025 Bartosz Golaszewski
%YAML 1.2
---
$id: http://devicetree.org/schemas/ti,da850-vpif.yaml#
$schema: http://devicetree.org/meta-schemas/core.yaml#

title: Texas Instruments VPIF

maintainers:
  - Bartosz Golaszewski <brgl@bgdev.pl>
  - Kevin Hilman <khilman@baylibre.com>
  - Rob Herring <robh@kernel.org>

description: |
  The TI Video Port InterFace (VPIF) is the primary component for video
  capture and display on the DA850/AM18x family of TI DaVinci/Sitara SoCs.

  TI Document reference: SPRUH82C, Chapter 35
  http://www.ti.com/lit/pdf/spruh82

properties:
  compatible:
    items:
      - const: ti,da850-vpif
  reg:
    items:
      - description: physical base address of the register set
      - description: size of the register set
  interrupts:
    description: IRQ line for the VPIF
    items:
      - description: VPIF interrupt

patternProperties:
  "^port@[0-9]+$":
    type: object
    description: Port channels, input or output
    additionalProperties: false
    patternProperties:
      "^endpoint(@[0-9]+)?$":
        type: object
        description: Endpoint configuration
        additionalProperties: false
        properties:
          reg:
            description: Endpoint identifier
            items:
              - description: endpoint index
          bus-width:
            description: Width of the data bus
            $ref: /schemas/types.yaml#/definitions/uint32
          remote-endpoint:
            description: Remote endpoint phandle
            $ref: /schemas/types.yaml#/definitions/phandle
          data-shift:
            description: Data shift for second 8-bit channel
            $ref: /schemas/types.yaml#/definitions/uint32
        required:
          - bus-width
        unevaluatedProperties: false
    unevaluatedProperties: false

additionalProperties: false

examples:
  - |
    vpif: vpif@217000 {
        compatible = "ti,da850-vpif";
        reg = <0x217000 0x1000>;
        interrupts = <92>;
        port@0 {
            vpif_input_ch0: endpoint@0 {
                reg = <0>;
                bus-width = <8>;
                remote-endpoint = <&composite_in>;
            };
            vpif_input_ch1: endpoint@1 {
                reg = <1>;
                bus-width = <8>;
                data-shift = <8>;
            };
        };
        port@1 {
            vpif_output_ch0: endpoint {
                bus-width = <8>;
                remote-endpoint = <&composite_out>;
            };
        };
    };
  - |
    vpif: vpif@217000 {
        compatible = "ti,da850-vpif";
        reg = <0x217000 0x1000>;
        interrupts = <92>;
        port {
            vpif_ch0: endpoint {
                bus-width = <16>;
            };
        };
    };
```

## Documentation/devicetree/bindings/media/ti,omap3-isp.yaml
```yaml
# SPDX-License-Identifier: (GPL-2.0-only OR BSD-2-Clause)
%YAML 1.2
---
$id: http://devicetree.org/schemas/media/ti,omap3-isp.yaml#
$schema: http://devicetree.org/meta-schemas/core.yaml#

title: OMAP 3 ISP

maintainers:
  - Sakari Ailus <sakari.ailus@linux.intel.com>

description: |
  OMAP 3 ISP Device Tree bindings

  The DT definitions can be found in include/dt-bindings/media/omap3-isp.h.

  Port nodes (optional)

  More documentation on these bindings is available in
  video-interfaces.txt in the same directory.

properties:
  compatible:
    items:
      - const: ti,omap3-isp

  reg:
    items:
      - description: core ISP registers up to end of SBL block
      - description: CSI PHYs and receivers registers

  interrupts:
    maxItems: 1

  iommus:
    description: Phandle and IOMMU specifier for the IOMMU that serves the ISP.
    maxItems: 1

  syscon:
    description: Phandle and register offset to the Complex I/O or CSI-PHY register.
    $ref: /schemas/types.yaml#/definitions/phandle-array

  ti,phy-type:
    description: "Select the PHY type: 0 = OMAP3ISP_PHY_TYPE_COMPLEX_IO, 1 = OMAP3ISP_PHY_TYPE_CSIPHY."
    $ref: /schemas/types.yaml#/definitions/uint32
    enum: [0, 1]

  "#clock-cells":
    const: 1

  vdd-csiphy1-supply: true

  vdd-csiphy2-supply: true

  ports:
    description: Port nodes
    type: object
    additionalProperties: false
    properties:
      "#address-cells":
        const: 1
      "#size-cells":
        const: 0

required:
  - compatible
  - reg
  - interrupts
  - iommus
  - syscon
  - ti,phy-type
  - "#clock-cells"

additionalProperties: false

examples:
  - |
    isp@480bc000 {
        compatible = "ti,omap3-isp";
        reg = <0x480bc000 0x12fc
               0x480bd800 0x0600>;
        interrupts = <24>;
        iommus = <&mmu_isp>;
        syscon = <&scm_conf 0x2f0>;
        ti,phy-type = <OMAP3ISP_PHY_TYPE_CSIPHY>;
        #clock-cells = <1>;
        ports {
            #address-cells = <1>;
            #size-cells = <0>;
        };
    };
```

## Documentation/devicetree/bindings/media/ti-am437x-vpfe.yaml
```yaml
# SPDX-License-Identifier: (GPL-2.0-only OR BSD-2-Clause)
%YAML 1.2
---
$id: http://devicetree.org/schemas/media/ti-am437x-vpfe.yaml#
# $schema is the meta-schema this schema should be validated with.
$schema: http://devicetree.org/meta-schemas/core.yaml#

title: Texas Instruments AM437x CAMERA (VPFE)

maintainers:
  - Benoit Parrot <bparrot@ti.com>

description: |
  Texas Instruments AM437x CAMERA (VPFE)

  The Video Processing Front End (VPFE) is a key component for image capture
  applications. The capture module provides the system interface and the
  processing capability to connect RAW image-sensor modules and video decoders
  to the AM437x device.

  VPFE supports a single port node with parallel bus. It should contain one
  'port' child node with child 'endpoint' node. Please refer to the bindings
  defined in Documentation/devicetree/bindings/media/video-interfaces.txt.

properties:
  compatible:
    const: ti,am437x-vpfe

  reg:
    description: Physical base address and length of the registers set for the device
    items:
      - description: base address
      - description: length

  interrupts:
    description: IRQ line for the VPFE
    items:
      - description: vpfe interrupt

  interrupt-controller: true

  ti,am437x-vpfe-interface:
    description: Interface type
    enum: [0, 1, 2, 3, 4]
    $ref: /schemas/types.yaml#/definitions/uint32

  pinctrl-names:
    items:
      - const: default
      - const: sleep

  port:
    description: Video input port
    type: object
    additionalProperties: false
    properties:
      '#address-cells':
        const: 1
      '#size-cells':
        const: 0
      endpoint:
        description: Video endpoint
        type: object
        additionalProperties: false
        properties:
          remote-endpoint:
            $ref: /schemas/types.yaml#/definitions/phandle
          ti,am437x-vpfe-interface:
            enum: [0, 1, 2, 3, 4]
          bus-width:
            description: Data bus width in bits
            items:
              - description: bus width
          hsync-active:
            description: HSYNC signal polarity
            type: boolean
          vsync-active:
            description: VSYNC signal polarity
            type: boolean
        required:
          - remote-endpoint
          - ti,am437x-vpfe-interface
          - bus-width
          - hsync-active
          - vsync-active
    required:
      - endpoint

required:
  - compatible
  - reg
  - interrupts
  - interrupt-controller
  - ti,am437x-vpfe-interface

additionalProperties: false
examples:
  - |
    vpfe: vpfe@f0034000 {
        compatible = "ti,am437x-vpfe";
        reg = <0x48328000 0x2000>;
        interrupts = <GIC_SPI 50 IRQ_TYPE_LEVEL_HIGH>;

        pinctrl-names = "default", "sleep";
        pinctrl-0 = <&vpfe_pins_default>;
        pinctrl-1 = <&vpfe_pins_sleep>;

        port {
            #address-cells = <1>;
            #size-cells = <0>;

            vpfe0_ep: endpoint {
                remote-endpoint = <&ov2659_1>;
                ti,am437x-vpfe-interface = <0>;
                bus-width = <8>;
                hsync-active = <0>;
                vsync-active = <0>;
            };
        };
    };

    i2c1: i2c@4802a000 {
        ov2659@30 {
            compatible = "ti,ov2659";
            reg = <0x30>;

            port {
                ov2659_1: endpoint {
                    remote-endpoint = <&vpfe0_ep>;
                    bus-width = <8>;
                    mclk-frequency = <12000000>;
                };
            };
        };
    };
```
