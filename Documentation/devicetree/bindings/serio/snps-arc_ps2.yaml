## Documentation/devicetree/bindings/serio/snps-arc_ps2.yaml
```yaml
# SPDX-License-Identifier: (GPL-2.0-only OR BSD-2-Clause)
%YAML 1.2
---
$id: http://devicetree.org/schemas/serio/snps-arc_ps2.yaml#
$schema: http://devicetree.org/meta-schemas/core.yaml#

title: Synopsys ARC PS/2 driver
maintainers:
  - Mischa Jonker <Mischa.Jonker@synopsys.com>

description: |
  ARC PS/2 driver: PS/2 block used in some ARC FPGA's & nSIM OSCI model

properties:
  compatible:
    items:
      - const: snps,arc_ps2

  reg:
    items:
      - description: Register base address
      - description: Length of registers (must be 0x14)
        const: 20

  interrupts:
    description: Interrupt input for PS/2 controller
    items:
      - description: Interrupt line for PS/2 controller

  interrupt-names:
    description: Name of the PS/2 interrupt
    items:
      - const: arc_ps2_irq

required:
  - compatible
  - reg
  - interrupts
  - interrupt-names

additionalProperties: false

examples:
  - |
    serio@c9000400 {
        compatible = "snps,arc_ps2";
        reg = <0xc9000400 0x14>;
        interrupts = <13>;
        interrupt-names = "arc_ps2_irq";
    };
```

## Documentation/devicetree/bindings/sifive/sifive,blocks-ip-versioning.yaml
```yaml
# SPDX-License-Identifier: (GPL-2.0-only OR BSD-2-Clause)
# Copyright 2025 SiFive Inc.
%YAML 1.2
---
$id: http://devicetree.org/schemas/sifive/sifive,blocks-ip-versioning.yaml#
$schema: http://devicetree.org/meta-schemas/core.yaml#

title: SiFive open-source IP blocks DT compatible string versioning

maintainers:
  - Paul Walmsley <paul.walmsley@sifive.com>

description: |
  DT compatible string versioning for SiFive open-source IP blocks

  This document describes the version specification for DT "compatible"
  strings for open-source SiFive IP blocks.  HDL for these IP blocks
  can be found in this public repository:

  https://github.com/sifive/sifive-blocks

  IP block-specific DT compatible strings are contained within the HDL,
  in the form "sifive,<ip-block-name><integer version number>".

  Until these IP blocks (or IP integration) support version
  auto-discovery, the maintainers of these IP blocks intend to increment
  the suffixed number in the compatible string whenever the software
  interface to these IP blocks changes, or when the functionality of the
  underlying IP blocks changes in a way that software should be aware of.

  Driver developers can use compatible string "match" values such as
  "sifive,uart0" to indicate that their driver is compatible with the
  register interface and functionality associated with the relevant
  upstream sifive-blocks commits.  It is expected that most drivers will
  match on these IP block-specific compatible strings.

  DT data authors, when writing data for a particular SoC, should
  continue to specify an SoC-specific compatible string value, such as
  "sifive,fu540-c000-uart".  This way, if SoC-specific
  integration-specific bug fixes or workarounds are needed, the kernel
  or other system software can match on this string to apply them.
  The IP block-specific compatible string (such as "sifive,uart0") should
  then be specified as a subsequent value.

properties:
  compatible:
    description: >
      List of compatible strings; the first entry is the SoC-specific
      integration string, and the second (if present) is the IP block-
      specific versioned string.
    oneOf:
      - items:
          - pattern: .*
          - pattern: .*
      - items:
          - pattern: .*

required:
  - compatible

additionalProperties: false

examples:
  - |
    node@1000 {
        compatible = "sifive,fu540-c000-uart", "sifive,uart0";
    };
```

## Documentation/devicetree/bindings/siox/eckelmann,siox-gpio.yaml
```yaml
# SPDX-License-Identifier: (GPL-2.0-only OR BSD-2-Clause)
%YAML 1.2
---
$id: http://devicetree.org/schemas/siox/eckelmann,siox-gpio.yaml#
$schema: http://devicetree.org/meta-schemas/core.yaml#

title: Eckelmann SIOX GPIO bus
maintainers:
  - Uwe Kleine-König <u.kleine-koenig@pengutronix.de>

description: |
  Eckelmann SIOX GPIO bus

properties:
  compatible:
    const: eckelmann,siox-gpio

  din-gpios:
    description: GPIO for data-in signal
    maxItems: 1

  dout-gpios:
    description: GPIO for data-out signal
    maxItems: 1

  dclk-gpios:
    description: GPIO for clock signal
    maxItems: 1

  dld-gpios:
    description: GPIO for data-load signal
    maxItems: 1

required:
  - compatible
  - pinctrl-names
  - pinctrl-0
  - din-gpios
  - dout-gpios
  - dclk-gpios
  - dld-gpios

additionalProperties: false

examples:
  - |
    siox {
      compatible = "eckelmann,siox-gpio";
      pinctrl-names = "default";
      pinctrl-0 = <&pinctrl_siox>;

      din-gpios = <&gpio6 11 0>;
      dout-gpios = <&gpio6 8 0>;
      dclk-gpios = <&gpio6 9 0>;
      dld-gpios = <&gpio6 10 0>;
    };
```

## Documentation/devicetree/bindings/soc/dove/marvell,dove-pmu.yaml
```yaml
# SPDX-License-Identifier: (GPL-2.0-only OR BSD-2-Clause)
# Copyright 2025 Russell King <rmk+kernel@arm.linux.org.uk>
%YAML 1.2
---
$id: http://devicetree.org/schemas/soc/dove/marvell,dove-pmu.yaml#
$schema: http://devicetree.org/meta-schemas/core.yaml#

title: Marvell Dove PMU

maintainers:
  - Russell King <rmk+kernel@arm.linux.org.uk>

properties:
  compatible:
    oneOf:
      - items:
          - const: marvell,dove-pmu
          - const: simple-bus
      - items:
          - const: marvell,dove-pmu

  reg:
    description: Base addresses and sizes for the PM controller and PMU.
    items:
      - description: PM controller registers
      - description: PMU registers

  interrupts:
    maxItems: 1

  interrupt-controller: true

  '#interrupt-cells':
    const: 1

  '#reset-cells':
    const: 1

  ranges: true

  domains:
    description: Sub-node containing domain descriptions.
    type: object
    additionalProperties:
      $ref: '#/definitions/domain'

required:
  - compatible
  - reg
  - interrupts
  - interrupt-controller

allOf:
  - if:
      properties:
        compatible:
          contains:
            const: simple-bus
    then:
      required:
        - ranges

additionalProperties: false

definitions:
  domain:
    description: Power domain description.
    type: object
    properties:
      '#power-domain-cells':
        const: 0
      marvell,pmu_pwr_mask:
        description: Mask value for PMU power register.
        $ref: /schemas/types.yaml#/definitions/uint32
      marvell,pmu_iso_mask:
        description: Mask value for PMU isolation register.
        $ref: /schemas/types.yaml#/definitions/uint32
      resets:
        description: Points to the reset manager (PMU node) and reset index.
        maxItems: 1

    required:
      - '#power-domain-cells'

examples:
  - |
    pmu: power-management@d0000 {
      compatible = "marvell,dove-pmu";
      reg = <0xd0000 0x8000>, <0xd8000 0x8000>;
      interrupts = <33>;
      interrupt-controller;
      #interrupt-cells = <1>;
      #reset-cells = <1>;

      domains {
        vpu_domain: vpu-domain {
          #power-domain-cells = <0>;
          marvell,pmu_pwr_mask = <0x00000008>;
          marvell,pmu_iso_mask = <0x00000001>;
          resets = <&pmu 16>;
        };

        gpu_domain: gpu-domain {
          #power-domain-cells = <0>;
          marvell,pmu_pwr_mask = <0x00000004>;
          marvell,pmu_iso_mask = <0x00000002>;
          resets = <&pmu 18>;
        };
      };
    };
```

## Documentation/devicetree/bindings/soc/fsl/cpm_qe/cpm/fsl,cpm-brg.yaml
```yaml
# SPDX-License-Identifier: (GPL-2.0-only OR BSD-2-Clause)
# Copyright 2025 NXP
%YAML 1.2
---
$id: http://devicetree.org/schemas/soc/fsl/cpm_qe/cpm/fsl,cpm-brg.yaml#
$schema: http://devicetree.org/meta-schemas/core.yaml#

title: Freescale CPM Baud Rate Generator
maintainers:
  - Zhao Qiang <qiang.zhao@nxp.com>

description: |
  * Baud Rate Generators

  Currently defined compatibles:
  fsl,cpm-brg
  fsl,cpm1-brg
  fsl,cpm2-brg

properties:
  compatible:
    items:
      - enum:
          - fsl,cpm-brg
          - fsl,cpm1-brg
          - fsl,cpm2-brg
          - fsl,mpc8272-brg
    description: >
      List of supported compatible strings for this binding.

  reg:
    description: >
      Register specification entries; BRG numbers assigned in order.
    items:
      description: BRG number and its configuration tuple.

  clock-frequency:
    description: >
      Specifies the base frequency driving the BRG.
    $ref: /schemas/types.yaml#/definitions/uint32

required:
  - compatible
  - reg
  - clock-frequency

additionalProperties: false

examples:
  - |
    brg@119f0 {
        compatible = "fsl,mpc8272-brg",
                     "fsl,cpm2-brg",
                     "fsl,cpm-brg";
        reg = <119f0 10 115f0 10>;
        clock-frequency = <d#25000000>;
    };
```

## Documentation/devicetree/bindings/soc/fsl/cpm_qe/cpm/fsl,cpm1-i2c.yaml
```yaml
# SPDX-License-Identifier: (GPL-2.0-only OR BSD-2-Clause)
%YAML 1.2
---
$id: http://devicetree.org/schemas/soc/fsl/cpm_qe/cpm/fsl,cpm1-i2c.yaml#
$schema: http://devicetree.org/meta-schemas/core.yaml#

title: Freescale CPM I2C controller
maintainers:
  - Zhao Qiang <qiang.zhao@nxp.com>

description: |
  The I2C controller is expressed as a bus under the CPM node.

  Properties:
  - compatible: "fsl,cpm1-i2c", "fsl,cpm2-i2c"
  - reg: Base region and CPM parameter RAM region on CPM2 devices
  - #address-cells: One address cell, representing I2C device address with the r/w bit cleared
  - #size-cells: Zero size cells
  - clock-frequency: I2C bus clock frequency in Hz (default 60000)
  - linux,i2c-index: Hard-coded I2C bus number (deprecated)
  - linux,i2c-class: I2C legacy device class number (deprecated)
  - fsl,cpm-command: CPM command register offset

properties:
  compatible:
    oneOf:
      - items:
          - enum:
              - "fsl,cpm1-i2c"
              - "fsl,cpm2-i2c"
  reg:
    items:
      - description: Base address and size
      - description: CPM parameter RAM on CPM2
  '#address-cells':
    const: 1
    description: Address cell count for child I2C devices
  '#size-cells':
    const: 0
    description: Size cell count for child I2C devices
  clock-frequency:
    description: I2C bus clock frequency in Hz
    default: 60000
  interrupts:
    items:
      - description: I2C interrupt
  linux,i2c-index:
    description: Hard-coded I2C bus number
  linux,i2c-class:
    description: I2C legacy device class number
  fsl,cpm-command:
    description: CPM command register offset
    $ref: /schemas/types.yaml#/definitions/uint32

additionalProperties: false

examples:
  - |
    i2c@860 {
        compatible = "fsl,cpm1-i2c", "fsl,cpm2-i2c";
        reg = <0x860 0x20 0x3c80 0x30>;
        interrupts = <16>;
        fsl,cpm-command = <0x10>;
        #address-cells = <1>;
        #size-cells = <0>;
    };
```

## Documentation/devicetree/bindings/soc/fsl/cpm_qe/cpm/fsl,qe-usb.yaml
```yaml
# SPDX-License-Identifier: (GPL-2.0-only OR BSD-2-Clause)
%YAML 1.2
---
$id: http://devicetree.org/schemas/soc/fsl/cpm_qe/cpm/fsl,qe-usb.yaml#
$schema: http://devicetree.org/meta-schemas/core.yaml#

title: Freescale CPM QE USB Controller

maintainers:
  - Zhao Qiang <qiang.zhao@nxp.com>

description: |
  Universal Serial Bus Controller.
  Supports controllers compatible with fsl,cpm1-usb, fsl,cpm2-usb, and fsl,qe-usb.

properties:
  compatible:
    items:
      - enum:
          - fsl,cpm1-usb
          - fsl,cpm2-usb
          - fsl,qe-usb

  reg:
    description: |
      Register base and size pairs: first for the control registers,
      second for the data registers.
    items:
      - description: control registers
      - description: data registers

  interrupts:
    description: |
      Interrupt lines: first TX or combined interrupt, second RX interrupt.
    items:
      - description: tx or combined interrupt
      - description: rx interrupt

  fsl,cpm-command:
    description: CPM command register base address.
    items:
      - description: command register base

additionalProperties: false

examples:
  - |
    usb@11bc0 {
        #address-cells = <1>;
        #size-cells = <0>;
        compatible = "fsl,cpm2-usb";
        reg = <0x11b60 0x18>, <0x8b00 0x100>;
        interrupts = <0xb 0x8>;
        fsl,cpm-command = <0x2e600000>;
    };
```

## Documentation/devicetree/bindings/soc/fsl/cpm_qe/cpm/pic.yaml
```yaml
# SPDX-License-Identifier: (GPL-2.0-only OR BSD-2-Clause)
# Copyright 2025 NXP
%YAML 1.2
---
$id: http://devicetree.org/schemas/soc/fsl/cpm_qe/cpm/pic.yaml#
$schema: http://devicetree.org/meta-schemas/core.yaml#

title: Freescale CPM/QE PIC

maintainers:
  - Zhao Qiang <qiang.zhao@nxp.com>

properties:
  compatible:
    items:
      - enum:
          - fsl,cpm1-pic
          - fsl,pq1-pic
          - fsl,cpm2-pic
          - mpc8272-pic

  reg:
    items:
      - description: Register block for the interrupt controller

  interrupt-controller: true

  '#interrupt-cells':
    enum:
      - 1
      - 2

required:
  - compatible
  - reg
  - interrupt-controller
  - '#interrupt-cells'

additionalProperties: false

examples:
  - |
      interrupt-controller@10c00 {
          compatible = "mpc8272-pic", "fsl,cpm2-pic";
          reg = <0x10c00 0x80>;
          interrupt-controller;
          #interrupt-cells = <2>;
      };
```
