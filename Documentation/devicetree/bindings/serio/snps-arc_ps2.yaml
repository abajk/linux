## Documentation/devicetree/bindings/soc/ti/ti,keystone-navigator-qmss.yaml
```yaml
# SPDX-License-Identifier: (GPL-2.0-only OR BSD-2-Clause)
# Copyright 2018-2025 Texas Instruments
%YAML 1.2
---
$id: http://devicetree.org/schemas/soc/ti/ti,keystone-navigator-qmss.yaml#
$schema: http://devicetree.org/meta-schemas/core.yaml#

title: Texas Instruments Keystone Navigator Queue Management SubSystem
maintainers:
  - Eric Engestrom <eric@engestrom.ch>
  - Mathieu Malaterre <malat@debian.org>
  - Murali Karicheri <m-karicheri2@ti.com>
  - Sandeep Nair <sandeep_n@ti.com>

description: |
  * Texas Instruments Keystone Navigator Queue Management SubSystem driver

  The QMSS (Queue Manager Sub System) found on Keystone SOCs is one of
  the main hardware sub system which forms the backbone of the Keystone
  multi-core Navigator. QMSS consist of queue managers, packed-data structure
  processors (PDSP), linking RAM, descriptor pools and infrastructure
  Packet DMA.
  The Queue Manager is a hardware module that is responsible for accelerating
  management of the packet queues. Packets are queued/de-queued by writing or
  reading descriptor address to a particular memory mapped location. The PDSPs
  perform QMSS related functions like accumulation, QoS, or event management.
  Linking RAM registers are used to link the descriptors which are stored in
  descriptor RAM. Descriptor RAM is configurable as internal or external memory.
  The QMSS driver manages the PDSP setups, linking RAM regions,
  queue pool management (allocation, push, pop and notify) and descriptor
  pool management.

properties:
  compatible:
    items:
      - const: ti,keystone-navigator-qmss
      - const: ti,66ak2g-navss-qm

  clocks:
    description: Reference clock for this device.
    maxItems: 1

  dma-coherent: true

  queue-range:
    description: Total range of queue numbers for the device.
    $ref: /schemas/types.yaml#/definitions/uint32-array
    items:
      - description: Base queue number
        minimum: 0
      - description: Number of queues
        minimum: 0

  linkram0:
    description: Internal link RAM address and total entries.
    $ref: /schemas/types.yaml#/definitions/uint32-array
    items:
      - description: Base address
      - description: Total link RAM entries

  linkram1:
    description: |
      External link RAM address and total entries.
      If entries is 0, memory is allocated by the driver.
    $ref: /schemas/types.yaml#/definitions/uint32-array
    items:
      - description: Base address
      - description: Total link RAM entries

  qmgrs:
    description: Child nodes describing individual queue managers.
    type: object
    additionalProperties: false
    patternProperties:
      '.*':
        type: object
        additionalProperties: false
        properties:
          managed-queues:
            description: Base queue and number of queues managed by this queue manager.
            $ref: /schemas/types.yaml#/definitions/uint32-array
            items:
              - description: Base queue number
                minimum: 0
              - description: Number of queues
                minimum: 0
          reg:
            description: Address and size of register regions for this queue manager.
            items:
              - description: Queue Peek region
              - description: Queue status RAM
              - description: Queue configuration region
              - description: Descriptor memory setup region
              - description: Queue Management/Queue Proxy region for queue Push
              - description: Queue Management/Queue Proxy region for queue Pop
        required:
          - managed-queues
          - reg

  queue-pools:
    description: Child node classifying queue ranges into pools.
    type: object
    additionalProperties: false
    patternProperties:
      '.*':
        type: object
        additionalProperties: false
        properties:
          qrange:
            description: Base queue and number of queues for this range.
            $ref: /schemas/types.yaml#/definitions/uint32-array
            items:
              - description: Base queue number
                minimum: 0
              - description: Number of queues
                minimum: 0
          interrupts:
            maxItems: 1
            
          qalloc-by-id:
            description: Queues in this range can only be allocated by queue id.
            type: boolean
          accumulator:
            description: Accumulator channel specification.
            $ref: /schemas/types.yaml#/definitions/uint32-array
            items:
              - description: PDSP id
              - description: Channel
              - description: Number of entries
              - description: Pacing mode
              - description: Latency in microseconds
        required:
          - qrange

  descriptor-regions:
    description: Child node describing memory regions for packet DMA descriptors.
    type: object
    additionalProperties: false
    patternProperties:
      '.*':
        type: object
        additionalProperties: false
        properties:
          id:
            description: Region number in QMSS.
            $ref: /schemas/types.yaml#/definitions/uint32
          region-spec:
            description: Number of descriptors and descriptor size.
            $ref: /schemas/types.yaml#/definitions/uint32-array
            items:
              - description: Number of descriptors
              - description: Descriptor size in bytes
          link-index:
            description: Index of the first descriptor in the region.
            $ref: /schemas/types.yaml#/definitions/uint32
        required:
          - id
          - region-spec
          - link-index

  pdsps:
    description: Child node describing the PDSP configuration.
    type: object
    additionalProperties: false
    patternProperties:
      '.*':
        type: object
        additionalProperties: false
        properties:
          firmware:
            description: Firmware to be loaded on the PDSP.
            $ref: /schemas/types.yaml#/definitions/string
          id:
            description: QMSS PDSP id.
            $ref: /schemas/types.yaml#/definitions/uint32
          reg:
            description: Address and size of the register set for the PDSP.
            items:
              - description: PDSP internal RAM region
              - description: PDSP control/status region registers
              - description: QMSS interrupt distributor registers
              - description: PDSP command interface region
        required:
          - reg
          - id

required:
  - compatible
  - clocks
  - queue-range
  - linkram0
  - linkram1
  - qmgrs
  - queue-pools
  - descriptor-regions

additionalProperties: false
```

## Documentation/devicetree/bindings/sound/adi,adau1701.yaml
```yaml
# SPDX-License-Identifier: (GPL-2.0-only OR BSD-2-Clause)
%YAML 1.2
---
$id: http://devicetree.org/schemas/adi,adau1701.yaml#
$schema: http://devicetree.org/meta-schemas/core.yaml#

title: Analog Devices ADAU1701

maintainers:
  - Daniel Mack <zonque@gmail.com>
  - Pascal Huerst <pascal.huerst@gmail.com>

description: |
  Analog Devices ADAU1701

properties:
  compatible:
    items:
      - const: adi,adau1701

  reg:
    description: I2C address depending on ADDR0 and ADDR1 wiring.
    items:
      - description: I2C 7-bit address of the ADAU1701

  reset-gpio:
    description: GPIO connected to the !RESET pin.
    maxItems: 1

  adi,pll-mode-gpios:
    description: GPIO lines controlling the PLL mode pins before firmware load.
    items:
      - description: PLL mode pin 0
      - description: PLL mode pin 1

  adi,pin-config:
    description: |
      Pin configuration array of 12 values as described in datasheet table 53.
      Values must be prefixed with '/bits/ 8'.
    items:
      - description: Configuration for pin 1
      - description: Configuration for pin 2
      - description: Configuration for pin 3
      - description: Configuration for pin 4
      - description: Configuration for pin 5
      - description: Configuration for pin 6
      - description: Configuration for pin 7
      - description: Configuration for pin 8
      - description: Configuration for pin 9
      - description: Configuration for pin 10
      - description: Configuration for pin 11
      - description: Configuration for pin 12

  avdd-supply:
    description: Power supply for AVDD, providing 3.3V

  dvdd-supply:
    description: Power supply for DVDD, providing 3.3V

required:
  - compatible
  - reg

additionalProperties: false

examples:
  - |
    i2c_bus {
        adau1701@34 {
            compatible = "adi,adau1701";
            reg = <0x34>;
            reset-gpio = <&gpio 23 0>;
            avdd-supply = <&vdd_3v3_reg>;
            dvdd-supply = <&vdd_3v3_reg>;
            adi,pll-mode-gpios = <&gpio 24 0 &gpio 25 0>;
            adi,pin-config = /bits/ 8 <0x4 0x7 0x5 0x5 0x4 0x4
                                 0x4 0x4 0x4 0x4 0x4 0x4>;
        };
    };
```

## Documentation/devicetree/bindings/sound/adi,axi-i2s-1.00.a.yaml
```yaml
# SPDX-License-Identifier: (GPL-2.0-only OR BSD-2-Clause)
%YAML 1.2
---
$id: http://devicetree.org/schemas/sound/adi,axi-i2s-1.00.a.yaml#
$schema: http://devicetree.org/meta-schemas/core.yaml#

title: ADI AXI-I2S controller

maintainers:
  - Lars-Peter Clausen <lars@metafoo.de>
  - Luca Ceresoli <luca.ceresoli@bootlin.com>
  - Mathieu Malaterre <malat@debian.org>

description: |
  ADI AXI-I2S controller

  The core can be generated with transmit (playback), only receive (capture) or both directions enabled.

  Required properties:
    - compatible: Must be "adi,axi-i2s-1.00.a"
    - reg: Must contain I2S core's registers location and length
    - clocks: Pairs of phandle and specifier referencing the controller's clocks.
      The controller expects two clocks, the clock used for the AXI interface and the
      clock used as the sampling rate reference clock.
    - clock-names: "axi" for the clock to the AXI interface, "ref" for the sampling rate reference clock.
    - dmas: Pairs of phandle and specifier for the DMA channels that are used by the core.
      The core expects two DMA channels if both transmit and receive are enabled,
      one channel otherwise.
    - dma-names: "tx" for the transmit channel, "rx" for the receive channel.

  For more details on the 'dma', 'dma-names', 'clock' and 'clock-names' properties please check:
    * resource-names.txt
    * clock/clock-bindings.txt
    * dma/dma.txt

properties:
  compatible:
    const: adi,axi-i2s-1.00.a

  reg:
    items:
      - description: Base address of the I2S core register block
      - description: Size of the I2S core register block

  clocks:
    description: A list of two phandle and specifier tuples for the clocks required by the controller.
    items:
      - description: Clock for the AXI interface
      - description: Sampling rate reference clock

  clock-names:
    items:
      - const: axi
      - const: ref

  dmas:
    description: DMA channels used by the controller.
    items:
      - description: Transmit DMA channel phandle and specifier
      - description: Receive DMA channel phandle and specifier

  dma-names:
    items:
      - const: tx
      - const: rx

required:
  - compatible
  - reg
  - clocks
  - clock-names
  - dmas
  - dma-names

additionalProperties: false

examples:
  - |
    i2s: i2s@77600000 {
        compatible = "adi,axi-i2s-1.00.a";
        reg = <0x77600000 0x1000>;
        clocks = <&clk 15>, <&audio_clock>;
        clock-names = "axi", "ref";
        dmas = <&ps7_dma 0>, <&ps7_dma 1>;
        dma-names = "tx", "rx";
    };
```

## Documentation/devicetree/bindings/sound/adi,axi-spdif-tx-1.00.a.yaml
```yaml
# SPDX-License-Identifier: (GPL-2.0-only OR BSD-2-Clause)
%YAML 1.2
---
$id: http://devicetree.org/schemas/sound/adi,axi-spdif-tx-1.00.a.yaml#
$schema: http://devicetree.org/meta-schemas/core.yaml#

title: ADI AXI-SPDIF controller

maintainers:
  - Andreas Färber <afaerber@suse.de>
  - Lars-Peter Clausen <lars@metafoo.de>
  - Mathieu Malaterre <malat@debian.org>

description: |
  ADI AXI-SPDIF controller

  For more details on the 'dma', 'dma-names', 'clock' and 'clock-names' properties
  please check:
    * resource-names.txt
    * clock/clock-bindings.txt
    * dma/dma.txt

properties:
  compatible:
    enum:
      - adi,axi-spdif-tx-1.00.a

  reg:
    items:
      - description: SPDIF core registers

  clocks:
    items:
      - description: AXI interface clock
      - description: sampling reference clock

  clock-names:
    items:
      - const: axi
      - const: ref

  dmas:
    items:
      - description: transmit DMA channel

  dma-names:
    items:
      - const: tx

required:
  - compatible
  - reg
  - clocks
  - clock-names
  - dmas
  - dma-names

additionalProperties: false

examples:
  - |
    spdif: spdif@77400000 {
        compatible = "adi,axi-spdif-tx-1.00.a";
        reg = <0x77600000 0x1000>;
        clocks = <&clk 15>, <&audio_clock>;
        clock-names = "axi", "ref";
        dmas = <&ps7_dma 0>;
        dma-names = "tx";
    };
```

## Documentation/devicetree/bindings/sound/adi,ssm2305.yaml
```yaml
# SPDX-License-Identifier: (GPL-2.0-only OR BSD-2-Clause)
# Copyright 2025 Marco Felsch <m.felsch@pengutronix.de>
%YAML 1.2
---
$id: http://devicetree.org/schemas/sound/adi,ssm2305.yaml#
$schema: http://devicetree.org/meta-schemas/core.yaml#

title: Analog Devices SSM2305 Speaker Amplifier

maintainers:
  - Marco Felsch <m.felsch@pengutronix.de>

description: |
  Analog Devices SSM2305 Speaker Amplifier

properties:
  compatible:
    items:
      - const: adi,ssm2305

  shutdown-gpios:
    description: |
      The gpio connected to the shutdown pin.
      The gpio signal is ACTIVE_LOW.
    maxItems: 1

required:
  - compatible
  - shutdown-gpios

additionalProperties: false

examples:
  - |
    ssm2305: analog-amplifier {
        compatible = "adi,ssm2305";
        shutdown-gpios = <&gpio3 20 GPIO_ACTIVE_LOW>;
    };
```

## Documentation/devicetree/bindings/sound/adi,ssm2602.yaml
```yaml
# SPDX-License-Identifier: (GPL-2.0-only OR BSD-2-Clause)
# Copyright 2025 Stefan Kristiansson
%YAML 1.2
---
$id: http://devicetree.org/schemas/adi,ssm2602.yaml#
$schema: http://devicetree.org/meta-schemas/core.yaml#

title: Analog Devices SSM2602, SSM2603 and SSM2604 I2S audio CODEC devices
maintainers:
  - Stefan Kristiansson <stefan.kristiansson@saunalahti.fi>

description: |
  Analog Devices SSM2602, SSM2603 and SSM2604 I2S audio CODEC devices

  SSM2602 support both I2C and SPI as the configuration interface,
  the selection is made by the MODE strap-in pin.
  SSM2603 and SSM2604 only support I2C as the configuration interface.

properties:
  compatible:
    description: Device compatible identifier
    items:
      - enum: ["adi,ssm2602", "adi,ssm2603", "adi,ssm2604"]
  reg:
    description: I2C address for I2C or SPI chip select number for SPI
    items:
      - description: Address or chip select

required:
  - compatible
  - reg

additionalProperties: false

examples:
  - |
    ssm2602: ssm2602@1a {
        compatible = "adi,ssm2602";
        reg = <0x1a>;
    };
```
