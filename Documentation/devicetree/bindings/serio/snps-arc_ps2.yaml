## Documentation/devicetree/bindings/sound/adi,ssm4567.yaml
```yaml
# SPDX-License-Identifier: (GPL-2.0-only OR BSD-2-Clause)
%YAML 1.2
---
$id: http://devicetree.org/schemas/sound/adi,ssm4567.yaml#
$schema: http://devicetree.org/meta-schemas/core.yaml#

title: Analog Devices SSM4567 audio amplifier

maintainers:
  - Anatol Pomozov <anatol.pomozov@gmail.com>

description: |
  Analog Devices SSM4567 audio amplifier

  This device supports I2C only.

properties:
  compatible:
    items:
      - const: adi,ssm4567
  reg:
    items:
      - description: |
          The I2C address of the device. It will be one of:
          - 0x34 (LR_SEL/ADDR connected to AGND)
          - 0x35 (LR_SEL/ADDR connected to IOVDD)
          - 0x36 (LR_SEL/ADDR open)

required:
  - compatible
  - reg

additionalProperties: false

examples:
  - |
    ssm4567: ssm4567@34 {
        compatible = "adi,ssm4567";
        reg = <0x34>;
    };
```
