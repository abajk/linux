## Documentation/devicetree/bindings/soc/fsl/cpm_qe/fsl,cpm1-pario-bank-a.yaml
```yaml
# SPDX-License-Identifier: (GPL-2.0-only OR BSD-2-Clause)
# Copyright 2018 Linaro Ltd.
%YAML 1.2
---
$id: http://devicetree.org/schemas/soc/fsl/cpm_qe/fsl,cpm1-pario-bank-a.yaml#
$schema: http://devicetree.org/meta-schemas/core.yaml#

title: Freescale CPM QE GPIO Controller Banks
maintainers:
  - Christophe Leroy <christophe.leroy@c-s.fr>
  - Rob Herring <robh@kernel.org>
  - Zhao Qiang <qiang.zhao@nxp.com>

description: |
  Every GPIO controller node must have #gpio-cells property defined,
  this information will be used to translate gpio-specifiers.

  On CPM1 devices, all ports are using slightly different register layouts.
  Ports A, C and D are 16bit ports and Ports B and E are 32bit ports.

  On CPM2 devices, all ports are 32bit ports and use a common register layout.

properties:
  compatible:
    description: Must be one of the supported compatible strings.
    enum:
      - fsl,cpm1-pario-bank-a
      - fsl,cpm1-pario-bank-b
      - fsl,cpm1-pario-bank-c
      - fsl,cpm1-pario-bank-d
      - fsl,cpm1-pario-bank-e
      - fsl,cpm2-pario-bank

  '#gpio-cells':
    description: >
      Should be two. The first cell is the pin number and the
      second cell is used to specify optional parameters (currently unused).
    const: 2

  gpio-controller: true

  reg:
    items:
      - description: Register base address.
      - description: Register size.

  fsl,cpm1-gpio-irq-mask:
    description: >
      For banks having interrupt capability (like port C on CPM1), this item
      tells which ports have an associated interrupt (ports are listed in the
      same order as in the PCINT register).
    $ref: /schemas/types.yaml#/definitions/uint32-array
    items:
      - description: Mask of GPIO interrupt lines.

  interrupts:
    description: >
      This property provides the list of interrupts for each GPIO having one
      as described by the fsl,cpm1-gpio-irq-mask property. The first interrupt
      in the list corresponds to the most significant bit of the mask.
    items:
      - description: GPIO interrupt specifier.

required:
  - compatible
  - '#gpio-cells'
  - gpio-controller

additionalProperties: false

examples:
  - |
    CPM1_PIO_A: gpio-controller@950 {
      #gpio-cells = <2>;
      compatible = "fsl,cpm1-pario-bank-a";
      reg = <0x950 0x10>;
      gpio-controller;
    };

    CPM1_PIO_B: gpio-controller@ab8 {
      #gpio-cells = <2>;
      compatible = "fsl,cpm1-pario-bank-b";
      reg = <0xab8 0x10>;
      gpio-controller;
    };

    CPM1_PIO_C: gpio-controller@960 {
      #gpio-cells = <2>;
      compatible = "fsl,cpm1-pario-bank-c";
      reg = <0x960 0x10>;
      fsl,cpm1-gpio-irq-mask = <0x0fff>;
      interrupts = <1 2 6 9 10 11 14 15 23 24 26 31>;
      gpio-controller;
    };

    CPM1_PIO_E: gpio-controller@ac8 {
      #gpio-cells = <2>;
      compatible = "fsl,cpm1-pario-bank-e";
      reg = <0xac8 0x18>;
      gpio-controller;
    };
```

## Documentation/devicetree/bindings/soc/fsl/cpm_qe/fsl,cpm1-smc-uart.yaml
```yaml
# SPDX-License-Identifier: (GPL-2.0-only OR BSD-2-Clause)
# Copyright 2025 NXP
%YAML 1.2
---
$id: http://devicetree.org/schemas/soc/fsl/cpm_qe/fsl,cpm1-smc-uart.yaml#
$schema: http://devicetree.org/meta-schemas/core.yaml#

title: Serial CPM UART

maintainers:
  - Zhao Qiang <qiang.zhao@nxp.com>

description: |
  Modem control lines connected to GPIO controllers are listed in the gpios
  property as described in booting-without-of.txt, section IX.1 in the following
  order:

  CTS, RTS, DCD, DSR, DTR, and RI.

  The gpios property is optional and can be left out when control lines are
  not used.

properties:
  device_type:
    const: serial

  compatible:
    items:
      - enum:
          - fsl,cpm1-smc-uart
          - fsl,cpm2-smc-uart
          - fsl,cpm1-scc-uart
          - fsl,cpm2-scc-uart
          - fsl,qe-uart
          - fsl,mpc8272-scc-uart
    description: Identifies the device as a Freescale CPM UART.

  reg:
    description: Base and size for core and auxiliary CPM registers.
    items:
      - description: CPM core registers.
      - description: CPM auxiliary registers.

  interrupts:
    maxItems: 1

  gpios:
    description: "Modem control lines in order: CTS, RTS, DCD, DSR, DTR, RI."
    minItems: 1
    maxItems: 6

  fsl,cpm-brg:
    description: Baud rate generator setting.
    $ref: /schemas/types.yaml#/definitions/uint32

  fsl,cpm-command:
    description: CPM command register value.
    $ref: /schemas/types.yaml#/definitions/uint32

additionalProperties: false

examples:
  - |
    serial@11a00 {
        device_type = "serial";
        compatible = "fsl,mpc8272-scc-uart", "fsl,cpm2-scc-uart";
        reg = <0x11a00 0x20 0x8000 0x100>;
        interrupts = <28 8>;
        fsl,cpm-brg = <1>;
        fsl,cpm-command = <0x00800000>;
        gpios = <&gpio_c 15 0>, <&gpio_d 29 0>;
    };
```

## Documentation/devicetree/bindings/soc/fsl/cpm_qe/fsl,cpm1.yaml
```yaml
# SPDX-License-Identifier: (GPL-2.0-only OR BSD-2-Clause)
# Copyright 2025 NXP
%YAML 1.2
---
$id: http://devicetree.org/schemas/soc/fsl/cpm_qe/fsl,cpm1.yaml#
$schema: http://devicetree.org/meta-schemas/core.yaml#

title: Freescale Communications Processor Module
maintainers:
  - Zhao Qiang <qiang.zhao@nxp.com>

description: |
  * Freescale Communications Processor Module

  NOTE: This is an interim binding, and will likely change slightly,
  as more devices are supported.  The QE bindings especially are
  incomplete.

  * Root CPM node

  * Multi-User RAM (MURAM)

  The multi-user/dual-ported RAM is expressed as a bus under the CPM node.

  Ranges must be set up subject to the following restrictions:

  - Children's reg nodes must be offsets from the start of all muram, even
    if the user-data area does not begin at zero.
  - If multiple range entries are used, the difference between the parent
    address and the child address must be the same in all, so that a single
    mapping can cover them all while maintaining the ability to determine
    CPM-side offsets with pointer subtraction.  It is recommended that
    multiple range entries not be used.
  - A child address of zero must be translatable, even if no reg resources
    contain it.

  A child "data" node must exist, compatible with "fsl,cpm-muram-data", to
  indicate the portion of muram that is usable by the OS for arbitrary
  purposes.  The data node may have an arbitrary number of reg resources,
  all of which contribute to the allocatable muram pool.

properties:
  compatible:
    description: Device compatibility.
    oneOf:
      - items:
          - enum:
              - fsl,mpc8272-cpm
          - const: fsl,cpm2
      - items:
          - const: fsl,cpm1
      - items:
          - const: fsl,cpm2
      - items:
          - const: fsl,qe

  reg:
    maxItems: 1

  fsl,cpm-command:
    description: |
      ORed with the opcode and command flag to specify the device on which a
      CPM command operates.
    $ref: /schemas/types.yaml#/definitions/uint32

  fsl,cpm-brg:
    description: |
      Indicates which baud rate generator the device is associated with. If
      absent, an unused BRG should be dynamically allocated. If zero, the
      device uses an external clock rather than a BRG.
    $ref: /schemas/types.yaml#/definitions/uint32

patternProperties:
  "^muram@.*$":
    description: Multi-user RAM bus under the CPM node.
    type: object
    additionalProperties: false
    properties:
      ranges: true

    required: [ranges]
    patternProperties:
      "^data@.*$":
        description: Portion of MURAM usable by the OS.
        type: object
        additionalProperties: false
        properties:
          compatible:
            enum: ["fsl,cpm-muram-data"]
          reg:
            maxItems: 1

        required: [compatible, reg]

additionalProperties: false

examples:
  - |
    cpm@119c0 {
        #address-cells = <1>;
        #size-cells = <1>;
        #interrupt-cells = <2>;
        compatible = "fsl,mpc8272-cpm", "fsl,cpm2";
        reg = <0x119c0 0x30>;
    };
  - |
    muram@0 {
        #address-cells = <1>;
        #size-cells = <1>;
        ranges = <0 0 10000>;

        data@0 {
            compatible = "fsl,cpm-muram-data";
            reg = <0 2000 9800 800>;
        };
    };
```

## Documentation/devicetree/bindings/soc/fsl/cpm_qe/fsl,t1040-ucc-uart.yaml
```yaml
# SPDX-License-Identifier: (GPL-2.0-only OR BSD-2-Clause)
# Copyright 2025 NXP Semiconductors
%YAML 1.2
---
$id: http://devicetree.org/schemas/soc/fsl/cpm_qe/fsl,t1040-ucc-uart.yaml#
$schema: http://devicetree.org/meta-schemas/core.yaml#

title: Freescale UCC UART

maintainers:
  - Zhao Qiang <qiang.zhao@nxp.com>

description: |
  * Serial

properties:
  compatible:
    items:
      - const: "fsl,t1040-ucc-uart"
    description: |
      Freescale UCC-UART binding compatible string.

  port-number:
    description: |
      Port number of the UCC-UART.
    $ref: /schemas/types.yaml#/definitions/uint32

  rx-clock-name:
    description: |
      Name of the receive clock source.

  tx-clock-name:
    description: |
      Name of the transmit clock source.

additionalProperties: false

examples:
  - |
    ucc_serial: ucc@2200 {
        compatible = "fsl,t1040-ucc-uart";
        port-number = <0>;
        rx-clock-name = "brg2";
        tx-clock-name = "brg2";
    };
```

## Documentation/devicetree/bindings/soc/fsl/cpm_qe/qe/fsl,mpc8323-qe-usb.yaml
```yaml
# SPDX-License-Identifier: (GPL-2.0-only OR BSD-2-Clause)
%YAML 1.2
---
$id: http://devicetree.org/schemas/soc/fsl/cpm_qe/qe/fsl,mpc8323-qe-usb.yaml#
$schema: http://devicetree.org/meta-schemas/core.yaml#

title: Freescale QUICC Engine USB Controller

maintainers:
  - Rob Herring <robh@kernel.org>
  - Zhao Qiang <qiang.zhao@nxp.com>

description: |
  Freescale QUICC Engine USB Controller

properties:
  compatible:
    items:
      - pattern: '^fsl,.*-qe-usb$'
      - const: fsl,mpc8323-qe-usb

  reg:
    description: Register window and PRAM ranges.
    items:
      - description: USB registers location and length
      - description: PRAM location and length

  interrupts:
    maxItems: 1

  interrupt-controller: true

  fsl,fullspeed-clock:
    $ref: /schemas/types.yaml#/definitions/string
    description: Full speed USB clock source.
    enum:
      - none
      - brg1
      - brg2
      - brg3
      - brg4
      - brg5
      - brg6
      - brg7
      - brg8
      - brg9
      - brg10
      - brg11
      - brg12
      - brg13
      - brg14
      - brg15
      - brg16
      - clk1
      - clk2
      - clk3
      - clk4
      - clk5
      - clk6
      - clk7
      - clk8
      - clk9
      - clk10
      - clk11
      - clk12
      - clk13
      - clk14
      - clk15
      - clk16
      - clk17
      - clk18
      - clk19
      - clk20
      - clk21
      - clk22
      - clk23
      - clk24

  fsl,lowspeed-clock:
    $ref: /schemas/types.yaml#/definitions/string
    description: Low speed USB clock source.
    enum:
      - none
      - brg1
      - brg2
      - brg3
      - brg4
      - brg5
      - brg6
      - brg7
      - brg8
      - brg9
      - brg10
      - brg11
      - brg12
      - brg13
      - brg14
      - brg15
      - brg16
      - clk1
      - clk2
      - clk3
      - clk4
      - clk5
      - clk6
      - clk7
      - clk8
      - clk9
      - clk10
      - clk11
      - clk12
      - clk13
      - clk14
      - clk15
      - clk16
      - clk17
      - clk18
      - clk19
      - clk20
      - clk21
      - clk22
      - clk23
      - clk24

  hub-power-budget:
    $ref: /schemas/types.yaml#/definitions/uint32
    description: USB root hub power budget in mA.

  gpios:
    description: GPIOs for USBOE, USBTP, USBTN, USBRP, USBRN, optional SPEED and POWER.
    items:
      - description: USBOE
      - description: USBTP
      - description: USBTN
      - description: USBRP
      - description: USBRN
      - description: SPEED (optional)
      - description: POWER (optional)
      
additionalProperties: false

examples:
  - |
    usb@6c0 {
        compatible = "fsl,mpc8360-qe-usb", "fsl,mpc8323-qe-usb";
        reg = <0x6c0 0x40 0x8b00 0x100>;
        interrupts = <11>;
        fsl,fullspeed-clock = "clk21";
        gpios = <&qe_pio_b  2 0 /* USBOE */
                 &qe_pio_b  3 0 /* USBTP */
                 &qe_pio_b  8 0 /* USBTN */
                 &qe_pio_b  9 0 /* USBRP */
                 &qe_pio_b 11 0 /* USBRN */
                 &qe_pio_e 20 0 /* SPEED */
                 &qe_pio_e 21 0 /* POWER */>;
    };
```

## Documentation/devicetree/bindings/soc/fsl/cpm_qe/qe/fsl,mpc8360-qe-pario-bank.yaml
```yaml
# SPDX-License-Identifier: (GPL-2.0-only OR BSD-2-Clause)
# Copyright 2025 NXP
%YAML 1.2
---
$id: http://devicetree.org/schemas/fsl,mpc8360-qe-pario-bank.yaml#
$schema: http://devicetree.org/meta-schemas/core.yaml#

title: QE Parallel I/O Bank
maintainers:
  - Marco Franchi <marco.franchi@nxp.com>
  - Zhao Qiang <qiang.zhao@nxp.com>

description: |
  * Parallel I/O Ports

  This node configures Parallel I/O ports for CPUs with QE support.
  The node should reside in the "soc" node of the tree.  For each
  device that using parallel I/O ports, a child node should be created.
  See the definition of the Pin configuration nodes below for more
  information.

  Note that "par_io" nodes are obsolete, and should not be used for
  the new device trees.  Instead, each Par I/O bank should be represented
  via its own gpio-controller node:

properties:
  compatible:
    description: Device compatible strings for the QE parallel I/O bank.
    items:
      - enum:
          - "fsl,mpc8360-qe-pario-bank"
          - "fsl,mpc8323-qe-pario-bank"

  '#gpio-cells':
    const: 2
    description: Number of GPIO specifier cells, must be 2.

  reg:
    description: Register address and size.
    items:
      - description: Register offset.
      - description: Register length.

  gpio-controller: true
    # The core schema checks this is a boolean, so just have to list it here to be valid for this binding.

required:
  - compatible
  - '#gpio-cells'
  - reg
  - gpio-controller

additionalProperties: false

examples:
  - |
    qe_pio_a: gpio-controller@1400 {
        #gpio-cells = <2>;
        compatible = "fsl,mpc8360-qe-pario-bank",
                     "fsl,mpc8323-qe-pario-bank";
        reg = <0x1400 0x18>;
        gpio-controller;
    };
```
