## Documentation/devicetree/bindings/soc/fsl/cpm_qe/qe/ucc_geth.yaml
```yaml
# SPDX-License-Identifier: (GPL-2.0-only OR BSD-2-Clause)
%YAML 1.2
---
$id: http://devicetree.org/schemas/ucc_geth.yaml#
$schema: http://devicetree.org/meta-schemas/core.yaml#

title: Unified Communications Controller (UCC)

maintainers:
  - Rob Herring <robh@kernel.org>
  - Zhao Qiang <qiang.zhao@nxp.com>

description: |
  * UCC (Unified Communications Controllers)

  Required properties:

  The following two properties are deprecated. rx-clock has been replaced
  with rx-clock-name, and tx-clock has been replaced with tx-clock-name.
  Drivers that currently use the deprecated properties should continue to
  do so, in order to support older device trees, but they should be updated
  to check for the new properties first.

  Required properties for network device_type:

  Recommended properties:

properties:
  compatible:
    items:
      - enum: [ ucc_geth, fsl_atm ]
  device_type:
    description: The interface type for this controller.
    enum: [ network, hldc, uart, transparent, bisync, atm, serial ]

  cell-index:
    description: The UCC number (1–8), corresponding to UCCx in the user manual.
    $ref: /schemas/types.yaml#/definitions/uint32

  reg:
    maxItems: 1

  interrupts:
    maxItems: 1

  pio-handle:
    description: The phandle for the Parallel I/O port configuration.
    $ref: /schemas/types.yaml#/definitions/phandle
  port-number:
    description: For UART drivers, the port number (0–3) to use.
    $ref: /schemas/types.yaml#/definitions/uint32
  soft-uart:
    description: Enable Soft‐UART mode via microcode upload for broken hardware.
    type: boolean
  rx-clock-name:
    description: The UCC receive clock source.
    $ref: /schemas/types.yaml#/definitions/string
    enum:
      - none
      - brg1
      - brg2
      - brg3
      - brg4
      - brg5
      - brg6
      - brg7
      - brg8
      - brg9
      - brg10
      - brg11
      - brg12
      - brg13
      - brg14
      - brg15
      - brg16
      - clk1
      - clk2
      - clk3
      - clk4
      - clk5
      - clk6
      - clk7
      - clk8
      - clk9
      - clk10
      - clk11
      - clk12
      - clk13
      - clk14
      - clk15
      - clk16
      - clk17
      - clk18
      - clk19
      - clk20
      - clk21
      - clk22
      - clk23
      - clk24
  tx-clock-name:
    description: The UCC transmit clock source.
    $ref: /schemas/types.yaml#/definitions/string
    enum:
      - none
      - brg1
      - brg2
      - brg3
      - brg4
      - brg5
      - brg6
      - brg7
      - brg8
      - brg9
      - brg10
      - brg11
      - brg12
      - brg13
      - brg14
      - brg15
      - brg16
      - clk1
      - clk2
      - clk3
      - clk4
      - clk5
      - clk6
      - clk7
      - clk8
      - clk9
      - clk10
      - clk11
      - clk12
      - clk13
      - clk14
      - clk15
      - clk16
      - clk17
      - clk18
      - clk19
      - clk20
      - clk21
      - clk22
      - clk23
      - clk24
  rx-clock:
    description: >
      Deprecated receive clock encoding (0x00: disabled;
      0x1–0x10: BRG1–BRG16; 0x11–0x28: QE_CLK1–QE_CLK24).
    $ref: /schemas/types.yaml#/definitions/uint32
  tx-clock:
    description: >
      Deprecated transmit clock encoding (0x00: disabled;
      0x1–0x10: BRG1–BRG16; 0x11–0x28: QE_CLK1–QE_CLK24).
    $ref: /schemas/types.yaml#/definitions/uint32

  phy-connection-type:
    enum: [ mii, rmii, gmii, rgmii, rgmii-id, rgmii-txid, rgmii-rxid, tbi, rtbi ]

required:
  - device_type
  - compatible
  - cell-index
  - reg
  - interrupts
  - pio-handle

allOf:
  - if:
      properties:
        device_type:
          enum: [ uart ]
    then:
      required: [ port-number ]
  - if:
      properties:
        device_type:
          enum: [ network ]
    then:
      required: [ mac-address, phy-handle ]

additionalProperties: false

examples:
  - |
    ucc@2000 {
        device_type = "network";
        compatible = "ucc_geth";
        cell-index = <1>;
        reg = <2000 200>;
        interrupts = <10 0>;
        mac-address = [ 00 04 9f 00 23 23 ];
        rx-clock-name = "none";
        tx-clock-name = "clk9";
        phy-handle = <212000>;
        phy-connection-type = "gmii";
        pio-handle = <140001>;
    };
```

## Documentation/devicetree/bindings/soc/fsl/guts.yaml
```yaml
# SPDX-License-Identifier: (GPL-2.0-only OR BSD-2-Clause)
%YAML 1.2
---
$id: http://devicetree.org/schemas/soc/fsl/guts.yaml#
$schema: http://devicetree.org/meta-schemas/core.yaml#

title: Freescale/NXP Global Utilities Block

maintainers:
  - yangbo lu <yangbo.lu@nxp.com>

description: |
  The global utilities block controls power management, I/O device
  enabling, power-on-reset configuration monitoring, general-purpose
  I/O signal configuration, alternate function selection for multiplexed
  signals, and clock control.

properties:
  compatible:
    description: Device compatible strings supported by this binding.
    items:
      - const: fsl,qoriq-device-config-1.0
      - const: fsl,qoriq-device-config-2.0
      - pattern: '^fsl,[^,]+-device-config$'
      - pattern: '^fsl,[^,]+-guts$'
  reg:
    description: Offset and length of the register set for the device.
    items:
      - description: core registers
  fsl,has-rstcr:
    description: |
      Indicates that the global utilities register set contains a functioning
      "reset control register" (i.e. the board is wired to reset upon setting
      the HRESET_REQ bit in this register).
    type: boolean
  fsl,liodn-bits:
    description: Indicates the number of defined bits in the LIODN registers.
  little-endian:
    description: Indicates that the global utilities block is little endian. The default is big endian.
    type: boolean

required:
  - compatible
  - reg

additionalProperties: false

examples:
  - |
    global-utilities@e0000 {
        compatible = "fsl,mpc8548-guts";
        reg = <0xe0000 0xe00>;
        fsl,has-rstcr;
        #sleep-cells = <1>;
        fsl,liodn-bits = <12>;
    };
```

## Documentation/devicetree/bindings/soc/mediatek/mediatek,mt2701-scpsys.yaml
```yaml
# SPDX-License-Identifier: (GPL-2.0-only OR BSD-2-Clause)
%YAML 1.2
---
$id: http://devicetree.org/schemas/soc/mediatek/mediatek,mt2701-scpsys.yaml#
$schema: http://devicetree.org/meta-schemas/core.yaml#

title: MediaTek SCPSYS

maintainers:
  - James Liao <jamesjj.liao@mediatek.com>
  - Krzysztof Kozlowski <krzk@kernel.org>
  - Mars Cheng <mars.cheng@mediatek.com>
  - Ryder Lee <ryder.lee@mediatek.com>
  - Sascha Hauer <s.hauer@pengutronix.de>
  - Sean Wang <sean.wang@mediatek.com>
  - Shunli Wang <shunli.wang@mediatek.com>
  - weiyi.lu@mediatek.com <weiyi.lu@mediatek.com>
  - Yassine Oudjana <y.oudjana@protonmail.com>

description: |
  MediaTek SCPSYS
  ===============

  The System Control Processor System (SCPSYS) has several power management
  related tasks in the system. The tasks include thermal measurement, dynamic
  voltage frequency scaling (DVFS), interrupt filter and lowlevel sleep control.
  The System Power Manager (SPM) inside the SCPSYS is for the MTCMOS power
  domain control.

  The driver implements the Generic PM domain bindings described in
  power/power-domain.yaml. It provides the power domains defined in
  - include/dt-bindings/power/mt8173-power.h
  - include/dt-bindings/power/mt6797-power.h
  - include/dt-bindings/power/mt6765-power.h
  - include/dt-bindings/power/mt2701-power.h
  - include/dt-bindings/power/mt2712-power.h
  - include/dt-bindings/power/mt7622-power.h

properties:
  compatible:
    oneOf:
      - items:
          - enum:
              - "mediatek,mt2701-scpsys"
              - "mediatek,mt2712-scpsys"
              - "mediatek,mt6735-scpsys"
              - "mediatek,mt6765-scpsys"
              - "mediatek,mt6797-scpsys"
              - "mediatek,mt7622-scpsys"
              - "mediatek,mt7623a-scpsys"
              - "mediatek,mt8173-scpsys"
      - items:
          - const: "mediatek,mt7623-scpsys"
          - const: "mediatek,mt2701-scpsys"
      - items:
          - const: "mediatek,mt7629-scpsys"
          - const: "mediatek,mt7622-scpsys"

  '#power-domain-cells':
    description: Always 1
    const: 1

  reg:
    items:
      - description: Register base address
      - description: Register size

  infracfg:
    description: Infrastructure configuration controller phandle
    $ref: /schemas/types.yaml#/definitions/phandle

  clocks:
    maxItems: 1

  clock-names:
    items:
      - const: mm
      - const: mfg
      - const: ethif
      - const: venc
      - const: jpgdec
      - const: audio
      - const: vdec
      - const: mm-0
      - const: mm-1
      - const: mm-2
      - const: mm-3
      - const: isp-0
      - const: isp-1
      - const: cam-0
      - const: cam-1
      - const: cam-2
      - const: cam-3
      - const: cam-4
      - const: venc_lt
      - const: hif_sel

  vdec-supply: true
  venc-supply: true
  isp-supply: true
  mm-supply: true
  venc_lt-supply: true
  audio-supply: true
  usb-supply: true
  mfg_async-supply: true
  mfg_2d-supply: true
  mfg-supply: true

required:
  - compatible
  - '#power-domain-cells'
  - reg
  - infracfg
  - clocks
  - clock-names

additionalProperties: false

examples:
  - |
    scpsys: scpsys@10006000 {
        #power-domain-cells = <1>;
        compatible = "mediatek,mt8173-scpsys";
        reg = <0 0x10006000 0 0x1000>;
        infracfg = <&infracfg>;
        clocks = <&clk26m>,
                 <&topckgen CLK_TOP_MM_SEL>,
                 <&topckgen CLK_TOP_VENC_SEL>,
                 <&topckgen CLK_TOP_VENC_LT_SEL>;
        clock-names = "mfg", "mm", "venc", "venc_lt";
    };
```

## Documentation/devicetree/bindings/soc/ti/ti,keystone-navigator-dma.yaml
```yaml
# SPDX-License-Identifier: (GPL-2.0-only OR BSD-2-Clause)
# Copyright 2025 Texas Instruments Incorporated
%YAML 1.2
---
$id: http://devicetree.org/schemas/soc/ti/ti,keystone-navigator-dma.yaml#
$schema: http://devicetree.org/meta-schemas/core.yaml#

title: Keystone Navigator DMA Controller

maintainers:
  - Santosh Shilimkar <santosh.shilimkar@ti.com>

description: |
  This document explains the device tree bindings for the packet dma
  on keystone devices. The Keystone Navigator DMA driver sets up the dma
  channels and flows for the QMSS (Queue Manager SubSystem) who triggers
  the actual data movements across clients using destination queues. Every
  client modules like NETCP (Network Coprocessor), SRIO (Serial Rapid IO),
  CRYPTO Engines etc has its own instance of dma hardware. QMSS has also
  an internal packet DMA module which is used as an infrastructure DMA
  with zero copy.

  Navigator DMA cloud layout:
    ------------------
    | Navigator DMAs |
    ------------------
        |
        |-> DMA instance #0
        |
        |-> DMA instance #1
            .
            .
        |
        |-> DMA instance #n

properties:
  compatible:
    items:
      - const: ti,keystone-navigator-dma

  clocks:
    description: phandle to dma instance clocks.
      The clock handles can be as many as the dma instances.
      The order should be maintained as per the dma instances.

  '#address-cells':
    const: 1

  '#size-cells':
    const: 1

  ranges: true

  ti,navigator-cloud-address:
    description: |
      Should contain base address for the multi-core navigator cloud and number of
      addresses depends on SOC integration configuration.
      Navigator cloud global address needs to be programmed into DMA and the DMA
      uses it as the physical addresses to reach queue managers.
      Note that these addresses, though pointing to queue managers, are relevant
      only from DMA perspective.
      The QMSS may not choose to use them since it has a different address space
      view to reach all its components.
    $ref: /schemas/types.yaml#/definitions/uint32-array

  ti,enable-all:
    description: |
      Enable all DMA channels versus clients opening specific channels what they need.
      This property is useful for the userspace fast path case where the linux drivers
      enables the channels used by userland stack.
    type: boolean

  ti,loop-back:
    description: To loopback Tx streaming I/F to Rx streaming I/F. Used for infrastructure transfers.
    type: boolean

  ti,rx-retry-timeout:
    description: Number of dma cycles to wait before retry on buffer starvation.
    $ref: /schemas/types.yaml#/definitions/uint32

required:
  - compatible
  - clocks
  - ti,navigator-cloud-address

additionalProperties: false

examples:
  - |
    knav_dmas: knav_dmas@0 {
        compatible = "ti,keystone-navigator-dma";
        clocks = <&papllclk>, <&clkxge>;
        #address-cells = <1>;
        #size-cells = <1>;
        ranges;
        ti,navigator-cloud-address = <0x23a80000 0x23a90000
                                       0x23aa0000 0x23ab0000>;

        dma_gbe: dma_gbe@0 {
            reg = <0x2004000 0x100>,
                  <0x2004400 0x120>,
                  <0x2004800 0x300>,
                  <0x2004c00 0x120>,
                  <0x2005000 0x400>;
            reg-names = "global", "txchan", "rxchan",
                        "txsched", "rxflow";
        };

        dma_xgbe: dma_xgbe@0 {
            reg = <0x2fa1000 0x100>,
                <0x2fa1400 0x200>,
                <0x2fa1800 0x200>,
                <0x2fa1c00 0x200>,
                <0x2fa2000 0x400>;
            reg-names = "global", "txchan", "rxchan",
                        "txsched", "rxflow";
        };
    };
```
