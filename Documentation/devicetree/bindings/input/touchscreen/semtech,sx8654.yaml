## Documentation/devicetree/bindings/input/touchscreen/semtech,sx8654.yaml
```yaml
# SPDX-License-Identifier: (GPL-2.0-only OR BSD-2-Clause)
%YAML 1.2
---
$id: http://devicetree.org/schemas/input/touchscreen/semtech,sx8654.yaml#
$schema: http://devicetree.org/meta-schemas/core.yaml#

title: Semtech SX8654 I2C Touchscreen Controller

maintainers:
  - Richard Leitner <richard.leitner@linux.dev>
  - Rob Herring <robh@kernel.org>
  - Sébastien Szymanski <sebastien.szymanski@armadeus.com>

description: |
  * Semtech SX8654 I2C Touchscreen Controller

properties:
  compatible:
    description: Compatible string identifying the SX865x model.
    items:
      - enum:
          - semtech,sx8650
          - semtech,sx8654
          - semtech,sx8655
          - semtech,sx8656

  reg:
    description: I2C slave address for the touchscreen controller.

  interrupts:
    description: Interrupt line for touch events.

  reset-gpios:
    maxItems: 1
    description: GPIO specification for the NRST input.

required:
  - compatible
  - reg
  - interrupts

additionalProperties: false

examples:
  - |
    sx8654@48 {
      compatible = "semtech,sx8654";
      reg = <0x48>;
      interrupts = <3 IRQ_TYPE_EDGE_FALLING>;
      reset-gpios = <&gpio4 2 GPIO_ACTIVE_LOW>;
    };
```

## Documentation/devicetree/bindings/input/touchscreen/sis,9200-ts.yaml
```yaml
# SPDX-License-Identifier: (GPL-2.0-only OR BSD-2-Clause)
# Copyright 2025 NextFour
%YAML 1.2
---
$id: http://devicetree.org/schemas/input/touchscreen/sis,9200-ts.yaml#
$schema: http://devicetree.org/meta-schemas/core.yaml#

title: SiS I2C Multiple Touch Controller

maintainers:
  - Mika Penttilä <mika.penttila@nextfour.com>
  - Rob Herring <robh@kernel.org>

description: |
  * SiS I2C Multiple Touch Controller

  [0]: Documentation/devicetree/bindings/interrupt-controller/interrupts.txt
  [1]: Documentation/devicetree/bindings/pinctrl/pinctrl-bindings.txt

properties:
  compatible:
    items:
      - const: "sis,9200-ts"

  reg:
    items:
      - description: I2C slave address

  interrupts:
    items:
      - description: Interrupt number
      - description: IRQ type flags

  pinctrl-names:
    items:
      - const: default

  pinctrl-0:
    description: Phandle to the pin control settings for the default state

  attn-gpios:
    maxItems: 1
    description: GPIO line used as attention signal

  irq-gpios:
    maxItems: 1
    description: GPIO line used for interrupt notifications

  reset-gpios:
    maxItems: 1
    description: GPIO line used to reset the controller

  wakeup-source:
    type: boolean
    description: Enable touchscreen as a wakeup source

required:
  - compatible
  - reg
  - interrupts

additionalProperties: false

examples:
  - |
    sis9255@5c {
      compatible = "sis,9200-ts";
      reg = <0x5c>;
      pinctrl-names = "default";
      pinctrl-0 = <&pinctrl_sis>;
      interrupts = <19 IRQ_TYPE_EDGE_FALLING>;
      irq-gpios = <&gpio3 19 GPIO_ACTIVE_LOW>;
      reset-gpios = <&gpio2 30 GPIO_ACTIVE_LOW>;
      wakeup-source;
    };
```

## Documentation/devicetree/bindings/input/touchscreen/technologic,ts4800-ts.yaml
```yaml
# SPDX-License-Identifier: (GPL-2.0-only OR BSD-2-Clause)
# Copyright 2025 Damien Riegel <damien.riegel@savoirfairelinux.com>
%YAML 1.2
---
$id: http://devicetree.org/schemas/technologic,ts4800-ts.yaml#
$schema: http://devicetree.org/meta-schemas/core.yaml#

title: TS-4800 Touchscreen
maintainers:
  - Damien Riegel <damien.riegel@savoirfairelinux.com>

description: |
  * TS-4800 Touchscreen bindings

properties:
  compatible:
    items:
      - const: "technologic,ts4800-ts"

  reg:
    items:
      - description: physical base address of the controller
      - description: length of memory mapped region

  syscon:
    description: FPGA syscon register phandle and offsets
    items:
      - description: phandle to FPGA's syscon node
      - description: offset to the touchscreen register
      - description: offset to the touchscreen enable bit

required:
  - compatible
  - reg
  - syscon

additionalProperties: false

examples:
  - |
    touchscreen@0 {
        compatible = "technologic,ts4800-ts";
        reg = <0x1000 0x100>;
        syscon = <&fpga_syscon 0x10 0x4>;
    };
```

## Documentation/devicetree/bindings/input/touchscreen/zeitec,zet6223.yaml
```yaml
# SPDX-License-Identifier: (GPL-2.0-only OR BSD-2-Clause)
%YAML 1.2
---
$id: http://devicetree.org/schemas/input/touchscreen/zeitec,zet6223.yaml#
$schema: http://devicetree.org/meta-schemas/core.yaml#

title: Zeitec ZET6223 I2C touchscreen controller

maintainers:
  - Jelle van der Waa <jelle@vdwaa.nl>
  - Rob Herring <robh@kernel.org>

description: |
  Zeitec ZET6223 I2C touchscreen controller

properties:
  compatible:
    const: "zeitec,zet6223"

  reg:
    description: I2C slave address of the chip
    items:
      - description: I2C slave address of the chip

  interrupts:
    description: Interrupt specification for the ZET6223 touchscreen interrupt
    items:
      - description: "First cell: phandle or GPIO specifier"
      - description: "Second cell: IRQ number"
      - description: "Third cell: IRQ type flags"

  vio-supply:
    description: Specification for VIO supply (1.8V or 3.3V, depending on system interface needs)

  vcc-supply:
    description: Specification for 3.3V VCC supply

  touchscreen-size-x:
    description: Horizontal resolution of the touchscreen in pixels
    $ref: /schemas/types.yaml#/definitions/uint32

  touchscreen-size-y:
    description: Vertical resolution of the touchscreen in pixels
    $ref: /schemas/types.yaml#/definitions/uint32

  touchscreen-inverted-x:
    description: If true, invert the X axis
    type: boolean

  touchscreen-inverted-y:
    description: If true, invert the Y axis
    type: boolean

  touchscreen-swapped-x-y:
    description: If true, swap the X and Y axes
    type: boolean

required:
  - compatible
  - reg
  - interrupts

additionalProperties: false

examples:
  - |
    i2c@00000000 {
        zet6223: touchscreen@76 {
            compatible = "zeitec,zet6223";
            reg = <0x76>;
            interrupts = <6 11 IRQ_TYPE_EDGE_FALLING>;
        };
    };
```

## Documentation/devicetree/bindings/interrupt-controller/hisilicon,mbigen-v2.yaml
```yaml
# SPDX-License-Identifier: (GPL-2.0-only OR BSD-2-Clause)
%YAML 1.2
---
$id: http://devicetree.org/schemas/interrupt-controller/hisilicon,mbigen-v2.yaml#
$schema: http://devicetree.org/meta-schemas/core.yaml#

title: Hisilicon mbigen v2

maintainers:
  - Ma Jun <majun258@huawei.com>

description: >
  Mbigen means: message based interrupt generator.

  MBI is kind of msi interrupt only used on Non-PCI devices.

  To reduce the wired interrupt number connected to GIC, Hisilicon designed
  mbigen to collect and generate interrupt.

  Non-pci devices can connect to mbigen and generate the interrupt by writing
  ITS register.

properties:
  compatible:
    const: hisilicon,mbigen-v2

  reg:
    maxItems: 1

  interrupt-controller: true

  msi-parent:
    maxItems: 1
    description:
      Specifies the MSI controller this mbigen uses.

  num-pins:
    description: The total number of pins implemented in this Mbigen instance.
    $ref: /schemas/types.yaml#/definitions/uint32

  "#interrupt-cells":
    const: 2
    description: Number of cells needed to encode an interrupt source.

required:
  - compatible
  - reg
  - interrupt-controller
  - msi-parent
  - num-pins
  - "#interrupt-cells"

additionalProperties: false

examples:
  - |
    mbigen_chip_dsa {
      compatible = "hisilicon,mbigen-v2";
      reg = <0x0 0xc0080000 0x0 0x10000>;

      mbigen_gmac:intc_gmac {
        interrupt-controller;
        msi-parent = <&its_dsa 0x40b1c>;
        num-pins = <9>;
        #interrupt-cells = <2>;
      };

      mbigen_i2c:intc_i2c {
        interrupt-controller;
        msi-parent = <&its_dsa 0x40b0e>;
        num-pins = <2>;
        #interrupt-cells = <2>;
      };
    };
```

## Documentation/devicetree/bindings/iommu/nvidia,tegra30-smmu.yaml
```yaml
# SPDX-License-Identifier: (GPL-2.0-only OR BSD-2-Clause)
# Copyright 2025 NVIDIA Corporation
%YAML 1.2
---
$id: http://devicetree.org/schemas/iommu/nvidia,tegra30-smmu.yaml#
$schema: http://devicetree.org/meta-schemas/core.yaml#

title: NVIDIA Tegra30 SMMU
maintainers:
  - Hiroshi Doyu <hdoyu@nvidia.com>

description: |
  NVIDIA Tegra 30 IOMMU H/W, SMMU (System Memory Management Unit)

properties:
  compatible:
    items:
      - const: nvidia,tegra30-smmu

  reg:
    description: SMMU register banks (address and length).
    items:
      - description: bank 0 registers
      - description: bank 1 registers
      - description: bank 2 registers

  interrupts:
    description: MC General interrupt.
    items:
      - description: MC General interrupt

  nvidia,#asids:
    description: Number of ASIDs.
    $ref: /schemas/types.yaml#/definitions/uint32

  dma-window:
      $ref: /schemas/types.yaml#/definitions/address
    description: IOVA start address and length.

  nvidia,ahb:
    description: Phandle to the AHB bus connected to SMMU.
    $ref: /schemas/types.yaml#/definitions/phandle

required:
  - compatible
  - reg
  - interrupts
  - nvidia,#asids
  - dma-window
  - nvidia,ahb

additionalProperties: false

examples:
  - |
    smmu {
        compatible = "nvidia,tegra30-smmu";
        reg = <0x7000f010 0x02c
               0x7000f1f0 0x010
               0x7000f228 0x05c>;
        nvidia,#asids = <4>;
        dma-window = <0 0x40000000>;
        nvidia,ahb = <&ahb>;
    };
```

## Documentation/devicetree/bindings/iommu/ti,omap-iommu.yaml
```yaml
# SPDX-License-Identifier: (GPL-2.0-only OR BSD-2-Clause)
# Copyright 2025 Texas Instruments
%YAML 1.2
---
$id: http://devicetree.org/schemas/iommu/ti,omap-iommu.yaml#
$schema: http://devicetree.org/meta-schemas/core.yaml#

title: TI OMAP IOMMU

maintainers:
  - Florian Vaussard <florian.vaussard@epfl.ch>
  - Suman Anna <s-anna@ti.com>

description: |
  OMAP2+ IOMMU binding.

  Required properties:
  - compatible: one of "ti,omap2-iommu", "ti,omap4-iommu",
    "ti,dra7-dsp-iommu", or "ti,dra7-iommu"
  - ti,hwmods: Name of the hwmod associated with the IOMMU instance
  - reg: Address space for the configuration registers
  - interrupts: Interrupt specifier for the IOMMU instance
  - #iommu-cells: Must be 0

  Optional properties:
  - ti,#tlb-entries: Number of entries in the translation look-aside buffer.
    Either 8 or 32 (default: 32)
  - ti,iommu-bus-err-back: Indicates support for bus error response on MMU faults
  - ti,syscon-mmuconfig: Phandle to DSP_SYSTEM syscon node and MMU instance
    number (0-indexed); required for DRA7xx DSP IOMMU instances

properties:
  compatible:
    enum:
      - ti,omap2-iommu
      - ti,omap4-iommu
      - ti,dra7-dsp-iommu
      - ti,dra7-iommu

  ti,hwmods:
    description: Name of the hwmod associated with the IOMMU instance

  reg:
    description: Address space for the configuration registers
    items:
      - description: <address>
      - description: <size>

  interrupts:
    description: Interrupt specifier for the IOMMU instance
    maxItems: 1

  '#iommu-cells':
    const: 0

  ti,#tlb-entries:
    description: Number of entries in the translation look-aside buffer
    $ref: /schemas/types.yaml#/definitions/uint32
    enum: [8, 32]

  ti,iommu-bus-err-back:
    description: Indicates support for bus error response on MMU faults
    type: boolean

  ti,syscon-mmuconfig:
    description: Phandle to DSP_SYSTEM syscon node and MMU instance number
    $ref: /schemas/types.yaml#/definitions/phandle-array
    items:
      - items:
          - description: phandle to syscon node
          - description: MMU instance number (0-indexed)

required:
  - compatible
  - ti,hwmods
  - reg
  - interrupts
  - "#iommu-cells"

additionalProperties: false

examples:
  - |
    /* OMAP3 ISP MMU */
    mmu_isp: mmu@480bd400 {
      compatible = "ti,omap2-iommu";
      ti,hwmods = "mmu_isp";
      reg = <0x480bd400 0x80>;
      interrupts = <24>;
      #iommu-cells = <0>;
      ti,#tlb-entries = <8>;
    };

    /* DRA74x DSP2 MMUs */
    mmu0_dsp2: mmu@41501000 {
      compatible = "ti,dra7-dsp-iommu";
      ti,hwmods = "mmu0_dsp2";
      reg = <0x41501000 0x100>;
      interrupts = <GIC_SPI 146 IRQ_TYPE_LEVEL_HIGH>;
      #iommu-cells = <0>;
      ti,syscon-mmuconfig = <&dsp2_system 0>;
    };

    mmu1_dsp2: mmu@41502000 {
      compatible = "ti,dra7-dsp-iommu";
      ti,hwmods = "mmu1_dsp2";
      reg = <0x41502000 0x100>;
      interrupts = <GIC_SPI 147 IRQ_TYPE_LEVEL_HIGH>;
      #iommu-cells = <0>;
      ti,syscon-mmuconfig = <&dsp2_system 1>;
    };
```

## Documentation/devicetree/bindings/ipmi/aspeed,ast2400-ibt-bmc.yaml
```yaml
# SPDX-License-Identifier: (GPL-2.0-only OR BSD-2-Clause)
%YAML 1.2
---
$id: http://devicetree.org/schemas/ipmi/aspeed,ast2400-ibt-bmc.yaml#
$schema: http://devicetree.org/meta-schemas/core.yaml#

title: Aspeed BT IPMI interface

maintainers:
  - Cédric Le Goater <clg@kaod.org>
  - Jae Hyun Yoo <jae.hyun.yoo@linux.intel.com>
  - Joel Stanley <joel@jms.id.au>

description: |
  * Aspeed BT (Block Transfer) IPMI interface

  The Aspeed SOCs (AST2400 and AST2500) are commonly used as BMCs
  (BaseBoard Management Controllers) and the BT interface can be used to
  perform in-band IPMI communication with their host.

properties:
  compatible:
    items:
      - enum:
          - aspeed,ast2400-ibt-bmc
          - aspeed,ast2500-ibt-bmc
          - aspeed,ast2600-ibt-bmc

  reg:
    description: Physical address and size of the registers
    items:
      - description: register address
      - description: register size

  clocks:
    description: Clock for the device
    items:
      - description: bus clock

  interrupts:
    description: Interrupt generated by the BT interface; without an interrupt,
      the driver will operate in poll mode
    items:
      - description: interrupt number

required:
  - compatible
  - reg
  - clocks

additionalProperties: false

examples:
  - |
    ibt@1e789140 {
        compatible = "aspeed,ast2400-ibt-bmc";
        reg = <0x1e789140 0x18>;
        interrupts = <8>;
        clocks = <&syscon ASPEED_CLK_GATE_LCLK>;
    };
```

## Documentation/devicetree/bindings/ipmi/nuvoton,npcm750-kcs-bmc.yaml
```yaml
# SPDX-License-Identifier: (GPL-2.0-only OR BSD-2-Clause)
%YAML 1.2
---
$id: http://devicetree.org/schemas/ipmi/nuvoton,npcm750-kcs-bmc.yaml#
$schema: http://devicetree.org/meta-schemas/core.yaml#

title: Nuvoton NPCM KCS BMC

maintainers:
  - Geert Uytterhoeven <geert+renesas@glider.be>
  - Haiyue Wang <haiyue.wang@linux.intel.com>
  - Tomer Maimon <tmaimon77@gmail.com>

description: |
  * Nuvoton NPCM KCS (Keyboard Controller Style) IPMI interface

  The Nuvoton SOCs (NPCM) are commonly used as BMCs
  (Baseboard Management Controllers) and the KCS interface can be
  used to perform in-band IPMI communication with their host.

properties:
  compatible:
    items:
      - enum: [nuvoton, npcm750-kcs-bmc]
      - enum: [nuvoton, npcm845-kcs-bmc]
  reg:
    maxItems: 1

  interrupts:
    maxItems: 1

  kcs_chan:
    $ref: /schemas/types.yaml#/definitions/uint32
    description: The KCS channel number in the controller

required:
  - compatible
  - reg
  - interrupts
  - kcs_chan

additionalProperties: false

examples:
  - |
    kcs1: kcs1@0 {
      compatible = "nuvoton,npcm750-kcs-bmc";
      reg = <0x0 0x40>;
      interrupts = <9 4>;
      kcs_chan = <1>;
    };
```
