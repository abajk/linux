## Documentation/devicetree/bindings/jailhouse,cell.yaml
```yaml
# SPDX-License-Identifier: (GPL-2.0-only OR BSD-2-Clause)
# Copyright 2025 Siemens AG
%YAML 1.2
---
$id: http://devicetree.org/schemas/jailhouse,cell.yaml#
$schema: http://devicetree.org/meta-schemas/core.yaml#

title: Jailhouse non-root cell

maintainers:
  - Jan Kiszka <jan.kiszka@siemens.com>

description: |
  Jailhouse non-root cell device tree bindings

  When running in a non-root Jailhouse cell (partition), the device tree of this
  platform shall have a top-level "hypervisor" node with the following
  properties:

properties:
  compatible:
    description: Device compatible string for the Jailhouse hypervisor node.
    items:
      - const: jailhouse,cell

required:
  - compatible

additionalProperties: false

examples:
  - |
    hypervisor {
        compatible = "jailhouse,cell";
    };
```

## Documentation/devicetree/bindings/leds/ams,as3645a.yaml
```yaml
# SPDX-License-Identifier: (GPL-2.0-only OR BSD-2-Clause)
# Copyright 2025 Jacek Anaszewski <jacek.anaszewski@gmail.com>
# Copyright 2025 Sakari Ailus <sakari.ailus@linux.intel.com>
%YAML 1.2
---
$id: http://devicetree.org/schemas/leds/ams,as3645a.yaml#
$schema: http://devicetree.org/meta-schemas/core.yaml#

title: Analog Devices AS3645A flash LED controller

maintainers:
  - Jacek Anaszewski <jacek.anaszewski@gmail.com>
  - Sakari Ailus <sakari.ailus@linux.intel.com>

description: |
  Analog devices AS3645A device tree bindings

  The AS3645A flash LED controller can drive two LEDs, one high current
  flash LED and one indicator LED. The high current flash LED can be
  used in torch mode as well.

  Ranges below noted as [a, b] are closed ranges between a and b, i.e. a
  and b are included in the range.

  Please also see common.txt in the same directory.

properties:
  compatible:
    items:
      - const: ams,as3645a

  reg:
    items:
      - description: I2C address of the device

  "#address-cells":
    const: 1

  "#size-cells":
    const: 0

  led@0:
    description: Flash child node
    $ref: /schemas/leds/common.yaml#
    unevaluatedProperties: false
    properties:
      reg:
        const: 0
      flash-timeout-us:
        description: Flash timeout in microseconds
        minimum: 100000
        maximum: 850000
        multipleOf: 50000
      flash-max-microamp:
        description: Maximum flash current in microamperes
        minimum: 200000
        maximum: 500000
        multipleOf: 20000
      led-max-microamp:
        description: Maximum torch (assist) current in microamperes
        minimum: 20000
        maximum: 160000
        multipleOf: 20000
      ams,input-max-microamp:
        description: Maximum flash controller input current in microamperes
        minimum: 1250000
        maximum: 2000000
        multipleOf: 50000

    required:
      - reg
      - flash-timeout-us
      - flash-max-microamp
      - led-max-microamp
      - ams,input-max-microamp

  led@1:
    description: Indicator child node
    $ref: /schemas/leds/common.yaml#
    unevaluatedProperties: false
    properties:
      reg:
        const: 1
      led-max-microamp:
        description: Maximum indicator current in microamperes
        enum: [2500, 5000, 7500, 10000]

    required:
      - reg
      - led-max-microamp

required:
  - "#address-cells"
  - "#size-cells"
  - compatible
  - reg

additionalProperties: false

examples:
  - |
    #include <dt-bindings/leds/common.h>

    as3645a@30 {
        #address-cells = <1>;
        #size-cells = <0>;
        compatible = "ams,as3645a";
        reg = <0x30>;
        led@0 {
            reg = <0x0>;
            flash-timeout-us = <150000>;
            flash-max-microamp = <320000>;
            led-max-microamp = <60000>;
            ams,input-max-microamp = <1750000>;
            function = LED_FUNCTION_FLASH;
        };
        led@1 {
            reg = <0x1>;
            led-max-microamp = <10000>;
            function = LED_FUNCTION_INDICATOR;
        };
    };
```

## Documentation/devicetree/bindings/leds/backlight/arc,arc2c0608.yaml
```yaml
# SPDX-License-Identifier: (GPL-2.0-only OR BSD-2-Clause)
# Copyright 2025 ArcticSand Ltd.
%YAML 1.2
---
$id: http://devicetree.org/schemas/leds/backlight/arc,arc2c0608.yaml#
$schema: http://devicetree.org/meta-schemas/core.yaml#

title: ArcticSand arc2c0608 LED backlight controller

maintainers:
  - Olimpiu Dejeu <olimpiu@arcticsand.com>

description: |
  Binding for ArcticSand arc2c0608 LED driver

  Note: Optional properties not specified will default to values in IC EPROM

properties:
  compatible:
    items:
      - const: arc,arc2c0608

  reg:
    items:
      - description: Slave address of the LED driver

  default-brightness:
    description: Brightness value on boot (0-4095)
    $ref: /schemas/types.yaml#/definitions/uint32
    minimum: 0
    maximum: 4095

  label:
    description: Label of the backlight device
    $ref: /schemas/types.yaml#/definitions/string

  linux,default-trigger:
    description: Default Linux trigger for the backlight
    $ref: /schemas/types.yaml#/definitions/string

  led-sources:
    description: List of enabled LED channels (0 to 5)
    $ref: /schemas/types.yaml#/definitions/uint32-array
    items:
      minimum: 0
      maximum: 5

  arc,led-config-0:
    description: Setting for register ILED_CONFIG_0
    $ref: /schemas/types.yaml#/definitions/uint32

  arc,led-config-1:
    description: Setting for register ILED_CONFIG_1
    $ref: /schemas/types.yaml#/definitions/uint32

  arc,dim-freq:
    description: PWM mode frequency setting (bits [3:0] used)
    $ref: /schemas/types.yaml#/definitions/uint32

  arc,comp-config:
    description: Setting for register CONFIG_COMP
    $ref: /schemas/types.yaml#/definitions/uint32

  arc,filter-config:
    description: Setting for register FILTER_CONFIG
    $ref: /schemas/types.yaml#/definitions/uint32

  arc,trim-config:
    description: Setting for register IMAXTUNE
    $ref: /schemas/types.yaml#/definitions/uint32

required:
  - compatible
  - reg

additionalProperties: false

examples:
  - |
    arc2c0608@30 {
        compatible = "arc,arc2c0608";
        reg = <0x30>;
        default-brightness = <500>;
        label = "lcd-backlight";
        linux,default-trigger = "backlight";
        led-sources = <0 1 2 5>;
    };
```

## Documentation/devicetree/bindings/leds/backlight/skyworks,sky81452-backlight.yaml
```yaml
# SPDX-License-Identifier: (GPL-2.0-only OR BSD-2-Clause)
%YAML 1.2
---
$id: http://devicetree.org/schemas/leds/backlight/skyworks,sky81452-backlight.yaml#
$schema: http://devicetree.org/meta-schemas/core.yaml#

title: SKY81452 backlight
maintainers:
  - Rob Herring <robh@kernel.org>

description: |
  SKY81452-backlight bindings

properties:
  compatible:
    items:
      - const: skyworks,sky81452-backlight

  gpios:
    description: GPIO to use to EN pin.
    $ref: /schemas/types.yaml#/definitions/phandle-array

  led-sources:
    description: List of enabled channels (0–5).

  skyworks,ignore-pwm:
    description: Ignore both PWM inputs.
    type: boolean

  skyworks,dpwm-mode:
    description: Enable DPWM dimming mode; otherwise analog dimming.
    type: boolean

  skyworks,phase-shift:
    description: Enable phase-shift mode.
    type: boolean

  skyworks,short-detection-threshold-volt:
    description: Short-detection threshold voltage.
    enum:
      - 4
      - 5
      - 6
      - 7

  skyworks,current-limit-mA:
    description: Current limit in mA.
    enum:
      - 2300
      - 2750

additionalProperties: false

examples:
  - |
    backlight {
        compatible = "skyworks,sky81452-backlight";
        name = "pwm-backlight";
        led-sources = <0 1 2 5>;
        skyworks,ignore-pwm;
        skyworks,phase-shift;
        skyworks,current-limit-mA = <2300>;
    };
```

## Documentation/devicetree/bindings/leds/backlight/ti,tps65217.yaml
```yaml
# SPDX-License-Identifier: (GPL-2.0-only OR BSD-2-Clause)
%YAML 1.2
---
$id: http://devicetree.org/schemas/ti,tps65217.yaml#
$schema: http://devicetree.org/meta-schemas/core.yaml#

title: TI TPS65217 Backlight
maintainers:
  - Rob Herring <robh@kernel.org>

description: |
  TPS65217 family of regulators

  The TPS65217 chip contains a boost converter and current sinks which can be
  used to drive LEDs for use as backlights.

  Each regulator is defined using the standard binding for regulators.

properties:
  compatible:
    items:
      - const: ti,tps65217

  reg:
    description: I2C slave address
    items:
      - description: I2C slave address

  backlight:
    description: Node for specifying WLED1 and WLED2 lines in TPS65217
    type: object
    additionalProperties: false
    properties:
      isel:
        description: Selection bit, 1 for ISEL1 (low-level) or 2 for ISEL2 (high-level)
        enum: [1, 2]
      fdim:
        description: PWM dimming frequency
        enum: [100, 200, 500, 1000]
      default-brightness:
        description: Default brightness level
        minimum: 0
        maximum: 100
    required:
      - isel
      - fdim
      - default-brightness

required:
  - compatible
  - reg
  - backlight

additionalProperties: false

examples:
  - |
    tps: tps@24 {
        compatible = "ti,tps65217";
        reg = <0x24>;
        backlight {
            isel = <1>;  /* 1 - ISET1, 2 ISET2 */
            fdim = <100>; /* TPS65217_BL_FDIM_100HZ */
            default-brightness = <50>;
        };
    };
```

## Documentation/devicetree/bindings/leds/brcm,bcm6358-leds.yaml
```yaml
# SPDX-License-Identifier: (GPL-2.0-only OR BSD-2-Clause)
%YAML 1.2
---
$id: http://devicetree.org/schemas/leds/brcm,bcm6358-leds.yaml#
$schema: http://devicetree.org/meta-schemas/core.yaml#

title: Broadcom BCM6358 LEDs

maintainers:
  - Álvaro Fernández Rojas <noltari@gmail.com>
  - Christian Marangi <ansuelsmth@gmail.com>
  - Linus Walleij <linus.walleij@linaro.org>
  - Wan Jiabing <wanjiabing@vivo.com>

description: |
  LEDs connected to Broadcom BCM6358 controller

  This controller is present on BCM6358 and BCM6368.
  In these SoCs there are Serial LEDs (LEDs connected to a 74x164 controller),
  which can either be controlled by software (exporting the 74x164 as spi-gpio.
  See Documentation/devicetree/bindings/gpio/fairchild,74hc595.yaml), or
  by hardware using this driver.

properties:
  compatible:
    items:
      - enum:
          - brcm,bcm6358-leds
  '#address-cells':
    const: 1
  '#size-cells':
    const: 0
  reg:
    maxItems: 1

  brcm,clk-div:
    description: SCK signal divider.
    $ref: /schemas/types.yaml#/definitions/uint32
    enum:
      - 1
      - 2
      - 4
      - 8
    default: 1
  brcm,clk-dat-low:
    description: Makes clock and data signals active low.
    type: boolean
    default: false

patternProperties:
  '^[a-zA-Z0-9,_-]+$':
    description: Each LED sub-node.
    type: object
    properties:
      reg:
        description: LED pin number (only LEDs 0 to 31 are valid)
        minimum: 0
        maximum: 31
      label:
        description: See Documentation/devicetree/bindings/leds/common.txt
        $ref: /schemas/types.yaml#/definitions/string
      active-low:
        description: Active low output.
        type: boolean
      default-state:
        description: See Documentation/devicetree/bindings/leds/common.txt
        $ref: /schemas/types.yaml#/definitions/string
      linux,default-trigger:
        description: See Documentation/devicetree/bindings/leds/common.txt
        $ref: /schemas/types.yaml#/definitions/string
    required:
      - reg
    additionalProperties: false

required:
  - compatible
  - '#address-cells'
  - '#size-cells'
  - reg

additionalProperties: false
```

## Documentation/devicetree/bindings/leds/crane-cr0014114.yaml
```yaml
# SPDX-License-Identifier: (GPL-2.0-only OR BSD-2-Clause)
%YAML 1.2
---
$id: http://devicetree.org/schemas/leds/crane-cr0014114.yaml#
$schema: http://devicetree.org/meta-schemas/core.yaml#

title: Crane cr0014114 LED driver

maintainers:
  - Jacek Anaszewski <jacek.anaszewski@gmail.com>
  - Oleh Kravchenko <oleg@kaa.org.ua>

description: |
  Crane Merchandising System - cr0014114 LED driver

  This LED Board is widely used in vending machines produced
  by Crane Merchandising Systems.

  Property rules described in Documentation/devicetree/bindings/spi/spi-bus.txt
  apply. In particular, "reg" and "spi-max-frequency" properties must be given.

properties:
  compatible:
    description: Device compatible string.
    $ref: /schemas/types.yaml#/definitions/string-array
    items:
      - const: crane,cr0014114

  reg:
    description: SPI chip select number.
    items:
      - description: SPI chip select.

  spi-max-frequency:
    description: Maximum SPI clock frequency in Hz.
    $ref: /schemas/types.yaml#/definitions/uint32

  "#address-cells":
    const: 1

  "#size-cells":
    const: 0

patternProperties:
  "^led@[0-9]+$":
    description: LED sub-node definition.
    $ref: common.yaml#
    unevaluatedProperties: false

    properties:
      reg:
        description: LED index.
        items:
          - description: LED index.

    required:
      - reg
      - function
      - color

additionalProperties: false

examples:
  - |
    #include <dt-bindings/leds/common.h>
    led-controller@0 {
        compatible = "crane,cr0014114";
        reg = <0>;
        spi-max-frequency = <50000>;
        #address-cells = <1>;
        #size-cells = <0>;

        led@0 {
            reg = <0>;
            function = "coin";
            color = <LED_COLOR_ID_RED>;
        };
        led@1 {
            reg = <1>;
            function = "coin";
            color = <LED_COLOR_ID_GREEN>;
        };
        led@2 {
            reg = <2>;
            function = "coin";
            color = <LED_COLOR_ID_BLUE>;
        };
        led@3 {
            reg = <3>;
            function = "bill";
            color = <LED_COLOR_ID_RED>;
        };
        led@4 {
            reg = <4>;
            function = "bill";
            color = <LED_COLOR_ID_GREEN>;
        };
        led@5 {
            reg = <5>;
            function = "bill";
            color = <LED_COLOR_ID_BLUE>;
        };
    };
```
