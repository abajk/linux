## Documentation/devicetree/bindings/leds/crane-el15203000.yaml
```yaml
# SPDX-License-Identifier: (GPL-2.0-only OR BSD-2-Clause)
%YAML 1.2
---
$id: http://devicetree.org/schemas/leds/crane-el15203000.yaml#
$schema: http://devicetree.org/meta-schemas/core.yaml#

title: crane,el15203000
maintainers:
  - Oleh Kravchenko <oleg@kaa.org.ua>

description: |
  Crane Merchandising System - EL15203000 LED driver

  This LED Board (aka RED LEDs board) is widely used in
  coffee vending machines produced by Crane Merchandising Systems.
  The board manages 3 LEDs and supports predefined blinking patterns
  for specific leds.

  Vending area LED encoded with symbol 'V' (hex code 0x56).
  Doesn't have any hardware blinking pattern.

  Screen light tube LED which surrounds vending machine screen and
  encoded with symbol 'S' (hex code 0x53). Supports blinking breathing pattern.

  Water Pipe LED encoded with symbol 'P' (hex code 0x50) and
  actually consists of 5 LEDs that exposed by protocol like one LED.
  Supports next patterns:
    - cascade pattern
    - inversed cascade pattern
    - bounce pattern
    - inversed bounce pattern

properties:
  compatible:
    items:
      - const: "crane,el15203000"
    description: |
      Device compatible string.

  reg:
    items:
      - description: SPI chip-select index for the LED controller
    description: |
      SPI bus chip-select for this device.

  spi-max-frequency:
    description: |
      Maximum SPI clock frequency for the LED controller.
    $ref: /schemas/types.yaml#/definitions/uint32

  "#address-cells":
    const: 1
    description: |
      Number of address cells for LED sub-nodes.

  "#size-cells":
    const: 0
    description: |
      Number of size cells for LED sub-nodes.

patternProperties:
  "^led@[0-9A-Fa-f]+$":
    $ref: /schemas/leds/common.yaml#
    unevaluatedProperties: false
    properties:
      reg:
        items:
          - description: LED symbol register (hex code).
        description: |
          Sub-node register specifying the LED’s symbol code.

    required:
      - reg
      - function
      - color

required:
  - compatible
  - reg
  - spi-max-frequency
  - "#address-cells"
  - "#size-cells"

additionalProperties: false

examples:
  - |
    led-controller@0 {
      compatible = "crane,el15203000";
      reg = <0>;
      spi-max-frequency = <50000>;
      #address-cells = <1>;
      #size-cells = <0>;

      led@50 {
        reg = <0x50>;
        function = "pipe";
        color = <LED_COLOR_ID_RED>;
      };

      led@53 {
        reg = <0x53>;
        function = "screen";
        color = <LED_COLOR_ID_RED>;
      };

      led@56 {
        reg = <0x56>;
        function = "vend";
        color = <LED_COLOR_ID_RED>;
      };
    };
```

## Documentation/devicetree/bindings/leds/ibm,opal-v3-led.yaml
```yaml
# SPDX-License-Identifier: (GPL-2.0-only OR BSD-2-Clause)
%YAML 1.2
---
$id: http://devicetree.org/schemas/ibm,opal-v3-led.yaml#
$schema: http://devicetree.org/meta-schemas/core.yaml#

title: IBM PowerNV OPAL v3 LED Controller

maintainers:
  - Vasant Hegde <hegdevasant@linux.vnet.ibm.com>

description: |
  Device Tree binding for LEDs on IBM Power Systems

  Each location code of FRU/Enclosure must be expressed in the
  form of a sub-node.

properties:
  compatible:
    items:
      - const: "ibm,opal-v3-led"
  led-mode:
    description: LED operation mode selection.
    items:
      - enum: [lightpath, guidinglight]

patternProperties:
  '^[A-Za-z0-9.,-]+$':
    description: Sub-node for each FRU/Enclosure location code.
    type: object
    properties:
      led-types:
        description: Supported LED types for the location.
        items:
          - enum: [attention, identify, fault]
    required: [led-types]
    additionalProperties: false

required:
  - compatible
  - led-mode

additionalProperties: false

examples:
  - |
    leds {
        compatible = "ibm,opal-v3-led";
        led-mode = "lightpath";

        U78C9.001.RST0027-P1-C1 {
            led-types = "identify", "fault";
        };
    };
```

## Documentation/devicetree/bindings/leds/lacie,ns2-leds.yaml
```yaml
# SPDX-License-Identifier: (GPL-2.0-only OR BSD-2-Clause)
%YAML 1.2
---
$id: http://devicetree.org/schemas/leds/lacie,ns2-leds.yaml#
$schema: http://devicetree.org/meta-schemas/core.yaml#

title: LACIE NS2 dual-GPIO LEDs

maintainers:
  - Grant Likely <grant.likely@secretlab.ca>
  - Vincent Donnefort <vdonnefort@gmail.com>

description: |
  Binding for dual-GPIO LED found on Network Space v2 (and parents).

  Each LED is represented as a sub-node of the ns2-leds device.

properties:
  compatible:
    const: lacie,ns2-leds

patternProperties:
  "^.*$":
    description: A single LED sub-node.
    $ref: common.yaml#
    unevaluatedProperties: false

    properties:
      cmd-gpio:
        description: Command LED GPIO. See OF device-tree GPIO specification.
        maxItems: 1

      slow-gpio:
        description: Slow LED GPIO. See OF device-tree GPIO specification.
        maxItems: 1

      modes-map:
        description: A mapping between LED modes (off, on or SATA activity blinking) and
          the corresponding cmd-gpio/slow-gpio values. All the GPIO values combinations
          should be given in order to avoid having an unknown mode at driver probe time.
        $ref: /schemas/types.yaml#/definitions/uint32-array

    required:
      - cmd-gpio
      - slow-gpio
      - modes-map

additionalProperties: false

examples:
  - |
    #include <dt-bindings/leds/leds-ns2.h>
    lacie,ns2-leds {
      compatible = "lacie,ns2-leds";
      blue-sata {
        label = "ns2:blue:sata";
        slow-gpio = <&gpio0 29 0>;
        cmd-gpio = <&gpio0 30 0>;
        modes-map = <NS_V2_LED_OFF  0 1
                     NS_V2_LED_ON   1 0
                     NS_V2_LED_ON   0 0
                     NS_V2_LED_SATA 1 1>;
      };
    };
```

## Documentation/devicetree/bindings/leds/leds-is31fl32xx.yaml
```yaml
# SPDX-License-Identifier: (GPL-2.0-only OR BSD-2-Clause)
%YAML 1.2
---
$id: http://devicetree.org/schemas/leds/leds-is31fl32xx.yaml#
$schema: http://devicetree.org/meta-schemas/core.yaml#

title: ISSI IS31FL32xx and Si-En SN32xx LED drivers

maintainers:
  - David Rivshin <drivshin@allworx.com>

description: |
  Binding for ISSI IS31FL32xx and Si-En SN32xx LED Drivers

  The IS31FL32xx/SN32xx family of LED drivers are I2C devices with multiple
  constant-current channels, each with independent 256-level PWM control.
  Each LED is represented as a sub-node of the device.

properties:
  compatible:
    items:
      - enum:
          - issi,is31fl3236
          - issi,is31fl3235
          - issi,is31fl3218
          - issi,is31fl3216
          - si-en,sn3218
          - si-en,sn3216
    description: Device compatible string.

  reg:
    description: I2C slave address.
    items:
      - description: Slave address

  "#address-cells":
    const: 1
    description: Number of address cells for LED sub-nodes.

  "#size-cells":
    const: 0
    description: Number of size cells for LED sub-nodes.

patternProperties:
  "^led@.*":
    description: LED sub-node for individual LED channels.
    type: object
    additionalProperties: false
    properties:
      reg:
        description: LED channel number.
        items:
          - description: Channel number
      label:
        description: Label for LED.
        $ref: /schemas/types.yaml#/definitions/string-array
      linux,default-trigger:
        description: Default trigger for LED.
        $ref: /schemas/types.yaml#/definitions/string-array
    required:
      - reg

required:
  - compatible
  - reg
  - "#address-cells"
  - "#size-cells"

additionalProperties: false

examples:
  - |
    is31fl3236: led-controller@3c {
        compatible = "issi,is31fl3236";
        reg = <0x3c>;
        #address-cells = <1>;
        #size-cells = <0>;

        led@1 {
            reg = <1>;
            label = "EB:blue:usr0";
        };
        led@2 {
            reg = <2>;
            label = "EB:blue:usr1";
        };
        ...
        led@36 {
            reg = <36>;
            label = "EB:blue:usr35";
        };
    };
```

## Documentation/devicetree/bindings/leds/lltc,lt3593.yaml
```yaml
# SPDX-License-Identifier: (GPL-2.0-only OR BSD-2-Clause)
%YAML 1.2
---
$id: http://devicetree.org/schemas/leds/lltc,lt3593.yaml#
$schema: http://devicetree.org/meta-schemas/core.yaml#

title: Linear Technologies LT3593 LED controller

maintainers:
  - Daniel Mack <daniel@zonque.org>
  - Jacek Anaszewski <jacek.anaszewski@gmail.com>

description: |
  Bindings for Linear Technologies LT3593 LED controller

  The hardware supports only one LED. The properties of this LED are
  configured in a sub-node in the device node.

  If multiple chips of this type are found in a design, each one needs to
  be handled by its own device node.

properties:
  compatible:
    const: lltc,lt3593

  lltc,ctrl-gpios:
    description:
      A handle to the GPIO that is connected to the 'CTRL' pin of the chip.
    maxItems: 1

  led:
    $ref: /schemas/leds/common.yaml#
    unevaluatedProperties: false

required:
  - compatible
  - lltc,ctrl-gpios

additionalProperties: false

examples:
  - |
    #include <dt-bindings/leds/common.h>

    ltc:led-controller {
        compatible = "lltc,lt3593";
        lltc,ctrl-gpios = <&gpio 0 GPIO_ACTIVE_HIGH>;

        led {
            function = LED_FUNCTION_BACKLIGHT;
            color = <LED_COLOR_ID_WHITE>;
            default-state = "on";
        };
    };
```

## Documentation/devicetree/bindings/leds/motorola,cpcap-led.yaml
```yaml
# SPDX-License-Identifier: (GPL-2.0-only OR BSD-2-Clause)
# Copyright 2025 Sebastian Reichel <sre@kernel.org>
%YAML 1.2
---
$id: http://devicetree.org/schemas/leds/motorola,cpcap-led.yaml#
$schema: http://devicetree.org/meta-schemas/core.yaml#

title: Motorola CPCAP PMIC LEDs

maintainers:
  - Sebastian Reichel <sre@kernel.org>

description: |
  Motorola CPCAP PMIC LEDs
  ------------------------

  This module is part of the CPCAP. For more details about the whole
  chip see Documentation/devicetree/bindings/mfd/motorola-cpcap.txt.

properties:
  compatible:
    description: |
      Device compatibility string. Must be one of:
      - "motorola,cpcap-led-mdl" (Main Display Lighting)
      - "motorola,cpcap-led-kl" (Keyboard Lighting)
      - "motorola,cpcap-led-adl" (Aux Display Lighting)
      - "motorola,cpcap-led-red" (Red Triode)
      - "motorola,cpcap-led-green" (Green Triode)
      - "motorola,cpcap-led-blue" (Blue Triode)
      - "motorola,cpcap-led-cf" (Camera Flash)
      - "motorola,cpcap-led-bt" (Bluetooth)
      - "motorola,cpcap-led-cp" (Camera Privacy LED)
    items:
      - enum:
          - motorola,cpcap-led-mdl
          - motorola,cpcap-led-kl
          - motorola,cpcap-led-adl
          - motorola,cpcap-led-red
          - motorola,cpcap-led-green
          - motorola,cpcap-led-blue
          - motorola,cpcap-led-cf
          - motorola,cpcap-led-bt
          - motorola,cpcap-led-cp

  label:
    description: User-visible name for this LED.

  vdd-supply:
    description: Phandle to the regulator powering the LED.

required:
  - compatible
  - label
  - vdd-supply

additionalProperties: false

examples:
  - |
    &cpcap {
        cpcap_led_red: red-led {
            compatible = "motorola,cpcap-led-red";
            label = "cpcap:red";
            vdd-supply = <&sw5>;
        };
    };
```

## Documentation/devicetree/bindings/leds/ti,lm3532.yaml
```yaml
# SPDX-License-Identifier: (GPL-2.0-only OR BSD-2-Clause)
# Copyright 2025 Texas Instruments Inc.
%YAML 1.2
---
$id: http://devicetree.org/schemas/ti,lm3532.yaml#
$schema: http://devicetree.org/meta-schemas/core.yaml#

title: TI LM3532 White LED driver with ambient light sensing capability

maintainers:
  - Alexander A. Klimov <grandmaster@al2klimov.de>
  - Dan Murphy <dmurphy@ti.com>

description: |
  * Texas Instruments - lm3532 White LED driver with ambient light sensing
    capability.

  The LM3532 provides the 3 high-voltage, low-side current sinks. The device is
  programmable over an I2C-compatible interface and has independent
  current control for all three channels. The adaptive current regulation
  method allows for different LED currents in each current sink thus allowing
  for a wide variety of backlight and keypad applications.

  The main features of the LM3532 include dual ambient light sensor inputs
  each with 32 internal voltage setting resistors, 8-bit logarithmic and linear
  brightness control, dual external PWM brightness control inputs, and up to
  1000:1 dimming ratio with programmable fade in and fade out settings.

properties:
  compatible:
    const: ti,lm3532

  reg:
    maxItems: 1

  '#address-cells':
    const: 1
  '#size-cells':
    const: 0
  enable-gpios:
    maxItems: 1
    description: GPIO pin to enable (active high)/disable the device.
  ramp-up-us:
    description: |
      The run-time ramp rate/step from one current set-point to another
      after the device has reached its initial target set point from turn-on
  ramp-down-us:
    description: |
      The run-time ramp rate/step from one current set-point to another
      after the device has reached its initial target set point from turn-on
  ti,als-vmin:
    $ref: /schemas/types.yaml#/definitions/uint32
    description: Minimum ALS voltage defined in Volts
    minimum: 0
    maximum: 2
  ti,als-vmax:
    $ref: /schemas/types.yaml#/definitions/uint32
    description: Maximum ALS voltage defined in Volts
    minimum: 0
    maximum: 2
  ti,als1-imp-sel:
    $ref: /schemas/types.yaml#/definitions/uint32
    description: ALS1 impedance resistor selection in Ohms
    minimum: 1190
    maximum: 37000
  ti,als2-imp-sel:
    $ref: /schemas/types.yaml#/definitions/uint32
    description: ALS2 impedance resistor selection in Ohms
    minimum: 1190
    maximum: 37000
  ti,als-avrg-time-us:
    description: |
      Determines the length of time the device needs to average the two ALS inputs.
      Only used if the input mode is LM3532_ALS_INPUT_AVRG.
    minimum: 17920
    maximum: 2293760
  ti,als-input-mode:
    $ref: /schemas/types.yaml#/definitions/uint32
    description: Determines how the device uses the attached ALS devices.
    enum:
      - 0
      - 1
      - 2
      - 3

patternProperties:
  "^led@":
    description: LED channel child node
    $ref: common.yaml#
    unevaluatedProperties: false

    properties:
      reg:
        description: Indicates control bank the LED string is controlled by
        maxItems: 1

      ti,led-mode:
        description: |
          Defines if the LED strings are manually controlled or if the LED strings
          are controlled by the ALS.
        $ref: /schemas/types.yaml#/definitions/uint32
        enum:
          - 0
          - 1
      led-max-microamp:
        description: |
          Defines the full scale current value for each control bank.
          The range is from 5000uA-29800uA in increments of 800uA.
        minimum: 5000
        maximum: 29800

    required:
      - reg
      - led-sources
      - ti,led-mode

required:
  - compatible
  - reg

additionalProperties: false

examples:
  - |
    leds {
      compatible = "ti,lm3532";
      #address-cells = <1>;
      #size-cells = <0>;
      reg = <0x38>;
      enable-gpios = <&gpio6 12 GPIO_ACTIVE_HIGH>;
      ramp-up-us = <1024>;
      ramp-down-us = <65536>;
      ti,als-vmin = <0>;
      ti,als-vmax = <2000>;
      ti,als1-imp-sel = <4110>;
      ti,als2-imp-sel = <2180>;
      ti,als-avrg-time-us = <17920>;
      ti,als-input-mode = <0x00>;

      led@0 {
        reg = <0>;
        led-sources = <2>;
        ti,led-mode = <1>;
        led-max-microamp = <21800>;
        label = ":backlight";
        linux,default-trigger = "backlight";
      };

      led@1 {
        reg = <1>;
        led-sources = <1>;
        ti,led-mode = <0>;
        label = ":kbd_backlight";
      };
    };
```
