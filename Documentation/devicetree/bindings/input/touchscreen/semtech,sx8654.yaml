## Documentation/devicetree/bindings/leds/ti,lm3601x.yaml
```yaml
# SPDX-License-Identifier: (GPL-2.0-only OR BSD-2-Clause)
# Copyright (C) 2025 Texas Instruments Incorporated

%YAML 1.2
---
$id: http://devicetree.org/schemas/leds/ti,lm3601x.yaml#
$schema: http://devicetree.org/meta-schemas/core.yaml#

title: TI LM3601X Single-LED Flash Driver

maintainers:
  - Alexander A. Klimov <grandmaster@al2klimov.de>
  - Dan Murphy <dmurphy@ti.com>
  - Jacek Anaszewski <jacek.anaszewski@gmail.com>

description: |
  * Texas Instruments - lm3601x Single-LED Flash Driver

  The LM3601X are ultra-small LED flash drivers that
  provide a high level of adjustability.

  For more product information please see the links below:
  https://www.ti.com/product/LM36010
  https://www.ti.com/product/LM36011

properties:
  compatible:
    items:
      - enum:
          - ti,lm36010
          - ti,lm36011

  reg:
    items:
      - description: I2C slave address of the LM3601X device.

  '#address-cells':
    const: 1

  '#size-cells':
    const: 0

patternProperties:
  '^led@.*':
    $ref: /schemas/leds/common.yaml#
    unevaluatedProperties: false
    properties:
      reg:
        description: "0 for IR mode, 1 for Torch (white LED) mode"
        enum: [0, 1]
      flash-max-microamp:
        description: Maximum flash current in microamperes (11 mA–1.5 A).
      flash-max-timeout-us:
        description: Maximum flash timeout in microseconds (40 ms–1600 ms).
      led-max-microamp:
        description: Maximum LED (torch) current in microamperes (2.4 mA–376 mA).

    required:
      - reg
      - flash-max-microamp
      - flash-max-timeout-us
      - led-max-microamp

required:
  - compatible
  - reg

additionalProperties: false

examples:
  - |
    led-controller@64 {
        compatible = "ti,lm36010";
        #address-cells = <1>;
        #size-cells = <0>;
        reg = <0x64>;

        led@0 {
            reg = <1>;
            function = LED_FUNCTION_TORCH;
            color = <LED_COLOR_ID_WHITE>;
            led-max-microamp = <376000>;
            flash-max-microamp = <1500000>;
            flash-max-timeout-us = <1600000>;
        };
    };
```

## Documentation/devicetree/bindings/leds/ti,lm36274.yaml
```yaml
# SPDX-License-Identifier: (GPL-2.0-only OR BSD-2-Clause)
%YAML 1.2
---
$id: http://devicetree.org/schemas/leds/ti,lm36274.yaml#
$schema: http://devicetree.org/meta-schemas/core.yaml#
title: Texas Instruments LM36274 4-Channel LCD Backlight Driver
maintainers:
  - Alexander A. Klimov <grandmaster@al2klimov.de>
  - Dan Murphy <dmurphy@ti.com>
  - Mauro Carvalho Chehab <mchehab+samsung@kernel.org>
description: |
  * Texas Instruments LM36274 4-Channel LCD Backlight Driver w/Integrated Bias

  The LM36274 is an integrated four-channel WLED driver and LCD bias supply.
  The backlight boost provides the power to bias four parallel LED strings with
  up to 29V total output voltage. The 11-bit LED current is programmable via
  the I2C bus and/or controlled via a logic level PWM input from 60 uA to 30 mA.

  Parent device properties are documented in
  Documentation/devicetree/bindings/mfd/ti-lmu.txt

  Regulator properties are documented in
  Documentation/devicetree/bindings/regulator/lm363x-regulator.txt

  For more product information please see the link below:
  https://www.ti.com/lit/ds/symlink/lm36274.pdf

properties:
  compatible:
    items:
      - enum:
          - ti,lm36274
  reg:
    description: I2C address of the device.
    items:
      - description: Device register address on the I2C bus.
  '#address-cells':
    const: 1
  '#size-cells':
    const: 0
  enable-gpios:
    description: Control GPIO for enabling the device.
    items:
      - description: GPIO specifier.
  regulators:
    description: Voltage regulators for bias and boost supplies.
    type: object
    additionalProperties: false
    properties:
      compatible:
        items:
          - enum:
              - ti,lm363x-regulator
      '#address-cells':
        const: 1
      '#size-cells':
        const: 0
      enable-gpios:
        description: Enable GPIOs for regulator banks.
        items:
          - description: GPIO specifier.
      vboost:
        description: Boost regulator configuration.
        type: object
        additionalProperties: false
        properties:
          regulator-name:
            const: lcd_boost
          regulator-min-microvolt: {}
          regulator-max-microvolt: {}
          regulator-always-on:
            type: boolean
        required: [regulator-name, regulator-min-microvolt, regulator-max-microvolt]
      vpos:
        description: Positive bias regulator configuration.
        type: object
        additionalProperties: false
        properties:
          regulator-name:
            const: lcd_vpos
          regulator-min-microvolt: {}
          regulator-max-microvolt: {}
        required: [regulator-name, regulator-min-microvolt, regulator-max-microvolt]
      vneg:
        description: Negative bias regulator configuration.
        type: object
        additionalProperties: false
        properties:
          regulator-name:
            const: lcd_vneg
          regulator-min-microvolt: {}
          regulator-max-microvolt: {}
        required: [regulator-name, regulator-min-microvolt, regulator-max-microvolt]
  backlight:
    description: Backlight controller settings.
    type: object
    additionalProperties: false
    properties:
      compatible:
        items:
          - enum:
              - ti,lm36274-backlight
      '#address-cells':
        const: 1
      '#size-cells':
        const: 0
    patternProperties:
      '^led@\\d+$':
        description: LED string configuration.
        type: object
        additionalProperties: false
        properties:
          reg:
            items:
              - description: LED identifier.
          led-sources:
            description: LED strings to enable, values 0-3.
            items:
              minimum: 0
              maximum: 3
          label:
            description: Label for the backlight cluster.
          linux,default-trigger:
            description: Default LED trigger.
        required: [reg, led-sources]
required:
  - compatible
  - reg
additionalProperties: false
examples:
  - |
    lm36274@11 {
      compatible = "ti,lm36274";
      reg = <0x11>;
      enable-gpios = <&gpio1 28 GPIO_ACTIVE_HIGH>;
      regulators {
        compatible = "ti,lm363x-regulator";
        enable-gpios = <&pioC 0 GPIO_ACTIVE_HIGH>,
                       <&pioC 1 GPIO_ACTIVE_HIGH>;
        vboost {
          regulator-name = "lcd_boost";
          regulator-min-microvolt = <4000000>;
          regulator-max-microvolt = <7150000>;
          regulator-always-on;
        };
        vpos {
          regulator-name = "lcd_vpos";
          regulator-min-microvolt = <4000000>;
          regulator-max-microvolt = <6500000>;
        };
        vneg {
          regulator-name = "lcd_vneg";
          regulator-min-microvolt = <4000000>;
          regulator-max-microvolt = <6500000>;
        };
      };
      backlight {
        compatible = "ti,lm36274-backlight";
        led@0 {
          reg = <0>;
          led-sources = <0 2>;
          label = "white:backlight_cluster";
          linux,default-trigger = "backlight";
        };
      };
    };
```
