## Documentation/devicetree/bindings/input/touchscreen/brcm,iproc-touchscreen.yaml
```yaml
# SPDX-License-Identifier: (GPL-2.0-only OR BSD-2-Clause)
%YAML 1.2
---
$id: http://devicetree.org/schemas/brcm,iproc-touchscreen.yaml#
$schema: http://devicetree.org/meta-schemas/core.yaml#

title: Broadcom IPROC Touchscreen Controller

maintainers:
  - Geert Uytterhoeven <geert+renesas@glider.be>
  - Jonathan Richardson <jonathar@broadcom.com>
  - Raveendra Padasalagi <raveendra.padasalagi@broadcom.com>
  - Rob Herring <robh@kernel.org>

description: |
  * Broadcom's IPROC Touchscreen Controller

properties:
  compatible:
    items:
      - enum: [ "brcm,iproc-touchscreen" ]

  '#address-cells':
    const: 1
    description: Number of u32 entries needed in child nodes.

  '#size-cells':
    const: 1
    description: Number of u32 entries needed to specify child node size in reg.

  ts_syscon:
    description: |
      Handler of syscon node defining physical base address of the controller
      and length of memory mapped region. Requires MFD_SYSCON.
    $ref: /schemas/types.yaml#/definitions/phandle

  clocks:
    description: The clock provided by the SoC to drive the touchscreen controller.
    maxItems: 1

  clock-names:
    items:
      - const: tsc_clk

  interrupts:
    description: The touchscreen controller interrupt.
    items:
      - description: irq

  scanning_period:
    description: Time between scans in steps of 1024 µs. Valid 1–256.
    $ref: /schemas/types.yaml#/definitions/uint32

  debounce_timeout:
    description: Debounce duration in steps of 512 µs. Valid 0–255.
    $ref: /schemas/types.yaml#/definitions/uint32

  settling_timeout:
    description: Settling duration after driver enable, indexed 0–11 (0=0.008 ms … 11=10.24 ms).
    $ref: /schemas/types.yaml#/definitions/uint32

  touch_timeout:
    description: Number of scan periods without touch before idle. Valid 0–255.
    $ref: /schemas/types.yaml#/definitions/uint32

  average_data:
    description: Number of samples averaged before FIFO insert. Valid 0–7 (0=1 sample … 7=128 samples).
    $ref: /schemas/types.yaml#/definitions/uint32

  fifo_threshold:
    description: FIFO interrupt threshold. Valid 0–31.
    $ref: /schemas/types.yaml#/definitions/uint32

  touchscreen-size-x:
    description: Horizontal resolution of the touchscreen in pixels.
    $ref: /schemas/types.yaml#/definitions/uint32

  touchscreen-size-y:
    description: Vertical resolution of the touchscreen in pixels.
    $ref: /schemas/types.yaml#/definitions/uint32

  touchscreen-fuzz-x:
    description: Horizontal noise value of the absolute input device, in pixels.
    $ref: /schemas/types.yaml#/definitions/uint32

  touchscreen-fuzz-y:
    description: Vertical noise value of the absolute input device, in pixels.
    $ref: /schemas/types.yaml#/definitions/uint32

  touchscreen-inverted-x:
    description: X axis is inverted.
    type: boolean

  touchscreen-inverted-y:
    description: Y axis is inverted.
    type: boolean

required:
  - compatible
  - '#address-cells'
  - '#size-cells'
  - ts_syscon
  - clocks
  - clock-names
  - interrupts

additionalProperties: false

examples:
  - |
    ts_adc_syscon: ts_adc_syscon@180a6000 {
        compatible = "brcm,iproc-ts-adc-syscon","syscon";
        reg = <0x180a6000 0xc30>;
    };
    touchscreen: touchscreen@180a6000 {
        compatible = "brcm,iproc-touchscreen";
        #address-cells = <1>;
        #size-cells = <1>;
        ts_syscon = <&ts_adc_syscon>;
        clocks = <&adc_clk>;
        clock-names = "tsc_clk";
        interrupts = <GIC_SPI 164 IRQ_TYPE_LEVEL_HIGH>;

        scanning_period = <5>;
        debounce_timeout = <40>;
        settling_timeout = <7>;
        touch_timeout = <10>;
        average_data = <5>;
        fifo_threshold = <1>;
        /* Touchscreen is rotated 180 degrees. */
        touchscreen-inverted-x;
        touchscreen-inverted-y;
    };
```

## Documentation/devicetree/bindings/input/touchscreen/eeti,egalax_ts.yaml
```yaml
# SPDX-License-Identifier: (GPL-2.0-only OR BSD-2-Clause)
%YAML 1.2
---
$id: http://devicetree.org/schemas/input/touchscreen/eeti,egalax_ts.yaml#
$schema: http://devicetree.org/meta-schemas/core.yaml#

title: EETI eGalax Multiple Touch Controller

maintainers:
  - Dmitry Torokhov <dmitry.torokhov@gmail.com>
  - Fabio Estevam <fabio.estevam@freescale.com>
  - Hui Wang <jason77.wang@gmail.com>
  - Marco Franchi <marco.franchi@nxp.com>
  - Rob Herring <robh@kernel.org>

description: |
  * EETI eGalax Multiple Touch Controller

properties:
  compatible:
    items:
      - const: eeti,egalax_ts

  reg:
    items:
      - description: I2C slave address of the touch controller

  interrupts:
    description: Interrupt generated by the touch controller
    items:
      - description: Touch controller interrupt

  wakeup-gpios:
    maxItems: 1
    description: GPIO used to wake up the controller and used as interrupt

required:
  - compatible
  - reg
  - interrupts
  - wakeup-gpios

additionalProperties: false

examples:
  - |
    touchscreen@4 {
        compatible = "eeti,egalax_ts";
        reg = <0x04>;
        interrupts = <9 IRQ_TYPE_LEVEL_LOW>;
        wakeup-gpios = <&gpio1 9 GPIO_ACTIVE_LOW>;
    };
```

## Documentation/devicetree/bindings/input/touchscreen/eeti,exc3000-i2c.yaml
```yaml
# SPDX-License-Identifier: (GPL-2.0-only OR BSD-2-Clause)
# Copyright 2025 Daniel Mack <daniel@zonque.org>
%YAML 1.2
---
$id: http://devicetree.org/schemas/input/touchscreen/eeti,exc3000-i2c.yaml#
$schema: http://devicetree.org/meta-schemas/core.yaml#

title: EETI Exc3000 I2C Touchscreen Controller

maintainers:
  - Daniel Mack <daniel@zonque.org>

description: |
  Bindings for EETI touchscreen controller

  The following optional properties described in touchscreen.txt are
  also supported:

properties:
  compatible:
    const: "eeti,exc3000-i2c"
    description: |
      Matching table for EETI Exc3000 I2C touchscreen controller.

  reg:
    description: |
      I2C address of the Exc3000 touchscreen controller.
    items:
      - description: I2C address of the chip.

  interrupts:
    description: |
      Interrupt to which the touchscreen controller is connected.
    items:
      - description: Interrupt for touch events.

  attn-gpios:
    maxItems: 1
    description: |
      GPIO line to check whether interrupt is still latched; needed on
      platforms that lack support for level-triggered IRQs.

  touchscreen-inverted-x:
    description: |
      Invert the X axis of the touchscreen.

  touchscreen-inverted-y:
    description: |
      Invert the Y axis of the touchscreen.

  touchscreen-swapped-x-y:
    description: |
      Swap the X and Y axes of the touchscreen.

required:
  - compatible
  - reg
  - interrupts

additionalProperties: false

examples:
  - |-
    i2c-master {
      touchscreen@a {
        compatible = "eeti,exc3000-i2c";
        reg = <0xa>;
        interrupts = <123 IRQ_TYPE_EDGE_RISING>;
        attn-gpios = <&gpio 123 GPIO_ACTIVE_HIGH>;
      };
    };
```

## Documentation/devicetree/bindings/input/touchscreen/fsl-imx25-tcq.yaml
```yaml
# SPDX-License-Identifier: (GPL-2.0-only OR BSD-2-Clause)
# Copyright 2025 BayLibre
%YAML 1.2
---
$id: http://devicetree.org/schemas/fsl-imx25-tcq.yaml#
$schema: http://devicetree.org/meta-schemas/core.yaml#

title: Freescale mx25 TS conversion queue module

maintainers:
  - Eric Engestrom <eric@engestrom.ch>
  - Markus Schneider-Pargmann <msp@baylibre.com>
  - Rob Herring <robh@kernel.org>

description: |
  Freescale mx25 TS conversion queue module

  mx25 touchscreen conversion queue module which controls the ADC unit of the
  mx25 for attached touchscreens.

properties:
  compatible:
    items:
      - const: fsl,imx25-tcq

  reg:
    description: Memory range of the device.
    items:
      - description: Base address
      - description: Size in bytes

  interrupts:
    description: Interrupt number associated with this module within the tscadc unit.
    items:
      - description: Interrupt number

  fsl,wires:
    description: "Number of wires: 4 or 5."
    $ref: /schemas/types.yaml#/definitions/uint32
    enum: [4, 5]

  fsl,pen-debounce-ns:
    description: Pen debounce time in nanoseconds.

  fsl,pen-threshold:
    description: Pen-down threshold for the touchscreen.
    $ref: /schemas/types.yaml#/definitions/uint32
    minimum: 1
    maximum: 4096

  fsl,settling-time-ns:
    description: Settling time in nanoseconds to wait for an even charge distribution before touch detection.

required:
  - compatible
  - reg
  - interrupts
  - fsl,wires

additionalProperties: false

examples:
  - |
    tsc: tcq@50030400 {
        compatible = "fsl,imx25-tcq";
        reg = <0x50030400 0x60>;
        interrupts = <0>;
        fsl,wires = <4>;
    };
```

## Documentation/devicetree/bindings/input/touchscreen/hideep,hideep-ts.yaml
```yaml
# SPDX-License-Identifier: (GPL-2.0-only OR BSD-2-Clause)
%YAML 1.2
---
$id: http://devicetree.org/schemas/input/touchscreen/hideep,hideep-ts.yaml#
$schema: http://devicetree.org/meta-schemas/core.yaml#

title: HiDeep Finger and Stylus touchscreen controller

maintainers:
  - Anthony Kim <anthony.kim@hideep.com>
  - Jonathan Neuschäfer <j.neuschaefer@gmx.net>
  - Rob Herring <robh@kernel.org>

description: |
  HiDeep Finger and Stylus touchscreen controller

  Required properties:
  - compatible: must be "hideep,hideep-ts"
  - reg: I2C slave address (e.g. 0x6C)
  - interrupts: Interrupt to which the chip is connected

  Optional properties:
  - vdd-supply: Controller main voltage supply (3.3V)
  - vid-supply: IO voltage supply (1.8V)
  - reset-gpios: GPIO to reset the touchscreen IC
  - touchscreen-size-x: X axis size of the touchscreen in pixels
  - touchscreen-size-y: Y axis size of the touchscreen in pixels
  - linux,keycodes: Up to 3 numeric keycode values for button presses

properties:
  compatible:
    items:
      - const: hideep,hideep-ts
  reg:
    items:
      - description: I2C slave address
  interrupts:
    items:
      - description: Interrupt line and trigger type
  vdd-supply:
    description: Main voltage regulator supply (3.3V)
  vid-supply:
    description: IO voltage regulator supply (1.8V)
  reset-gpios:
    maxItems: 1
    description: Reset GPIO for the touchscreen IC
  touchscreen-size-x:
    $ref: /schemas/types.yaml#/definitions/uint32
    description: X axis size of the touchscreen in pixels
  touchscreen-size-y:
    $ref: /schemas/types.yaml#/definitions/uint32
    description: Y axis size of the touchscreen in pixels
  linux,keycodes:
    $ref: /schemas/types.yaml#/definitions/uint32-array
    maxItems: 3
    description: Up to 3 numeric keycodes for button presses

required:
  - compatible
  - reg
  - interrupts

additionalProperties: false

examples:
  - |
    i2c@00000000 {
      touchscreen@6c {
        compatible = "hideep,hideep-ts";
        reg = <0x6c>;
        interrupts = <2 IRQ_TYPE_LEVEL_LOW>;
        vdd-supply = <&ldo15_reg>;
        vid-supply = <&ldo18_reg>;
        reset-gpios = <&gpx1 5 0>;
        touchscreen-size-x = <1080>;
        touchscreen-size-y = <1920>;
        linux,keycodes = <KEY_HOME>, <KEY_MENU>, <KEY_BACK>;
      };
    };
```

## Documentation/devicetree/bindings/input/touchscreen/maxim,max11801.yaml
```yaml
# SPDX-License-Identifier: (GPL-2.0-only OR BSD-2-Clause)
# Copyright 2018 Linaro Ltd.
%YAML 1.2
---
$id: http://devicetree.org/schemas/maxim,max11801.yaml#
$schema: http://devicetree.org/meta-schemas/core.yaml#

title: Maxim MAX11801 Resistive Touch Screen Controller

maintainers:
  - Jagan Teki <jagan@amarulasolutions.com>
  - Rob Herring <robh@kernel.org>

description: |
  * MAXI MAX11801 Resistive touch screen controller with i2c interface

properties:
  compatible:
    items:
      - const: maxim,max11801

  reg:
    items:
      - description: I2C slave address

  interrupts:
    items:
      - description: touch controller interrupt

required:
  - compatible
  - reg
  - interrupts

additionalProperties: false

examples:
  - |
    &i2c1 {
        touchscreen@48 {
            compatible = "maxim,max11801";
            reg = <0x48>;
            interrupts = <31 IRQ_TYPE_EDGE_FALLING>;
        };
    };
```

## Documentation/devicetree/bindings/input/touchscreen/melfas,mip4_ts.yaml
```yaml
# SPDX-License-Identifier: (GPL-2.0-only OR BSD-2-Clause)
# Copyright 2025 Melfas
%YAML 1.2
---
$id: http://devicetree.org/schemas/input/touchscreen/melfas,mip4_ts.yaml#
$schema: http://devicetree.org/meta-schemas/core.yaml#

title: MELFAS MIP4 Touchscreen

maintainers:
  - Rob Herring <robh@kernel.org>
  - Sangwon Jee <jeesw@melfas.com>

description: |
  * MELFAS MIP4 Touchscreen

properties:
  compatible:
    items:
      - const: melfas,mip4_ts

  reg:
    items:
      - description: I2C slave address of the chip (0x48 or 0x34)

  interrupts:
    items:
      - description: Interrupt to which the chip is connected

  ce-gpios:
    maxItems: 1
    description: GPIO connected to the CE (chip enable) pin of the chip

required:
  - compatible
  - reg
  - interrupts

additionalProperties: false

examples:
  - |
    i2c@00000000 {
        touchscreen: melfas_mip4@48 {
            compatible = "melfas,mip4_ts";
            reg = <0x48>;
            interrupts = <0 IRQ_TYPE_EDGE_FALLING>;
            ce-gpios = <&gpio 0 GPIO_ACTIVE_HIGH>;
        };
    };
```

## Documentation/devicetree/bindings/input/touchscreen/microchip,ar1021-i2c.yaml
```yaml
# SPDX-License-Identifier: (GPL-2.0-only OR BSD-2-Clause)
%YAML 1.2
---
$id: http://devicetree.org/schemas/input/touchscreen/microchip,ar1021-i2c.yaml#
$schema: http://devicetree.org/meta-schemas/core.yaml#

title: Microchip AR1021 touchscreen interface

maintainers:
  - Martin Kepplinger <martink@posteo.de>
  - Rob Herring <robh@kernel.org>

description: |
  Microchip AR1020 and AR1021 touchscreen interface (I2C)

properties:
  compatible:
    items:
      - const: microchip,ar1021-i2c
    description: Compatible string for the Microchip AR1021 I2C touchscreen controller
  reg:
    items:
      - description: I2C slave address
  interrupts:
    items:
      - description: Touch controller interrupt

required:
  - compatible
  - reg
  - interrupts

additionalProperties: false

examples:
  - |
    touchscreen@4d {
        compatible = "microchip,ar1021-i2c";
        reg = <0x4d>;
        interrupts = <11 IRQ_TYPE_LEVEL_HIGH>;
    };
```
