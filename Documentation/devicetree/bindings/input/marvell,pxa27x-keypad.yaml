## Documentation/devicetree/bindings/input/touchscreen/raspberrypi,firmware-ts.yaml
```yaml
# SPDX-License-Identifier: (GPL-2.0-only OR BSD-2-Clause)
# Copyright 2025 Nicolas Saenz Julienne
%YAML 1.2
---
$id: http://devicetree.org/schemas/raspberrypi,firmware-ts.yaml#
$schema: http://devicetree.org/meta-schemas/core.yaml#

title: Raspberry Pi firmware based 7" touchscreen
maintainers:
  - Nicolas Saenz Julienne <nsaenz@kernel.org>

description: |
  Raspberry Pi firmware based 7" touchscreen

properties:
  compatible:
    description: Binding compatible string for Raspberry Pi firmware touchscreen
    $ref: /schemas/types.yaml#/definitions/string-array
    items:
      - enum:
          - raspberrypi,firmware-ts

  firmware:
    description: Reference to RPi's firmware device node
    $ref: /schemas/types.yaml#/definitions/phandle

  touchscreen-size-x:
    description: Width of the touchscreen in pixels
    $ref: /schemas/types.yaml#/definitions/uint32

  touchscreen-size-y:
    description: Height of the touchscreen in pixels
    $ref: /schemas/types.yaml#/definitions/uint32

  touchscreen-inverted-x:
    description: Invert the X axis
    type: boolean

  touchscreen-inverted-y:
    description: Invert the Y axis
    type: boolean

  touchscreen-swapped-x-y:
    description: Swap the X and Y axes
    type: boolean

required:
  - compatible

additionalProperties: false

examples:
  - |
    firmware: firmware-rpi {
        compatible = "raspberrypi,bcm2835-firmware";
        mboxes = <&mailbox>;

        ts: touchscreen {
            compatible = "raspberrypi,firmware-ts";
            touchscreen-size-x = <800>;
            touchscreen-size-y = <480>;
        };
    };
```

## Documentation/devicetree/bindings/input/touchscreen/rohm,bu21013_tp.yaml
```yaml
# SPDX-License-Identifier: (GPL-2.0-only OR BSD-2-Clause)
%YAML 1.2
---
$id: http://devicetree.org/schemas/input/touchscreen/rohm,bu21013_tp.yaml#
$schema: http://devicetree.org/meta-schemas/core.yaml#

title: Rohm BU21013 touch screen controller

maintainers:
  - Dmitry Torokhov <dmitry.torokhov@gmail.com>
  - Lee Jones <lee@kernel.org>
  - Linus Walleij <linus.walleij@linaro.org>
  - Mathieu Malaterre <malat@debian.org>

description: |
  Rohm BU21013 touch screen controller.

  Required properties:
    - compatible: "rohm,bu21013_tp"
    - reg: I2C device address
    - reset-gpios: GPIO pin enabling (selecting) chip (CS)
    - interrupt-parent: phandle for the GPIO controller
    - interrupts: (GPIO) interrupt to which the chip is connected

  Optional properties:
    - touch-gpios: GPIO pin registering a touch event
    - <supply_name>-supply: phandle to a regulator supply
    - touchscreen-size-x: width of the touchscreen in pixels
    - touchscreen-size-y: height of the touchscreen in pixels
    - touchscreen-inverted-x: invert the X axis
    - touchscreen-inverted-y: invert the Y axis
    - touchscreen-swapped-x-y: swap the X and Y axes

  Deprecated properties:
    - rohm,touch-max-x: maximum outward permitted limit in the X axis
    - rohm,touch-max-y: maximum outward permitted limit in the Y axis
    - rohm,flip-x: flip touch coordinates on the X axis
    - rohm,flip-y: flip touch coordinates on the Y axis

properties:
  compatible:
    items:
      - const: rohm,bu21013_tp

  reg:
    description: I2C address of the BU21013 controller
    maxItems: 1

  reset-gpios:
    description: GPIO pin enabling (selecting) chip (CS)
    maxItems: 1

  interrupts:
    maxItems: 1

  touch-gpios:
    description: GPIO pin registering a touch event
    maxItems: 1

  touchscreen-size-x:
    description: width of the touchscreen in pixels
    $ref: /schemas/types.yaml#/definitions/uint32

  touchscreen-size-y:
    description: height of the touchscreen in pixels
    $ref: /schemas/types.yaml#/definitions/uint32

  touchscreen-inverted-x:
    description: invert the X axis
    type: boolean

  touchscreen-inverted-y:
    description: invert the Y axis
    type: boolean

  touchscreen-swapped-x-y:
    description: swap the X and Y axes
    type: boolean

  rohm,touch-max-x:
    description: deprecated; maximum outward permitted limit in the X axis
    $ref: /schemas/types.yaml#/definitions/uint32

  rohm,touch-max-y:
    description: deprecated; maximum outward permitted limit in the Y axis
    $ref: /schemas/types.yaml#/definitions/uint32

  rohm,flip-x:
    description: deprecated; flip touch coordinates on the X axis
    type: boolean
    deprecated: true

  rohm,flip-y:
    description: deprecated; flip touch coordinates on the Y axis
    type: boolean
    deprecated: true

patternProperties:
  '^[a-zA-Z][a-zA-Z0-9,+._@-]*-supply$':
    description: phandle to a regulator supply

required:
  - compatible
  - reg
  - reset-gpios
  - interrupts

additionalProperties: false

examples:
  - |
    i2c@80110000 {
      bu21013_tp@5c {
        compatible = "rohm,bu21013_tp";
        reg = <0x5c>;
        reset-gpios = <&gpio2 20 GPIO_ACTIVE_LOW>;
        interrupts = <&gpio2 20 IRQ_TYPE_LEVEL_LOW>;
        touch-gpios = <&gpio2 20 GPIO_ACTIVE_LOW>;
        avdd-supply = <&ab8500_ldo_aux1_reg>;

        touchscreen-size-x = <384>;
        touchscreen-size-y = <704>;
        touchscreen-inverted-y;
      };
    };
```

## Documentation/devicetree/bindings/input/touchscreen/rohm,bu21029.yaml
```yaml
# SPDX-License-Identifier: (GPL-2.0-only OR BSD-2-Clause)
# Copyright 2025 Zhu Yi
%YAML 1.2
---
$id: http://devicetree.org/schemas/input/touchscreen/rohm,bu21029.yaml#
$schema: http://devicetree.org/meta-schemas/core.yaml#

title: Rohm BU21029 Touch Screen Controller
maintainers:
  - Zhu Yi <yi.zhu5@cn.bosch.com>

description: |
  * Rohm BU21029 Touch Screen Controller

properties:
  compatible:
    items:
      - const: rohm,bu21029
    description: Must be "rohm,bu21029".
  reg:
    items:
      - description: I2C bus address of the chip (0x40 or 0x41)
  interrupts:
    items:
      - description: (gpio) interrupt to which the chip is connected
  rohm,x-plate-ohms:
    description: X-plate resistance in Ohm
  reset-gpios:
    maxItems: 1
    description: GPIO pin to reset the chip (active low)
  touchscreen-size-x:
    description: Horizontal resolution of touchscreen (in pixels)
    $ref: /schemas/types.yaml#/definitions/uint32
  touchscreen-size-y:
    description: Vertical resolution of touchscreen (in pixels)
    $ref: /schemas/types.yaml#/definitions/uint32
  touchscreen-max-pressure:
    description: Maximum pressure value
    $ref: /schemas/types.yaml#/definitions/uint32
  vdd-supply:
    description: Power supply for the controller

required:
  - compatible
  - reg
  - interrupts
  - rohm,x-plate-ohms

additionalProperties: false

examples:
  - |
    &i2c1 {
      /* ... */
      bu21029: bu21029@40 {
        compatible = "rohm,bu21029";
        reg = <0x40>;
        interrupts = <4 IRQ_TYPE_EDGE_FALLING>;
        reset-gpios = <&gpio6 16 GPIO_ACTIVE_LOW>;
        rohm,x-plate-ohms = <600>;
        touchscreen-size-x = <800>;
        touchscreen-size-y = <480>;
        touchscreen-max-pressure = <4095>;
      };
      /* ... */
    };
```
