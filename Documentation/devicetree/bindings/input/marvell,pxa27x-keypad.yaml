## Documentation/devicetree/bindings/input/st,spear300-kbd.yaml
```yaml
# SPDX-License-Identifier: (GPL-2.0-only OR BSD-2-Clause)
# Copyright 2025 Viresh Kumar <vireshk@kernel.org>
%YAML 1.2
---
$id: http://devicetree.org/schemas/st,spear300-kbd.yaml#
$schema: http://devicetree.org/meta-schemas/core.yaml#

title: SPEAr keyboard controller
maintainers:
  - Viresh Kumar <vireshk@kernel.org>
description: |
  * SPEAr keyboard controller

properties:
  compatible:
    const: st,spear300-kbd

  reg:
    description: Memory region for the SPEAr keyboard controller.
    items:
      - description: Register window

  linux,keymap:
    description: Keymap entries for the SPEAr keyboard controller.
    $ref: /schemas/types.yaml#/definitions/uint32-array

  autorepeat:
    description: Enables key autorepeat.
    type: boolean

  st,mode:
    description: "Keyboard mode: 0 - 9x9, 1 - 6x6, 2 - 2x2."
    $ref: /schemas/types.yaml#/definitions/uint32-array
    items:
      - enum: [0, 1, 2]

required:
  - compatible

additionalProperties: false

examples:
  - |
    kbd@fc400000 {
        compatible = "st,spear300-kbd";
        reg = <0xfc400000 0x100>;
        linux,keymap = <0x00030012 0x0102003a>;
        autorepeat;
        st,mode = <0>;
    };
```

## Documentation/devicetree/bindings/input/st,sti-keyscan.yaml
```yaml
# SPDX-License-Identifier: (GPL-2.0-only OR BSD-2-Clause)
---
$id: http://devicetree.org/schemas/st,sti-keyscan.yaml#
$schema: http://devicetree.org/meta-schemas/core.yaml#

title: ST keyscan controller

maintainers:
  - Gabriel FERNANDEZ <gabriel.fernandez@st.com>

description: |
  * ST Keyscan controller Device Tree bindings

  The ST keyscan controller Device Tree binding is based on the
  matrix-keymap.

properties:
  compatible:
    const: st,sti-keyscan

  reg:
    description: Register base address and size of the keyscan controller
    items:
      - description: base address and size

  interrupts:
    description: Interrupt specifier for the keyscan controller
    items:
      - description: interrupt specifier

  interrupt-controller: true

  clocks:
    description: Module clock for the keyscan controller
    maxItems: 1

  pinctrl-names:
    items:
      - const: default

  pinctrl-0:
    description: Pin control group for keyscan controller

  linux,keymap:
    description: Keymap for keys as described in devicetree/bindings/input/matrix-keymap.txt
    items:
      - description: matrix key definition

  keypad,num-rows:
    description: Number of row lines connected to the keypad controller
    items:
      - description: row count

  keypad,num-columns:
    description: Number of column lines connected to the keypad controller
    items:
      - description: column count

  st,debounce_us:
    description: Debouncing interval time in microseconds
    $ref: /schemas/types.yaml#/definitions/uint32

additionalProperties: false

examples:
  - |
    keyscan: keyscan@fe4b0000 {
        compatible = "st,sti-keyscan";
        reg = <0xfe4b0000 0x2000>;
        interrupts = <GIC_SPI 212 IRQ_TYPE_NONE>;
        clocks = <&CLK_SYSIN>;
        pinctrl-names = "default";
        pinctrl-0 = <&pinctrl_keyscan>;
        keypad,num-rows = <4>;
        keypad,num-columns = <4>;
        st,debounce_us = <5000>;
        linux,keymap = <
            MATRIX_KEY(0x00, 0x00, KEY_F13)
            MATRIX_KEY(0x00, 0x01, KEY_F9)
            MATRIX_KEY(0x00, 0x02, KEY_F5)
            MATRIX_KEY(0x00, 0x03, KEY_F1)
            MATRIX_KEY(0x01, 0x00, KEY_F14)
            MATRIX_KEY(0x01, 0x01, KEY_F10)
            MATRIX_KEY(0x01, 0x02, KEY_F6)
            MATRIX_KEY(0x01, 0x03, KEY_F2)
            MATRIX_KEY(0x02, 0x00, KEY_F15)
            MATRIX_KEY(0x02, 0x01, KEY_F11)
            MATRIX_KEY(0x02, 0x02, KEY_F7)
            MATRIX_KEY(0x02, 0x03, KEY_F3)
            MATRIX_KEY(0x03, 0x00, KEY_F16)
            MATRIX_KEY(0x03, 0x01, KEY_F12)
            MATRIX_KEY(0x03, 0x02, KEY_F8)
            MATRIX_KEY(0x03, 0x03, KEY_F4)
        >;
    };
```

## Documentation/devicetree/bindings/input/ti,omap4-keypad.yaml
```yaml
# SPDX-License-Identifier: (GPL-2.0-only OR BSD-2-Clause)
%YAML 1.2
---
$id: http://devicetree.org/schemas/ti,omap4-keypad.yaml#
$schema: http://devicetree.org/meta-schemas/core.yaml#

title: TI OMAP4 Keypad Controller

maintainers:
  - Simon Glass <sjg@chromium.org>
  - Sourav Poddar <sourav.poddar@ti.com>

description: |
  * TI's Keypad Controller device tree bindings

  TI's Keypad controller is used to interface a SoC with a matrix-type
  keypad device. The keypad controller supports multiple row and column lines.
  A key can be placed at each intersection of a unique row and a unique column.
  The keypad controller can sense a key-press and key-release and report the
  event using a interrupt to the cpu.

  This binding is based on the matrix-keymap binding with the following
  changes:

properties:
  compatible:
    items:
      - const: ti,omap4-keypad
  keypad,num-rows:
    description: Number of rows in the keypad matrix.
    $ref: /schemas/types.yaml#/definitions/uint32
  keypad,num-columns:
    description: Number of columns in the keypad matrix.
    $ref: /schemas/types.yaml#/definitions/uint32
  linux,keypad-no-autorepeat:
    description: Disable the autorepeat feature in Linux.
    type: boolean

required:
  - compatible
  - keypad,num-rows
  - keypad,num-columns

additionalProperties: false

examples:
  - |
    keypad@4ae1c000 {
        compatible = "ti,omap4-keypad";
        keypad,num-rows = <2>;
        keypad,num-columns = <8>;
        linux,keypad-no-autorepeat;
    };
```

## Documentation/devicetree/bindings/input/ti,palmas-pwrbutton.yaml
```yaml
# SPDX-License-Identifier: (GPL-2.0-only OR BSD-2-Clause)
# Copyright 2025 Texas Instruments
%YAML 1.2
---
$id: http://devicetree.org/schemas/ti,palmas-pwrbutton.yaml#
$schema: http://devicetree.org/meta-schemas/core.yaml#

title: TI Palmas power button module
maintainers:
  - Nishanth Menon <nm@ti.com>
  - Rob Herring <robh@kernel.org>

description: |
  Texas Instruments Palmas family power button module

  This module is part of the Palmas family of PMICs. For more details
  about the whole chip see:
  Documentation/devicetree/bindings/mfd/palmas.txt.

  This module provides a simple power button event via an Interrupt.

properties:
  compatible:
    items:
      - const: ti,palmas-pwrbutton
  interrupts:
    description: Interrupt number of power button submodule on device.
    items:
      - description: Power button interrupt event.
  ti,palmas-long-press-seconds:
    description: Duration in seconds which the power button should be kept
      pressed for Palmas to power off automatically.
    $ref: /schemas/types.yaml#/definitions/uint32
    enum: [6, 8, 10, 12]
  ti,palmas-pwron-debounce-milli-seconds:
    description: Duration in milliseconds which the power button should be kept
      pressed for Palmas to register a press for debouncing purposes.
    $ref: /schemas/types.yaml#/definitions/uint32
    enum: [15, 100, 500, 1000]

required:
  - compatible
  - interrupts

additionalProperties: false

examples:
  - |
    &palmas {
        palmas_pwr_button: pwrbutton {
            compatible = "ti,palmas-pwrbutton";
            interrupts = <1 IRQ_TYPE_EDGE_FALLING>;
            ti,palmas-long-press-seconds = <12>;
            ti,palmas-pwron-debounce-milli-seconds = <15>;
        };
    };
```

## Documentation/devicetree/bindings/input/ti,tca8418.yaml
```yaml
# SPDX-License-Identifier: (GPL-2.0-only OR BSD-2-Clause)
# Copyright 2025 Avionic Design
%YAML 1.2
---
$id: http://devicetree.org/schemas/ti,tca8418.yaml#
$schema: http://devicetree.org/meta-schemas/core.yaml#

title: TI TCA8418 Keypad Controller

maintainers:
  - Alban Bedel <alban.bedel@avionic-design.de>
  - Simon Glass <sjg@chromium.org>

description: |
  This binding is based on the matrix-keymap binding with the following changes:

  keypad,num-rows and keypad,num-columns are required.

properties:
  compatible:
    items:
      - const: ti,tca8418

  reg:
    description: I2C address of the TCA8418 device.
    items:
      - description: I2C bus address

  interrupts:
    description: Interrupt line number, triggers on falling edge.
    items:
      - description: Interrupt, falling-edge triggered

  linux,keymap:
    description: Keys definitions, see keypad-matrix.
    $ref: /schemas/types.yaml#/definitions/string-array

required:
  - compatible
  - reg
  - interrupts
  - linux,keymap

additionalProperties: false

examples:
  - |
    keypad@24 {
        compatible = "ti,tca8418";
        reg = <0x24>;
        interrupts = <10 2>;
        linux,keymap = <0 1 2 3>;
    };
```

## Documentation/devicetree/bindings/input/ti,tps65218-pwrbutton.yaml
```yaml
# SPDX-License-Identifier: (GPL-2.0-only OR BSD-2-Clause)
%YAML 1.2
---
$id: http://devicetree.org/schemas/ti,tps65218-pwrbutton.yaml#
$schema: http://devicetree.org/meta-schemas/core.yaml#

title: Texas Instruments TPS65217 and TPS65218 power button

maintainers:
  - Felipe Balbi <balbi@ti.com>
  - Marcin Niestroj <m.niestroj@grinn-global.com>
  - Milo Kim <woogyom.kim@gmail.com>

description: |
  Texas Instruments TPS65217 and TPS65218 power button

  This module is part of the TPS65217/TPS65218. For more details about the whole
  TPS65217 chip see Documentation/devicetree/bindings/regulator/tps65217.txt.

  This driver provides a simple power button event via an Interrupt.

properties:
  compatible:
    description: >
      Must be one of:
      - "ti,tps65217-pwrbutton"
      - "ti,tps65218-pwrbutton"
    items:
      - enum:
          - ti,tps65217-pwrbutton
          - ti,tps65218-pwrbutton

  interrupts:
    description: |
      Interrupt for the power button. Use:
      - <2> for controllers compatible with ti,tps65217
      - <3 IRQ_TYPE_EDGE_BOTH> for controllers compatible with ti,tps65218

required:
  - compatible
  - interrupts

additionalProperties: false

examples:
  - |
      &tps {
          tps65217-pwrbutton {
              compatible = "ti,tps65217-pwrbutton";
              interrupts = <2>;
          };
      };
  - |
      &tps {
          power-button {
              compatible = "ti,tps65218-pwrbutton";
              interrupts = <3 IRQ_TYPE_EDGE_BOTH>;
          };
      };
```

## Documentation/devicetree/bindings/input/ti,twl4030-keypad.yaml
```yaml
# SPDX-License-Identifier: (GPL-2.0-only OR BSD-2-Clause)
# Copyright 2025 Sebastian Reichel <sre@kernel.org>
%YAML 1.2
---
$id: http://devicetree.org/schemas/ti,twl4030-keypad.yaml#
$schema: http://devicetree.org/meta-schemas/core.yaml#

title: TWL4030 Keypad Controller

maintainers:
  - Sebastian Reichel <sre@kernel.org>

description: |
  * TWL4030's Keypad Controller device tree bindings

  TWL4030's Keypad controller is used to interface a SoC with a matrix-type
  keypad device. The keypad controller supports multiple row and column lines.
  A key can be placed at each intersection of a unique row and a unique column.
  The keypad controller can sense a key-press and key-release and report the
  event using a interrupt to the cpu.

  This binding is based on the matrix-keymap binding with the following
  changes:

   * keypad,num-rows and keypad,num-columns are required.

properties:
  compatible:
    items:
      - const: "ti,twl4030-keypad"
    description: Name of the driver for the TWL4030 keypad controller.

  interrupts:
    maxItems: 1
    description: Interrupt line used by the keypad controller.

  keypad,num-rows:
    description: Number of rows in the keypad matrix.
    $ref: /schemas/types.yaml#/definitions/uint32

  keypad,num-columns:
    description: Number of columns in the keypad matrix.
    $ref: /schemas/types.yaml#/definitions/uint32

required:
  - compatible
  - interrupts
  - keypad,num-rows
  - keypad,num-columns

additionalProperties: false

examples:
  - |
    twl_keypad: keypad {
        compatible = "ti,twl4030-keypad";
        interrupts = <1>;
        keypad,num-rows = <8>;
        keypad,num-columns = <8>;
    };
```

## Documentation/devicetree/bindings/input/touchscreen/auo,auo_pixcir_ts.yaml
```yaml
# SPDX-License-Identifier: (GPL-2.0-only OR BSD-2-Clause)
%YAML 1.2
---
$id: http://devicetree.org/schemas/input/touchscreen/auo,auo_pixcir_ts.yaml#
$schema: http://devicetree.org/meta-schemas/core.yaml#

title: AUO In-Cell Touchscreen Controller using Pixcir Sensors

maintainers:
  - Dmitry Torokhov <dmitry.torokhov@gmail.com>
  - Heiko Stübner <heiko@sntech.de>

description: |
  AUO in-cell touchscreen controller using Pixcir sensors

properties:
  compatible:
    items:
      - const: "auo,auo_pixcir_ts"
  reg:
    items:
      - description: I2C address of the chip
    description: |
      I2C address of the chip.
  interrupts:
    items:
      - description: Interrupt to which the chip is connected
    description: |
      Interrupt used by the touchscreen controller.
  gpios:
    items:
      - description: Interrupt GPIO, active high trigger
      - description: Reset GPIO, active low reset
    description: |
      GPIOs used by the touchscreen controller.
      The first entry is the interrupt GPIO and the second is the reset GPIO.
  x-size:
    $ref: /schemas/types.yaml#/definitions/uint32
    description: |
      Horizontal resolution of the touchscreen.
  y-size:
    $ref: /schemas/types.yaml#/definitions/uint32
    description: |
      Vertical resolution of the touchscreen.

required:
  - compatible
  - reg
  - interrupts
  - gpios
  - x-size
  - y-size

additionalProperties: false

examples:
  - |
    i2c@00000000 {
        /* ... */

        auo_pixcir_ts@5c {
            compatible = "auo,auo_pixcir_ts";
            reg = <0x5c>;
            interrupts = <2 IRQ_TYPE_LEVEL_HIGH>;

            gpios = <&gpf 2 0 GPIO_LEVEL_HIGH>, /* INT */
                <&gpf 5 1 GPIO_LEVEL_LOW>; /* RST */

            x-size = <800>;
            y-size = <600>;
        };

        /* ... */
    };
```
