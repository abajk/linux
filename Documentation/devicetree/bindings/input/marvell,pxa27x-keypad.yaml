## Documentation/devicetree/bindings/input/marvell,pxa27x-keypad.yaml
```yaml
# SPDX-License-Identifier: (GPL-2.0-only OR BSD-2-Clause)
%YAML 1.2
---
$id: http://devicetree.org/schemas/marvell,pxa27x-keypad.yaml#
$schema: http://devicetree.org/meta-schemas/core.yaml#

title: Marvell PXA27x Keypad controller

maintainers:
  - Chao Xie <chao.xie@marvell.com>

description: |
  * Marvell PXA Keypad controller

properties:
  compatible:
    items:
      - const: marvell,pxa27x-keypad
    description: Device must be compatible with the Marvell PXA27x keypad controller.

  reg:
    items:
      - description: Base address of the keypad controller registers
      - description: Size of the register region in bytes

  interrupts:
    items:
      - description: Interrupt for the keypad controller

  marvell,debounce-interval:
    description: >
      Debounce intervals for direct and matrix keys in units of 2ms.
      Bit[31:16] is debounce interval for direct keys.
      Bit[15:0] is debounce interval for matrix keys.
    $ref: /schemas/types.yaml#/definitions/uint32

  keypad,num-rows:
    description: Number of rows in the keypad matrix.
    $ref: /schemas/types.yaml#/definitions/uint32

  keypad,num-columns:
    description: Number of columns in the keypad matrix.
    $ref: /schemas/types.yaml#/definitions/uint32

  linux,keymap:
    description: >
      Array of keymap entries for the keypad matrix.
      Each entry encodes row, column, and key code.
    $ref: /schemas/types.yaml#/definitions/uint32-array

  marvell,direct-key-count:
    description: Number of direct keys in use.
    $ref: /schemas/types.yaml#/definitions/uint32

  marvell,direct-key-mask:
    description: >
      Mask indicating which direct keys are used.
      Bit[X] set means direct key X is enabled.
    $ref: /schemas/types.yaml#/definitions/uint32

  marvell,direct-key-low-active:
    description: Direct keys are active when the input pin is low.
    type: boolean

  marvell,direct-key-map:
    description: Array of Linux key-codes for each direct key.
    $ref: /schemas/types.yaml#/definitions/uint32-array

  marvell,rotary0:
    description: >
      Linux key-codes for rotary 0; high 16 bits for rotate up,
      low 16 bits for rotate down.
    $ref: /schemas/types.yaml#/definitions/uint32

  marvell,rotary1:
    description: >
      Linux key-codes for rotary 1; high 16 bits for rotate up,
      low 16 bits for rotate down.
    $ref: /schemas/types.yaml#/definitions/uint32

  marvell,rotary-rel-key:
    description: >
      Linux key-codes for relative rotary axes; high 16 bits for rotary 1,
      low 16 bits for rotary 0.
    $ref: /schemas/types.yaml#/definitions/uint32

required:
  - compatible
  - reg
  - interrupts

additionalProperties: false

examples:
  - |
    keypad@d4012000 {
      compatible = "marvell,pxa27x-keypad";
      reg = <0xd4012000 0x1000>;
      interrupts = <113>;
      marvell,debounce-interval = <0x001e001e>;
      keypad,num-rows = <3>;
      keypad,num-columns = <5>;
      linux,keymap = <
        0x0000000e /* KEY_BACKSPACE */
        0x0001006b /* KEY_END */
        0x00020061 /* KEY_RIGHTCTRL */
        0x0003000b /* KEY_0 */
        0x00040002 /* KEY_1 */
        0x0100008b /* KEY_MENU */
        0x01010066 /* KEY_HOME */
        0x010200e7 /* KEY_SEND */
        0x01030009 /* KEY_8 */
        0x0104000a /* KEY_9 */
        0x02000160 /* KEY_OK */
        0x02010003 /* KEY_2 */
        0x02020004 /* KEY_3 */
        0x02030005 /* KEY_4 */
        0x02040006 /* KEY_5 */
      >;
      marvell,rotary0 = <0x006c0067>; /* KEY_UP & KEY_DOWN */
      marvell,direct-key-count = <1>;
      marvell,direct-key-map = <0x001c>;
    };
```

## Documentation/devicetree/bindings/input/microchip,qt1050.yaml
```yaml
# SPDX-License-Identifier: (GPL-2.0-only OR BSD-2-Clause)
%YAML 1.2
---
$id: http://devicetree.org/schemas/microchip,qt1050.yaml#
$schema: http://devicetree.org/meta-schemas/core.yaml#

title: Microchip AT42QT1050 Five-channel Touch Sensor IC

maintainers:
  - Marco Felsch <m.felsch@pengutronix.de>

description: |
  The AT42QT1050 (QT1050) is a QTouchADC sensor device. The device can sense from
  one to five keys, dependent on mode. The QT1050 includes all signal processing
  functions necessary to provide stable sensing under a wide variety of changing
  conditions, and the outputs are fully debounced.

properties:
  compatible:
    const: microchip,qt1050

  reg:
    maxItems: 1

  interrupts:
    maxItems: 1
    description: Touch sensor IRQ specifier

  wakeup-source:
    type: boolean
    description: Touch keys can be used as a wakeup source

  microchip,pre-charge-time-ns:
    description: Time for touchpad pre-charge in nanoseconds
    minimum: 0
    maximum: 637500
    multipleOf: 2500
    default: 0

  microchip,average-samples:
    description: Number of data samples to average for each read
    $ref: /schemas/types.yaml#/definitions/uint32
    enum: [1, 4, 16, 64, 256, 1024, 4096, 16384]
    default: 1

  microchip,average-scaling:
    description: Scaling factor for average-samples
    $ref: /schemas/types.yaml#/definitions/uint32
    enum: [1, 2, 4, 8, 16, 32, 64, 128]
    default: 1

  microchip,threshold:
    description: Number of counts to register a touch detection
    $ref: /schemas/types.yaml#/definitions/uint32
    minimum: 0
    maximum: 255
    default: 20

patternProperties:
  "^[^/]+$":
    type: object
    description: Touch key sub-node
    properties:
      reg:
        description: Key number (0–4)
        enum: [0, 1, 2, 3, 4]

      linux,code:
        $ref: /schemas/types.yaml#/definitions/uint32
        description: Keycode to emit

      microchip,pre-charge-time-ns:
        description: Time for touchpad pre-charge in nanoseconds
        minimum: 0
        maximum: 637500
        multipleOf: 2500
        default: 0

      microchip,average-samples:
        description: Number of data samples to average for each read
        $ref: /schemas/types.yaml#/definitions/uint32
        enum: [1, 4, 16, 64, 256, 1024, 4096, 16384]
        default: 1

      microchip,average-scaling:
        description: Scaling factor for average-samples
        $ref: /schemas/types.yaml#/definitions/uint32
        enum: [1, 2, 4, 8, 16, 32, 64, 128]
        default: 1

      microchip,threshold:
        description: Number of counts to register a touch detection
        $ref: /schemas/types.yaml#/definitions/uint32
        minimum: 0
        maximum: 255
        default: 20

    required:
      - reg
      - linux,code
    additionalProperties: false

additionalProperties: false

examples:
  - |
    touchkeys@41 {
        compatible = "microchip,qt1050";
        reg = <0x41>;
        interrupts = <17 IRQ_TYPE_EDGE_FALLING>;

        up@0 {
            reg = <0>;
            linux,code = <KEY_UP>;
            microchip,average-samples = <64>;
            microchip,average-scaling = <16>;
            microchip,pre-charge-time-ns = <10000>;
        };

        right@1 {
            reg = <1>;
            linux,code = <KEY_RIGHT>;
            microchip,average-samples = <64>;
            microchip,average-scaling = <8>;
        };

        down@3 {
            reg = <3>;
            linux,code = <KEY_DOWN>;
            microchip,average-samples = <256>;
            microchip,average-scaling = <16>;
        };
    };
```

## Documentation/devicetree/bindings/input/motorola,cpcap-pwrbutton.yaml
```yaml
# SPDX-License-Identifier: (GPL-2.0-only OR BSD-2-Clause)
# Copyright 2025 Sebastian Reichel
%YAML 1.2
---
$id: http://devicetree.org/schemas/motorola,cpcap-pwrbutton.yaml#
$schema: http://devicetree.org/meta-schemas/core.yaml#

title: Motorola CPCAP power button

maintainers:
  - Sebastian Reichel <sre@kernel.org>

description: |
  Motorola CPCAP on key

  This module is part of the CPCAP. For more details about the whole
  chip see Documentation/devicetree/bindings/mfd/motorola-cpcap.txt.

  This module provides a simple power button event via an Interrupt.

properties:
  compatible:
    items:
      - const: motorola,cpcap-pwrbutton
  interrupts:
    description: IRQ specifier for CPCAP's ON IRQ
    items:
      - description: IRQ specifier for CPCAP's ON IRQ

required:
  - compatible
  - interrupts

additionalProperties: false

examples:
  - |
    &cpcap {
        cpcap_pwrbutton: pwrbutton {
            compatible = "motorola,cpcap-pwrbutton";
            interrupts = <23 IRQ_TYPE_NONE>;
        };
    };
```

## Documentation/devicetree/bindings/input/nvidia,tegra20-kbc.yaml
```yaml
# SPDX-License-Identifier: (GPL-2.0-only OR BSD-2-Clause)
# Copyright (c) 2025 NVIDIA Corporation
%YAML 1.2
---
$id: http://devicetree.org/schemas/nvidia,tegra20-kbc.yaml#
$schema: http://devicetree.org/meta-schemas/core.yaml#

title: NVIDIA Tegra20 Keyboard Controller

maintainers:
  - Laxman Dewangan <ldewangan@nvidia.com>
  - Stephen Warren <swarren@nvidia.com>
  - Sudeep Holla <sudeep.holla@arm.com>

description: |
  * Tegra keyboard controller
  The key controller has maximum 24 pins to make matrix keypad. Any pin
  can be configured as row or column. The maximum column pin can be 8
  and maximum row pins can be 16 for Tegra20/Tegra30.

properties:
  compatible:
    items:
      - const: nvidia,tegra20-kbc

  reg:
    description: Register base address of the KBC and its size.
    items:
      - description: base address
      - description: size

  interrupts:
    description: >
      Interrupt specifier for the KBC: interrupt-parent phandle, IRQ number and
      flags.
    items:
      - description: interrupt-parent phandle
      - description: IRQ number
      - description: flags

  clocks:
    maxItems: 1
    description: Module clock for the KBC.

  resets:
    description: Reset control for the KBC.

  reset-names:
    items:
      - const: kbc

  nvidia,kbc-row-pins:
    description: >
      The KBC pins which are configured as row. This is an array of pin
      numbers which are used as rows.
    $ref: /schemas/types.yaml#/definitions/uint32-array
    minItems: 1
    maxItems: 16

  nvidia,kbc-col-pins:
    description: >
      The KBC pins which are configured as column. This is an array of pin
      numbers which are used as columns.
    $ref: /schemas/types.yaml#/definitions/uint32-array
    minItems: 1
    maxItems: 8

  linux,keymap:
    description: >
      The keymap for keys as described in the binding document
      devicetree/bindings/input/matrix-keymap.txt.
    $ref: /schemas/types.yaml#/definitions/uint32-array

  linux,fn-keymap:
    description: >
      A second keymap, same specification as linux,keymap but used when the
      KEY_FN modifier key is pressed.
    $ref: /schemas/types.yaml#/definitions/uint32-array

  nvidia,debounce-delay-ms:
    description: Delay in milliseconds per row scan for debouncing.

  nvidia,repeat-delay-ms:
    description: Delay in milliseconds before repeat starts.

  nvidia,ghost-filter:
    description: Enable ghost filtering for this device.
    type: boolean

  wakeup-source:
    description: Configure keyboard as a wakeup source for suspend/resume.
    type: boolean

  "nvidia,wakeup-source":
    description: >
      Legacy property supported: Configure keyboard as a wakeup source for suspend/resume.
    type: boolean

required:
  - compatible
  - reg
  - interrupts
  - clocks
  - resets
  - reset-names
  - nvidia,kbc-row-pins
  - nvidia,kbc-col-pins
  - linux,keymap

additionalProperties: false

examples:
  - |
    keyboard: keyboard {
        compatible = "nvidia,tegra20-kbc";
        reg = <0x7000e200 0x100>;
        interrupts = <0 85 0x04>;
        clocks = <&tegra_car 36>;
        resets = <&tegra_car 36>;
        reset-names = "kbc";
        nvidia,ghost-filter;
        nvidia,debounce-delay-ms = <640>;
        nvidia,kbc-row-pins = <0 1 2>;
        nvidia,kbc-col-pins = <11 12 13>;
        linux,keymap = <0x00000074
                0x00010067
                0x00020066
                0x01010068
                0x02000069
                0x02010070
                0x02020071>;
    };
```

## Documentation/devicetree/bindings/input/nxp,lpc3220-key.yaml
```yaml
# SPDX-License-Identifier: (GPL-2.0-only OR BSD-2-Clause)
%YAML 1.2
---
$id: http://devicetree.org/schemas/nxp,lpc3220-key.yaml#
$schema: http://devicetree.org/meta-schemas/core.yaml#

title: NXP LPC32xx Key Scan Interface
maintainers:
  - Roland Stigge <stigge@antcom.de>
  - Simon Glass <sjg@chromium.org>
  - Vladimir Zapolskiy <vz@mleia.com>

description: |
  NXP LPC32xx Key Scan Interface

  This binding is based on the matrix-keymap binding with the following changes:

  Note: keypad,num-rows and keypad,num-columns are required, and must be equal
    since LPC32xx only supports square matrices

properties:
  compatible:
    items:
      - const: nxp,lpc3220-key

  reg:
    items:
      - description: Physical base address of the controller
      - description: Length of memory mapped region

  clocks:
    maxItems: 1
    description: phandle to clock controller plus clock-specifier pair

  interrupts:
    items:
      - description: Interrupt number to the CPU
      - description: Interrupt type flags

  keypad,num-rows:
    $ref: /schemas/types.yaml#/definitions/uint32
    description: Number of rows in the keypad. Must equal keypad,num-columns for square matrix support.

  keypad,num-columns:
    $ref: /schemas/types.yaml#/definitions/uint32
    description: Number of columns in the keypad. Must equal keypad,num-rows for square matrix support.

  nxp,debounce-delay-ms:
    description: Debounce delay in ms

  nxp,scan-delay-ms:
    description: Repeated scan period in ms

  linux,keymap:
    $ref: /schemas/types.yaml#/definitions/uint32-array
    maxItems: 1
    description: The key-code to be reported when the key is pressed and released.
      see also Documentation/devicetree/bindings/input/matrix-keymap.txt

required:
  - compatible
  - reg
  - clocks
  - interrupts
  - keypad,num-rows
  - keypad,num-columns
  - nxp,debounce-delay-ms
  - nxp,scan-delay-ms
  - linux,keymap

additionalProperties: false

examples:
  - |
    key@40050000 {
        compatible = "nxp,lpc3220-key";
        reg = <0x40050000 0x1000>;
        clocks = <&clk LPC32XX_CLK_KEY>;
        interrupts = <22 IRQ_TYPE_LEVEL_HIGH>;
        keypad,num-rows = <1>;
        keypad,num-columns = <1>;
        nxp,debounce-delay-ms = <3>;
        nxp,scan-delay-ms = <34>;
        linux,keymap = <0x00000002>;
    };
```

## Documentation/devicetree/bindings/input/raydium,rm32380.yaml
```yaml
# SPDX-License-Identifier: (GPL-2.0-only OR BSD-2-Clause)
# Copyright 2025 Rad-ic Ltd.
%YAML 1.2
---
$id: http://devicetree.org/schemas/raydium,rm32380.yaml#
$schema: http://devicetree.org/meta-schemas/core.yaml#

title: Raydium I2C touchscreen

maintainers:
  - Jeffrey Lin <jeffrey.lin@rad-ic.com>
  - Rob Herring <robh@kernel.org>

description: |
  Raydium I2C touchscreen

  Required properties:
  - compatible: must be "raydium,rm32380"
  - reg: The I2C address of the device
  - interrupts: interrupt to which the chip is connected (See ../interrupt-controller/interrupts.txt)

properties:
  compatible:
    const: raydium,rm32380

  reg:
    description: The I2C address of the device
    items:
      - description: I2C device address

  interrupts:
    description: Interrupt to which the chip is connected
    items:
      - description: Interrupt specifier

  avdd-supply:
    description: Analog power supply needed to power the device

  vccio-supply:
    description: IO power source for the device

  reset-gpios:
    maxItems: 1
    description: Reset GPIO the chip is connected to

required:
  - compatible
  - reg
  - interrupts

additionalProperties: false

examples:
  - |
    touchscreen@39 {
        compatible = "raydium,rm32380";
        reg = <0x39>;
        interrupts = <0x0 IRQ_TYPE_EDGE_FALLING>;
    };
```
