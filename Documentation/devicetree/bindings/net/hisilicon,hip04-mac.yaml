## Documentation/devicetree/bindings/net/marvell,orion-eth.yaml
```yaml
# SPDX-License-Identifier: (GPL-2.0-only OR BSD-2-Clause)
# Copyright 2025 Linaro Ltd.
%YAML 1.2
---
$id: http://devicetree.org/schemas/net/marvell,orion-eth.yaml#
$schema: http://devicetree.org/meta-schemas/core.yaml#

title: Marvell Orion/Discovery ethernet controller

maintainers:
  - Grant Likely <grant.likely@linaro.org>
  - Jason Gunthorpe <jgg@ziepe.ca>
  - Sebastian Hesselbarth <sebastian.hesselbarth@gmail.com>
  - Sergei Shtylyov <sergei.shtylyov@cogentembedded.com>

description: |
  Marvell Orion/Discovery ethernet controller

  The Marvell Discovery ethernet controller can be found on Marvell Orion SoCs
  (Kirkwood, Dove, Orion5x, and Discovery Innovation) and as part of Marvell
  Discovery system controller chips (mv64[345]60).

  The Discovery ethernet controller is described with two levels of nodes. The
  first level describes the ethernet controller itself and the second level
  describes up to 3 ethernet port nodes within that controller. The reason for
  the multiple levels is that the port registers are interleaved within a single
  set of controller registers. Each port node describes port-specific properties.

  Note: The above separation is only true for Discovery system controllers.
  For Orion SoCs we stick to the separation, although there each controller has
  only one port associated. Multiple ports are implemented as multiple single-port
  controllers. As Kirkwood has some issues with proper initialization after reset,
  an extra compatible string is added for it.

properties:
  compatible:
    items:
      - enum:
          - marvell,orion-eth
          - marvell,kirkwood-eth

  reg:
    maxItems: 1

  interrupts:
    maxItems: 1

  clocks:
    maxItems: 1

  marvell,tx-checksum-limit:
    description: Maximum transmit packet size for hardware checksum.
    $ref: /schemas/types.yaml#/definitions/uint32

  "#address-cells":
    description: Number of address cells for the controller node.
    const: 1

  "#size-cells":
    description: Number of size cells for the controller node.
    const: 0

patternProperties:
  "^ethernet@[0-9a-fA-F]+$":
    description: Ethernet port child node.
    type: object
    additionalProperties: false
    properties:
      compatible:
        items:
          - enum:
              - marvell,orion-eth-port
              - marvell,kirkwood-eth-port

      reg:
        description: Port number relative to ethernet controller.
        items:
          - description: Port index (0, 1, or 2).

      interrupts:
        maxItems: 1

      phy-handle:
        description: PHY device handle for the port.
        $ref: /schemas/types.yaml#/definitions/phandle

      phy-mode:
        description: PHY mode if no PHY-controller is present.
        $ref: /schemas/types.yaml#/definitions/string

      marvell,tx-queue-size:
        description: Size of the transmit ring buffer.
        $ref: /schemas/types.yaml#/definitions/uint32

      marvell,tx-sram-addr:
        description: Address of transmit descriptor buffer located in SRAM.
        $ref: /schemas/types.yaml#/definitions/uint32

      marvell,tx-sram-size:
        description: Size of transmit descriptor buffer located in SRAM.
        $ref: /schemas/types.yaml#/definitions/uint32

      marvell,rx-queue-size:
        description: Size of the receive ring buffer.
        $ref: /schemas/types.yaml#/definitions/uint32

      marvell,rx-sram-addr:
        description: Address of receive descriptor buffer located in SRAM.
        $ref: /schemas/types.yaml#/definitions/uint32

      marvell,rx-sram-size:
        description: Size of receive descriptor buffer located in SRAM.
        $ref: /schemas/types.yaml#/definitions/uint32

      speed:
        description: Port speed if no PHY-controller connected.
        enum:
          - 10
          - 100
          - 1000

      duplex:
        description: Port duplex mode if no PHY-controller connected.
        enum:
          - half
          - full

    required:
      - compatible
      - reg
      - interrupts
      - local-mac-address

additionalProperties: false

examples:
  - |
    mdio-bus {
        ethphy: ethernet-phy@8 {
            /* PHY node omitted */
        };

        eth: ethernet-controller@72000 {
            compatible = "marvell,orion-eth";
            #address-cells = <1>;
            #size-cells = <0>;
            reg = <0x72000 0x2000>;
            clocks = <&gate_clk 2>;
            marvell,tx-checksum-limit = <1600>;
            interrupts = <29>;

            ethernet@0 {
                compatible = "marvell,orion-eth-port";
                reg = <0>;
                interrupts = <29>;
                phy-handle = <&ethphy>;
                local-mac-address = [00 00 00 00 00 00];
            };
        };
    };
```

## Documentation/devicetree/bindings/net/marvell,pxa168-eth.yaml
```yaml
# SPDX-License-Identifier: (GPL-2.0-only OR BSD-2-Clause)
# Copyright 2025 Antoine Tenart <atenart@kernel.org>
# Copyright 2025 Petr Štetiar <ynezz@true.cz>
%YAML 1.2
---
$id: http://devicetree.org/schemas/net/marvell,pxa168-eth.yaml#
$schema: http://devicetree.org/meta-schemas/core.yaml#

title: Marvell PXA168 Ethernet Controller

maintainers:
  - Antoine Tenart <atenart@kernel.org>
  - Petr Štetiar <ynezz@true.cz>

description: |
  * Marvell PXA168 Ethernet Controller

  The MAC address will be determined using the optional properties
  defined in ethernet.txt.

  Sub-nodes:
  Each PHY can be represented as a sub-node. This is not mandatory.

  Sub-nodes required properties:
  - reg: the MDIO address of the PHY.

properties:
  compatible:
    items:
      - const: marvell,pxa168-eth

  reg:
    items:
      - description: Register set for the controller

  clocks:
    description: Pointer to the clock for the device
    maxItems: 1

  interrupts:
    items:
      - description: Interrupt for the device

  port-id:
    description: Ethernet port number
    $ref: /schemas/types.yaml#/definitions/uint32
    enum: [0, 1, 2]

  "#address-cells":
    description: Number of address cells for child nodes
    const: 1

  "#size-cells":
    description: Number of size cells for child nodes
    const: 0

  phy-handle:
    description: Reference to the attached PHY
    $ref: /schemas/types.yaml#/definitions/phandle

required:
  - compatible
  - reg
  - clocks
  - interrupts

additionalProperties: false

examples:
  - |
    eth0: ethernet@f7b90000 {
        compatible = "marvell,pxa168-eth";
        reg = <0xf7b90000 0x10000>;
        clocks = <&chip CLKID_GETH0>;
        interrupts = <GIC_SPI 24 IRQ_TYPE_LEVEL_HIGH>;
        #address-cells = <1>;
        #size-cells = <0>;
        phy-handle = <&ethphy0>;

        ethphy0: ethernet-phy@0 {
            reg = <0>;
        };
    };
```

## Documentation/devicetree/bindings/net/marvell,sd8897-bt.yaml
```yaml
# SPDX-License-Identifier: (GPL-2.0-only OR BSD-2-Clause)
# Copyright 2025 Rajat Jain <rajatja@google.com>
# Copyright 2025 Rob Herring <robh@kernel.org>
%YAML 1.2
---
$id: http://devicetree.org/schemas/net/marvell,sd8897-bt.yaml#
$schema: http://devicetree.org/meta-schemas/core.yaml#

title: Marvell Bluetooth 8897/8997
maintainers:
  - Rajat Jain <rajatja@google.com>
  - Rob Herring <robh@kernel.org>

description: |
  Marvell 8897/8997 (sd8897/sd8997) bluetooth devices (SDIO or USB based)
  ------
  The 8997 devices supports multiple interfaces. When used on SDIO interfaces,
  the btmrvl driver is used and when used on USB interface, the btusb driver is
  used.

properties:
  compatible:
    enum:
      - marvell,sd8897-bt
      - marvell,sd8997-bt
      - usb1286,204e

  reg:
    description: Interface register index for the device.
    items:
      - description: Index of the data register for this device.

  interrupts:
    maxItems: 1
    description: |
      Interrupt pin and type used by the device.
      For SDIO the first interrupt is used by btmrvl; for USB the 'wakeup' interrupt is used.

  interrupt-names:
    items:
      - const: wakeup

  marvell,cal-data:
    description: Calibration data downloaded to the device during initialization.
    $ref: /schemas/types.yaml#/definitions/uint8-array
    minItems: 28
    maxItems: 28

  marvell,wakeup-pin:
    description: Wakeup pin number of the Bluetooth chip.
    $ref: /schemas/types.yaml#/definitions/uint16

  marvell,wakeup-gap-ms:
    description: Wakeup latency of the host platform in milliseconds.

additionalProperties: false

examples:
  - |
      &mmc3 {
          vmmc-supply = <&wlan_en_reg>;
          bus-width = <4>;
          cap-power-off-card;
          keep-power-in-suspend;

          btmrvl: bluetooth@2 {
              compatible = "marvell,sd8897-bt";
              reg = <2>;
              interrupts = <119 IRQ_TYPE_LEVEL_LOW>;
              marvell,cal-data = /bits/ 8 <
                  0x37 0x01 0x1c 0x00 0xff 0xff 0xff 0xff 0x01 0x7f 0x04 0x02
                  0x00 0x00 0xba 0xce 0xc0 0xc6 0x2d 0x00 0x00 0x00 0x00 0x00
                  0x00 0x00 0xf0 0x00>;
              marvell,wakeup-pin = /bits/ 16 <0x0d>;
              marvell,wakeup-gap-ms = /bits/ 16 <0x64>;
          };
      };
  - |
      &usb_host1_ohci {
          #address-cells = <1>;
          #size-cells = <0>;

          mvl_bt1: bt@1 {
              compatible = "usb1286,204e";
              reg = <1>;
              interrupt-names = "wakeup";
              interrupts = <119 IRQ_TYPE_LEVEL_LOW>;
              marvell,wakeup-pin = /bits/ 16 <0x0d>;
              marvell,wakeup-gap-ms = /bits/ 16 <0x64>;
          };
      };
```

## Documentation/devicetree/bindings/net/marvell-armada-370-neta.yaml
```yaml
# SPDX-License-Identifier: (GPL-2.0-only OR BSD-2-Clause)
# Copyright 2025 Allied Telesis
%YAML 1.2
---
$id: http://devicetree.org/schemas/net/marvell-armada-370-neta.yaml#
$schema: http://devicetree.org/meta-schemas/core.yaml#

title: Marvell Armada 370 / Armada XP / Armada 3700 / Armada AC5 Ethernet Controller (NETA)

maintainers:
  - Chris Packham <chris.packham@alliedtelesis.co.nz>
  - Jisheng Zhang <jszhang@kernel.org>
  - Marcin Wojtas <mw@semihalf.com>
  - Masahiro Yamada <yamada.masahiro@socionext.com>
  - Rob Herring <robh@kernel.org>
  - Russell King <rmk+kernel@armlinux.org.uk>
  - Sergei Shtylyov <sergei.shtylyov@cogentembedded.com>
  - Simon Guinot <simon.guinot@sequanux.org>
  - Thomas Petazzoni <thomas.petazzoni@free-electrons.com>

description: |
  Marvell Armada 370 / Armada XP / Armada 3700 Ethernet Controller (NETA)

properties:
  compatible:
    description: List of compatible strings; device must specify one.
    items:
      - enum:
          - marvell,armada-370-neta
          - marvell,armada-xp-neta
          - marvell,armada-3700-neta
          - marvell,armada-ac5-neta

  reg:
    description: Register base address and size.
    items:
      - description: Base address of register set
      - description: Length of register set in bytes

  interrupts:
    description: Interrupt specifier for the device.
    items:
      - description: Interrupt number

  clocks:
    description: List of clocks; first is core clock, optional second is bus clock.
    $ref: /schemas/types.yaml#/definitions/phandle-array

  clock-names:
    description: Names corresponding to clocks; "core" and optionally "bus".
    items:
      - const: core
      - const: bus

  phy:
    description: PHY node phandle; see ../phy/phy-bindings.txt.
    $ref: /schemas/types.yaml#/definitions/phandle

  phy-mode:
    description: PHY interface mode; see ethernet.txt in this directory.
    $ref: /schemas/types.yaml#/definitions/string

  tx-csum-limit:
    description: Maximum MTU in bytes for Tx checksum offload; default is 1600 for
      armada-370-neta and 9800 for others.
    $ref: /schemas/types.yaml#/definitions/uint32

  buffer-manager:
    description: Phandle to hardware buffer manager.
    $ref: /schemas/types.yaml#/definitions/phandle

  'bm,pool-long':
    description: Pool ID for packets larger than the short threshold.
    $ref: /schemas/types.yaml#/definitions/uint32

  'bm,pool-short':
    description: Pool ID for packets smaller than the long threshold.
    $ref: /schemas/types.yaml#/definitions/uint32

additionalProperties: false

examples:
  - |
    ethernet@70000 {
      compatible = "marvell,armada-370-neta";
      reg = <0x70000 0x2500>;
      interrupts = <8>;
      clocks = <&gate_clk 4>;
      tx-csum-limit = <9800>;
      phy = <&phy0>;
      phy-mode = "rgmii-id";
      buffer-manager = <&bm>;
      bm,pool-long = <0>;
      bm,pool-short = <1>;
    };
```

## Documentation/devicetree/bindings/net/microchip,enc28j60.yaml
```yaml
# SPDX-License-Identifier: (GPL-2.0-only OR BSD-2-Clause)
%YAML 1.2
---
$id: http://devicetree.org/schemas/net/microchip,enc28j60.yaml#
$schema: http://devicetree.org/meta-schemas/core.yaml#

title: Microchip ENC28J60 Ethernet Controller

maintainers:
  - Michael Heimpold <mhei@heimpold.de>
  - Petr Štetiar <ynezz@true.cz>
  - Rob Herring <robh@kernel.org>

description: |
  This is a standalone 10 MBit ethernet controller with SPI interface.

  For each device connected to a SPI bus, define a child node within
  the SPI master node.

properties:
  compatible:
    items:
      - const: microchip,enc28j60

  reg:
    items:
      - description: SPI chip select the ENC28J60 is wired to

  interrupts:
    items:
      - description: Interrupt index and type for ENC28J60

  pinctrl-names:
    items:
      - const: default

  pinctrl-0:
    $ref: /schemas/types.yaml#/definitions/phandle-array
    items:
      - description: GPIO pinctrl for ENC28J60 interrupt line

  spi-max-frequency:
    description: Maximum SPI bus frequency for ENC28J60
    $ref: /schemas/types.yaml#/definitions/uint32

required:
  - compatible
  - reg
  - interrupts
  - pinctrl-names
  - pinctrl-0

additionalProperties: false

examples:
  - |
      ssp2: ssp@80014000 {
          compatible = "fsl,imx28-spi";
          pinctrl-names = "default";
          pinctrl-0 = <&spi2_pins_b &spi2_sck_cfg>;

          enc28j60: ethernet@0 {
              compatible = "microchip,enc28j60";
              pinctrl-names = "default";
              pinctrl-0 = <&enc28j60_pins>;
              reg = <0>;
              interrupts = <3 IRQ_TYPE_EDGE_FALLING>;
              spi-max-frequency = <12000000>;
          };
      };
```
