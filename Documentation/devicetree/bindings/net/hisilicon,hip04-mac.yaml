## Documentation/devicetree/bindings/net/samsung,sxgbe-v2.0a.yaml
```yaml
# SPDX-License-Identifier: (GPL-2.0-only OR BSD-2-Clause)
# Copyright 2025
%YAML 1.2
---
$id: http://devicetree.org/schemas/net/samsung,sxgbe-v2.0a.yaml#
$schema: http://devicetree.org/meta-schemas/core.yaml#

title: Samsung SXGBE 10G Ethernet Controller

maintainers:
  - Bjorn Helgaas <bhelgaas@google.com>
  - Hayato Suzuki <hytszk@gmail.com>
  - Petr Štetiar <ynezz@true.cz>
  - Rob Herring <robh@kernel.org>
  - Siva Reddy <siva.kallam@samsung.com>

description: |
  * Samsung 10G Ethernet driver (SXGBE)

  The MAC address will be determined using the optional properties
  defined in ethernet.txt.

properties:
  compatible:
    items:
      - const: samsung,sxgbe-v2.0a

  reg:
    maxItems: 1

  interrupts:
    description: >
      SXGBE interrupts. The first entry is the fixed common interrupt, followed
      by up to 8 transmit DMA interrupts, up to 16 receive DMA interrupts, and
      an optional LPI interrupt.
    minItems: 1
    maxItems: 26
    items:
      - description: Fixed common interrupt
    additionalItems: true

  phy-mode:
    description: Operation mode of the PHY interface.
    enum:
      - sgmii
      - xgmii

  samsung,pbl:
    description: Programmable Burst Length.
    $ref: /schemas/types.yaml#/definitions/uint32
    enum: [1, 2, 4, 8, 16, 32]

  samsung,burst-map:
    description: >
      Program possible DMA bursts when fixed burst mode is enabled. Allowable
      range is 0x01–0x3F.
    $ref: /schemas/types.yaml#/definitions/uint32
    minimum: 1
    maximum: 63

  max-frame-size:
    description: Maximum frame size (MTU).
    $ref: /schemas/types.yaml#/definitions/uint32

required:
  - compatible
  - reg
  - interrupts
  - phy-mode
  - samsung,pbl
  - samsung,burst-map

additionalProperties: false

examples:
  - |
    sxgbe0: ethernet@1a040000 {
        compatible = "samsung,sxgbe-v2.0a";
        reg = <0 0x1a040000 0 0x10000>;
        interrupts = <0 209 4>, <0 185 4>, <0 186 4>, <0 187 4>,
                     <0 188 4>, <0 189 4>, <0 190 4>, <0 191 4>,
                     <0 192 4>, <0 193 4>, <0 194 4>, <0 195 4>,
                     <0 196 4>, <0 197 4>, <0 198 4>, <0 199 4>,
                     <0 200 4>, <0 201 4>, <0 202 4>, <0 203 4>,
                     <0 204 4>, <0 205 4>, <0 206 4>, <0 207 4>,
                     <0 208 4>, <0 210 4>;
        samsung,pbl = <0x08>;
        samsung,burst-map = <0x20>;
        mac-address = [00 11 22 33 44 55];
        max-frame-size = <9000>;
        phy-mode = "xgmii";
    };
```

## Documentation/devicetree/bindings/net/snps,dwc-qos-ethernet.yaml
```yaml
# SPDX-License-Identifier: (GPL-2.0-only OR BSD-2-Clause)
%YAML 1.2
---
$id: http://devicetree.org/schemas/net/snps,dwc-qos-ethernet.yaml#
$schema: http://devicetree.org/meta-schemas/core.yaml#

title: Synopsys DWC Ethernet QoS IP version 4.10 driver (GMAC)

maintainers:
  - Bjorn Helgaas <bhelgaas@google.com>
  - jpinto <Joao.Pinto@synopsys.com>
  - Lars Persson <lars.persson@axis.com>
  - Petr Štetiar <ynezz@true.cz>
  - Rob Herring <robh@kernel.org>
  - Stephen Warren <swarren@nvidia.com>

description: |
  Synopsys DWC Ethernet QoS IP version 4.10 driver (GMAC)

  This binding is deprecated, but it continues to be supported, but new
  features should be preferably added to the stmmac binding document.

  This binding supports the Synopsys Designware Ethernet QoS (Quality Of Service)
  IP block. The IP supports multiple options for bus type, clocking and reset
  structure, and feature list. Consequently, a number of properties and list
  entries in properties are marked as optional, or only required in specific HW
  configurations.

properties:
  compatible:
    oneOf:
      - enum:
          - axis,artpec6-eqos
          - snps,dwc-qos-ethernet-4.10
      - enum:
          - nvidia,tegra186-eqos
          - snps,dwc-qos-ethernet-4.10
      - const: snps,dwc-qos-ethernet-4.10

  reg:
    items:
      - description: Address of the register set
      - description: Length of the register set

  clocks:
    description: Phandle and clock specifiers for each entry in clock-names, in the same order

  clock-names:
    items:
      - enum: [tx, rx, slave_bus, master_bus, ptp_ref, phy_ref_clk, apb_pclk]

  interrupts:
    description: Should contain the core's combined interrupt signal
    items:
      - description: Combined interrupt specifier

  phy-mode:
    description: See ethernet.txt file in the same directory
    $ref: /schemas/types.yaml#/definitions/string

  resets:
    description: Phandle and reset specifiers for each entry in reset-names, in the same order

  reset-names:
    items:
      - const: eqos

  phy-handle: true

  dma-coherent:
    description: Present if DMA operations are coherent
    type: boolean

  phy-reset-gpios:
    description: Phandle and specifier for any GPIO used to reset the PHY
    maxItems: 1

  snps,en-lpi:
    description: If present it enables use of the AXI low-power interface
    type: boolean

  snps,write-requests:
    description: Number of write requests that the AXI port can issue
    $ref: /schemas/types.yaml#/definitions/uint32

  snps,read-requests:
    description: Number of read requests that the AXI port can issue
    $ref: /schemas/types.yaml#/definitions/uint32

  snps,burst-map:
    description: Bitmap of allowed AXI burst lengths, with the LSB representing 4, then 8 etc
    $ref: /schemas/types.yaml#/definitions/uint32

  snps,txpbl:
    description: DMA Programmable burst length for the TX DMA
    $ref: /schemas/types.yaml#/definitions/uint32

  snps,rxpbl:
    description: DMA Programmable burst length for the RX DMA
    $ref: /schemas/types.yaml#/definitions/uint32

  snps,en-tx-lpi-clockgating:
    description: Enable gating of the MAC TX clock during TX low-power mode
    type: boolean

  mdio:
    description: MDIO bus controller subnode containing PHY subnodes
    type: object
    properties:
      compatible:
        const: snps,dwc-qos-ethernet-mdio
      '#address-cells':
        const: 1
      '#size-cells':
        const: 0
    additionalProperties: false

required:
  - compatible
  - reg
  - clocks
  - clock-names
  - interrupts
  - phy-mode
  - resets
  - reset-names

additionalProperties: false

examples:
  - |
    ethernet2@40010000 {
        compatible = "snps,dwc-qos-ethernet-4.10";
        reg = <0x40010000 0x4000>;
        clock-names = "phy_ref_clk", "apb_pclk";
        clocks = <&clkc 17>, <&clkc 15>;
        interrupts = <0x0 0x1e 0x4>;
        phy-handle = <&phy2>;
        phy-mode = "gmii";
        phy-reset-gpios = <&gpioctlr 43 GPIO_ACTIVE_LOW>;

        snps,en-tx-lpi-clockgating;
        snps,en-lpi;
        snps,write-requests = <2>;
        snps,read-requests = <16>;
        snps,burst-map = <0x7>;
        snps,txpbl = <8>;
        snps,rxpbl = <2>;

        dma-coherent;

        mdio {
            #address-cells = <0x1>;
            #size-cells = <0x0>;
            phy2: phy@1 {
                compatible = "ethernet-phy-ieee802.3-c22";
                device_type = "ethernet-phy";
                reg = <0x1>;
            };
        };
    };
```
