## Documentation/devicetree/bindings/net/ibm,emac.yaml
```yaml
# SPDX-License-Identifier: (GPL-2.0-only OR BSD-2-Clause)
# Copyright 2025 Rob Herring <robh@kernel.org>
%YAML 1.2
---
$id: http://devicetree.org/schemas/net/ibm,emac.yaml#
$schema: http://devicetree.org/meta-schemas/core.yaml#

title: IBM and AMCC 4xx/Axon EMAC Ethernet Controller

maintainers:
  - Rob Herring <robh@kernel.org>

description: |
  4xx/Axon EMAC ethernet nodes

  The EMAC ethernet controller in IBM and AMCC 4xx chips, and also
  the Axon bridge.  To operate this needs to interact with a this
  special McMAL DMA controller, and sometimes an RGMII or ZMII
  interface.  In addition to the nodes and properties described
  below, the node for the OPB bus on which the EMAC sits must have a
  correct clock-frequency property.

properties:
  device_type:
    const: network

  compatible:
    oneOf:
      - items:
          - enum:
              - ibm,emac-440gp
              - ibm,emac-405gp
              - ibm,emac-axon
              - ibm,emac-apm821xx
          - enum:
              - ibm,emac
              - ibm,emac4
              - ibm,emac4sync

  reg:
    items:
      - description: base address of registers
      - description: length of registers in bytes

  interrupts:
    items:
      - description: EMAC IRQ mapping
      - description: WOL IRQ mapping

  mal-device:
    description: phandle of the associated McMAL node
    $ref: /schemas/types.yaml#/definitions/phandle

  mal-tx-channel:
    description: index of the tx channel on McMAL associated with this EMAC
    items:
      - description: TX channel index

  mal-rx-channel:
    description: index of the rx channel on McMAL associated with this EMAC
    items:
      - description: RX channel index

  cell-index:
    description: hardware index of the EMAC cell on this ASIC
    items:
      - description: EMAC cell index

  max-frame-size:
    description: maximum frame size supported in bytes
    $ref: /schemas/types.yaml#/definitions/uint32

  rx-fifo-size:
    description: Rx FIFO size in bytes for 10 and 100 Mb/sec operations
    items:
      - description: FIFO size in bytes

  tx-fifo-size:
    description: Tx FIFO size in bytes for 10 and 100 Mb/sec operations
    items:
      - description: FIFO size in bytes

  fifo-entry-size:
    description: size of a FIFO entry used to calculate thresholds
    items:
      - description: FIFO entry size

  mal-burst-size:
    description: MAL burst size in bytes used to calculate thresholds
    items:
      - description: burst size in bytes

  phy-mode:
    description: mode of operations of the PHY interface
    enum:
      - mii
      - rmii
      - smii
      - rgmii
      - tbi
      - gmii
      - rtbi
      - sgmii

  mdio-device:
    description: phandle of the MDIO controller for shared MDIO registers
    $ref: /schemas/types.yaml#/definitions/phandle

  zmii-device:
    description: phandle of the ZMII device
    $ref: /schemas/types.yaml#/definitions/phandle

  zmii-channel:
    description: which ZMII channel or 0xffffffff if ZMII is only used for MDIO
    items:
      - description: ZMII channel index or 0xffffffff

  rgmii-device:
    description: phandle of the RGMII device
    $ref: /schemas/types.yaml#/definitions/phandle

  rgmii-channel:
    description: RGMII channel index
    items:
      - description: RGMII channel index

  phy-address:
    description: MDIO address of the PHY; if absent, a search is performed
    items:
      - description: MDIO address to probe

  phy-map:
    description: bitmap of addresses to probe the PHY; bit 0x00000001 is MDIO address 0
    items:
      - description: PHY probe map

  phy-handle:
    description: phandle of an external PHY device node
    $ref: /schemas/types.yaml#/definitions/phandle

  rx-fifo-size-gige:
    description: Rx FIFO size in bytes for 1000 Mb/sec operations (if absent, same as rx-fifo-size)
    items:
      - description: FIFO size in bytes for gigabit

  tx-fifo-size-gige:
    description: Tx FIFO size in bytes for 1000 Mb/sec operations (if absent, same as tx-fifo-size)
    items:
      - description: FIFO size in bytes for gigabit

  tah-device:
    description: phandle of the TAH device node
    $ref: /schemas/types.yaml#/definitions/phandle

  tah-channel:
    description: channel used on the TAH engine
    items:
      - description: TAH channel index

  fixed-link:
    description: Fixed-link subnode describing a link to a non-MDIO managed entity
    type: object
    additionalProperties: false
    properties:
      phy-handle:
        description: phandle of the fixed-link device
        $ref: /schemas/types.yaml#/definitions/phandle
      local-rx-len:
        description: local receive length in bytes
        $ref: /schemas/types.yaml#/definitions/uint32
      remote-rx-len:
        description: remote receive length in bytes
        $ref: /schemas/types.yaml#/definitions/uint32
      pause:
        description: pause parameter
        $ref: /schemas/types.yaml#/definitions/uint32
    required:
      - phy-handle
      - local-rx-len
      - remote-rx-len

  mdio:
    description: MDIO bus subnode for PHY definitions
    type: object
    additionalProperties: false
    properties:
      "#address-cells":
        const: 1
      "#size-cells":
        const: 0
    required:
      - "#address-cells"
      - "#size-cells"
    patternProperties:
      "^[a-zA-Z0-9,\\-]+$":
        description: PHY device node definition
        type: object
        additionalProperties: false
        properties:
          compatible:
            items:
              - const: ethernet-phy-ieee802.3-c22
          reg:
            items:
              - description: PHY register address
        required:
          - compatible
          - reg

required:
  - device_type
  - compatible
  - reg
  - interrupts
  - local-mac-address
  - mal-device
  - mal-tx-channel
  - mal-rx-channel
  - cell-index
  - max-frame-size
  - rx-fifo-size
  - tx-fifo-size
  - fifo-entry-size
  - mal-burst-size
  - phy-mode

additionalProperties: false
```

## Documentation/devicetree/bindings/net/ieee802154/adi,adf7242.yaml
```yaml
# SPDX-License-Identifier: (GPL-2.0-only OR BSD-2-Clause)
# Copyright 2025 Michael Hennerich <michael.hennerich@analog.com>
%YAML 1.2
---
$id: http://devicetree.org/schemas/adi,adf7242.yaml#
$schema: http://devicetree.org/meta-schemas/core.yaml#

title: ADF7242 IEEE 802.15.4

maintainers:
  - Michael Hennerich <michael.hennerich@analog.com>

description: |
  * ADF7242 IEEE 802.15.4 *

properties:
  compatible:
    description: Device compatibility.
    $ref: /schemas/types.yaml#/definitions/string-array
    items:
      - enum:
          - adi,adf7242
          - adi,adf7241

  spi-max-frequency:
    description: Maximum SPI bus speed.
    $ref: /schemas/types.yaml#/definitions/uint32

  reg:
    description: Chip select index.
    items:
      - description: Chip select index.

  interrupts:
    description: Interrupt for device via pin IRQ1. IRQ_TYPE_LEVEL_HIGH (4) or IRQ_TYPE_EDGE_FALLING (1).
    items:
      - description: Interrupt number.
      - description: Interrupt trigger type.

required:
  - compatible
  - spi-max-frequency
  - reg
  - interrupts

additionalProperties: false

examples:
  - |
    adf7242@0 {
        compatible = "adi,adf7242";
        spi-max-frequency = <10000000>;
        reg = <0>;
        interrupts = <98 IRQ_TYPE_LEVEL_HIGH>;
    };
```

## Documentation/devicetree/bindings/net/ieee802154/at86rf230.yaml
```yaml
# SPDX-License-Identifier: (GPL-2.0-only OR BSD-2-Clause)
# Copyright 2025 Alexander Aring
%YAML 1.2
---
$id: http://devicetree.org/schemas/net/ieee802154/at86rf230.yaml#
$schema: http://devicetree.org/meta-schemas/core.yaml#

title: Atmel AT86RF230 IEEE 802.15.4 RF transceiver
maintainers:
  - Alexander Aring <alex.aring@gmail.com>

description: |
  * AT86RF230 IEEE 802.15.4 *

properties:
  compatible:
    description: One or more compatible strings for the device.
    $ref: /schemas/types.yaml#/definitions/string-array
    items:
      - enum:
          - atmel,at86rf230
          - atmel,at86rf231
          - atmel,at86rf233
          - atmel,at86rf212

  spi-max-frequency:
    description: Maximal bus speed, should be set to 7500000 depending on sync or async operation mode.
    $ref: /schemas/types.yaml#/definitions/uint32

  reg:
    description: The chipselect index.
    items:
      - description: Chip-select index

  interrupts:
    description: |
      The interrupt spec (number and flags) generated by the device.
      Non high-level interrupts can cause deadlocks while handling ISR.
    items:
      - description: Interrupt number
      - description: Interrupt flags (trigger type and level)

  reset-gpio:
    description: GPIO spec for the rstn pin.
    maxItems: 1

  sleep-gpio:
    description: GPIO spec for the slp_tr pin.
    maxItems: 1

  xtal-trim:
    description: |
      U8 value for fine tuning the internal capacitance arrays of XTAL pins.
      0 = +0 pF, 0xf = +4.5 pF.
    $ref: /schemas/types.yaml#/definitions/uint32
    minimum: 0
    maximum: 15

required:
  - compatible
  - spi-max-frequency
  - reg
  - interrupts

additionalProperties: false

examples:
  - |
    at86rf231@0 {
        compatible = "atmel,at86rf231";
        spi-max-frequency = <7500000>;
        reg = <0>;
        interrupts = <19 4>;
        xtal-trim = /bits/ 8 <0x06>;
    };
```

## Documentation/devicetree/bindings/net/ieee802154/cascoda,ca8210.yaml
```yaml
# SPDX-License-Identifier: (GPL-2.0-only OR BSD-2-Clause)
%YAML 1.2
---
$id: http://devicetree.org/schemas/net/ieee802154/cascoda,ca8210.yaml#
$schema: http://devicetree.org/meta-schemas/core.yaml#

title: CA8210 IEEE 802.15.4

maintainers:
  - Andy Shevchenko <andriy.shevchenko@linux.intel.com>
  - Harry Morris <harrymorris12@gmail.com>

description: |
  * CA8210 IEEE 802.15.4 *

properties:
  compatible:
    items:
      - const: cascoda,ca8210
    description: Must be "cascoda,ca8210" to select this driver
  reg:
    items:
      - description: Controlling chip select
  spi-max-frequency:
    $ref: /schemas/types.yaml#/definitions/uint32
    description: Maximum SPI clock frequency, should be less than 4000000 Hz
  spi-cpol:
    type: boolean
    description: Requires inverted clock polarity on the SPI bus
  reset-gpio:
    maxItems: 1
    description: GPIO connected to the CA8210 reset line
  irq-gpio:
    maxItems: 1
    description: GPIO connected to the CA8210 interrupt line
  extclock-enable:
    type: boolean
    description: Include for the CA8210 to route its 16MHz clock to an output
  extclock-freq:
    $ref: /schemas/types.yaml#/definitions/uint32
    description: Frequency in Hz of the external clock
  extclock-gpio:
    $ref: /schemas/types.yaml#/definitions/uint32
    description: GPIO of the CA8210 to output the clock on

required:
  - compatible
  - reg
  - spi-max-frequency
  - spi-cpol
  - reset-gpio
  - irq-gpio

additionalProperties: false

examples:
  - |
    ca8210@0 {
        compatible = "cascoda,ca8210";
        reg = <0>;
        spi-max-frequency = <3000000>;
        spi-cpol;
        reset-gpio = <&gpio1 1 GPIO_ACTIVE_LOW>;
        irq-gpio = <&gpio1 2 GPIO_ACTIVE_HIGH>;
        extclock-enable;
        extclock-freq = <16000000>;
        extclock-gpio = <2>;
    };
```

## Documentation/devicetree/bindings/net/ieee802154/microchip,mrf24j40.yaml
```yaml
%YAML 1.2
---
$schema: http://devicetree.org/meta-schemas/core.yaml#
$id: http://devicetree.org/schemas/net/ieee802154/microchip,mrf24j40.yaml#
title: Microchip MRF24J40 IEEE 802.15.4 Transceiver
maintainers:
  - Alexander Aring <alex.aring@gmail.com>
description: |
  * MRF24J40 IEEE 802.15.4 *
properties:
  compatible:
    items:
      - enum:
          - microchip,mrf24j40
          - microchip,mrf24j40ma
          - microchip,mrf24j40mc
  reg:
    description: chipselect index
    items:
      - description: chipselect index
  spi-max-frequency:
    description: maximal bus speed
    $ref: /schemas/types.yaml#/definitions/uint32
    maximum: 10000000
  interrupts:
    description: interrupt specifier and flags for the MRF24J40
    items:
      - description: interrupt specifier
      - description: interrupt flags
required:
  - compatible
  - reg
  - spi-max-frequency
  - interrupts
additionalProperties: false
examples:
  - |
    mrf24j40ma@0 {
        compatible = "microchip,mrf24j40ma";
        spi-max-frequency = <8500000>;
        reg = <0>;
        interrupts = <19 8>;
    };
```

## Documentation/devicetree/bindings/net/ieee802154/nxp,mcr20a.yaml
```yaml
# SPDX-License-Identifier: (GPL-2.0-only OR BSD-2-Clause)
# Copyright 2025 Xue Liu <liuxuenetmail@gmail.com>
%YAML 1.2
---
$id: http://devicetree.org/schemas/net/ieee802154/nxp,mcr20a.yaml#
$schema: http://devicetree.org/meta-schemas/core.yaml#
title: MCR20A IEEE 802.15.4 transceiver
maintainers:
  - Xue Liu <liuxuenetmail@gmail.com>
description: |
  * MCR20A IEEE 802.15.4 *
properties:
  compatible:
    items:
      - const: nxp,mcr20a
  spi-max-frequency:
    description: >
      Maximal SPI bus speed; should be lower than 9000000 depending on
      synchronous or asynchronous operation mode.
  reg:
    items:
      - description: Chipselect index.
  interrupts:
    items:
      - description: >
          Interrupt generated by the device; non-high-level interrupts can
          cause deadlocks during ISR handling.
  rst_b-gpio:
    maxItems: 1
    description: GPIO spec for the RST_B pin.
required:
  - compatible
  - spi-max-frequency
  - reg
  - interrupts
additionalProperties: false
examples:
  - |
    mcr20a@0 {
        compatible = "nxp,mcr20a";
        spi-max-frequency = <9000000>;
        reg = <0>;
        interrupts = <17 2>;
        rst_b-gpio = <&gpio 27 1>;
    };
```
