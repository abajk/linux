## Documentation/devicetree/bindings/net/microchip/usb424,7800.yaml
```yaml
# SPDX-License-Identifier: (GPL-2.0-only OR BSD-2-Clause)
%YAML 1.2
---
$id: http://devicetree.org/schemas/usb424,7800.yaml#
$schema: http://devicetree.org/meta-schemas/core.yaml#

title: Microchip LAN78xx Gigabit Ethernet controller

maintainers:
  - Petr Štetiar <ynezz@true.cz>
  - Phil Elwell <phil@raspberrypi.org>

description: |
  Microchip LAN78xx Gigabit Ethernet controller

  The LAN78XX devices are usually configured by programming their OTP or with
  an external EEPROM, but some platforms (e.g. Raspberry Pi 3 B+) have neither.
  The Device Tree properties, if present, override the OTP and EEPROM.

  The MAC address will be determined using the optional properties defined in
  ethernet.txt.

properties:
  compatible:
    items:
      - enum:
          - usb424,7800
          - usb424,7801
          - usb424,7850

  reg:
    items:
      - description: USB port index on the host controller.

  local-mac-address:
    description: Unicast MAC address assigned to the Ethernet controller.
    $ref: /schemas/types.yaml#/definitions/uint8-array
    minItems: 6
    maxItems: 6

  mdio:
    description: MDIO bus exposing the embedded PHY.
    type: object
    additionalProperties: false
    properties:
      "#address-cells":
        const: 1
      "#size-cells":
        const: 0

      ethernet-phy:
        description: Embedded Ethernet PHY on the MDIO bus.
        type: object
        additionalProperties: false
        properties:
          reg:
            items:
              - description: PHY address on the MDIO bus.
          microchip,led-modes:
            description: Operating modes for the PHY LEDs.
            $ref: /schemas/types.yaml#/definitions/uint32-array
            maxItems: 4
            items:
              enum:
                - LAN78XX_LINK_1000_ACTIVITY
                - LAN78XX_LINK_10_100_ACTIVITY
        required:
          - reg

required:
  - compatible
  - reg

additionalProperties: false

examples:
  - |
    &usb {
      usb-port@1 {
        compatible = "usb424,2514";
        reg = <1>;
        #address-cells = <1>;
        #size-cells = <0>;

        usb-port@1 {
          compatible = "usb424,2514";
          reg = <1>;
          #address-cells = <1>;
          #size-cells = <0>;

          ethernet: ethernet@1 {
            compatible = "usb424,7800";
            reg = <1>;
            local-mac-address = [ 00 11 22 33 44 55 ];

            mdio {
              #address-cells = <0x1>;
              #size-cells = <0x0>;
              eth_phy: ethernet-phy@1 {
                reg = <1>;
                microchip,led-modes = <
                  LAN78XX_LINK_1000_ACTIVITY
                  LAN78XX_LINK_10_100_ACTIVITY
                >;
              };
            };
          };
        };
      };
    };
```

## Documentation/devicetree/bindings/net/ni,xge-enet-3.00.yaml
```yaml
%YAML 1.2
---
$id: http://devicetree.org/schemas/net/ni,xge-enet-3.00.yaml#
$schema: http://devicetree.org/meta-schemas/core.yaml#

title: NI XGE Ethernet controller

maintainers:
  - Alex Williams <alex.williams@ni.com>
  - Moritz Fischer <mdf@kernel.org>

description: |
  * NI XGE Ethernet controller

properties:
  compatible:
    oneOf:
      - items:
          - const: ni,xge-enet-3.00
      - items:
          - const: ni,xge-enet-2.00

  reg:
    oneOf:
      - items:
          - description: DMA engine control and status region
          - description: MDIO and PHY control and status region
      - items:
          - description: Address and length of the register set for the device

  reg-names:
    items:
      - const: dma
      - const: ctrl

  interrupts:
    description: Interrupts for TX and RX
    items:
      - description: TX or combined interrupt
      - description: RX interrupt

  interrupt-names:
    items:
      - const: rx
      - const: tx

  phy-mode:
    description: PHY interface mode
    enum:
      - xgmii

  nvmem-cells:
    description: Phandle to nvmem cell containing the MAC address
    maxItems: 1

  nvmem-cell-names:
    items:
      - const: address

  phy-handle:
    description: Phandle to the PHY device

  fixed-link:
    description: Fixed-link parameters for 1G fixed-link PHY
    type: object
    additionalProperties: false
    properties:
      speed:
        $ref: /schemas/types.yaml#/definitions/uint32
        description: Link speed in Mbps
      pause:
        type: boolean
        description: Pause frame support
      link-gpios:
        maxItems: 1
        description: GPIO for link status
    required:
      - speed

  mdio:
    description: MDIO bus subnode to enumerate PHYs
    type: object
    additionalProperties: true

required:
  - compatible
  - reg
  - reg-names
  - interrupts
  - interrupt-names
  - phy-mode
  - nvmem-cells
  - nvmem-cell-names

additionalProperties: false

examples:
  - |
    nixge0: ethernet@40000000 {
      compatible = "ni,xge-enet-3.00";
      reg = <0x40000000 0x4000 0x41002000 0x2000>;
      reg-names = "dma", "ctrl";
      nvmem-cells = <&eth1_addr>;
      nvmem-cell-names = "address";
      interrupts = <0 29 IRQ_TYPE_LEVEL_HIGH>, <0 30 IRQ_TYPE_LEVEL_HIGH>;
      interrupt-names = "rx", "tx";
      phy-mode = "xgmii";
      phy-handle = <&ethernet_phy1>;
      mdio {
        ethernet_phy1: ethernet-phy@4 {
          compatible = "ethernet-phy-ieee802.3-c45";
          reg = <4>;
        };
      };
    };

  - |
    nixge0: ethernet@40000000 {
      compatible = "ni,xge-enet-2.00";
      reg = <0x40000000 0x6000>;
      nvmem-cells = <&eth1_addr>;
      nvmem-cell-names = "address";
      interrupts = <0 29 IRQ_TYPE_LEVEL_HIGH>, <0 30 IRQ_TYPE_LEVEL_HIGH>;
      interrupt-names = "rx", "tx";
      phy-mode = "xgmii";
      phy-handle = <&ethernet_phy1>;
    };

  - |
    nixge0: ethernet@40000000 {
      compatible = "ni,xge-enet-2.00";
      reg = <0x40000000 0x6000>;
      nvmem-cells = <&eth1_addr>;
      nvmem-cell-names = "address";
      interrupts = <0 29 IRQ_TYPE_LEVEL_HIGH>, <0 30 IRQ_TYPE_LEVEL_HIGH>;
      interrupt-names = "rx", "tx";
      phy-mode = "xgmii";
      fixed-link {
        speed = <1000>;
        pause;
        link-gpios = <&gpio0 63 GPIO_ACTIVE_HIGH>;
      };
      mdio {
        ethernet_phy1: ethernet-phy@4 {
          compatible = "ethernet-phy-ieee802.3-c22";
          reg = <4>;
        };
      };
    };
```

## Documentation/devicetree/bindings/net/opencores,ethoc.yaml
```yaml
# SPDX-License-Identifier: (GPL-2.0-only OR BSD-2-Clause)
%YAML 1.2
---
$id: http://devicetree.org/schemas/opencores,ethoc.yaml#
$schema: http://devicetree.org/meta-schemas/core.yaml#

title: OpenCores Ethernet MAC (ethoc)

maintainers:
  - Max Filippov <jcmvbkbc@gmail.com>

description: |
  * OpenCores MAC 10/100 Mbps

properties:
  compatible:
    description: Must be "opencores,ethoc".
    items:
      - const: opencores,ethoc

  reg:
    description: |
      Two memory regions: first for the device registers and descriptor rings,
      second for the device packet memory.
    items:
      - description: Device registers and descriptor rings
      - description: Device packet memory

  interrupts:
    description: Interrupt for the device.
    items:
      - description: Device interrupt

  local-mac-address:
    description: Unique Ethernet MAC address for the device.
    $ref: /schemas/types.yaml#/definitions/uint8-array
    minItems: 6
    maxItems: 6

  clocks:
    description: Phandle to refer to the clock used by the device.
    maxItems: 1

required:
  - compatible
  - reg
  - interrupts

additionalProperties: false

examples:
  - |
    ethoc@fd030000 {
        compatible = "opencores,ethoc";
        reg = <0xfd030000 0x4000 0xfd800000 0x4000>;
        interrupts = <1>;
        local-mac-address = [00 50 c2 13 6f 00];
        clocks = <&osc>;
    };
```

## Documentation/devicetree/bindings/net/qcom,fsm9900-emac.yaml
```yaml
# SPDX-License-Identifier: (GPL-2.0-only OR BSD-2-Clause)
%YAML 1.2
---
$id: http://devicetree.org/schemas/qcom,fsm9900-emac.yaml#
$schema: http://devicetree.org/meta-schemas/core.yaml#

title: Qualcomm FSM9900 EMAC Gigabit Ethernet Controller

maintainers:
  - Geert Uytterhoeven <geert+renesas@glider.be>
  - Slark Xiao <slark_xiao@163.com>
  - Timur Tabi <timur@codeaurora.org>

description: |
  Qualcomm Technologies EMAC Gigabit Ethernet Controller

  This network controller consists of two devices: a MAC and an SGMII
  internal PHY. Each device is represented by a device tree node. A phandle
  connects the MAC node to its corresponding internal phy node. Another
  phandle points to the external PHY node.

properties:
  compatible:
    items:
      - enum:
          - qcom,fsm9900-emac
      - enum:
          - qcom,fsm9900-emac-sgmii
      - enum:
          - qcom,qdf2432-emac-sgmii

  reg:
    description: Offset and length of the register region(s) for the device
    items:
      - description: Primary register region
      - description: Secondary register region

  interrupts:
    description: Interrupt specifier cells for the device
    items:
      - description: Interrupt specifier cells as defined by the parent interrupt controller

  clocks:
    description: Clocks used by the EMAC controller
    items:
      - description: axi_clk
      - description: cfg_ahb_clk
      - description: high_speed_clk
      - description: mdio_clk
      - description: tx_clk
      - description: rx_clk
      - description: sys_clk

  clock-names:
    description: Names for each clock
    items:
      - const: axi_clk
      - const: cfg_ahb_clk
      - const: high_speed_clk
      - const: mdio_clk
      - const: tx_clk
      - const: rx_clk
      - const: sys_clk

  internal-phy:
    description: Phandle to the internal SGMII PHY node
    $ref: /schemas/types.yaml#/definitions/phandle

required:
  - compatible
  - reg
  - interrupts

additionalProperties: false

examples:
  - |
    emac0: ethernet@feb20000 {
        compatible = "qcom,fsm9900-emac";
        reg = <0xfeb20000 0x10000>,
              <0xfeb36000 0x1000>;
        interrupts = <76>;
        clocks = <&gcc 0>, <&gcc 1>, <&gcc 3>, <&gcc 4>, <&gcc 5>,
                 <&gcc 6>, <&gcc 7>;
        clock-names = "axi_clk", "cfg_ahb_clk", "high_speed_clk",
                      "mdio_clk", "tx_clk", "rx_clk", "sys_clk";
        internal-phy = <&emac_sgmii>;
        phy-handle = <&phy0>;
        pinctrl-names = "default";
        pinctrl-0 = <&mdio_pins_a>;
    };

  - |
    emac_sgmii: ethernet@feb38000 {
        compatible = "qcom,fsm9900-emac-sgmii";
        reg = <0xfeb38000 0x1000>;
        interrupts = <80>;
    };

  - |
    emac0: ethernet@38800000 {
        compatible = "qcom,fsm9900-emac";
        reg = <0x0 0x38800000 0x0 0x10000>,
              <0x0 0x38816000 0x0 0x1000>;
        interrupts = <0 256 4>;
        clocks = <&gcc 0>, <&gcc 1>, <&gcc 3>, <&gcc 4>, <&gcc 5>,
                 <&gcc 6>, <&gcc 7>;
        clock-names = "axi_clk", "cfg_ahb_clk", "high_speed_clk",
                      "mdio_clk", "tx_clk", "rx_clk", "sys_clk";
        internal-phy = <&emac_sgmii>;
        phy-handle = <&phy0>;
        pinctrl-names = "default";
        pinctrl-0 = <&mdio_pins_a>;
    };

  - |
    emac_sgmii: ethernet@410400 {
        compatible = "qcom,qdf2432-emac-sgmii";
        reg = <0x0 0x00410400 0x0 0xc00>,
              <0x0 0x00410000 0x0 0x400>;
        interrupts = <0 254 1>;
    };
```

## Documentation/devicetree/bindings/net/qcom,ipq806x-gmac.yaml
```yaml
# SPDX-License-Identifier: (GPL-2.0-only OR BSD-2-Clause)
%YAML 1.2
---
$id: http://devicetree.org/schemas/qcom,ipq806x-gmac.yaml#
$schema: http://devicetree.org/meta-schemas/core.yaml#

title: IPQ806x DWMAC Ethernet controller

maintainers:
  - Mathieu Olivari <mathieu@codeaurora.org>

description: |
  * IPQ806x DWMAC Ethernet controller

  The device inherits all the properties of the dwmac/stmmac devices
  described in the file net/stmmac.txt with the following changes.

properties:
  compatible:
    oneOf:
      - items:
          - const: snps,dwmac
          - const: qcom,ipq806x-gmac
        additionalItems: false
      - items:
          - const: qcom,ipq806x-gmac
        additionalItems: false

  device_type:
    enum: [network]
    description: Device type, must be "network".

  reg:
    items:
      - description: Base address and size of the GMAC registers.

  interrupts:
    items:
      - description: Interrupt specifier for the MAC controller.

  interrupt-names:
    items:
      - const: macirq

  clocks:
    maxItems: 1
    description: Clock for the GMAC core.

  clock-names:
    items:
      - const: stmmaceth

  resets:
    items:
      - description: Reset control for the GMAC core.

  reset-names:
    items:
      - const: stmmaceth

  qcom,nss-common:
    description: phandle to a syscon device mapping the nss-common registers.
    $ref: /schemas/types.yaml#/definitions/phandle

  qcom,qsgmii-csr:
    description: phandle to a syscon device mapping the qsgmii-csr registers.
    $ref: /schemas/types.yaml#/definitions/phandle

required:
  - compatible
  - device_type
  - reg
  - interrupts
  - qcom,nss-common
  - qcom,qsgmii-csr

additionalProperties: false

examples:
  - |
    gmac: ethernet@37000000 {
        device_type = "network";
        compatible = "qcom,ipq806x-gmac";
        reg = <0x37000000 0x200000>;
        interrupts = <GIC_SPI 220 IRQ_TYPE_LEVEL_HIGH>;
        interrupt-names = "macirq";

        qcom,nss-common = <&nss_common>;
        qcom,qsgmii-csr = <&qsgmii_csr>;

        clocks = <&gcc GMAC_CORE1_CLK>;
        clock-names = "stmmaceth";

        resets = <&gcc GMAC_CORE1_RESET>;
        reset-names = "stmmaceth";
    };
```
