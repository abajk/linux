## Documentation/devicetree/bindings/net/hisilicon,hip04-mac.yaml
```yaml
# SPDX-License-Identifier: (GPL-2.0-only OR BSD-2-Clause)
# Copyright 2025 Huawei Technologies Co., Ltd.
%YAML 1.2
---
$id: http://devicetree.org/schemas/net/hisilicon,hip04-mac.yaml#
$schema: http://devicetree.org/meta-schemas/core.yaml#

title: Hisilicon hip04 Ethernet Controller

maintainers:
  - huangdaode <huangdaode@hisilicon.com>
  - Jiangfeng Xiao <xiaojiangfeng@huawei.com>
  - Rob Herring (Arm) <robh@kernel.org>
  - Zhangfei Gao <zhangfei.gao@linaro.org>

description: |
  Hisilicon hip04 Ethernet Controller

  * Ethernet controller node

  * MDIO bus node:

  Inherits from MDIO bus node binding [2]

  [2] Documentation/devicetree/bindings/net/phy.txt

properties:
  compatible:
    items:
      - const: "hisilicon,hip04-mac"

  reg:
    description: Address and size of the device register set
    items:
      - description: Register block (address and length)

  interrupts:
    description: Interrupt specifier for the device
    items:
      - description: Interrupt specifier cells (parent, number, flags)

  port-handle:
    description: PPE syscon phandle with port, channel, and group
    $ref: /schemas/types.yaml#/definitions/phandle-array
    items:
      - items:
          - description: PPE syscon phandle
          - description: Port number connected to the controller
          - description: Receive channel start (RX_DESC_NUM × channel)
          - description: Group field in packet descriptor

  phy-mode:
    description: PHY interface mode (see Documentation/devicetree/bindings/net/ethernet.txt)

  phy-handle:
    description: Optional PHY node phandle on MDIO bus

required:
  - compatible
  - reg
  - interrupts
  - port-handle
  - phy-mode

additionalProperties: false
```

## Documentation/devicetree/bindings/net/hisilicon,hns-mdio.yaml
```yaml
# SPDX-License-Identifier: (GPL-2.0-only OR BSD-2-Clause)
# Copyright 2025 Hisilicon Ltd.
%YAML 1.2
---
$id: http://devicetree.org/schemas/net/hisilicon,hns-mdio.yaml#
$schema: http://devicetree.org/meta-schemas/core.yaml#

title: Hisilicon HNS MDIO bus controller

maintainers:
  - huangdaode <huangdaode@hisilicon.com>
  - yankejian <yankejian@huawei.com>

description: |
  Hisilicon MDIO bus controller

  Typically an MDIO bus might have several children.

properties:
  compatible:
    oneOf:
      - items:
          - enum:
              - hisilicon,hns-mdio
              - hisilicon,mdio

  reg:
    description: The base address of the MDIO bus controller register bank.
    items:
      - description: Specifier prefix (unused)
      - description: Base address of the MDIO controller register bank
      - description: Reserved, must be zero
      - description: Size of the MDIO controller register bank in bytes

  '#address-cells':
    const: 1

  '#size-cells':
    const: 0

required:
  - compatible
  - reg
  - '#address-cells'
  - '#size-cells'

additionalProperties: false

examples:
  - |
    mdio@803c0000 {
      #address-cells = <1>;
      #size-cells = <0>;
      compatible = "hisilicon,hns-mdio","hisilicon,mdio";
      reg = <0x0 0x803c0000 0x0 0x10000>;

      ethernet-phy@0 {
        reg = <0>;
      };
    };
```

## Documentation/devicetree/bindings/net/hisilicon-femac-mdio.yaml
```yaml
# SPDX-License-Identifier: (GPL-2.0-only OR BSD-2-Clause)
%YAML 1.2
---
$id: http://devicetree.org/schemas/net/hisilicon-femac-mdio.yaml#
$schema: http://devicetree.org/meta-schemas/core.yaml#

title: Hisilicon Fast Ethernet MDIO Controller
maintainers:
  - Dongpo Li <lidongpo@hisilicon.com>

description: |
  Hisilicon Fast Ethernet MDIO Controller interface

  PHY subnode inherits from the standard PHY binding [1]:
    [1] Documentation/devicetree/bindings/net/phy.txt

allOf:
  - $ref: /schemas/net/mdio.yaml

properties:
  compatible:
    items:
      - const: hisilicon,hisi-femac-mdio
    description: Must be "hisilicon,hisi-femac-mdio".
  reg:
    items:
      - description: Memory region for MDIO controller registers.
  clocks:
    items:
      - description: Reference clock for MDIO controller.

unevaluatedProperties: false

examples:
  - |
    mdio@10091100 {
        compatible = "hisilicon,hisi-femac-mdio";
        reg = <0x10091100 0x10>;
        clocks = <&crg HI3516CV300_MDIO_CLK>;
        #address-cells = <1>;
        #size-cells = <0>;

        phy0: phy@1 {
          reg = <1>;
        };
    };
```

## Documentation/devicetree/bindings/net/hisilicon-hix5hd2-gmac.yaml
```yaml
# SPDX-License-Identifier: (GPL-2.0-only OR BSD-2-Clause)
# Copyright 2025 Hisilicon

%YAML 1.2
---
$id: http://devicetree.org/schemas/net/hisilicon-hix5hd2-gmac.yaml#
$schema: http://devicetree.org/meta-schemas/core.yaml#

title: Hisilicon HIX5HD2 GMAC controller

maintainers:
  - Dongpo Li <lidongpo@hisilicon.com>
  - Petr Štetiar <ynezz@true.cz>
  - Zhangfei Gao <zhangfei.gao@linaro.org>

properties:
  compatible:
    items:
      - enum: ["hisilicon,hix5hd2-gmac", "hisilicon,hi3798cv200-gmac", "hisilicon,hi3516a-gmac"]
      - enum: ["hisilicon,hisi-gmac-v1", "hisilicon,hisi-gmac-v2"]

  reg:
    items:
      - description: MAC register base and size.
      - description: External interface control register.

  interrupts:
    description: MAC interrupt.
    items:
      - description: MAC interrupt specifier.

  '#address-cells':
    const: 1
    description: Number of address cells for child nodes.

  '#size-cells':
    const: 0
    description: Number of size cells for child nodes.

  phy-mode:
    description: PHY interface mode, see Documentation/devicetree/bindings/net/ethernet.txt.
    $ref: /schemas/types.yaml#/definitions/string

  clocks:
    description: Clock phandles and specifier pairs.
    minItems: 1
    maxItems: 2

  clock-names:
    description: Names for the clocks in 'clocks'.
    minItems: 1
    items:
      - const: mac_core
      - const: mac_ifc

  resets:
    description: Reset phandles for MAC and PHY.
    minItems: 1
    maxItems: 3

  reset-names:
    description: Names for reset signals in 'resets'.
    minItems: 1
    items:
      - const: mac_core
      - const: mac_ifc
      - const: phy

  hisilicon,phy-reset-delays-us:
    description: Triplet of PHY reset delays in microseconds.
    items:
      - description: Pre-reset delay.
      - description: Reset pulse duration.
      - description: Post-reset delay.

patternProperties:
  "^phy@[0-9]+$":
    description: PHY child node.
    $ref: /schemas/devicetree/bindings/net/phy.yaml#

required:
  - compatible
  - reg
  - interrupts
  - '#address-cells'
  - '#size-cells'
  - phy-mode
  - phy-handle
  - clocks
  - clock-names

additionalProperties: false

examples:
  - |
    gmac0: ethernet@f9840000 {
        compatible = "hisilicon,hi3798cv200-gmac", "hisilicon,hisi-gmac-v2";
        reg = <0xf9840000 0x1000>, <0xf984300c 0x4>;
        interrupts = <0 71 4>;
        #address-cells = <1>;
        #size-cells = <0>;
        phy-mode = "rgmii";
        phy-handle = <&phy2>;
        mac-address = [00 00 00 00 00 00];
        clocks = <&crg HISTB_ETH0_MAC_CLK>, <&crg HISTB_ETH0_MACIF_CLK>;
        clock-names = "mac_core", "mac_ifc";
        resets = <&crg 0xcc 8>, <&crg 0xcc 10>, <&crg 0xcc 12>;
        reset-names = "mac_core", "mac_ifc", "phy";
        hisilicon,phy-reset-delays-us = <10000 10000 30000>;

        phy2: ethernet-phy@2 {
            reg = <2>;
        };
    };
```

## Documentation/devicetree/bindings/net/hisilicon-hns-dsaf.yaml
```yaml
# SPDX-License-Identifier: (GPL-2.0-only OR BSD-2-Clause)
# Copyright 2025 Hisilicon Ltd.
%YAML 1.2
---
$id: http://devicetree.org/schemas/net/hisilicon-hns-dsaf.yaml#
$schema: http://devicetree.org/meta-schemas/core.yaml#

title: Hisilicon DSA Fabric device controller

maintainers:
  - huangdaode <huangdaode@hisilicon.com>
  - Kejian Yan <yankejian@huawei.com>
  - Rob Herring <robh@kernel.org>
  - yankejian <yankejian@huawei.com>
  - Yisen.Zhuang(Zhuangyuzeng) <Yisen.Zhuang@huawei.com>

description: |
  Hisilicon DSA Fabric device controller

  [1] Documentation/devicetree/bindings/net/phy.txt

properties:
  compatible:
    items:
      - enum:
          - hisilicon,hns-dsaf-v1
          - hisilicon,hns-dsaf-v2

  reg:
    items:
      - description: |
         external interface control register base and size (optional,
         only used when subctrl-syscon does not exist)
      - description: |
         SerDes base register and size (optional,
         only used when serdes-syscon in port node does not exist)
      - description: PPE register base and size
      - description: DSA Fabric base register and size (not required for single-port mode)

  reg-names:
    items:
      - const: ppe-base
      - const: dsaf-base

  interrupts:
    minItems: 1
    items:
      - description: DSA Fabric interrupt
      - description: RCB interrupt

  mode:
    description: DSA Fabric mode string
    $ref: /schemas/types.yaml#/definitions/string

  phy-handle:
    description: PHY handle of physical port, 0 if no PHY device
    $ref: /schemas/types.yaml#/definitions/phandle

  subctrl-syscon:
    description: syscon handle for external interface control register
    $ref: /schemas/types.yaml#/definitions/phandle

  reset-field-offset:
    description: offset of reset field in the control register
    $ref: /schemas/types.yaml#/definitions/uint32

  buf-size:
    description: RX buffer size (bytes)
    $ref: /schemas/types.yaml#/definitions/uint32

  desc-num:
    description: number of descriptors in TX and RX queue
    $ref: /schemas/types.yaml#/definitions/uint32

  dma-coherent: true

patternProperties:
  "^port@.*":
    description: DSA Fabric port node
    type: object
    additionalProperties: false
    properties:
      reg:
        description: physical port index within the DSA Fabric
        maxItems: 1

      phy-handle:
        description: PHY handle for this port
        $ref: /schemas/types.yaml#/definitions/phandle
      serdes-syscon:
        description: syscon handle for SerDes register
        $ref: /schemas/types.yaml#/definitions/phandle
      cpld-syscon:
        description: syscon handle plus register offset for CPLD register
        $ref: /schemas/types.yaml#/definitions/phandle-array
        items:
          - items:
              - description: CPLD phandle
              - description: offset
      port-rst-offset:
        description: reset field offset for this port
        $ref: /schemas/types.yaml#/definitions/uint32
      port-mode-offset:
        description: port mode field offset for this port
        $ref: /schemas/types.yaml#/definitions/uint32
      mc-mac-mask:
        description: multicast MAC address mask
        $ref: /schemas/types.yaml#/definitions/uint8-array
    required:
      - reg

required:
  - compatible
  - reg
  - reg-names
  - interrupts
  - mode

additionalProperties: false

examples:
  - |
    dsaf0: dsa@c7000000 {
        compatible = "hisilicon,hns-dsaf-v1";
        mode = "6port-16rss";
        reg = <0x0 0xc5000000 0x0 0x890000
               0x0 0xc7000000 0x0 0x60000>;
        reg-names = "ppe-base", "dsaf-base";
        subctrl-syscon = <&subctrl>;
        reset-field-offset = <0>;
        interrupts = <131 4>,<132 4>, <133 4>,<134 4>,
                     <135 4>,<136 4>, <137 4>,<138 4>,
                     <139 4>,<140 4>, <141 4>,<142 4>,
                     <143 4>,<144 4>, <145 4>,<146 4>,
                     <147 4>,<148 4>, <384 1>,<385 1>,
                     <386 1>,<387 1>, <388 1>,<389 1>,
                     <390 1>,<391 1>,
        buf-size = <4096>;
        desc-num = <1024>;
        dma-coherent;
        port@0 {
            reg = <0>;
            phy-handle = <&phy0>;
            serdes-syscon = <&serdes>;
            mc-mac-mask = [ff f0 00 00 00 00];
        };
        port@1 {
            reg = <1>;
            serdes-syscon = <&serdes>;
            mc-mac-mask = [ff f0 00 00 00 00];
        };
    };
```
