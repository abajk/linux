## Documentation/devicetree/bindings/pci/ti,dra7-pcie.yaml
```yaml
# SPDX-License-Identifier: (GPL-2.0-only OR BSD-2-Clause)
# Copyright 2025 Texas Instruments.

%YAML 1.2
---
$id: http://devicetree.org/schemas/pci/ti,dra7-pcie.yaml#
$schema: http://devicetree.org/meta-schemas/core.yaml#

title: TI PCI Controllers

maintainers:
  - Bjorn Helgaas <bhelgaas@google.com>
  - Kishon Vijay Abraham I <kishon@kernel.org>
  - Mauro Carvalho Chehab <mchehab+huawei@kernel.org>
  - Vignesh R <vigneshr@ti.com>

description: |
  TI PCI Controllers

  PCIe DesignWare Controller

  NOTE: Two DT nodes may be added for each PCI controller; one for host
  mode and another for device mode. So in order for PCI to work in host mode,
  EP mode DT node should be disabled and in order to PCI to work in EP mode,
  host mode DT node should be disabled. Host mode and EP mode are mutually
  exclusive.

properties:
  compatible:
    $ref: /schemas/types.yaml#/definitions/string-array
    items:
      - enum:
          - "ti,dra7-pcie"
          - "ti,dra7-pcie-ep"
          - "ti,dra746-pcie-rc"
          - "ti,dra746-pcie-ep"
          - "ti,dra726-pcie-rc"
          - "ti,dra726-pcie-ep"

  phys:
    $ref: /schemas/types.yaml#/definitions/phandle-array
    description: |
      List of PHY specifiers used by the generic PHY framework.

  phy-names:
    items:
      - const: pcie-phy0
        description: First PHY specifier name.
      - const: pcie-phy1
        description: Second PHY specifier name.
      - const: pcie-phyN
        description: Subsequent PHY specifier names.

  ti,hwmods:
    $ref: /schemas/types.yaml#/definitions/string-array
    items:
      - description: Name of the hwmod associated with this PCIe instance.
    description: |
      Hardware module names for this PCIe controller.

  ti,syscon-lane-sel:
    $ref: /schemas/types.yaml#/definitions/phandle-array
    items:
      - description: Phandle to the syscon node.
      - description: Register offset and bitfield for lane selection.
    description: |
      System controller register and bitfield to select PCIe lanes.

  reg:
    oneOf:
      - items:
          - description: TI-specific registers (ti-conf).
          - description: DesignWare DBICS registers (rc-dbics).
          - description: PCIe configuration space registers.
      - items:
          - description: TI-specific registers (ti-conf).
          - description: Standard config registers in DIF CS space (ep_dbics).
          - description: Standard config registers in DIF CS2 space (ep_dbics2).
          - description: Address translation window for remote RC (addr_space).
    description: |
      Register ranges for the TI-specific and DesignWare PCIe controllers.

  reg-names:
    oneOf:
      - items:
          - const: ti-conf
          - const: rc-dbics
          - const: config
      - items:
          - const: ti-conf
          - const: ep_dbics
          - const: ep_dbics2
          - const: addr_space

  interrupts:
    oneOf:
      - items:
          - description: Main interrupt line.
          - description: MSI interrupt line.
      - items:
          - description: Main interrupt line.
    description: |
      Interrupt entries for main and MSI interrupt lines.

  "#address-cells":
    $ref: /schemas/types.yaml#/definitions/uint32
    const: 3
    description: |
      Number of address cells for child nodes.

  "#size-cells":
    $ref: /schemas/types.yaml#/definitions/uint32
    const: 2
    description: |
      Number of size cells for child nodes.

  device_type:
    const: pci
    description: |
      Must be set to "pci".

  ranges:
    description: |
      Address mapping ranges for the PCI bus.

  "#interrupt-cells":
    $ref: /schemas/types.yaml#/definitions/uint32
    description: |
      Number of interrupt cells for this interrupt controller.

  interrupt-controller: true

  ti,syscon-unaligned-access:
    $ref: /schemas/types.yaml#/definitions/phandle-array
    items:
      - description: Phandle to the syscon node.
      - description: Bitfield to enable unaligned access.
    description: |
      Enable unaligned access control in the system controller.

  num-ib-windows:
    $ref: /schemas/types.yaml#/definitions/uint32
    description: |
      Number of inbound address translation windows.

  num-ob-windows:
    $ref: /schemas/types.yaml#/definitions/uint32
    description: |
      Number of outbound address translation windows.

  gpios:
    maxItems: 1
    description: |
      GPIO line for driving the PERST# reset signal.

required:
  - compatible
  - reg
  - interrupts
  - interrupt-controller

additionalProperties: false

examples:
  - |
    axi {
      compatible = "simple-bus";
      #size-cells = <1>;
      #address-cells = <1>;
      ranges = <0x51000000 0x51000000 0x3000
                0x0         0x20000000 0x10000000>;
      pcie@51000000 {
        compatible = "ti,dra7-pcie";
        reg = <0x51000000 0x2000>, <0x51002000 0x14c>, <0x1000 0x2000>;
        reg-names = "ti-conf", "rc-dbics", "config";
        interrupts = <0 232 0x4>, <0 233 0x4>;
        #address-cells = <3>;
        #size-cells = <2>;
        device_type = "pci";
        ranges = <0x81000000 0 0          0x03000 0 0x00010000
                  0x82000000 0 0x20013000 0x13000 0 0xffed000>;
        num-lanes = <1>;
        ti,hwmods = "pcie1";
        phys = <&pcie1_phy>;
        phy-names = "pcie-phy0";
        interrupt-map-mask = <0 0 0 7>;
        interrupt-map = <0 0 0 1 &pcie_intc 1>,
                         <0 0 0 2 &pcie_intc 2>,
                         <0 0 0 3 &pcie_intc 3>,
                         <0 0 0 4 &pcie_intc 4>;
        pcie_intc: interrupt-controller {
          interrupt-controller;
          #address-cells = <0>;
          #interrupt-cells = <1>;
        };
      };
    };
```

## Documentation/devicetree/bindings/perf/apm-xgene-pmu.yaml
```yaml
# SPDX-License-Identifier: (GPL-2.0-only OR BSD-2-Clause)
# Copyright 2025 APM
%YAML 1.2
---
$id: http://devicetree.org/schemas/apm-xgene-pmu.yaml#
$schema: http://devicetree.org/meta-schemas/core.yaml#

title: APM X-Gene SoC PMU

maintainers:
  - Tai Nguyen <ttnguyen@apm.com>

description: |
  * APM X-Gene SoC PMU bindings

  This is APM X-Gene SoC PMU (Performance Monitoring Unit) module.
  The following PMU devices are supported:

    L3C            - L3 cache controller
    IOB            - IO bridge
    MCB            - Memory controller bridge
    MC             - Memory controller

  The following section describes the SoC PMU DT node binding.

properties:
  compatible:
    items:
      - enum:
          - apm,xgene-pmu
          - apm,xgene-pmu-v2
          - apm,xgene-pmu-l3c
          - apm,xgene-pmu-iob
          - apm,xgene-pmu-mcb
          - apm,xgene-pmu-mc
    description: >
      Supported compatible strings for the root PMU node and its subnodes.

  "#address-cells":
    const: 2

  "#size-cells":
    const: 2

  ranges:
    description: >
      Indicates this node does not map any address ranges.

  regmap-csw: true
  regmap-mcba: true
  regmap-mcbb: true

  reg:
    description: CPU bus PMU resource.
    items:
      - description: CPU bus PMU resource

  interrupts:
    description: IRQ specifier for the PMU interrupt.
    items:
      - description: PMU IRQ

  enable-bit-index:
    description: >
      Specifies which bit enables the associated resource in MCB or MC subnodes.

required:
  - compatible
  - regmap-csw
  - regmap-mcba
  - regmap-mcbb
  - reg
  - interrupts

additionalProperties: false

examples:
  - |
    csw: csw@7e200000 {
        compatible = "apm,xgene-csw", "syscon";
        reg = <0x0 0x7e200000 0x0 0x1000>;
    };

    mcba: mcba@7e700000 {
        compatible = "apm,xgene-mcb", "syscon";
        reg = <0x0 0x7e700000 0x0 0x1000>;
    };

    mcbb: mcbb@7e720000 {
        compatible = "apm,xgene-mcb", "syscon";
        reg = <0x0 0x7e720000 0x0 0x1000>;
    };

    pmu: pmu@78810000 {
        compatible = "apm,xgene-pmu-v2";
        #address-cells = <2>;
        #size-cells = <2>;
        ranges;
        regmap-csw = <&csw>;
        regmap-mcba = <&mcba>;
        regmap-mcbb = <&mcbb>;
        reg = <0x0 0x78810000 0x0 0x1000>;
        interrupts = <0x0 0x22 0x4>;

        pmul3c@7e610000 {
            compatible = "apm,xgene-pmu-l3c";
            reg = <0x0 0x7e610000 0x0 0x1000>;
        };

        pmuiob@7e940000 {
            compatible = "apm,xgene-pmu-iob";
            reg = <0x0 0x7e940000 0x0 0x1000>;
        };

        pmucmcb@7e710000 {
            compatible = "apm,xgene-pmu-mcb";
            reg = <0x0 0x7e710000 0x0 0x1000>;
            enable-bit-index = <0>;
        };

        pmucmcb@7e730000 {
            compatible = "apm,xgene-pmu-mcb";
            reg = <0x0 0x7e730000 0x0 0x1000>;
            enable-bit-index = <1>;
        };

        pmucmc@7e810000 {
            compatible = "apm,xgene-pmu-mc";
            reg = <0x0 0x7e810000 0x0 0x1000>;
            enable-bit-index = <0>;
        };

        pmucmc@7e850000 {
            compatible = "apm,xgene-pmu-mc";
            reg = <0x0 0x7e850000 0x0 0x1000>;
            enable-bit-index = <1>;
        };

        pmucmc@7e890000 {
            compatible = "apm,xgene-pmu-mc";
            reg = <0x0 0x7e890000 0x0 0x1000>;
            enable-bit-index = <2>;
        };

        pmucmc@7e8d0000 {
            compatible = "apm,xgene-pmu-mc";
            reg = <0x0 0x7e8d0000 0x0 0x1000>;
            enable-bit-index = <3>;
        };
    };
```

## Documentation/devicetree/bindings/phy/phy-bindings.yaml
```yaml
%YAML 1.2
---
$id: http://devicetree.org/schemas/phy-bindings.yaml#
$schema: http://devicetree.org/meta-schemas/core.yaml#

title: Generic PHY

maintainers:
  - Baruch Siach <baruch@tkos.co.il>
  - Hayato Suzuki <hytszk@gmail.com>
  - Kishon Vijay Abraham I <kishon@kernel.org>
  - Mauro Carvalho Chehab <mchehab+samsung@kernel.org>
  - Roger Quadros <rogerq@ti.com>

description: |
  This document explains only the device tree data binding. For general
  information about PHY subsystem refer to Documentation/driver-api/phy/phy.rst

  PHY device node
  ===============

  That node describes an IP block (PHY provider) that implements two
  different PHYs. In order to differentiate between these two PHYs, an
  additional specifier should be given while trying to get a reference to it.

  PHY user node
  =============

  This node represents a controller that uses two PHYs, one for usb2 and
  one for usb3.

  This node represents a controller that uses one of the PHYs of the
  PHY provider device defined previously. Note that the phy handle has an
  additional specifier "1" to differentiate between the two PHYs.

properties:
  compatible:
    items:
      - const: xxx
  reg:
    description: Register space of the PHY provider.
  '#phy-cells':
    description: Number of cells in a PHY specifier; The meaning of all
      those cells is defined by the binding for the phy node. The PHY
      provider can use the values in cells to find the appropriate PHY.
    $ref: /schemas/types.yaml#/definitions/uint32
  phy-supply:
    description: Regulator that provides power to the PHY.
  phys:
    description: The phandle(s) for the PHY device (used by the PHY
      subsystem; not to be confused with the Ethernet-specific 'phy' and
      'phy-handle' properties—see Documentation/devicetree/bindings/net/ethernet.txt)
  phy-names:
    description: Names of the PHY corresponding to the PHYs present in
      the phys phandle.

oneOf:
  - required: [compatible, reg, "#phy-cells"]
  - required: [compatible, phys, phy-names]

additionalProperties: false

examples:
  - |
    phy: phy {
        compatible = "xxx";
        reg = <0x...>;
        #phy-cells = <1>;
        phy-supply = <&vcc_phy>;
    };
  - |
    usb1: usb_otg_ss@xxx {
        compatible = "xxx";
        phys = <&usb2_phy>, <&usb3_phy>;
        phy-names = "usb2phy", "usb3phy";
    };
```
