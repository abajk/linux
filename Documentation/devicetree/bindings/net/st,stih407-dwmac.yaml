## Documentation/devicetree/bindings/pci/nvidia,tegra20-pcie.yaml
```yaml
# SPDX-License-Identifier: (GPL-2.0-only OR BSD-2-Clause)
# Copyright 2018 Linaro Ltd.
%YAML 1.2
---
$id: http://devicetree.org/schemas/nvidia,tegra20-pcie.yaml#
$schema: http://devicetree.org/meta-schemas/core.yaml#

title: NVIDIA Tegra PCIe controller

maintainers:
  - Jay Agarwal <jagarwal@nvidia.com>
  - Lucas Stach <l.stach@pengutronix.de>
  - Manikanta Maddireddy <mmaddireddy@nvidia.com>
  - Marco Franchi <marco.franchi@nxp.com>
  - Paul Walmsley <paul@pwsan.com>
  - Stephen Warren <swarren@nvidia.com>
  - Thierry Reding <thierry.reding@avionic-design.de>
  - Thierry Reding <treding@nvidia.com>

description: |
  NVIDIA Tegra PCIe controller

  Root ports are defined as subnodes of the PCIe controller node.

properties:
  compatible:
    description: >
      List of compatible strings identifying the Tegra PCIe controller variant.
    items:
      - enum:
          - nvidia,tegra20-pcie
          - nvidia,tegra30-pcie
          - nvidia,tegra124-pcie
          - nvidia,tegra210-pcie
          - nvidia,tegra186-pcie

  device_type:
    const: pci
    description: >
      Specifies that the node represents a PCI bus.

  reg:
    description: >
      Physical base addresses and sizes for controller registers.

  reg-names:
    items:
      - const: pads
      - const: afi
      - const: cs

  interrupts:
    description: >
      Interrupt outputs of the controller.

  interrupt-names:
    items:
      - const: intr
      - const: msi

  interrupt-controller: true

  '#interrupt-cells':
    const: 1

  interrupt-map-mask:
    description: >
      Mask for standard PCI IRQ mapping.

  interrupt-map:
    description: >
      Standard PCI IRQ mapping entries.

  bus-range:
    description: >
      Range of PCI bus numbers managed by this controller.
    items:
      type: integer
      minimum: 0
      maximum: 255

  '#address-cells':
    const: 3

  '#size-cells':
    const: 2

  ranges:
    description: >
      Address translation entries for root ports and PCI regions.
    items:
      minItems: 6
      maxItems: 6

  clocks:
    description: >
      Clock phandles required by the controller.

  clock-names:
    items:
      - const: pex
      - const: afi
      - const: pll_e
      - const: cml

  resets:
    description: >
      Reset phandles required by the controller.

  reset-names:
    items:
      - const: pex
      - const: afi
      - const: pcie_x


  power-domains:
    description: >
      Phandles and IDs for BPMP powergate domains (Tegra186 only).

  pinctrl-names:
    items:
      - const: default
      - const: idle

  pinctrl-0:
    description: >
      Phandle for the active pinctrl state.

  pinctrl-1:
    description: >
      Phandle for the idle pinctrl state.

  phys:
    description: >
      Deprecated PHY aliases for Tegra124 and later.

  phy-names:
    items:
      - const: pcie

  avdd-pex-supply: true
  vdd-pex-supply: true
  avdd-pex-pll-supply: true
  avdd-plle-supply: true
  vddio-pex-clk-supply: true
  vdd-supply: true
  pex-clk-supply: true

  avdd-pexa-supply: true
  vdd-pexa-supply: true
  avdd-pexb-supply: true
  vdd-pexb-supply: true

  avddio-pex-supply: true
  dvddio-pex-supply: true
  hvdd-pex-supply: true
  hvdd-pex-pll-e-supply: true
  vddio-pex-ctl-supply: true
  avdd-pll-erefe-supply: true

  avdd-pll-uerefe-supply: true
  hvddio-pex-supply: true
  dvdd-pex-pll-supply: true

  dvdd-pex-supply: true
  hvdd-pex-pll-supply: true
  vddio-pexctl-aud-supply: true

required:
  - compatible
  - reg
  - interrupts
  - interrupt-controller

additionalProperties: false

examples:
  - |
    pcie-controller@80003000 {
        compatible = "nvidia,tegra20-pcie";
        device_type = "pci";
        reg = <0x80003000 0x00000800>,
              <0x80003800 0x00000200>,
              <0x90000000 0x10000000>;
        reg-names = "pads", "afi", "cs";
        interrupts = <0 98 0x04>, <0 99 0x04>;
        interrupt-names = "intr", "msi";
        #interrupt-cells = <1>;
        interrupt-map-mask = <0 0 0 0>;
        interrupt-map = <0 0 0 0 &intc GIC_SPI 98 IRQ_TYPE_LEVEL_HIGH>;
        bus-range = <0x00 0xff>;
        #address-cells = <3>;
        #size-cells = <2>;
        ranges = <0x82000000 0 0x80000000 0x80000000 0 0x00001000>,
                 <0x82000000 0 0x80001000 0x80001000 0 0x00001000>,
                 <0x81000000 0 0 0x82000000 0 0x00010000>,
                 <0x82000000 0 0xa0000000 0xa0000000 0 0x10000000>,
                 <0xc2000000 0 0xb0000000 0xb0000000 0 0x10000000>;
        clocks = <&tegra_car 70>, <&tegra_car 72>, <&tegra_car 118>;
        clock-names = "pex", "afi", "pll_e";
        resets = <&tegra_car 70>, <&tegra_car 72>, <&tegra_car 74>;
        reset-names = "pex", "afi", "pcie_x";
        status = "okay";
        vdd-supply = <&pci_vdd_reg>;
        pex-clk-supply = <&pci_clk_reg>;
    };
  - |
    pcie-controller@80003000 {
        status = "okay";
        pci@1,0 {
            status = "okay";
        };
    };
```

## Documentation/devicetree/bindings/pci/ralink,rt3883-pci.yaml
```yaml
# SPDX-License-Identifier: (GPL-2.0-only OR BSD-2-Clause)
%YAML 1.2
---
$id: http://devicetree.org/schemas/ralink,rt3883-pci.yaml#
$schema: http://devicetree.org/meta-schemas/core.yaml#

title: Mediatek/Ralink RT3883 PCI controller

maintainers:
  - Bjorn Helgaas <bhelgaas@google.com>
  - Gabor Juhos <juhosg@openwrt.org>
  - Rob Herring <robh@kernel.org>

description: |
  Mediatek/Ralink RT3883 PCI controller.

  The main node defines the PCI controller with its memory map and
  address translation. It has two mandatory child nodes: an interrupt
  controller for PCI interrupts and a PCI host bridge node which defines
  the bus range, memory and I/O mappings, and interrupt mappings.
  The host bridge node may include subnodes for onboard PCI bridges
  and device slots.

properties:
  compatible:
    const: ralink,rt3883-pci

  reg:
    maxItems: 1

  '#address-cells':
    const: 1

  '#size-cells':
    const: 1

  ranges: true

patternProperties:
  ".*":
    anyOf:
      - description: Interrupt controller child node.
        properties:
          interrupt-controller:
            type: boolean
          '#address-cells':
            const: 0
          '#interrupt-cells':
            const: 1
          interrupts:
            description: Interrupt from the parent interrupt controller.
            items:
              - description: interrupt line number
        required:
          - interrupt-controller
          - '#address-cells'
          - '#interrupt-cells'
          - interrupts
        additionalProperties: false

      - description: PCI host bridge and its subnodes.
        properties:
          '#address-cells':
            const: 0
          '#size-cells':
            const: 2
          '#interrupt-cells':
            const: 1
          device_type:
            const: pci
          bus-range:
            description: Range of PCI bus numbers.
            items:
              - description: first bus number
              - description: last bus number
          ranges:
            description: PCI memory and I/O mappings.
          interrupt-map-mask:
            description: Mask for PCI interrupt specifiers.
          interrupt-map:
            description: Mapping from PCI interrupts to parent interrupts.
        required:
          - '#address-cells'
          - '#size-cells'
          - '#interrupt-cells'
          - device_type
          - bus-range
          - ranges
          - interrupt-map-mask
          - interrupt-map
        additionalProperties: false
        patternProperties:
          "^pci-bridge@.*":
            description: On-chip PCI bridge.
            type: object
            properties:
              reg:
                description: Bridge identifier for interrupt mapping.
                items:
                  - description: bus/device/function/bridge number
              device_type:
                const: pci
              '#address-cells':
                const: 3
              '#size-cells':
                const: 2
              '#interrupt-cells':
                const: 1
              interrupt-map-mask:
                description: Mask for bridge interrupts.
              interrupt-map:
                description: Mapping for bridge interrupts.
            required:
              - reg
              - device_type
              - '#address-cells'
              - '#size-cells'
              - '#interrupt-cells'
              - interrupt-map-mask
              - interrupt-map
            additionalProperties: false

          "^pci-slot@.*":
            description: Onboard PCI device slot.
            type: object
            properties:
              reg:
                description: Slot identifier for interrupt mapping.
                items:
                  - description: bus/device/function/slot number
              device_type:
                const: pci
            required:
              - reg
              - device_type
            additionalProperties: false

additionalProperties: false

examples:
  - |
    pci@10140000 {
      compatible = "ralink,rt3883-pci";
      reg = <0x10140000 0x20000>;
      #address-cells = <1>;
      #size-cells = <1>;
      ranges; /* direct mapping */
      status = "disabled";

      pciintc: interrupt-controller {
        interrupt-controller;
        #address-cells = <0>;
        #interrupt-cells = <1>;
        interrupts = <4>;
      };

      host-bridge {
        #address-cells = <0>;
        #size-cells = <2>;
        #interrupt-cells = <1>;
        device_type = "pci";
        bus-range = <0 255>;
        ranges = <
          0x02000000 0 0x00000000 0x20000000 0 0x10000000 /* pci memory */
          0x01000000 0 0x00000000 0x10160000 0 0x00010000 /* I/O space */
        >;
        interrupt-map-mask = <0xf800 0 0 7>;
        interrupt-map = <
          /* IDSEL 17 */
          0x8800 0 0 1 &pciintc 18
          0x8800 0 0 2 &pciintc 18
          0x8800 0 0 3 &pciintc 18
          0x8800 0 0 4 &pciintc 18
          /* IDSEL 18 */
          0x9000 0 0 1 &pciintc 19
          0x9000 0 0 2 &pciintc 19
          0x9000 0 0 3 &pciintc 19
          0x9000 0 0 4 &pciintc 19
        >;

        pci-bridge@1 {
          reg = <0x0800 0 0 0 0>;
          device_type = "pci";
          #address-cells = <3>;
          #size-cells = <2>;
          #interrupt-cells = <1>;
          interrupt-map-mask = <0x0 0 0 0>;
          interrupt-map = <0x0 0 0 0 &pciintc 20>;
          status = "disabled";
        };

        pci-slot@17 {
          reg = <0x8800 0 0 0 0>;
          device_type = "pci";
          status = "disabled";
        };

        pci-slot@18 {
          reg = <0x9000 0 0 0 0>;
          device_type = "pci";
          status = "disabled";
        };
      };
    };
```
