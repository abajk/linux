## Documentation/devicetree/bindings/net/st,stih407-dwmac.yaml
```yaml
# SPDX-License-Identifier: (GPL-2.0-only OR BSD-2-Clause)
# Copyright 2025 STMicroelectronics
%YAML 1.2
---
$id: http://devicetree.org/schemas/net/st,stih407-dwmac.yaml#
$schema: http://devicetree.org/meta-schemas/core.yaml#

title: STMicroelectronics SoC DWMAC glue layer controller

maintainers:
  - Alain Volmat <avolmat@me.com>
  - Bjorn Helgaas <bhelgaas@google.com>
  - Giuseppe CAVALLARO <peppe.cavallaro@st.com>
  - Peter Griffin <peter.griffin@linaro.org>
  - Rob Herring <robh@kernel.org>
  - Srinivas Kandagatla <srinivas.kandagatla@st.com>

description: |
  STMicroelectronics SoC DWMAC glue layer controller

  This file documents differences between the core properties in
  Documentation/devicetree/bindings/net/stmmac.txt
  and what is needed on STi platforms to program the stmmac glue logic.

properties:
  compatible:
    items:
      - enum:
          - st,stih407-dwmac
          - snps,dwmac
          - snps,dwmac-3.710

  reg:
    items:
      - description: MAC register region (base address and size)

  reg-names:
    items:
      - const: stmmaceth

  clocks:
    description: Clocks controlling MAC and PHY interfaces
    items:
      - description: stmmac interface clock
      - description: PHY interface clock

  clock-names:
    items:
      - const: stmmaceth
      - const: sti-ethclk

  interrupts:
    description: Interrupts for the MAC, wake, and low power idle events
    items:
      - description: MAC interrupt
      - description: Ethernet wake interrupt
      - description: Ethernet low power idle interrupt

  interrupt-names:
    items:
      - const: macirq
      - const: eth_wake_irq
      - const: eth_lpi

  st,syscon:
    description: syscon for MAC glue logic control registers
    items:
      - description: phandle to syscon register bank
      - description: offset of the control register

  st,gmac_en:
    description: Enable GMAC via dedicated sysctl control register
    type: boolean

  pinctrl-0:
    description: pin-control for MII mode
    items:
      - description: phandle to pin control state

  resets:
    description: Reset controller phandle for Ethernet reset
    items:
      - description: phandle to reset controller

  reset-names:
    items:
      - const: stmmaceth

  st,ext-phyclk:
    description: External PHY clock phandle for RMII mode
    items:
      - description: phandle to external PHY clock

  st,tx-retime-src:
    description: TX retiming source for MAC TX lines
    enum:
      - txclk
      - clk_125
      - clkgen

  sti-ethclk:
    description: PHY clock phandle
    items:
      - description: phandle to PHY clock

  sti-clkconf:
    description: Extra sysconfig register for clock retiming
    items:
      - description: phandle to sysconfig register bank
      - description: offset of clock retiming register

  snps,pbl:
    description: Programmable burst length
    $ref: /schemas/types.yaml#/definitions/uint32

  snps,mixed-burst:
    description: Enable mixed burst transfers
    type: boolean

additionalProperties: false

required:
  - compatible
  - st,syscon
  - st,gmac_en
  - pinctrl-0

examples:
  - |
    ethernet0: dwmac@9630000 {
        device_type = "network";
        compatible = "st,stih407-dwmac", "snps,dwmac", "snps,dwmac-3.710";
        reg = <0x9630000 0x8000>;
        reg-names = "stmmaceth";
        st,syscon = <&syscfg_sbc_reg 0x80>;
        st,gmac_en;
        resets = <&softreset STIH407_ETH1_SOFTRESET>;
        reset-names = "stmmaceth";
        interrupts = <GIC_SPI 98 IRQ_TYPE_NONE>,
                     <GIC_SPI 99 IRQ_TYPE_NONE>,
                     <GIC_SPI 100 IRQ_TYPE_NONE>;
        interrupt-names = "macirq", "eth_wake_irq", "eth_lpi";
        snps,pbl = <32>;
        snps,mixed-burst;
        pinctrl-names = "default";
        pinctrl-0 = <&pinctrl_rgmii1>;
        clock-names = "stmmaceth", "sti-ethclk";
        clocks = <&CLK_S_C0_FLEXGEN CLK_EXT2F_A9>,
                 <&CLK_S_C0_FLEXGEN CLK_ETH_PHY>;
    };
```

## Documentation/devicetree/bindings/net/ti,am3352-cpsw-phy-sel.yaml
```yaml
# SPDX-License-Identifier: (GPL-2.0-only OR BSD-2-Clause)
%YAML 1.2
---
$id: http://devicetree.org/schemas/ti,am3352-cpsw-phy-sel.yaml#
$schema: http://devicetree.org/meta-schemas/core.yaml#
title: TI CPSW Phy mode selection
maintainers:
  - Grygorii Strashko <grygorii.strashko@ti.com>
  - Mugunthan V N <mugunthanvnm@ti.com>
description: |
  TI CPSW Phy mode Selection Device Tree Bindings (DEPRECATED)
  -----------------------------------------------
properties:
  compatible:
    description: Device compatible strings for CPSW Phy mode selection.
    items:
      - enum:
          - ti,am3352-cpsw-phy-sel
          - ti,dra7xx-cpsw-phy-sel
          - ti,am43xx-cpsw-phy-sel
  reg:
    description: Physical base address and size of the CPSW registers map.
    items:
      - description: CPSW register base address
      - description: CPSW register size
  reg-names:
    description: Names of the CPSW registers map entries.
    $ref: /schemas/types.yaml#/definitions/string-array
    items:
      - const: gmii-sel
  rmii-clock-ext:
    description: If present, the driver will configure the RMII interface to external clock usage.
    type: boolean
required:
  - compatible
  - reg
  - reg-names
additionalProperties: false
examples:
  - |
    phy_sel: cpsw-phy-sel@44e10650 {
        compatible = "ti,am3352-cpsw-phy-sel";
        reg = <0x44e10650 0x4>;
        reg-names = "gmii-sel";
    };
  - |
    phy_sel: cpsw-phy-sel@44e10650 {
        compatible = "ti,am3352-cpsw-phy-sel";
        reg = <0x44e10650 0x4>;
        reg-names = "gmii-sel";
        rmii-clock-ext;
    };
```

## Documentation/devicetree/bindings/net/ti,cpsw.yaml
```yaml
# SPDX-License-Identifier: (GPL-2.0-only OR BSD-2-Clause)
%YAML 1.2
---
$id: http://devicetree.org/schemas/ti,cpsw.yaml#
$schema: http://devicetree.org/meta-schemas/core.yaml#

title: TI SoC Ethernet Switch Controller

maintainers:
  - Daniel Mack <zonque@gmail.com>
  - David Rivshin <drivshin@allworx.com>
  - David S. Miller <davem@davemloft.net>
  - Grygorii Strashko <grygorii.strashko@ti.com>
  - Heiko Schocher <hs@denx.de>
  - Ivan Khoronzhuk <ivan.khoronzhuk@linaro.org>
  - Markus Brunner <systemprogrammierung.brunner@gmail.com>
  - Markus Schneider-Pargmann <msp@baylibre.com>
  - Mugunthan V N <mugunthanvnm@ti.com>
  - Petr Štetiar <ynezz@true.cz>
  - Randy Dunlap <rdunlap@infradead.org>
  - Richard Cochran <richardcochran@gmail.com>
  - Rob Herring <robh@kernel.org>
  - Sergei Shtylyov <sergei.shtylyov@cogentembedded.com>
  - Tony Lindgren <tony@atomide.com>

description: |
  TI SoC Ethernet Switch Controller Device Tree Bindings
  ------------------------------------------------------

properties:
  compatible:
    $ref: /schemas/types.yaml#/definitions/string-array
    items:
      - enum:
          - ti,cpsw
          - ti,am335x-cpsw
          - ti,am4372-cpsw
          - ti,dra7-cpsw

  reg:
    items:
      - description: Physical base address of the CPSW registers map
      - description: Size of the CPSW registers map

  interrupts:
    items:
      - description: Interrupt number
      - description: Interrupt flags

  cpdma-channels:
    description: Specifies number of channels in CPDMA
    $ref: /schemas/types.yaml#/definitions/uint32

  ale-entries:
    description: Specifies number of ALE entries
    $ref: /schemas/types.yaml#/definitions/uint32

  bd-ram-size:
    description: Specifies internal descriptor RAM size
    $ref: /schemas/types.yaml#/definitions/uint32

  rx-descs:
    description: Specifies number of Rx descriptors
    $ref: /schemas/types.yaml#/definitions/uint32

  mac-control:
    description: Specifies default MAC control register content
    $ref: /schemas/types.yaml#/definitions/uint32

  slaves:
    description: Specifies number of slaves
    $ref: /schemas/types.yaml#/definitions/uint32

  active-slave:
    description: Specifies the slave to use for time stamping, ethtool and SIOCGMIIPHY
    $ref: /schemas/types.yaml#/definitions/uint32

  cpsw-phy-sel:
    description: Specifies the phandle to the CPSW PHY mode selection device
    $ref: /schemas/types.yaml#/definitions/phandle

  ti,hwmods:
    description: Must be "cpgmac0"
    const: cpgmac0

  dual-emac:
    description: Specifies switch to act as Dual EMAC
    type: boolean

  syscon:
    description: Phandle to the system control device node
    $ref: /schemas/types.yaml#/definitions/phandle

  mode-gpios:
    description: |
      Should be added if one or multiple GPIO lines are required to be driven
      so that CPSW data lines can be connected to the PHY via selective mux
    items:
      $ref: /schemas/types.yaml#/definitions/phandle

  cpts-clock-mult:
    description: Numerator to convert input clock ticks into nanoseconds
    $ref: /schemas/types.yaml#/definitions/uint32

  cpts-clock-shift:
    description: Denominator to convert input clock ticks into nanoseconds
    $ref: /schemas/types.yaml#/definitions/uint32

patternProperties:
  "^cpsw_emac[0-9]+$":
    description: CPSW slave sub-node properties
    type: object
    additionalProperties: false
    properties:
      phy-mode:
        description: See ethernet.txt file in the same directory
        $ref: /schemas/types.yaml#/definitions/string

      phys:
        description: Phandle on PHY (see phy/ti-phy-gmii-sel.txt)
        items:
          $ref: /schemas/types.yaml#/definitions/phandle

      dual-emac-res-vlan:
        description: Specifies VID to be used to segregate the ports
        $ref: /schemas/types.yaml#/definitions/uint32

      phy-id:
        description: Specifies slave phy id (deprecated, use phy-handle)
        $ref: /schemas/types.yaml#/definitions/uint32

      phy-handle:
        description: See ethernet.txt file in the same directory
        $ref: /schemas/types.yaml#/definitions/phandle

      fixed-link:
        description: Fixed link sub-node (see fixed-link.txt)
        type: object
        additionalProperties: false

    required:
      - phy-mode
      - phys

required:
  - compatible
  - reg
  - interrupts
  - cpdma-channels
  - ale-entries
  - bd-ram-size
  - mac-control
  - slaves
  - active-slave
  - cpsw-phy-sel

additionalProperties: false

examples:
  - |
    mac: ethernet@4a100000 {
      compatible = "ti,cpsw";
      reg = <0x4A100000 0x1000>;
      interrupts = <55 0x4>;
      cpdma-channels = <8>;
      ale-entries = <1024>;
      bd-ram-size = <0x2000>;
      rx-descs = <64>;
      mac-control = <0x20>;
      slaves = <2>;
      active-slave = <0>;
      cpts-clock-mult = <0x80000000>;
      cpts-clock-shift = <29>;
      syscon = <&cm>;
      cpsw-phy-sel = <&phy_sel>;
      cpsw_emac0: slave@0 {
        /* Filled in by U-Boot */
        mac-address = [00 00 00 00 00 00];
        phy-mode = "rgmii-txid";
        phys = <&phy_gmii_sel 1 0>;
      };
      cpsw_emac1: slave@1 {
        /* Filled in by U-Boot */
        mac-address = [00 00 00 00 00 00];
        phy-mode = "rgmii-txid";
        phys = <&phy_gmii_sel 2 0>;
      };
    };
```

## Documentation/devicetree/bindings/net/ti,davinci-dm6467-emac.yaml
```yaml
# SPDX-License-Identifier: (GPL-2.0-only OR BSD-2-Clause)
%YAML 1.2
---
$id: http://devicetree.org/schemas/ti,davinci-dm6467-emac.yaml#
$schema: http://devicetree.org/meta-schemas/core.yaml#

title: TI Davinci EMAC
maintainers:
  - Heiko Schocher <hs@denx.de>
  - Petr Štetiar <ynezz@true.cz>
  - Sergei Shtylyov <sergei.shtylyov@cogentembedded.com>
  - Tony Lindgren <tony@atomide.com>

description: |
  Texas Instruments Davinci EMAC

  This file provides information, what the device node
  for the davinci_emac interface contains.

  The MAC address will be determined using the optional properties
  defined in ethernet.txt.

properties:
  compatible:
    enum:
      - "ti,davinci-dm6467-emac"
      - "ti,am3517-emac"
      - "ti,dm816-emac"

  reg:
    description: Base address and size of EMAC registers
    items:
      - description: Register base offset
      - description: Register region size

  interrupts:
    description: |
      Interrupt mapping for the Davinci EMAC, in order:
      Receive Threshold, Receive, Transmit, Miscellaneous
    items:
      - description: Receive Threshold Interrupt
      - description: Receive Interrupt
      - description: Transmit Interrupt
      - description: Miscellaneous Interrupt

  ti,davinci-ctrl-reg-offset:
    description: Offset to EMAC control register
    $ref: /schemas/types.yaml#/definitions/uint32

  ti,davinci-ctrl-mod-reg-offset:
    description: Offset to EMAC control module register
    $ref: /schemas/types.yaml#/definitions/uint32

  ti,davinci-ctrl-ram-offset:
    description: Offset to EMAC control RAM
    $ref: /schemas/types.yaml#/definitions/uint32

  ti,davinci-ctrl-ram-size:
    description: Size of EMAC control RAM
    $ref: /schemas/types.yaml#/definitions/uint32

  phy-handle:
    description: Phandle to external PHY; if absent, defaults to 100/FULL
    $ref: /schemas/types.yaml#/definitions/phandle

  local-mac-address:
    description: Local MAC address for the EMAC interface
    $ref: /schemas/types.yaml#/definitions/uint8-array
    minItems: 6
    maxItems: 6

  ti,davinci-rmii-en:
    description: Enable RMII interface when true
    type: boolean

  ti,davinci-no-bd-ram:
    description: Indicates absence of BD RAM when true
    type: boolean

required:
  - compatible
  - reg
  - interrupts
  - ti,davinci-ctrl-reg-offset
  - ti,davinci-ctrl-mod-reg-offset
  - ti,davinci-ctrl-ram-offset
  - ti,davinci-ctrl-ram-size

additionalProperties: false

examples:
  - |
    eth0: emac@1e20000 {
        compatible = "ti,davinci-dm6467-emac";
        reg = <0x220000 0x4000>;
        ti,davinci-ctrl-reg-offset = <0x3000>;
        ti,davinci-ctrl-mod-reg-offset = <0x2000>;
        ti,davinci-ctrl-ram-offset = <0>;
        ti,davinci-ctrl-ram-size = <0x2000>;
        local-mac-address = [ 00 00 00 00 00 00 ];
        interrupts = <33 34 35 36>;
    };
```
