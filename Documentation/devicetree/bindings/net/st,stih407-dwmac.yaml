## Documentation/devicetree/bindings/net/usb1286,204e.yaml
```yaml
# SPDX-License-Identifier: (GPL-2.0-only OR BSD-2-Clause)
# Copyright (C) 2025 Brian Norris <briannorris@chromium.org>
# Copyright (C) 2025 Chunfeng Yun <chunfeng.yun@mediatek.com>
# Copyright (C) 2025 Geert Uytterhoeven <geert+renesas@glider.be>
# Copyright (C) 2025 Rajat Jain <rajatja@google.com>
# Copyright (C) 2025 Rob Herring <robh@kernel.org>
%YAML 1.2
---
$id: http://devicetree.org/schemas/net/usb1286,204e.yaml#
$schema: http://devicetree.org/meta-schemas/core.yaml#

title: Generic Bluetooth controller over USB (btusb driver)

maintainers:
  - Brian Norris <briannorris@chromium.org>
  - Chunfeng Yun <chunfeng.yun@mediatek.com>
  - Geert Uytterhoeven <geert+renesas@glider.be>
  - Rajat Jain <rajatja@google.com>
  - Rob Herring <robh@kernel.org>

description: |
  Generic Bluetooth controller over USB (btusb driver)

  Required properties:
    - compatible: should comply with the format "usbVID,PID" specified in
      Documentation/devicetree/bindings/usb/usb-device.yaml. At the time of writing,
      the only OF supported devices (more may be added later) are:
        - "usb1286,204e" (Marvell 8997)
        - "usbcf3,e300" (Qualcomm QCA6174A)
        - "usb4ca,301a" (Qualcomm QCA6174A (Lite-On))

  Optional properties:
    - interrupt-names: The name "wakeup" indicates the out-of-band
      wake-on-Bluetooth interrupt.
    - interrupts: The interrupt specified by the name "wakeup" is used for
      out-of-band wake-on-Bluetooth.

properties:
  compatible:
    $ref: /schemas/types.yaml#/definitions/string-array
    items:
      - enum: ["usb1286,204e", "usbcf3,e300", "usb4ca,301a"]

  reg:
    items:
      - description: USB port number assigned by the host controller

  interrupts:
    description: Out-of-band wake-on-Bluetooth interrupt specifier
    items:
      - description: Interrupt specifier (GPIO or IRQ number and flags)

  interrupt-names:
    items:
      - const: wakeup
    description: Name of the wake-on-Bluetooth interrupt

required:
  - compatible

additionalProperties: false

examples:
  - |
    &usb_host1_ehci {
        #address-cells = <1>;
        #size-cells = <0>;

        mvl_bt1: bt@1 {
            compatible = "usb1286,204e";
            reg = <1>;
            interrupt-names = "wakeup";
            interrupts = <3 IRQ_TYPE_LEVEL_LOW>;
        };
    };
```

## Documentation/devicetree/bindings/net/via,velocity-vt6110.yaml
```yaml
# SPDX-License-Identifier: (GPL-2.0-only OR BSD-2-Clause)
%YAML 1.2
---
$id: http://devicetree.org/schemas/net/via,velocity-vt6110.yaml#
$schema: http://devicetree.org/meta-schemas/core.yaml#

title: VIA Velocity 10/100/1000 Network Controller

maintainers:
  - Tony Prisk <linux@prisktech.co.nz>

description: |
  VIA Velocity 10/100/1000 Network Controller

properties:
  compatible:
    items:
      - const: via,velocity-vt6110

  reg:
    items:
      - description: Address and length of the I/O space

  interrupts:
    items:
      - description: Controller interrupt line

  no-eeprom:
    type: boolean
    description: |
      PCI network cards use an external EEPROM to store data.
      Embedded devices quite often set this data in uboot and do not provide an eeprom.
      Specify this option if you have no external eeprom.

required:
  - compatible
  - reg
  - interrupts

additionalProperties: false

examples:
  - |
    eth0@d8004000 {
        compatible = "via,velocity-vt6110";
        reg = <0xd8004000 0x400>;
        interrupts = <10>;
        no-eeprom;
    };
```

## Documentation/devicetree/bindings/net/wireless/ti,wl1251.yaml
```yaml
# SPDX-License-Identifier: (GPL-2.0-only OR BSD-2-Clause)
%YAML 1.2
---
$id: http://devicetree.org/schemas/net/wireless/ti,wl1251.yaml#
$schema: http://devicetree.org/meta-schemas/core.yaml#

title: TI WL1251 wireless lan controller

maintainers:
  - H. Nikolaus Schaller <hns@goldelico.com>
  - Rob Herring <robh@kernel.org>
  - Sebastian Reichel <sre@kernel.org>

description: |
  Texas Instruments wl1251 wireless lan controller

  The wl1251 chip can be connected via SPI or via SDIO. This
  document describes the binding for the SPI connected chip.

  Optional properties:
  - ti,wl1251-has-eeprom: boolean, the wl1251 has an external EEPROM
    for calibration and MAC
  - ti,power-gpio: GPIO connected to chip's PMEN pin if operated in
    SPI mode
  - Please consult Documentation/devicetree/bindings/spi/spi-bus.txt for
    optional SPI connection related properties.

properties:
  compatible:
    description: Compatibility string for TI WL1251 controller
    items:
      - const: ti,wl1251
  reg:
    description: Chip select address of the SPI device
    items:
      - description: chip select index
  spi-max-frequency:
    description: Maximum SPI clocking speed of device in Hz
    $ref: /schemas/types.yaml#/definitions/uint32
  spi-cpol:
    description: SPI clock polarity flag
    type: boolean
  spi-cpha:
    description: SPI clock phase flag
    type: boolean
  interrupts:
    description: Interrupt specifier for the device
    items:
      - description: IRQ line and trigger flags
  interrupt-names:
    description: Names for the IRQ cells
    items:
      - const: irq
  vio-supply:
    description: Regulator supplying VIO for the device
  ti,wl1251-has-eeprom:
    description: Indicates presence of external EEPROM for calibration and MAC
    type: boolean
  ti,power-gpio:
    description: GPIO for power enable (PMEN) pin in SPI mode
    maxItems: 1

required:
  - compatible
  - reg
  - spi-max-frequency
  - interrupts
  - vio-supply

additionalProperties: false

examples:
  - |
    &spi1 {
      wl1251@0 {
        compatible = "ti,wl1251";
        reg = <0>;
        spi-max-frequency = <48000000>;
        spi-cpol;
        spi-cpha;
        interrupts = <10 IRQ_TYPE_NONE>; /* gpio line 42 */
        vio-supply = <&vio>;
        ti,power-gpio = <&gpio3 23 GPIO_ACTIVE_HIGH>; /* 87 */
      };
    };
  - |
    &mmc3 {
      vmmc-supply = <&wlan_en>;
      bus-width = <4>;
      non-removable;
      ti,non-removable;
      cap-power-off-card;
      pinctrl-names = "default";
      pinctrl-0 = <&mmc3_pins>;
      #address-cells = <1>;
      #size-cells = <0>;
      wlan: wifi@1 {
        compatible = "ti,wl1251";
        reg = <1>;
        interrupts = <21 IRQ_TYPE_LEVEL_HIGH>; /* GPIO_21 */
        ti,wl1251-has-eeprom;
      };
    };
```

## Documentation/devicetree/bindings/net/wiznet,w5x00.yaml
```yaml
---
$id: http://devicetree.org/schemas/net/wiznet,w5x00.yaml#
$schema: http://devicetree.org/meta-schemas/core.yaml#

title: Wiznet W5x00 Ethernet Controller

maintainers:
  - Nicolas Saenz Julienne <nsaenz@kernel.org>

description: |
  A standalone 10/100 MBit Ethernet controller with SPI interface.

  For each device connected to a SPI bus, define a child node within
  the SPI master node.

properties:
  compatible:
    description: Device compatibility strings.
    $ref: /schemas/types.yaml#/definitions/string-array
    items:
      - enum:
          - wiznet,w5100
          - wiznet,w5200
          - wiznet,w5500

  reg:
    description: SPI chip select the chip is wired to.
    items:
      - description: Chip select number

  interrupts:
    description: 'Interrupt specifier: index and type.'
    items:
      - description: Index of the interrupt within the controller
      - description: Interrupt trigger type (e.g. IRQ_TYPE_EDGE_FALLING)

  pinctrl-names:
    description: Pin control state names for the interrupt line.
    $ref: /schemas/types.yaml#/definitions/string-array

  pinctrl-0:
    description: Phandle references to configure the GPIO pin for interrupts.
    $ref: /schemas/types.yaml#/definitions/phandle-array

  spi-max-frequency:
    description: Maximum SPI bus frequency for the controller (Hz).
    $ref: /schemas/types.yaml#/definitions/uint32

  local-mac-address:
    description: Local MAC address.
    $ref: /schemas/types.yaml#/definitions/string

required:
  - compatible
  - reg
  - interrupts
  - pinctrl-names
  - pinctrl-0

additionalProperties: false

examples:
  - |
    &spi {
      ethernet@0: w5500@0 {
        compatible = "wiznet,w5500";
        reg = <0>;
        pinctrl-names = "default";
        pinctrl-0 = <&eth1_pins>;
        interrupts = <25 IRQ_TYPE_EDGE_FALLING>;
        spi-max-frequency = <30000000>;
      };
    };
```

## Documentation/devicetree/bindings/nios2/altr,nios2-1.0.yaml
```yaml
# SPDX-License-Identifier: (GPL-2.0-only OR BSD-2-Clause)
# Copyright 2018 Linaro Ltd.
%YAML 1.2
---
$id: http://devicetree.org/schemas/altr,nios2-1.0.yaml#
$schema: http://devicetree.org/meta-schemas/core.yaml#

title: Nios II Processor

maintainers:
  - Bjorn Helgaas <bhelgaas@google.com>
  - Ley Foon Tan <lftan@altera.com>
  - Mathieu Malaterre <malat@debian.org>

description: |
  Nios II Processor Binding

  This binding specifies what properties available in the device tree
  representation of a Nios II Processor Core.

  Users can use sopc2dts tool for generating device tree sources (dts) from a
  Qsys system. See more detail in: http://www.alterawiki.com/wiki/Sopc2dts

properties:
  compatible:
    items:
      - const: altr,nios2-1.0

  device_type:
    description: Must be "cpu".
    items:
      - const: cpu

  reg:
    description: CPU index.
    items:
      - description: CPU index

  interrupt-controller: true

  '#interrupt-cells':
    const: 1

  clock-frequency:
    description: Contains the clock frequency for CPU, in Hz.

  dcache-line-size:
    description: Contains data cache line size.

  icache-line-size:
    description: Contains instruction cache line size.

  dcache-size:
    description: Contains data cache size.

  icache-size:
    description: Contains instruction cache size.

  altr,implementation:
    description: Nios II core implementation.
    enum:
      - fast

  altr,pid-num-bits:
    description: Specifies the number of bits to use to represent the process identifier (PID).

  altr,tlb-num-ways:
    description: Specifies the number of set-associativity ways in the TLB.

  altr,tlb-num-entries:
    description: Specifies the number of entries in the TLB.

  altr,tlb-ptr-sz:
    description: Specifies size of TLB pointer.

  altr,has-div:
    description: Specifies CPU hardware divide support.

  altr,has-mul:
    description: Specifies CPU hardware multiply support.
    const: 1

  altr,has-initda:
    description: Specifies CPU support for initda instruction.
    const: 1

  altr,has-mmu:
    description: Specifies CPU support for MMU.
    const: 1

  altr,reset-addr:
    description: Specifies CPU reset address.

  altr,fast-tlb-miss-addr:
    description: Specifies CPU fast TLB miss exception address.

  altr,exception-addr:
    description: Specifies CPU exception address.

required:
  - compatible
  - device_type
  - reg
  - interrupt-controller
  - '#interrupt-cells'
  - clock-frequency
  - dcache-line-size
  - icache-line-size
  - dcache-size
  - icache-size
  - altr,pid-num-bits
  - altr,tlb-num-ways
  - altr,tlb-num-entries
  - altr,tlb-ptr-sz
  - altr,has-mul
  - altr,has-initda
  - altr,has-mmu
  - altr,reset-addr
  - altr,fast-tlb-miss-addr
  - altr,exception-addr

additionalProperties: false

examples:
  - |
    cpu@0 {
      device_type = "cpu";
      compatible = "altr,nios2-1.0";
      reg = <0>;
      interrupt-controller;
      #interrupt-cells = <1>;
      clock-frequency = <125000000>;
      dcache-line-size = <32>;
      icache-line-size = <32>;
      dcache-size = <32768>;
      icache-size = <32768>;
      altr,implementation = "fast";
      altr,pid-num-bits = <8>;
      altr,tlb-num-ways = <16>;
      altr,tlb-num-entries = <128>;
      altr,tlb-ptr-sz = <7>;
      altr,has-div = <1>;
      altr,has-mul = <1>;
      altr,reset-addr = <0xc2800000>;
      altr,fast-tlb-miss-addr = <0xc7fff400>;
      altr,exception-addr = <0xd0000020>;
      altr,has-initda = <1>;
      altr,has-mmu = <1>;
    };
```

## Documentation/devicetree/bindings/nvmem/brcm,ocotp.yaml
```yaml
# SPDX-License-Identifier: (GPL-2.0-only OR BSD-2-Clause)
# Copyright 2025 Broadcom Ltd.
%YAML 1.2
---
$id: http://devicetree.org/schemas/nvmem/brcm,ocotp.yaml#
$schema: http://devicetree.org/meta-schemas/core.yaml#

title: Broadcom OTP memory controller

maintainers:
  - Jonathan Richardson <jonathar@broadcom.com>
  - Marco Franchi <marco.franchi@nxp.com>

description: |
  Broadcom OTP memory controller

properties:
  compatible:
    $ref: /schemas/types.yaml#/definitions/string-array
    description: >-
      Must be "brcm,ocotp" for first-generation Broadcom OTP controllers or
      "brcm,ocotp-v2" for second-generation controllers.
    items:
      - enum: ["brcm,ocotp", "brcm,ocotp-v2"]

  reg:
    items:
      - description: Base address of the OTP controller registers
      - description: Size of the OTP controller register window

  brcm,ocotp-size:
    description: Amount of memory available, in 32-bit words
    $ref: /schemas/types.yaml#/definitions/uint32

required:
  - compatible
  - reg
  - brcm,ocotp-size

additionalProperties: false

examples:
  - |
    otp: otp@301c800 {
        compatible = "brcm,ocotp";
        reg = <0x0301c800 0x2c>;
        brcm,ocotp-size = <2048>;
    };
```

## Documentation/devicetree/bindings/nvmem/nxp,lpc1850-otp.yaml
```yaml
# SPDX-License-Identifier: (GPL-2.0-only OR BSD-2-Clause)
%YAML 1.2
---
$id: http://devicetree.org/schemas/nxp,lpc1850-otp.yaml#
$schema: http://devicetree.org/meta-schemas/core.yaml#

title: NXP LPC1850 OTP memory

maintainers:
  - Joachim Eastwood <manabian@gmail.com>

description: |
  * NXP LPC18xx OTP memory

  Internal OTP (One Time Programmable) memory for NXP LPC18xx/43xx devices.

  See nvmem.txt for more information.

properties:
  compatible:
    items:
      - const: nxp,lpc1850-otp

  reg:
    items:
      - description: OTP memory region

  '#address-cells':
    const: 1

  '#size-cells':
    const: 1

required:
  - compatible
  - reg
  - '#address-cells'
  - '#size-cells'

additionalProperties: false

examples:
  - |
    otp: otp@40045000 {
        compatible = "nxp,lpc1850-otp";
        reg = <0x40045000 0x1000>;
        #address-cells = <1>;
        #size-cells = <1>;
    };
```
