## Documentation/devicetree/bindings/phy/st,miphy28lp-phy.yaml
```yaml
# SPDX-License-Identifier: (GPL-2.0-only OR BSD-2-Clause)
# Copyright 2025 STMicroelectronics
%YAML 1.2
---
$id: http://devicetree.org/schemas/phy/st,miphy28lp-phy.yaml#
$schema: http://devicetree.org/meta-schemas/core.yaml#

title: STMicroelectronics STi MIPHY28LP PHY

maintainers:
  - Gabriel FERNANDEZ <gabriel.fernandez@st.com>

description: |
  STMicroelectronics STi MIPHY28LP PHY binding

  This binding describes a miphy device that is used to control PHY hardware
  for SATA, PCIe or USB3.

  Specifying phy control of devices
  ==================================

  Device nodes should specify the configuration required in their "phys"
  property, containing a phandle to the miphy device node and an index
  specifying which configuration to use, as described in phy-bindings.txt.

definitions:
  port:
    description: MIPHY channel controller sub-node.
    type: object
    properties:
      reg:
        items:
          - description: SATA PHY register range.
          - description: PCIe PHY register range.
          - description: PIPEW PHY register range.
        description: Register ranges for the PHY channel.
      reg-names:
        items:
          - const: sata-up
          - const: pcie-up
          - const: pipew
        description: Names for the register ranges.
#      st,syscfg:
#        $ref: /schemas/types.yaml#/definitions/uint32-array
#        description: Offset of the parent configuration register.
      "#phy-cells":
        const: 1
        description: Number of cells after port phandle specifying PHY type.
      st,osc-rdy:
        type: boolean
        description: Check the MIPHY0_OSC_RDY status in the glue logic.
      st,osc-force-ext:
        type: boolean
        description: Select the external oscillator.
      st,sata_gen:
        $ref: /schemas/types.yaml#/definitions/uint32
        description: SATA_SPDMODE setting for the SATA system config.
      st,px_rx_pol_inv:
        type: boolean
        description: Invert polarity of RXn/RXp.
      st,scc-on:
        type: boolean
        description: Enable SSC to reduce EMI effects.
      st,tx-impedance-comp:
        $ref: /schemas/types.yaml#/definitions/uint32
        description: Compensate TX impedance.
      resets:
        items:
          - $ref: /schemas/types.yaml#/definitions/phandle
        description: Phandle to the parent reset controller.
      reset-names:
        items:
          - const: miphy-sw-rst
        description: Associated name for the reset.
    required:
      - reg
      - reg-names
      - st,syscfg
      - "#phy-cells"
      - resets
      - reset-names
    additionalProperties: false

properties:
  compatible:
    const: st,miphy28lp-phy
    description: Device compatible string.
  st,syscfg:
    $ref: /schemas/types.yaml#/definitions/phandle
    description: Phandle of the system configuration register group
      which contain the SATA, PCIe or USB3 mode setting bits.

patternProperties:
  "^port@[0-9A-Fa-f]+$":
    $ref: "#/definitions/port"
additionalProperties: false

examples:
  - |
    miphy28lp_phy: miphy28lp@9b22000 {
        compatible = "st,miphy28lp-phy";
        st,syscfg = <&syscfg_core>;
        #address-cells = <1>;
        #size-cells = <1>;
        ranges;

        phy_port0: port@9b22000 {
            reg = <0x9b22000 0xff>,
                  <0x9b09000 0xff>,
                  <0x9b04000 0xff>;
            reg-names = "sata-up",
                        "pcie-up",
                        "pipew";

            st,syscfg = <0x114 0x818 0xe0 0xec>;
            #phy-cells = <1>;
            st,osc-rdy;
            reset-names = "miphy-sw-rst";
            resets = <&softreset STIH407_MIPHY0_SOFTRESET>;
        };

        phy_port1: port@9b2a000 {
            reg = <0x9b2a000 0xff>,
                  <0x9b19000 0xff>,
                  <0x9b14000 0xff>;
            reg-names = "sata-up",
                        "pcie-up",
                        "pipew";

            st,syscfg = <0x118 0x81c 0xe4 0xf0>;

            #phy-cells = <1>;
            st,osc-force-ext;
            reset-names = "miphy-sw-rst";
            resets = <&softreset STIH407_MIPHY1_SOFTRESET>;
        };

        phy_port2: port@8f95000 {
            reg = <0x8f95000 0xff>,
                  <0x8f90000 0xff>;
            reg-names = "pipew",
                        "usb3-up";

            st,syscfg = <0x11c 0x820>;

            #phy-cells = <1>;
            reset-names = "miphy-sw-rst";
            resets = <&softreset STIH407_MIPHY2_SOFTRESET>;
        };
    };
  - |
    sata0: sata@9b20000  {
        ...
        phys = <&phy_port0 PHY_TYPE_SATA>;
        ...
    };
```

## Documentation/devicetree/bindings/phy/st,miphy365x-phy.yaml
```yaml
# SPDX-License-Identifier: (GPL-2.0-only OR BSD-2-Clause)
# Copyright 2025 STMicroelectronics
%YAML 1.2
---
$id: http://devicetree.org/schemas/phy/st,miphy365x-phy.yaml#
$schema: http://devicetree.org/meta-schemas/core.yaml#

title: STMicroelectronics STi MIPHY365x PHY

maintainers:
  - Lee Jones <lee@kernel.org>
  - Peter Griffin <peter.griffin@linaro.org>

description: |
  STMicroelectronics STi MIPHY365x PHY binding

  This binding describes a miphy device that is used to control PHY hardware
  for SATA and PCIe.

  Specifying phy control of devices

  Device nodes should specify the configuration required in their "phys"
  property, containing a phandle to the phy port node and a device type.

properties:
  compatible:
    items:
      - const: st,miphy365x-phy

  "st,syscfg":
    description: Phandle to sysconfig group and integer offsets for each port sub-node.
    $ref: /schemas/types.yaml#/definitions/phandle-array

  "#address-cells":
    const: 1

  "#size-cells":
    const: 1

  ranges: true

patternProperties:
  "^port@.*":
    description: Port sub-node describing each PHY port.
    type: object
    additionalProperties: false
    properties:
      reg:
        maxItems: 1
      "#phy-cells":
        const: 1
        description: Cell after port phandle specifying device type (PHY_TYPE_SATA or PHY_TYPE_PCI).
      "st,sata-gen":
        description: Generation of locally attached SATA IP. Expected values {1,2,3}.
        $ref: /schemas/types.yaml#/definitions/uint32
        enum: [1, 2, 3]
      "st,pcie-tx-pol-inv":
        description: Invert polarity of PCIe Tx (Txn/Txp).
        type: boolean
      "st,sata-tx-pol-inv":
        description: Invert polarity of SATA Tx (Txn/Txp).
        type: boolean
    required:
      - reg
      - reg-names
      - "#phy-cells"

required:
  - compatible
  - "st,syscfg"

additionalProperties: false
```

## Documentation/devicetree/bindings/phy/ti-phy.yaml
```yaml
# SPDX-License-Identifier: (GPL-2.0-only OR BSD-2-Clause)
%YAML 1.2
---
$id: http://devicetree.org/schemas/ti-phy.yaml#
$schema: http://devicetree.org/meta-schemas/core.yaml#

title: TI PHY

maintainers:
  - Bjorn Helgaas <bhelgaas@google.com>
  - Kishon Vijay Abraham I <kishon@kernel.org>
  - Rob Herring <robh@kernel.org>
  - Roger Quadros <rogerq@ti.com>
  - Sekhar Nori <nsekhar@ti.com>

description: |
  TI PHY: DT DOCUMENTATION FOR PHYs in TI PLATFORMs

  OMAP CONTROL PHY

  TI PIPE3 PHY

properties:
  compatible:
    description: Vendor and device string to identify the TI PHY type.
    items:
      - const: ti,control-phy-otghs
      - const: ti,control-phy-usb2
      - const: ti,control-phy-pipe3
      - const: ti,control-phy-pcie
      - const: ti,control-phy-usb2-dra7
      - const: ti,control-phy-usb2-am437
      - const: ti,phy-usb3
      - const: ti,phy-pipe3-sata
      - const: ti,phy-pipe3-pcie
      - const: ti,omap-usb3
  reg:
    description: Address and length of the register sets for the device.
    oneOf:
      - items:
          - description: Control PHY register block
      - items:
          - description: First register block
          - description: Second register block
          - description: Third register block
  reg-names:
    description: Names corresponding to each register in reg.
    oneOf:
      - items:
          - const: otghs_control
      - items:
          - const: power
      - items:
          - const: power
          - const: pcie_pcs
          - const: control_sma
      - items:
          - const: phy_rx
          - const: phy_tx
          - const: pll_ctrl
  '#phy-cells':
    description: Number of cells in the phandle when referencing this PHY.
    const: 0
  clocks:
    description: Clocks required by PIPE3 PHYs.
    items:
      - description: Wakeup clock.
      - description: System clock.
      - description: Reference clock.
      - description: External DPLL reference clock.
      - description: Alternative DPLL reference clock.
      - description: Divider for APLL.
      - description: APLL clock.
  clock-names:
    description: Names corresponding to each clock in clocks.
    items:
      - const: wkupclk
      - const: sysclk
      - const: refclk
      - const: dpll_ref
      - const: dpll_ref_m2
      - const: phy-div
      - const: div-clk
  id:
    description: Differentiates multiple instances of the same PHY type.
    $ref: /schemas/types.yaml#/definitions/uint32
  syscon-pllreset:
    description: System control and register offset for PLL soft reset (sata_phy only).
    $ref: /schemas/types.yaml#/definitions/phandle-with-offset
  syscon-pcs:
    description: System control and register offset to program PCS delay.
    $ref: /schemas/types.yaml#/definitions/phandle-with-offset
  syscon-phy-power:
    description: System control and register offset to power on/off the PHY.
    $ref: /schemas/types.yaml#/definitions/phandle-with-offset
  ctrl-module:
    description: Deprecated phandle of the control module used to power on the PHY.
    $ref: /schemas/types.yaml#/definitions/phandle

required:
  - compatible
  - reg
  - reg-names

additionalProperties: false

examples:
  - |
    omap-control-usb@4a002300 {
      compatible = "ti,control-phy-otghs";
      reg = <0x4a00233c 0x4>;
      reg-names = "otghs_control";
    };
  - |
    usb3phy@4a084400 {
      compatible = "ti,phy-usb3";
      reg = <0x4a084400 0x80>,
            <0x4a084800 0x64>,
            <0x4a084c00 0x40>;
      reg-names = "phy_rx", "phy_tx", "pll_ctrl";
      ctrl-module = <&omap_control_usb>;
      #phy-cells = <0>;
      clocks = <&usb_phy_cm_clk32k>,
               <&sys_clkin>,
               <&usb_otg_ss_refclk960m>;
      clock-names = "wkupclk",
                    "sysclk",
                    "refclk";
    };
  - |
    phy@4a096000 {
      compatible = "ti,phy-pipe3-sata";
      reg = <0x4A096000 0x80>, /* phy_rx */
            <0x4A096400 0x64>, /* phy_tx */
            <0x4A096800 0x40>; /* pll_ctrl */
      reg-names = "phy_rx", "phy_tx", "pll_ctrl";
      ctrl-module = <&omap_control_sata>;
      clocks = <&sys_clkin1>, <&sata_ref_clk>;
      clock-names = "sysclk", "refclk";
      syscon-pllreset = <&scm_conf 0x3fc>;
      #phy-cells = <0>;
    };
```

## Documentation/devicetree/bindings/pinctrl/abilis,tb10x-iomux.yaml
```yaml
# SPDX-License-Identifier: (GPL-2.0-only OR BSD-2-Clause)
%YAML 1.2
---
$id: http://devicetree.org/schemas/pinctrl/abilis,tb10x-iomux.yaml#
$schema: http://devicetree.org/meta-schemas/core.yaml#

title: Abilis Systems TB10x pin controller

maintainers:
  - Christian Ruppert <christian.ruppert@abilis.com>
  - Rob Herring <robh@kernel.org>

description: |
  Abilis Systems TB10x pin controller

  Required properties

  Function definitions

  Functions are defined (and referenced) by sub-nodes of the pin controller.
  Every sub-node defines exactly one function (implying a set of pins).
  Every function is associated to one named pin group inside the pin controller
  driver and these names are used to associate pin group predefinitions to pin
  controller sub-nodes.

  The following pin groups are available:
    - GPIO ports: gpioa, gpiob, gpioc, gpiod, gpioe, gpiof, gpiog,
                  gpioh, gpioi, gpioj, gpiok, gpiol, gpiom, gpion
    - Serial TS input ports: mis0, mis1, mis2, mis3, mis4, mis5, mis6, mis7
    - Parallel TS input ports: mip1, mip3, mip5, mip7
    - Serial TS output ports: mos0, mos1, mos2, mos3
    - Parallel TS output port: mop
    - CI+ port: ciplus
    - CableCard (Mcard) port: mcard
    - Smart card ports: stc0, stc1
    - UART ports: uart0, uart1
    - SPI ports: spi1, spi3
    - JTAG: jtag

  All other ports of the chip are not multiplexed and thus not managed by this
  driver.

  GPIO ranges definition

  The named pin groups of GPIO ports can be used to define GPIO ranges as
  explained in Documentation/devicetree/bindings/gpio/gpio.txt.

properties:
  compatible:
    description: Must be "abilis,tb10x-iomux".
    items:
      - const: abilis,tb10x-iomux

  reg:
    description: Register block address and size.
    items:
      - description: Physical address the pin controller register block is mapped to.
      - description: Size of the pin controller register block.

patternProperties:
  "^[a-z][a-z0-9,_-]+$":
    description: Function definition sub-nodes of the pin controller.
    type: object
    additionalProperties: false
    properties:
      abilis,function:
        description: Name of the function's pin group.
        enum:
          - gpioa
          - gpiob
          - gpioc
          - gpiod
          - gpioe
          - gpiof
          - gpiog
          - gpioh
          - gpioi
          - gpioj
          - gpiok
          - gpiol
          - gpiom
          - gpion
          - mis0
          - mis1
          - mis2
          - mis3
          - mis4
          - mis5
          - mis6
          - mis7
          - mip1
          - mip3
          - mip5
          - mip7
          - mos0
          - mos1
          - mos2
          - mos3
          - mop
          - ciplus
          - mcard
          - stc0
          - stc1
          - uart0
          - uart1
          - spi1
          - spi3
          - jtag
    required:
      - abilis,function

required:
  - compatible
  - reg

additionalProperties: false

examples:
  - |
      iomux: iomux@ff10601c {
        compatible = "abilis,tb10x-iomux";
        reg = <0xFF10601c 0x4>;
        pctl_gpio_a: pctl-gpio-a {
          abilis,function = "gpioa";
        };
        pctl_uart0: pctl-uart0 {
          abilis,function = "uart0";
        };
      };
```
