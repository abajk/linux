## Documentation/devicetree/bindings/arm/omap/ti,irq-crossbar.yaml
```yaml
# SPDX-License-Identifier: (GPL-2.0-only OR BSD-2-Clause)
%YAML 1.2
---
$id: http://devicetree.org/schemas/ti,irq-crossbar.yaml#
$schema: http://devicetree.org/meta-schemas/core.yaml#

title: TI IRQ Crossbar

maintainers:
  - Jon Hunter <jonathanh@nvidia.com>
  - Marc Zyngier <maz@kernel.org>
  - Mathieu Malaterre <malat@debian.org>
  - Mauro Carvalho Chehab <mchehab+samsung@kernel.org>
  - Nishanth Menon <nm@ti.com>
  - Rob Herring <robh@kernel.org>
  - Sricharan R <r.sricharan@ti.com>

description: |
  Some socs have a large number of interrupts requests to service
  the needs of its many peripherals and subsystems. All of the
  interrupt lines from the subsystems are not needed at the same
  time, so they have to be muxed to the irq-controller appropriately.
  In such places a interrupt controllers are preceded by an CROSSBAR
  that provides flexibility in muxing the device requests to the controller
  inputs.

properties:
  compatible:
    enum: ["ti,irq-crossbar"]
  reg:
    maxItems: 1

  interrupt-controller: true
  ti,max-irqs:
    description: Total number of IRQs available at the parent interrupt controller
    $ref: /schemas/types.yaml#/definitions/uint32
  ti,max-crossbar-sources:
    description: Maximum number of crossbar sources that can be routed
    $ref: /schemas/types.yaml#/definitions/uint32
  ti,reg-size:
    description: Size of each crossbar register in bytes (valid values are 1, 2, or 4)
    $ref: /schemas/types.yaml#/definitions/uint32
    enum: [1, 2, 4]
#  "ti,irqs-reserved":
#    description: List of reserved IRQ lines not muxed by the crossbar
#    $ref: /schemas/types.yaml#/definitions/uint32-array
  "ti,irqs-skip":
    description: SOC-specific hard-wired IRQs with crossbar registers that cannot be used
    $ref: /schemas/types.yaml#/definitions/uint32-array
  "ti,irqs-safe-map":
    description: Safe configuration map used when an interrupt is unused
    $ref: /schemas/types.yaml#/definitions/uint32

required:
  - compatible
  - reg
  - interrupt-controller
  - ti,max-irqs
  - ti,max-crossbar-sources
  - ti,reg-size
  - ti,irqs-reserved

additionalProperties: false

examples:
  - |
    crossbar_mpu: crossbar@4a002a48 {
      compatible = "ti,irq-crossbar";
      reg = <0x4a002a48 0x130>;
      ti,max-irqs = <160>;
      ti,max-crossbar-sources = <400>;
      ti,reg-size = <2>;
      ti,irqs-reserved = <0 1 2 3 5 6 131 132>;
      ti,irqs-skip = <10 133 139 140>;
    };
```

## Documentation/devicetree/bindings/arm/omap/ti,iva.yaml
```yaml
# SPDX-License-Identifier: (GPL-2.0-only OR BSD-2-Clause)
# Copyright 2025 Texas Instruments
---
$id: http://devicetree.org/schemas/ti,iva.yaml#
$schema: http://devicetree.org/meta-schemas/core.yaml#

title: TI IVA (Imaging and Video Accelerator)

maintainers:
  - Benoit Cousson <b-cousson@ti.com>

description: |
  * TI - IVA (Imaging and Video Accelerator) subsystem

  The IVA contain various audio, video or imaging HW accelerator
  depending of the version.

properties:
  compatible:
    description: List of hardware compatible strings for different IVA versions.
    items:
      - enum:
          - ti,ivahd
          - ti,iva2.2
          - ti,iva2.1
          - ti,iva1
          - ti,iva

  ti,hwmods:
    description: Hardware modules to enable for IVA.
    $ref: /schemas/types.yaml#/definitions/string
    enum:
      - iva

required:
  - compatible
  - ti,hwmods

additionalProperties: false
```

## Documentation/devicetree/bindings/arm/omap/ti,omap-counter32k.yaml
```yaml
# SPDX-License-Identifier: (GPL-2.0-only OR BSD-2-Clause)
# Copyright 2025 Texas Instruments Inc.
%YAML 1.2
---
$id: http://devicetree.org/schemas/ti,omap-counter32k.yaml#
$schema: http://devicetree.org/meta-schemas/core.yaml#

title: TI OMAP Counter-32K

maintainers:
  - Jon Hunter <jon-hunter@ti.com>

description: |
  OMAP Counter-32K bindings.

  Required properties:
  - compatible: Must be "ti,omap-counter32k" for OMAP controllers
  - reg: Contains timer register address range (base address and length)
  - ti,hwmods: Name of the hwmod associated to the counter, which is typically
    "counter_32k"

  Example:

    counter32k: counter@4a304000 {
      compatible = "ti,omap-counter32k";
      reg = <0x4a304000 0x20>;
      ti,hwmods = "counter_32k";
    };

properties:
  compatible:
    const: ti,omap-counter32k

  reg:
    description: Timer register address range (base address and length)
    items:
      - description: base address
      - description: length

  ti,hwmods:
    description: Name of the hwmod associated to the counter
    $ref: /schemas/types.yaml#/definitions/string-array
    items:
      - enum: [counter_32k]

additionalProperties: false

required:
  - compatible
  - reg
  - ti,hwmods
```

## Documentation/devicetree/bindings/arm/omap/ti,omap-prm-inst.yaml
```yaml
# SPDX-License-Identifier: (GPL-2.0-only OR BSD-2-Clause)
%YAML 1.2
---
$id: http://devicetree.org/schemas/ti,omap-prm-inst.yaml#
$schema: http://devicetree.org/meta-schemas/core.yaml#

title: OMAP Power and Reset Manager instance

maintainers:
  - Tero Kristo <t-kristo@ti.com>
  - Tony Lindgren <tony@atomide.com>

description: |
  Power and Reset Manager is an IP block on OMAP family of devices which
  handle the power domains and their current state, and provide reset
  handling for the domains and/or separate IP blocks under the power domain
  hierarchy.

properties:
  compatible:
    oneOf:
      - items:
          - enum:
              - ti,am3-prm-inst
              - ti,am4-prm-inst
              - ti,omap4-prm-inst
              - ti,omap5-prm-inst
              - ti,dra7-prm-inst
          - const: ti,omap-prm-inst

  reg:
    description: Contains PRM instance register address range (base address and length)
    items:
      - description: base address
      - description: length

  '#power-domain-cells':
    description: Should be 0 if the instance is a power domain provider
    const: 0

  '#reset-cells':
    description: Should be 1 if the PRM instance in question supports resets
    const: 1

required:
  - compatible
  - reg

additionalProperties: false
```

## Documentation/devicetree/bindings/arm/omap/ti,omap.yaml
```yaml
%YAML 1.2
---
$id: http://devicetree.org/schemas/arm/omap/ti,omap.yaml#
$schema: http://devicetree.org/meta-schemas/core.yaml#

title: TI OMAP SoC

maintainers:
  - Adam Ford <aford173@gmail.com>
  - Afzal Mohammed <afzal@ti.com>
  - Andrew Davis <afd@ti.com>
  - AnilKumar Ch <anilkumar@ti.com>
  - Benoit Cousson <b-cousson@ti.com>
  - Carlos Garcia <carlos@cgarcia.org>
  - Dmitry Lifshitz <lifshitz@compulab.co.il>
  - Felipe Balbi <balbi@ti.com>
  - Florian Vaussard <florian.vaussard@epfl.ch>
  - George McCollister <george.mccollister@gmail.com>
  - H. Nikolaus Schaller <hns@goldelico.com>
  - Ilya Ledvich <ilya@compulab.co.il>
  - Joachim Eastwood <manabian@gmail.com>
  - Keerthy <j-keerthy@ti.com>
  - Lokesh Vutla <lokeshvutla@ti.com>
  - Masanari Iida <standby24x7@gmail.com>
  - Nikita Kiryanov <nikita@compulab.co.il>
  - Nishanth Menon <nm@ti.com>
  - Rajendra Nayak <rnayak@ti.com>
  - Roger Quadros <rogerq@ti.com>
  - R Sricharan <r.sricharan@ti.com>
  - Schuyler Patton <spatton@ti.com>
  - SZ Lin <sz.lin@moxa.com>
  - Teresa Remmet <t.remmet@phytec.de>
  - Tony Lindgren <tony@atomide.com>
  - Uri Mashiach <uri.mashiach@compulab.co.il>
  - Vaibhav Hiremath <hvaibhav@ti.com>

description: |
  * Texas Instruments OMAP

  OMAP is currently using a static file per SoC family to describe the
  IPs present in the SoC.
  On top of that an omap_device is created to extend the platform_device
  capabilities and to allow binding with one or several hwmods.
  The hwmods will contain all the information to build the device:
  address range, irq lines, dma lines, interconnect, PRCM register,
  clock domain, input clocks.
  For the moment just point to the existing hwmod, the next step will be
  move data from hwmod to device-tree representation.

properties:
  compatible:
    description: System compatibility string for the OMAP device
    $ref: /schemas/types.yaml#/definitions/string-array
    items:
      - pattern: '^ti,.*$'
  reg:
    description: Address ranges for this module
    $ref: /schemas/types.yaml#/definitions/reg
  interrupts:
    description: Interrupt lines for this module
    $ref: /schemas/types.yaml#/definitions/interrupts
  interrupt-controller:
    type: boolean
    description: Marks this node as an interrupt controller
  interrupt-names:
    description: Names of the interrupts
    $ref: /schemas/types.yaml#/definitions/interrupt-names
  ti,hwmods:
    description: List of hardware-module names for this OMAP device
    $ref: /schemas/types.yaml#/definitions/string-array
  ti,no_idle_on_suspend:
    type: boolean
    description: Prevent idling of the module during suspend
  ti,no-reset-on-init:
    type: boolean
    description: Prevent reset of the module at initialization
  ti,no-idle-on-init:
    type: boolean
    description: Prevent idling of the module at initialization
  ti,no-idle:
    type: boolean
    description: Prevent idling of the module at any time

required:
  - compatible
  - ti,hwmods

additionalProperties: false

examples:
  - |
    spinlock@1 {
        compatible = "ti,omap4-spinlock";
        ti,hwmods = "spinlock";
    };
```

## Documentation/devicetree/bindings/arm/omap/ti,omap2-l4.yaml
```yaml
# SPDX-License-Identifier: (GPL-2.0-only OR BSD-2-Clause)
# Copyright 2025 Texas Instruments Inc.
%YAML 1.2
---
$id: http://devicetree.org/schemas/arm/omap/ti,omap2-l4.yaml#
$schema: http://devicetree.org/meta-schemas/core.yaml#

title: OMAP L4 interconnect bus

maintainers:
  - Tero Kristo <t-kristo@ti.com>
  - Tony Lindgren <tony@atomide.com>

description: |
  L4 interconnect bindings

  These bindings describe the OMAP SoCs L4 interconnect bus.

properties:
  compatible:
    oneOf:
      - items:
          - enum:
            - ti,omap2-l4
            - ti,omap2-l4-wkup
            - ti,omap3-l4-core
            - ti,omap4-l4-cfg
            - ti,omap4-l4-per
            - ti,omap4-l4-wkup
            - ti,omap5-l4-cfg
            - ti,omap5-l4-wkup
            - ti,dra7-l4-cfg
            - ti,dra7-l4-wkup
            - ti,am3-l4-wkup
            - ti,am4-l4-wkup
          - const: simple-bus
      - items:
          - enum:
            - ti,omap2-l4
            - ti,omap2-l4-wkup
            - ti,omap3-l4-core
            - ti,omap4-l4-cfg
            - ti,omap4-l4-per
            - ti,omap4-l4-wkup
            - ti,omap5-l4-cfg
            - ti,omap5-l4-wkup
            - ti,dra7-l4-cfg
            - ti,dra7-l4-wkup
            - ti,am3-l4-wkup
            - ti,am4-l4-wkup

  ranges: true

  reg:
    items:
      - description: link agent
      - description: interconnect agent 0
      - description: interconnect agent 1
      - description: interconnect agent 2
      - description: interconnect agent 3
      - description: access protection

  reg-names:
    items:
      - const: la
      - const: ia0
      - const: ia1
      - const: ia2
      - const: ia3
      - const: ap

additionalProperties: false

examples:
  - |
    l4: interconnect@48000000 {
        compatible = "ti,omap4-l4-per", "simple-bus";
        reg = <0x48000000 0x800>,
              <0x48000800 0x800>,
              <0x48001000 0x400>,
              <0x48001400 0x400>,
              <0x48001800 0x400>,
              <0x48001c00 0x400>;
        reg-names = "ap", "la", "ia0", "ia1", "ia2", "ia3";
        #address-cells = <1>;
        #size-cells = <1>;
        ranges = <0 0x48000000 0x100000>;
    };
```

## Documentation/devicetree/bindings/arm/omap/ti,omap3-c64.yaml
```yaml
# SPDX-License-Identifier: (GPL-2.0-only OR BSD-2-Clause)
# Copyright 2025 Texas Instruments
%YAML 1.2
---
$id: http://devicetree.org/schemas/ti,omap3-c64.yaml#
$schema: http://devicetree.org/meta-schemas/core.yaml#

title: TI OMAP DSP
maintainers:
  - Benoit Cousson <b-cousson@ti.com>

description: |
  * TI - DSP (Digital Signal Processor)

  TI DSP included in OMAP SoC

properties:
  compatible:
    const: ti,omap3-c64

  ti,hwmods:
    description: Hardware modules string identifying the module.
    $ref: /schemas/types.yaml#/definitions/string-array
    items:
      - const: dsp

required:
  - compatible
  - ti,hwmods

additionalProperties: false

examples:
  - |
    dsp {
        compatible = "ti,omap3-c64";
        ti,hwmods = "dsp";
    };
```

## Documentation/devicetree/bindings/arm/omap/ti,omap3-mpu.yaml
```yaml
# SPDX-License-Identifier: (GPL-2.0-only OR BSD-2-Clause)
%YAML 1.2
---
$id: http://devicetree.org/schemas/arm/omap/ti,omap3-mpu.yaml#
$schema: http://devicetree.org/meta-schemas/core.yaml#

title: TI OMAP MPU

maintainers:
  - Benoit Cousson <b-cousson@ti.com>
  - Dave Gerlach <d-gerlach@ti.com>
  - Mauro Carvalho Chehab <mchehab+huawei@kernel.org>
  - Rajendra Nayak <rnayak@ti.com>
  - Sricharan R <r.sricharan@ti.com>

description: |
  TI - MPU (Main Processor Unit) subsystem
  The MPU subsystem contain one or several ARM cores depending of the version.
  The MPU contain CPUs, GIC, L2 cache and a local PRCM.

properties:
  compatible:
    description: The compatibility string for the MPU type
    items:
      - enum:
          - "ti,omap3-mpu"
          - "ti,omap4-mpu"
          - "ti,omap5-mpu"

  ti,hwmods:
    description: Hardware modules for the MPU, must be "mpu"
    items:
      - const: mpu

  sram:
    description: Phandle to the OCMCRAM node
    $ref: /schemas/types.yaml#/definitions/phandle

  pm-sram:
    description: >
      Phandles to OCMCRAM nodes for power management; first is protect-exec
      region, second is data region
    $ref: /schemas/types.yaml#/definitions/phandle-array
    minItems: 2
    maxItems: 2

required:
  - compatible
  - ti,hwmods

allOf:
  - if:
      properties:
        compatible:
          contains:
            const: "ti,omap3-mpu"
    then:
      required:
        - pm-sram
    else:
      properties:
        pm-sram: false

additionalProperties: false

examples:
  - |
    mpu {
        compatible = "ti,omap5-mpu";
        ti,hwmods = "mpu";
    };
  - |
    mpu {
        compatible = "ti,omap3-mpu";
        ti,hwmods = "mpu";
        pm-sram = <&pm_sram_code
                   &pm_sram_data>;
    };
```

## Documentation/devicetree/bindings/arm/omap/ti,omap4-dmm.yaml
```yaml
# SPDX-License-Identifier: (GPL-2.0-only OR BSD-2-Clause)
# Copyright 2025 Archit Taneja <archit@ti.com>
%YAML 1.2
---
$id: http://devicetree.org/schemas/arm/omap/ti,omap4-dmm.yaml#
$schema: http://devicetree.org/meta-schemas/core.yaml#

title: OMAP Dynamic Memory Manager (DMM)
maintainers:
  - Archit Taneja <archit@ti.com>

description: |
  OMAP Dynamic Memory Manager (DMM) bindings

  The dynamic memory manager (DMM) is a module located immediately in front of the
  SDRAM controllers (called EMIFs on OMAP). DMM manages various aspects of memory
  accesses such as priority generation amongst initiators, configuration of SDRAM
  interleaving, optimizing transfer of 2D block objects, and provide MMU-like page
  translation for initiators which need contiguous dma bus addresses.

properties:
  compatible:
    description: Accepted compatible values for OMAP DMM
    oneOf:
      - items:
          - const: ti,omap4-dmm
          - const: ti,omap5-dmm
      - items:
          - const: ti,omap5-dmm

  reg:
    description: Register base address and size for DMM
    items:
      - description: base address of DMM registers
      - description: size of DMM register range

  interrupts:
    description: Interrupt specifier(s) for DMM IRQ
    items:
      - description: DMM IRQ

  ti,hwmods:
    description: Name of the hardware module associated with DMM
    $ref: /schemas/types.yaml#/definitions/string-array
    items:
      - const: dmm

required:
  - compatible
  - reg
  - interrupts
  - ti,hwmods

additionalProperties: false
```
