## Documentation/devicetree/bindings/clock/airoha,en7523-scu.yaml
```yaml
# SPDX-License-Identifier: (GPL-2.0-only OR BSD-2-Clause)
%YAML 1.2
---
$id: http://devicetree.org/schemas/clock/airoha,en7523-scu.yaml#
$schema: http://devicetree.org/meta-schemas/core.yaml#

title: EN7523 Clock

maintainers:
  - Felix Fietkau <nbd@nbd.name>
  - John Crispin <nbd@nbd.name>
  - Christian Marangi <ansuelsmth@gmail.com>

description: |
  This node defines the System Control Unit of the EN7523 SoC,
  a collection of registers configuring many different aspects of the SoC.

  The clock driver uses it to read and configure settings of the
  PLL controller, which provides clocks for the CPU, the bus and
  other SoC internal peripherals.

  Each clock is assigned an identifier and client nodes use this identifier
  to specify which clock they consume.

  All these identifiers can be found in:
  [1]: <include/dt-bindings/clock/en7523-clk.h>.

  The clocks are provided inside a system controller node.

  The System Control Unit may also set different mode for the Serdes ports
  present on the SoC.

  These are toggeled in the System Status Register and are used to
  toggle Serdes port for USB 3.0 mode or HSGMII, USB 3.0 mode or PCIe2
  or setup port for PCIe mode or Ethernet mode (HSGMII/USXGMII).

  Modes are mutually exclusive and selecting one mode cause the
  other feature to not work (example a mode in USB 3.0 cause PCIe
  port 2 to not work) This depends also on what is physically
  connected to the Hardware and needs to correctly reflect the
  System Status Register bits.

  Special care is needed for PCIe port 0 in 2 line mode that
  requires both WiFi1 and WiFi2 Serdes port set to PCIe0 2 Line
  mode.

properties:
  compatible:
    items:
      - enum:
          - airoha,en7523-scu
          - airoha,en7581-scu

  reg:
    items:
      - description: scu base address
      - description: misc scu base address
    minItems: 1

  "#clock-cells":
    description:
      The first cell indicates the clock number, see [1] for available
      clocks.
    const: 1

  '#reset-cells':
    description: ID of the controller reset line
    const: 1

  airoha,serdes-wifi1:
    description: Configure the WiFi1 Serdes port
    $ref: /schemas/types.yaml#/definitions/string
    enum:
      - pcie0_x2
      - pcie0_x1
      - ethernet
    default: pcie0_x1

  airoha,serdes-wifi2:
    description: Configure the WiFi2 Serdes port
    $ref: /schemas/types.yaml#/definitions/string
    enum:
      - pcie0_x2
      - pcie1_x1
      - ethernet
    default: pcie1_x1

  airoha,serdes-usb1:
    description: Configure the USB1 Serdes port
    $ref: /schemas/types.yaml#/definitions/string
    enum:
      - usb3
      - ethernet
    default: usb3

  airoha,serdes-usb2:
    description: Configure the USB2 Serdes port
    $ref: /schemas/types.yaml#/definitions/string
    enum:
      - usb3
      - pcie2_x1
    default: usb3

required:
  - compatible
  - reg
  - '#clock-cells'

allOf:
  - if:
      properties:
        compatible:
          const: airoha,en7523-scu
    then:
      properties:
        reg:
          minItems: 2

        airoha,serdes-wifi1: false
        airoha,serdes-wifi2: false

        airoha,serdes-usb1: false
        airoha,serdes-usb2: false

        '#reset-cells': false

  - if:
      properties:
        compatible:
          const: airoha,en7581-scu
    then:
      properties:
        reg:
          maxItems: 1

  - if:
      properties:
        airoha,serdes-wifi1:
          const: pcie0_x2
    then:
      properties:
        airoha,serdes-wifi2:
          const: pcie0_x2

  - if:
      properties:
        airoha,serdes-wifi2:
          const: pcie0_x2
    then:
      properties:
        airoha,serdes-wifi1:
          const: pcie0_x2

additionalProperties: false

examples:
  - |
    #include <dt-bindings/clock/en7523-clk.h>
    scu: system-controller@1fa20000 {
      compatible = "airoha,en7523-scu";
      reg = <0x1fa20000 0x400>,
            <0x1fb00000 0x1000>;
      #clock-cells = <1>;
    };

  # Example SCU node with Serdes set to PCIe0 to x2 mode
  # and USB2 set to PCIe2 to x1 mode
  - |
    soc {
        #address-cells = <2>;
        #size-cells = <2>;

        scuclk: clock-controller@1fb00000 {
            compatible = "airoha,en7581-scu";
            reg = <0x0 0x1fb00000 0x0 0x970>;

            airoha,serdes-wifi1 = "pcie0_x2";
            airoha,serdes-wifi2 = "pcie0_x2";
            airoha,serdes-usb2 = "pcie2_x1";

            #clock-cells = <1>;
            #reset-cells = <1>;
        };
    };
```

## Documentation/devicetree/bindings/clock/fujitsu,mb86s70-crg11.yaml
```yaml
# SPDX-License-Identifier: (GPL-2.0-only OR BSD-2-Clause)
# Copyright 2025 Linaro Ltd.
%YAML 1.2
---
$id: http://devicetree.org/schemas/fujitsu,mb86s70-crg11.yaml#
$schema: http://devicetree.org/meta-schemas/core.yaml#

title: Fujitsu MB86S70 CRG11 Clock Driver
maintainers:
  - Jassi Brar <jaswinder.singh@linaro.org>

description: |
  Fujitsu CRG11 clock driver bindings

  The consumer specifies the desired clock pointing to its phandle.

properties:
  compatible:
    description: 'Shall contain "fujitsu,mb86s70-crg11"'
    items:
      - const: fujitsu,mb86s70-crg11
  '#clock-cells':
    description: 'Number of cells in the clock specifier: controller, domain, port'
    const: 3

required:
  - compatible
  - '#clock-cells'

additionalProperties: false

examples:
  - |
    clock: crg11 {
        compatible = "fujitsu,mb86s70-crg11";
        #clock-cells = <3>;
    };
```
