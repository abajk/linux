## Documentation/devicetree/bindings/arm/omap/ti,omap4-l3-noc.yaml
```yaml
# SPDX-License-Identifier: (GPL-2.0-only OR BSD-2-Clause)
# Copyright 2025 Texas Instruments
%YAML 1.2
---
$id: http://devicetree.org/schemas/arm/omap/ti,omap4-l3-noc.yaml#
$schema: http://devicetree.org/meta-schemas/core.yaml#

title: TI OMAP L3 NoC
maintainers:
  - Afzal Mohammed <afzal@ti.com>
  - Benoit Cousson <b-cousson@ti.com>
  - Rajendra Nayak <rnayak@ti.com>
  - Santosh Shilimkar <santosh.shilimkar@ti.com>
  - Suman Anna <s-anna@ti.com>

description: |
  * TI - L3 Network On Chip (NoC)

  This version is an implementation of the generic NoC IP provided by Arteris.

properties:
  compatible:
    description: Device compatible string for OMAP and AM43 SoC families.
    items:
      - enum:
          - ti,omap3-l3-smx
          - ti,omap4-l3-noc
          - ti,omap5-l3-noc
          - ti,dra7-l3-noc
          - ti,am4372-l3-noc

  ranges: true

  ti,hwmods:
    description: One hardware module for each NoC domain.
    $ref: /schemas/types.yaml#/definitions/string-array
    items:
      - enum: [l3_main_1]
        description: Hardware module domain 1.
      - enum: [l3_main_2]
        description: Hardware module domain 2.
      - enum: [l3_main_3]
        description: Hardware module domain 3.

required:
  - compatible
  - ranges
  - ti,hwmods

additionalProperties: false

examples:
  - |
    ocp {
        compatible = "ti,omap4-l3-noc", "simple-bus";
        #address-cells = <1>;
        #size-cells = <1>;
        ranges;
        ti,hwmods = "l3_main_1", "l3_main_2", "l3_main_3";
    };
```

## Documentation/devicetree/bindings/arm/stericsson,nomadik,src.yaml
```yaml
%YAML 1.2
---
$id: http://devicetree.org/schemas/stericsson,nomadik,src.yaml#
$schema: http://devicetree.org/meta-schemas/core.yaml#

title: ST-Ericsson Nomadik System and Reset Controller

maintainers:
  - Linus Walleij <linus.walleij@linaro.org>

description: |
  ST-Ericsson Nomadik Device Tree Bindings

  For various board the "board" node may contain specific properties
  that pertain to this particular board, such as board-specific GPIOs.

  Required root node property: src
  - Nomadik System and reset controller used for basic chip control, clock
    and reset line control.
  - compatible: must be "stericsson,nomadik,src"

  Boards with the Nomadik SoC include:

  Nomadik NHK-15 board manufactured by ST Microelectronics:

  Required root node property:

  compatible="st,nomadik-nhk-15";

  S8815 "MiniKit" manufactured by Calao Systems:

  Required root node property:

  compatible="calaosystems,usb-s8815";

  Required node: usb-s8815

properties:
  compatible:
    description: Identify the SoC or board variant
    items:
      - enum: [stericsson, nomadik, src]
      - enum: [st, nomadik-nhk-15]
      - enum: [calaosystems, usb-s8815]

  usb-s8815:
    description: USB-S8815 child node on Calao MiniKit
    type: object
    additionalProperties: false
    properties:
      ethernet-gpio-node:
        description: Ethernet GPIO child node
        type: object
        additionalProperties: false
        properties:
          gpios:
            description: GPIO specifier for ethernet
            maxItems: 1
          interrupts:
            description: Interrupt specifier for ethernet
            maxItems: 1
        required:
          - gpios
          - interrupts
      mmcsd-gpio-node:
        description: MMC/SD GPIO child node
        type: object
        additionalProperties: false
        properties:
          gpios:
            description: GPIO specifier for MMC/SD
            maxItems: 1
        required:
          - gpios

required:
  - compatible

allOf:
  - if:
      properties:
        compatible:
          contains:
            const: calao­systems,usb-s8815
    then:
      required:
        - usb-s8815
    else:
      properties:
        usb-s8815: false

additionalProperties: false
```

## Documentation/devicetree/bindings/arm/ux500/st-ericsson,u8500.yaml
```yaml
# SPDX-License-Identifier: (GPL-2.0-only OR BSD-2-Clause)
%YAML 1.2
---
$id: http://devicetree.org/schemas/arm/ux500/st-ericsson,u8500.yaml#
$schema: http://devicetree.org/meta-schemas/core.yaml#

title: ST-Ericsson Ux500 boards

maintainers:
  - Geert Uytterhoeven <geert+renesas@glider.be>
  - Jon Hunter <jonathanh@nvidia.com>
  - Linus Walleij <linus.walleij@linaro.org>
  - Rob Herring <robh@kernel.org>

description: |
  ST-Ericsson Ux500 boards
  ------------------------

  Required properties (in root node) one of these:

  Required node (under root node):

  soc: represents the system-on-chip and contains the chip peripherals

  Required property of soc node, one of these:

  Required subnodes under soc node:

  backupram: (used for CPU spin tables and for storing data
  during retention, system won't boot without this)

  scu:
      see binding for arm/arm,scu.yaml

  interrupt-controller:
      see binding for interrupt-controller/arm,gic.yaml

  timer:
      see binding for timer/arm,twd-timer.yaml

  clocks:
      see binding for clocks/ux500.yaml

properties:
  compatible:
    enum:
      - stericsson,db8500

required:
  - compatible
  - interrupt-parent
  - ranges
  - backupram
  - interrupt-controller
  - scu
  - timer
  - clocks

additionalProperties: true
```

## Documentation/devicetree/bindings/arm/ux500/stericsson,ux500-pm-domains.yaml
```yaml
# SPDX-License-Identifier: (GPL-2.0-only OR BSD-2-Clause)
# Copyright 2025 Linaro Ltd.
%YAML 1.2
---
$id: http://devicetree.org/schemas/stericsson,ux500-pm-domains.yaml#
$schema: http://devicetree.org/meta-schemas/core.yaml#

title: ST-Ericsson UX500 PM Domains

maintainers:
  - Ulf Hansson <ulf.hansson@linaro.org>

description: |
  * ST-Ericsson UX500 PM Domains

  UX500 supports multiple PM domains which are used to gate power to one or
  more peripherals on the SOC.

  The implementation of PM domains for UX500 are based upon the generic PM domain
  and use the corresponding DT bindings.

properties:
  compatible:
    const: stericsson,ux500-pm-domains
    description: Must be "stericsson,ux500-pm-domains".
  "#power-domain-cells":
    description: Number of cells in a power domain specifier.
    const: 1

additionalProperties: false

examples:
  - |
    pm_domains: pm_domains0 {
        compatible = "stericsson,ux500-pm-domains";
        #power-domain-cells = <1>;
    };
```

## Documentation/devicetree/bindings/arm/vt8500/via,vt8500-pmc.yaml
```yaml
# SPDX-License-Identifier: (GPL-2.0-only OR BSD-2-Clause)
%YAML 1.2
---
$id: http://devicetree.org/schemas/arm/vt8500/via,vt8500-pmc.yaml#
$schema: http://devicetree.org/meta-schemas/core.yaml#

title: VIA/Wondermedia VT8500 Power Management Controller
maintainers:
  - Tony Prisk <linux@prisktech.co.nz>

properties:
  compatible:
    items:
      - const: via,vt8500-pmc

  reg:
    maxItems: 1

required:
  - compatible
  - reg

additionalProperties: false

examples:
  - |
    pmc@d8130000 {
      compatible = "via,vt8500-pmc";
      reg = <0xd8130000 0x1000>;
    };
```

## Documentation/devicetree/bindings/arm/xen,xen.yaml
```yaml
# SPDX-License-Identifier: (GPL-2.0-only OR BSD-2-Clause)
%YAML 1.2
---
$id: http://devicetree.org/schemas/arm/xen,xen.yaml#
$schema: http://devicetree.org/meta-schemas/core.yaml#

title: Xen hypervisor for ARM virtual platforms

maintainers:
  - Jonathan Corbet <corbet@lwn.net>
  - Mauro Carvalho Chehab <mchehab+samsung@kernel.org>
  - Oleksandr Tyshchenko <oleksandr_tyshchenko@epam.com>
  - Shannon Zhao <shannon.zhao@linaro.org>
  - Stefano Stabellini <stefano.stabellini@eu.citrix.com>

description: |
  * Xen hypervisor device tree bindings

  Xen ARM virtual platforms shall have a top-level "hypervisor" node with
  the following properties:

  To support UEFI on Xen ARM virtual platforms, Xen populates the FDT "uefi" node
  under /hypervisor with following parameters:

  The format and meaning of the "xen,uefi-*" parameters are similar to those in
  Documentation/arch/arm/uefi.rst, which are provided by the regular UEFI stub.
  However they differ because they are provided by the Xen hypervisor, together with a set
  of UEFI runtime services implemented via hypercalls, see
  http://xenbits.xen.org/docs/unstable/hypercall/x86_64/include,public,platform.h.html.

properties:
  compatible:
    # Must be either ["xen,xen-<version>", "xen,xen"] or ["xen,xen"]
    oneOf:
      - items:
          - pattern: "^xen,xen-[0-9]+(\\.[0-9]+)*$"
          - const: xen,xen
      - items:
          - const: xen,xen

  reg:
    description: Memory regions for the grant table and extended regions.
    items:
      - description: Grant table region

  interrupts:
    description: Xen event notification interrupt.
    items:
      - description: Event interrupt specifier

  interrupt-names:
    items:
      - const: hypervisor-event

  uefi:
    description: UEFI hypervisor runtime parameters.
    type: object
    additionalProperties: false
    properties:
      xen,uefi-system-table:
        description: Guest physical address of the UEFI System Table.
        $ref: /schemas/types.yaml#/definitions/uint64
      xen,uefi-mmap-start:
        description: Guest physical address of the UEFI memory map.
        $ref: /schemas/types.yaml#/definitions/uint64
      xen,uefi-mmap-size:
        description: Size in bytes of the UEFI memory map.
        $ref: /schemas/types.yaml#/definitions/uint32
      xen,uefi-mmap-desc-size:
        description: Size in bytes of each entry in the UEFI memory map.
        $ref: /schemas/types.yaml#/definitions/uint32
      xen,uefi-mmap-desc-ver:
        description: Version of the mmap descriptor format.
        $ref: /schemas/types.yaml#/definitions/uint32
    required:
      - xen,uefi-system-table
      - xen,uefi-mmap-start
      - xen,uefi-mmap-size
      - xen,uefi-mmap-desc-size
      - xen,uefi-mmap-desc-ver

required:
  - compatible
  - reg
  - interrupts

additionalProperties: false
```

## Documentation/devicetree/bindings/bus/brcm,bus-axi.yaml
```yaml
# SPDX-License-Identifier: (GPL-2.0-only OR BSD-2-Clause)
# Copyright 2025 Broadcom
%YAML 1.2
---
$id: http://devicetree.org/schemas/bus/brcm,bus-axi.yaml#
$schema: http://devicetree.org/meta-schemas/core.yaml#

title: Broadcom ARM AXI Bus

maintainers:
  - Scott Branden <sbranden@broadcom.com>

description: |
  Driver for ARM AXI Bus with Broadcom Plugins (bcma)

  The cores on the AXI bus are automatically detected by bcma with the
  memory ranges they are using and they get registered afterwards.
  Automatic detection of the IRQ number is not working on
  BCM47xx/BCM53xx ARM SoCs. To assign IRQ numbers to the cores, provide
  them manually through device tree. Use an interrupt-map to specify the
  IRQ used by the devices on the bus. The first address is just an index,
  because we do not have any special register.

  The top-level axi bus may contain children representing attached cores
  (devices). This is needed since some hardware details can't be auto
  detected (e.g. IRQ numbers). Also some of the cores may be responsible
  for extra things, e.g. ChipCommon providing access to the GPIO chip.

properties:
  compatible:
    # List of compatible strings
    items:
      - const: brcm,bus-axi

  reg:
    # iomem address range of ChipCommon core
    items:
      - description: base and size of ChipCommon registers

  ranges:
    # Mapping of bus addresses to parent address space
    items:
      - description: child bus address
      - description: parent bus address
      - description: size

  '#address-cells':
    # Number of address cells in child nodes
    const: 1

  '#size-cells':
    # Number of size cells in child nodes
    const: 1

  '#interrupt-cells':
    # Number of interrupt specifier cells in child nodes
    const: 1

  interrupt-map-mask:
    # Mask to extract address and interrupt specifier fields
    items:
      - description: address mask
      - description: interrupt specifier mask

  interrupt-map:
    # <child address> <child interrupt specifier> <parent phandle> <type> <number> <flags>
    items:
      - description: child address within mask
      - description: child interrupt specifier
      - description: parent interrupt controller phandle
      - description: interrupt controller type
      - description: interrupt number
      - description: interrupt trigger type flags

  chipcommon:
    description: Child node representing the ChipCommon core.
    type: object
    properties:
      reg:
        items:
          - description: base address of ChipCommon registers
          - description: size of ChipCommon registers

      gpio-controller:
        description: Enable GPIO controller support
        type: boolean

      '#gpio-cells':
        description: Number of GPIO specifier cells
        const: 2

    required:
      - reg
      - gpio-controller
      - '#gpio-cells'

    additionalProperties: false

required:
  - compatible
  - reg

additionalProperties: false
```

## Documentation/devicetree/bindings/bus/cznic,moxtet.yaml
```yaml
# SPDX-License-Identifier: (GPL-2.0-or-later)
# Copyright 2025 Marek Behún <kabel@kernel.org>
%YAML 1.2
---
$id: http://devicetree.org/schemas/bus/cznic,moxtet.yaml#
$schema: http://devicetree.org/meta-schemas/core.yaml#

title: Turris Moxtet SPI bus

maintainers:
  - Marek Behún <kabel@kernel.org>

description: |
  Turris Mox module status and configuration bus (over SPI)

  The driver finds the devices connected to the bus by itself, but it may be
  needed to reference some of them from other parts of the device tree. In that
  case the devices can be defined as subnodes of the moxtet node.

properties:
  compatible:
    items:
      - const: cznic,moxtet

  reg:
    maxItems: 1

  "#address-cells":
    const: 1

  "#size-cells":
    const: 0

  spi-cpol: true

  spi-cpha: true

  spi-max-frequency:
    description: Maximum supported SPI frequency
    $ref: /schemas/types.yaml#/definitions/uint32

  interrupt-controller: true

  "#interrupt-cells":
    const: 1

  interrupts:
    description: Shared interrupt line
    items:
      - description: Reference to shared interrupt


required:
  - compatible
  - "#address-cells"
  - "#size-cells"
  - spi-cpol
  - spi-cpha
  - interrupts
  - interrupt-controller
  - "#interrupt-cells"

additionalProperties: false

examples:
  - |
    #include <dt-bindings/interrupt-controller/irq.h>

    moxtet@1 {
        compatible = "cznic,moxtet";
        #address-cells = <1>;
        #size-cells = <0>;
        reg = <1>;
        spi-max-frequency = <10000000>;
        spi-cpol;
        spi-cpha;
        interrupt-controller;
        #interrupt-cells = <1>;
        interrupt-parent = <&gpiosb>;
        interrupts = <5 IRQ_TYPE_EDGE_FALLING>;

        moxtet_sfp: gpio@0 {
            compatible = "cznic,moxtet-gpio";
            gpio-controller;
            #gpio-cells = <2>;
            reg = <0>;
        };
    };
```
