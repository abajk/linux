## Documentation/devicetree/bindings/bus/marvell,armada370-mbus.yaml
```yaml
# SPDX-License-Identifier: (GPL-2.0-only OR BSD-2-Clause)
%YAML 1.2
---
$id: http://devicetree.org/schemas/marvell,armada370-mbus.yaml#
$schema: http://devicetree.org/meta-schemas/core.yaml#

title: Marvell MBus
maintainers:
  - Carlos Garcia <carlos@cgarcia.org>
  - Ezequiel Garcia <ezequiel.garcia@free-electrons.com>
  - Rob Herring <robh@kernel.org>
  - Thomas Petazzoni <thomas.petazzoni@free-electrons.com>

description: |
  Marvell MBus

  ** MBus address decoding window specification

  The MBus children address space is comprised of two cells: the first one for
  the window ID and the second one for the offset within the window. In order
  to allow to describe valid and non-valid window entries, the following
  encoding is used:

    0xSIAA0000 0x00oooooo

  Where:

    S = 0x0 for a MBus valid window
    S = 0xf for a non-valid window

  If S = 0x0, then:

     I = 4-bit window target ID
    AA = window attribute

  If S = 0xf, then:

     I = don't care
     AA = 1 for internal register

  Following the above encoding, for each ranges entry for a MBus valid window
  (S = 0x0), an address decoding window is allocated. Entries for translation
  that do not correspond to valid windows (S = 0xf) are skipped.

  ** About the window base address

  The MBus controller allows flexibility for choosing the decoding window base
  address. When planning the device tree layout it's possible to choose any
  aligned address as the base, provided there's a region large enough available.

  ** Window allocation policy

  The mbus-node ranges property defines a set of mbus windows that are expected
  to be set by the operating system and that are guaranteed to be free of
  overlaps with one another or with system memory ranges. Each entry refers to
  exactly one window. The OS may insert additional windows that do not conflict
  with the listed ones; the internal register window must be set up by the
  bootloader at the address listed in ranges.

properties:
  compatible:
    enum:
      - marvell,armada370-mbus
      - marvell,armadaxp-mbus
      - marvell,armada375-mbus
      - marvell,armada380-mbus
      - marvell,kirkwood-mbus
      - marvell,dove-mbus
      - marvell,orion5x-88f5281-mbus
      - marvell,orion5x-88f5182-mbus
      - marvell,orion5x-88f5181-mbus
      - marvell,orion5x-88f6183-mbus
      - marvell,mv78xx0-mbus

  "#address-cells":
    description: The first cell is the MBus window ID encoding, the second is the offset within the window.
    const: 2

  "#size-cells":
    const: 1

  ranges:
    description: Translation entries for each child device.
    items:
      - description: Encoded window ID and attribute.
      - description: High 32 bits of child bus address.
      - description: Low 32 bits of child bus address.
      - description: High 32 bits of parent bus address.
      - description: Low 32 bits of parent bus address.

  controller:
    description: Phandle referring to the MBus controller node.
    $ref: /schemas/types.yaml#/definitions/phandle

  pcie-mem-aperture:
    description: Aperture for the PCIe memory region, encoding base address and size.
    $ref: /schemas/types.yaml#/definitions/uint32-array
    items:
      - description: Base address
      - description: Size in bytes

  pcie-io-aperture:
    description: Aperture for the PCIe I/O region, encoding base address and size.
    $ref: /schemas/types.yaml#/definitions/uint32-array
    items:
      - description: Base address
      - description: Size in bytes

required:
  - compatible
  - "#address-cells"
  - "#size-cells"
  - ranges
  - controller

additionalProperties:
  type: object

examples:
  - |
    soc {
      compatible = "marvell,armada370-mbus", "simple-bus";
      #address-cells = <2>;
      #size-cells = <1>;
      ranges;
      controller = <&mbusc>;
      pcie-mem-aperture = <0xe0000000 0x8000000>;
      pcie-io-aperture  = <0xe8000000 0x100000>;

      internal-regs {
        compatible = "simple-bus";
        #address-cells = <1>;
        #size-cells = <1>;

        mbusc: mbus-controller@20000 {
          compatible = "marvell,mbus-controller";
          reg = <0x20000 0x100>, <0x20180 0x20>, <0x20250 0x8>;
        };
      };
    };
```

## Documentation/devicetree/bindings/bus/marvell,mbus-controller.yaml
```yaml
# SPDX-License-Identifier: (GPL-2.0-only OR BSD-2-Clause)
%YAML 1.2
---
$id: http://devicetree.org/schemas/marvell,mbus-controller.yaml#
$schema: http://devicetree.org/meta-schemas/core.yaml#

title: Marvell MBus Controller

maintainers:
  - Carlos Garcia <carlos@cgarcia.org>
  - Ezequiel Garcia <ezequiel.garcia@free-electrons.com>
  - Thomas Petazzoni <thomas.petazzoni@free-electrons.com>

description:
  Marvell MBus controller nodes appear under a Marvell MBus bus and provide the
  register interfaces for controlling decoding windows and the MBus bridge.

properties:
  compatible:
    const: marvell,mbus-controller

  reg:
    minItems: 2
    items:
      - description: Decoding window register address and size.
      - description: SDRAM window register address and size.
      - description: MBus bridge register address and size.

required:
  - compatible
  - reg

additionalProperties: false

examples:
  - |
    mbus-controller@20000 {
        compatible = "marvell,mbus-controller";
        reg = <0x20000 0x100>, <0x20180 0x20>, <0x20250 0x8>;
    };
```

## Documentation/devicetree/bindings/bus/nvidia,tegra20-gmi.yaml
```yaml
# SPDX-License-Identifier: (GPL-2.0-only OR BSD-2-Clause)
# Copyright 2018 Linaro Ltd.
%YAML 1.2
---
$id: http://devicetree.org/schemas/bus/nvidia,tegra20-gmi.yaml#
$schema: http://devicetree.org/meta-schemas/core.yaml#

title: NVIDIA Tegra20 Generic Memory Interface bus

maintainers:
  - Marcel Ziswiler <marcel.ziswiler@toradex.com>
  - Mirza Krak <mirza.krak@gmail.com>
  - Rob Herring <robh@kernel.org>

description: |
  Device tree bindings for NVIDIA Tegra Generic Memory Interface bus

  The Generic Memory Interface bus enables memory transfers between internal and
  external memory. Can be used to attach various high speed devices such as
  synchronous/asynchronous NOR, FPGA, UARTS and more.

  The actual devices are instantiated from the child nodes of a GMI node.

  Note that the GMI controller does not have any internal chip-select address
  decoding, because of that chip-selects either need to be managed via software
  or by employing external chip-select decoding logic.

  If external chip-select logic is used to support multiple devices it is assumed
  that the devices use the same timing and so are probably the same type. It also
  assumes that they can fit in the 256MB address range. In this case only one
  child device is supported which represents the active chip-select line, see
  examples for more insight.

  The chip-select number is decoded from the child nodes second address cell of
  'ranges' property, if 'ranges' property is not present or empty chip-select will
  then be decoded from the first cell of the 'reg' property.

  Optional child cs node properties:
  - nvidia,snor-data-width-32bit: Use 32bit data-bus, default is 16bit.
  - nvidia,snor-mux-mode: Enable address/data MUX mode.
  - nvidia,snor-rdy-active-before-data: Assert RDY signal one cycle before data.
    If omitted it will be asserted with data.
  - nvidia,snor-rdy-active-high: RDY signal is active high
  - nvidia,snor-adv-active-high: ADV signal is active high
  - nvidia,snor-oe-active-high: WE/OE signal is active high
  - nvidia,snor-cs-active-high: CS signal is active high

    Note that there is some special handling for the timing values.
    From Tegra TRM:
    Programming 0 means 1 clock cycle: actual cycle = programmed cycle + 1

  - nvidia,snor-muxed-width: Number of cycles MUX address/data asserted on the
    bus. Valid values are 0–15, default is 1
  - nvidia,snor-hold-width: Number of cycles CE stays asserted after the
    de-assertion of WR_N (in case of SLAVE/MASTER Request) or OE_N
    (in case of MASTER Request). Valid values are 0–15, default is 1
  - nvidia,snor-adv-width: Number of cycles during which ADV stays asserted.
    Valid values are 0–15, default is 1.
  - nvidia,snor-ce-width: Number of cycles before CE is asserted.
    Valid values are 0–15, default is 4
  - nvidia,snor-we-width: Number of cycles during which WE stays asserted.
    Valid values are 0–255, default is 1
  - nvidia,snor-oe-width: Number of cycles during which OE stays asserted.
    Valid values are 0–255, default is 1
  - nvidia,snor-wait-width: Number of cycles before READY is asserted.
    Valid values are 0–255, default is 3

properties:
  compatible:
    items:
      - enum:
          - nvidia,tegra20-gmi
          - nvidia,tegra30-gmi

  reg:
    items:
      - description: GMI controller registers base address and length

  clocks:
    maxItems: 1
    description: Clock input for the GMI controller

  clock-names:
    items:
      - const: gmi

  resets:
    items:
      - description: Reset line for the GMI controller

  reset-names:
    items:
      - const: gmi

  '#address-cells':
    const: 2

  '#size-cells':
    const: 1

  ranges:
    items:
      - description: Chip-select number
      - description: Offset within the GMI address space
      - description: Physical address of mapping
      - description: Size of mapping

required:
  - compatible
  - reg
  - clocks
  - clock-names
  - resets
  - reset-names
  - '#address-cells'
  - '#size-cells'
  - ranges

additionalProperties: true
```

## Documentation/devicetree/bindings/bus/technologic-ts-nbus.yaml
```yaml
# SPDX-License-Identifier: (GPL-2.0-only OR BSD-2-Clause)
# Copyright 2025 Savoir-faire Linux
%YAML 1.2
---
$id: http://devicetree.org/schemas/bus/technologic-ts-nbus.yaml#
$schema: http://devicetree.org/meta-schemas/core.yaml#

title: Technologic Systems NBUS

maintainers:
  - Sebastien Bourdelin <sebastien.bourdelin@savoirfairelinux.com>

description: |
  Technologic Systems NBUS

  The NBUS is a bus used to interface with peripherals in the Technologic
  Systems FPGA on the TS-4600 SoM.

  Child nodes:

  The NBUS node can contain zero or more child nodes representing peripherals
  on the bus.

properties:
  compatible:
    items:
      - const: "technologic,ts-nbus"
    description: Device compatible string

  '#address-cells':
    const: 1
    description: Number of address cells for the NBUS

  '#size-cells':
    const: 0
    description: Number of size cells for the NBUS

  pwms:
    $ref: /schemas/types.yaml#/definitions/phandle-array
    description: PWM bound to the FPGA

  ts,data-gpios:
    description: The 8 GPIO pins connected to the data lines on the FPGA
    items:
      - description: Data bit 0
      - description: Data bit 1
      - description: Data bit 2
      - description: Data bit 3
      - description: Data bit 4
      - description: Data bit 5
      - description: Data bit 6
      - description: Data bit 7

  ts,csn-gpios:
    maxItems: 1
    description: The GPIO pin connected to the CSN line on the FPGA

  ts,txrx-gpios:
    maxItems: 1
    description: The GPIO pin connected to the TXRX line on the FPGA

  ts,strobe-gpios:
    maxItems: 1
    description: The GPIO pin connected to the strobe line on the FPGA

  ts,ale-gpios:
    maxItems: 1
    description: The GPIO pin connected to the ALE line on the FPGA

  ts,rdy-gpios:
    maxItems: 1
    description: The GPIO pin connected to the RDY line on the FPGA

required:
  - compatible
  - "#address-cells"
  - "#size-cells"
  - pwms
  - ts,data-gpios
  - ts,csn-gpios
  - ts,txrx-gpios
  - ts,strobe-gpios
  - ts,ale-gpios
  - ts,rdy-gpios

additionalProperties: false
```

## Documentation/devicetree/bindings/bus/ti,da850-mstpri.yaml
```yaml
# SPDX-License-Identifier: (GPL-2.0-only OR BSD-2-Clause)
%YAML 1.2
---
$id: http://devicetree.org/schemas/bus/ti,da850-mstpri.yaml#
$schema: http://devicetree.org/meta-schemas/core.yaml#

title: TI DA8XX master peripheral priority

maintainers:
  - Bartosz Golaszewski <brgl@bgdev.pl>

description: |
  * Device tree bindings for Texas Instruments da8xx master peripheral
    priority driver

  DA8XX SoCs feature a set of registers allowing to change the priority of all
  peripherals classified as masters.

  Documentation:
  OMAP-L138 (DA850) - http://www.ti.com/lit/ug/spruh82c/spruh82c.pdf

properties:
  compatible:
    items:
      - const: ti,da850-mstpri

  reg:
    maxItems: 1

required:
  - compatible
  - reg

additionalProperties: false

examples:
  - |
    mstpri {
        compatible = "ti,da850-mstpri";
        reg = <0x14110 0x0c>;
    };
```

## Documentation/devicetree/bindings/bus/ti,omap-ocp2scp.yaml
```yaml
# SPDX-License-Identifier: (GPL-2.0-only OR BSD-2-Clause)
# Copyright 2025 Kishon Vijay Abraham I

%YAML 1.2
---
$id: http://devicetree.org/schemas/bindings/bus/ti,omap-ocp2scp.yaml#
$schema: http://devicetree.org/meta-schemas/core.yaml#

title: OMAP OCP2SCP Controller
maintainers:
  - Kishon Vijay Abraham I <kishon@kernel.org>

description: |
  OMAP OCP2SCP - ocp interface to scp interface

  Sub-nodes:
  All the devices connected to ocp2scp are described using sub-node to ocp2scp

properties:
  compatible:
    oneOf:
      - items:
          - enum:
              - ti,am437x-ocp2scp
          - const: ti,omap-ocp2scp
      - items:
          - const: ti,omap-ocp2scp
  reg:
    maxItems: 1

  "#address-cells":
    const: 1

  "#size-cells":
    const: 1

  ranges:
    description: The child address space is mapped 1:1 onto the parent address space

  ti,hwmods:
    description: Must be "ocp2scp_usb_phy"
    items:
      - const: ocp2scp_usb_phy

additionalProperties:
  type: object

examples:
  - |
    ocp2scp@4a0ad000 {
        compatible = "ti,omap-ocp2scp";
        reg = <0x4a0ad000 0x1f>;
        #address-cells = <1>;
        #size-cells = <1>;
        ranges;
        ti,hwmods = "ocp2scp_usb_phy";

        subnode1 {
        };

        subnode2 {
        };
    };
```
