## Documentation/devicetree/bindings/hwmon/vexpress.yaml
```yaml
# SPDX-License-Identifier: (GPL-2.0-only OR BSD-2-Clause)
# Copyright 2025 Arm Ltd.
%YAML 1.2
---
$id: http://devicetree.org/schemas/hwmon/vexpress.yaml#
$schema: http://devicetree.org/meta-schemas/core.yaml#

title: Versatile Express hwmon sensors

maintainers:
  - Mauro Carvalho Chehab <mchehab@kernel.org>
  - Pawel Moll <pawel.moll@arm.com>

description: |
  Versatile Express hardware monitoring sensors.
  Requires a compatible value of one of:
    "arm,vexpress-volt",
    "arm,vexpress-amp",
    "arm,vexpress-temp",
    "arm,vexpress-power",
    "arm,vexpress-energy".
  When controlled via vexpress-sysreg, the "arm,vexpress-sysreg,func" property
  specifies the system register function to monitor.
  The label property can be used to describe the monitored value.

properties:
  compatible:
    description: Sensor type.
    items:
      - enum:
          - arm,vexpress-volt
          - arm,vexpress-amp
          - arm,vexpress-temp
          - arm,vexpress-power
          - arm,vexpress-energy

  arm,vexpress-sysreg,func:
    description: System register function specifier for monitoring via vexpress-sysreg.
    $ref: /schemas/types.yaml#/definitions/phandle-array
    items:
      - description: phandle to the vexpress-sysreg controller
      - description: function identifier

  label:
    description: Descriptive string for the monitored value.
    $ref: /schemas/types.yaml#/definitions/string

required:
  - compatible

additionalProperties: false

examples:
  - |
    energy@0 {
      compatible = "arm,vexpress-energy";
      arm,vexpress-sysreg,func = <13 0>;
      label = "A15 Jcore";
    };
```

## Documentation/devicetree/bindings/hwmon/zyxel,nsa320-mcu.yaml
```yaml
# SPDX-License-Identifier: (GPL-2.0-only OR BSD-2-Clause)
# Copyright 2025 Adam Baker <linux@baker-net.org.uk>
%YAML 1.2
---
$id: http://devicetree.org/schemas/hwmon/zyxel,nsa320-mcu.yaml#
# $schema is the meta‐schema this schema should be validated with.
$schema: http://devicetree.org/meta-schemas/core.yaml#

title: Zyxel NSA320 MCU fan and temperature monitor

maintainers:
  - Adam Baker <linux@baker-net.org.uk>

description: |
  Bindings for the fan / temperature monitor microcontroller used on
  the Zyxel NSA 320 and several subsequent models.

properties:
  compatible:
    items:
      - const: zyxel,nsa320-mcu
  pinctrl-0:
    description: Pin multiplexing configuration for the MCU data, clock, and active lines.
    $ref: /schemas/types.yaml#/definitions/phandle-array
  pinctrl-names:
    description: Names for the pin control states.
    $ref: /schemas/types.yaml#/definitions/string-array
    items:
      - const: default
  act-gpios:
    description: The GPIO pin connected to the active line on the MCU
  clk-gpios:
    description: The GPIO pin connected to the clock line on the MCU
  data-gpios:
    description: The GPIO pin connected to the data line on the MCU

required:
  - compatible
  - pinctrl-0
  - pinctrl-names
  - act-gpios
  - clk-gpios
  - data-gpios

additionalProperties: false

examples:
  - |
    hwmon {
        compatible = "zyxel,nsa320-mcu";
        pinctrl-0 = <&pmx_mcu_data &pmx_mcu_clk &pmx_mcu_act>;
        pinctrl-names = "default";

        data-gpios = <&gpio0 14 GPIO_ACTIVE_HIGH>;
        clk-gpios = <&gpio0 16 GPIO_ACTIVE_HIGH>;
        act-gpios = <&gpio0 17 GPIO_ACTIVE_LOW>;
    };
```

## Documentation/devicetree/bindings/i2c/altr,softip-i2c-v1.0.yaml
```yaml
# SPDX-License-Identifier: (GPL-2.0-only OR BSD-2-Clause)
# Copyright 2025 Thor Thayer
%YAML 1.2
---
$id: http://devicetree.org/schemas/i2c/altr,softip-i2c-v1.0.yaml#
$schema: http://devicetree.org/meta-schemas/core.yaml#

title: Altera I2C Controller

maintainers:
  - Thor Thayer <thor.thayer@linux.intel.com>

description: |
  Altera I2C Controller
  This is Altera's synthesizable logic block I2C Controller for use
  in Altera's FPGAs.

properties:
  compatible:
    items:
      - const: altr,softip-i2c-v1.0
  reg:
    maxItems: 1

  interrupts:
    maxItems: 1

  clocks:
    maxItems: 1

  clock-names:
    items:
      - const: bus

  fifo-size:
    description: Size of the RX and TX FIFOs in bytes
    $ref: /schemas/types.yaml#/definitions/uint32

required:
  - compatible
  - reg
  - interrupts
  - clocks
  - '#address-cells'
  - '#size-cells'

allOf:
  - $ref: /schemas/i2c/i2c-controller.yaml#

unevaluatedProperties: false

examples:
  - |
    i2c@100080000 {
        compatible = "altr,softip-i2c-v1.0";
        reg = <0x00000001 0x00080000 0x00000040>;
        interrupts = <0 43 4>;
        clocks = <&clk_0>;
        clock-frequency = <100000>;
        #address-cells = <1>;
        #size-cells = <0>;
        fifo-size = <4>;

        eeprom@51 {
            compatible = "atmel,24c32";
            reg = <0x51>;
            pagesize = <32>;
        };
    };
```

## Documentation/devicetree/bindings/i2c/apm,xgene-slimpro-i2c.yaml
```yaml
# SPDX-License-Identifier: (GPL-2.0-only OR BSD-2-Clause)
# Copyright 2025 APM
%YAML 1.2
---
$id: http://devicetree.org/schemas/apm,xgene-slimpro-i2c.yaml#
$schema: http://devicetree.org/meta-schemas/core.yaml#

title: APM X-Gene SLIMpro Mailbox I2C Driver

maintainers:
  - Feng Kan <fkan@apm.com>

description: |
  APM X-Gene SLIMpro Mailbox I2C Driver

  An I2C controller accessed over the "SLIMpro" mailbox.

properties:
  compatible:
    items:
      - enum:
          - apm,xgene-slimpro-i2c

  mboxes:
    description: SLIMpro mailbox phandle and channel number.
    items:
      - $ref: /schemas/types.yaml#/definitions/phandle
      - $ref: /schemas/types.yaml#/definitions/uint32
        description: SLIMpro channel number

required:
  - compatible
  - mboxes

additionalProperties: false

examples:
  - |
    i2cslimpro {
        compatible = "apm,xgene-slimpro-i2c";
        mboxes = <&mailbox 0>;
    };
```

## Documentation/devicetree/bindings/i2c/cavium,octeon-3860-twsi.yaml
```yaml
# SPDX-License-Identifier: (GPL-2.0-only OR BSD-2-Clause)
%YAML 1.2
---
$id: http://devicetree.org/schemas/cavium,octeon-3860-twsi.yaml#
$schema: http://devicetree.org/meta-schemas/core.yaml#

title: Cavium Octeon TWSI / I2C bus controller

maintainers:
  - Jan Glauber <jan.glauber@gmail.com>
  - Wolfram Sang <wolfram@the-dreams.de>

description: |
  * Two Wire Serial Interface (TWSI) / I2C

properties:
  '#address-cells':
    const: 1
    description: Number of address cells (must be 1).
  '#size-cells':
    const: 0
    description: Number of size cells (must be 0).
  compatible:
    oneOf:
      - items:
          - enum:
              - "cavium,octeon-3860-twsi"
      - items:
          - enum:
              - "cavium,octeon-7890-twsi"
  reg:
    # The core schema already checks that reg values are numbers
    items:
      - description: Controller register bank
  interrupts:
    items:
      - description: Controller interrupt
  interrupt-controller: true
  clock-frequency:
    description: I2C bus clock rate in Hz.
    $ref: /schemas/types.yaml#/definitions/uint32

required:
  - '#address-cells'
  - '#size-cells'
  - compatible
  - reg
  - interrupts
  - interrupt-controller

additionalProperties: false

examples:
  - |
    twsi0: i2c@1180000001000 {
        #address-cells = <1>;
        #size-cells = <0>;
        compatible = "cavium,octeon-3860-twsi";
        reg = <0x11800 0x00001000 0x0 0x200>;
        interrupts = <0 45>;
        clock-frequency = <100000>;

        rtc@68 {
            compatible = "dallas,ds1337";
            reg = <0x68>;
        };
        tmp@4c {
            compatible = "ti,tmp421";
            reg = <0x4c>;
        };
    };
```

## Documentation/devicetree/bindings/i2c/cnxt,cx92755-i2c.yaml
```yaml
# SPDX-License-Identifier: (GPL-2.0-only OR BSD-2-Clause)
# Copyright 2025 Baruch Siach <baruch@tkos.co.il>
%YAML 1.2
---
$id: http://devicetree.org/schemas/i2c/cnxt,cx92755-i2c.yaml#
$schema: http://devicetree.org/meta-schemas/core.yaml#

title: Conexant Digicolor I2C controller

maintainers:
  - Baruch Siach <baruch@tkos.co.il>

description: |
  Conexant Digicolor I2C controller

properties:
  compatible:
    items:
      - const: cnxt,cx92755-i2c

  reg:
    items:
      - description: Device registers

  interrupts:
    description: Interrupt line for the controller
    items:
      - description: Interrupt specifier

  clocks:
    maxItems: 1
    description: Clock for the I2C bus

  "#address-cells":
    const: 1

  "#size-cells":
    const: 0

  clock-frequency:
    description: Desired I2C bus clock frequency in Hz
    default: 100000

required:
  - compatible
  - reg
  - interrupts
  - clocks
  - "#address-cells"
  - "#size-cells"

additionalProperties: false

examples:
  - |
    i2c@f0000120 {
        compatible = "cnxt,cx92755-i2c";
        reg = <0xf0000120 0x10>;
        interrupts = <28>;
        clocks = <&main_clk>;
        clock-frequency = <100000>;
        #address-cells = <1>;
        #size-cells = <0>;
    };
```

## Documentation/devicetree/bindings/i2c/hisilicon,hix5hd2-i2c.yaml
```yaml
# SPDX-License-Identifier: (GPL-2.0-only OR BSD-2-Clause)
# Copyright 2025 Huawei Technologies Co., Ltd.
%YAML 1.2
---
$id: http://devicetree.org/schemas/i2c/hisilicon,hix5hd2-i2c.yaml#
$schema: http://devicetree.org/meta-schemas/core.yaml#

title: hisilicon,hix5hd2-i2c

maintainers:
  - Wei Yan <sledge.yanwei@huawei.com>

description: |
  I2C for Hisilicon hix5hd2 chipset platform

allOf:
  - $ref: /schemas/i2c/i2c-controller.yaml#

properties:
  compatible:
    const: hisilicon,hix5hd2-i2c

  reg:
    maxItems: 1

  interrupts:
    maxItems: 1

  clocks:
    maxItems: 1

  clock-frequency:
    description: Desired I2C bus frequency in Hz, defaults to 100000
    default: 100000

unevaluatedProperties: false

examples:
  - |
    i2c@f8b10000 {
        compatible = "hisilicon,hix5hd2-i2c";
        reg = <0xf8b10000 0x1000>;
        interrupts = <0 38 4>;
        clocks = <&clock HIX5HD2_I2C0_RST>;
        #address-cells = <1>;
        #size-cells = <0>;
    };
```

## Documentation/devicetree/bindings/i2c/i2c-cbus-gpio.yaml
```yaml
# SPDX-License-Identifier: (GPL-2.0-only OR BSD-2-Clause)
# Copyright 2025 Aaro Koskinen, Javier Martinez Canillas
%YAML 1.2
---
$id: http://devicetree.org/schemas/i2c/i2c-cbus-gpio.yaml#
$schema: http://devicetree.org/meta-schemas/core.yaml#

title: I2C C-Bus GPIO

maintainers:
  - Aaro Koskinen <aaro.koskinen@iki.fi>
  - Javier Martinez Canillas <javier@dowhile0.org>

properties:
  compatible:
    const: i2c-cbus-gpio

  gpios:
    description: phandle array for clk, dat, and sel GPIO lines
    items:
      - description: clk GPIO phandle and specifier
      - description: dat GPIO phandle and specifier
      - description: sel GPIO phandle and specifier

required:
  - compatible
  - gpios
  - '#address-cells'
  - '#size-cells'

allOf:
  - $ref: /schemas/i2c/i2c-controller.yaml#

unevaluatedProperties: false

examples:
  - |
    i2c@0 {
        compatible = "i2c-cbus-gpio";
        gpios = <&gpio 66 0 /* clk */
                 &gpio 65 0 /* dat */
                 &gpio 64 0 /* sel */
                >;
        #address-cells = <1>;
        #size-cells = <0>;

        retu: retu@1 {
            compatible = "nokia,retu";
            reg = <0x1>;
        };
    };
```

## Documentation/devicetree/bindings/i2c/i2c-mux-reg.yaml
```yaml
# SPDX-License-Identifier: (GPL-2.0-only OR BSD-2-Clause)
%YAML 1.2
---
$id: http://devicetree.org/schemas/i2c-mux-reg.yaml#
$schema: http://devicetree.org/meta-schemas/core.yaml#

title: Register-based I2C Bus Mux

maintainers:
  - Rob Herring <robh@kernel.org>
  - Simon Horman <horms+renesas@verge.net.au>
  - York Sun <yorksun@freescale.com>

description: |
  This binding describes an I2C bus multiplexer that uses a single register
  to route the I2C signals.

  Whenever an access is made to a device on a child bus, the value set
  in the relevant node's reg property will be output to the register.

  If an idle state is defined, using the idle-state property, whenever
  an access is not being made to a device on a child bus, the register
  will be set according to the idle-state value.

  If an idle state is not defined, the most recently used value will be
  left programmed into the register.

properties:
  compatible:
    const: i2c-mux-reg

  i2c-parent:
    description: The phandle of the I2C bus that this multiplexer’s master-side port is connected to.
    $ref: /schemas/types.yaml#/definitions/phandle

  reg:
    maxItems: 1

  little-endian:
    description: Indicates the register is in little endian.
    type: boolean

  big-endian:
    description: Indicates the register is in big endian.
    type: boolean

  write-only:
    description: Indicates the register is write-only.
    type: boolean

  idle-state:
    description: Value to set the multiplexer to when idle.
    $ref: /schemas/types.yaml#/definitions/uint32

  '#address-cells':
    const: 1

  '#size-cells':
    const: 0
    
patternProperties:
  '^i2c@.*$':
    type: object
    additionalProperties: true

    properties:
      reg:
        description: The channel selection value written to the parent register.
        maxItems: 1

    required:
      - reg

required:
  - compatible
  - i2c-parent

additionalProperties: false

examples:
  - |
    i2c-mux {
        reg = <0x6028 0x4>;
        little-endian;
        compatible = "i2c-mux-reg";
        #address-cells = <1>;
        #size-cells = <0>;
        i2c-parent = <&i2c1>;

        i2c@0 {
            reg = <0>;
            #address-cells = <1>;
            #size-cells = <0>;

            si5338: clock-generator@70 {
                compatible = "silabs,si5338";
                reg = <0x70>;
            };
        };

        i2c@1 {
            reg = <1>;
            #address-cells = <1>;
            #size-cells = <0>;

            si5338: clock-generator@70 {
                compatible = "silabs,si5338";
                reg = <0x70>;
            };
        };
    };
```

## Documentation/devicetree/bindings/i2c/ibm,opal-i2c.yaml
```yaml
# SPDX-License-Identifier: (GPL-2.0-only OR BSD-2-Clause)
# Copyright 2025 IBM Corporation
%YAML 1.2
---
$id: http://devicetree.org/schemas/ibm,opal-i2c.yaml#
$schema: http://devicetree.org/meta-schemas/core.yaml#

title: IBM OPAL I2C Controller

maintainers:
  - Neelesh Gupta <neelegup@linux.vnet.ibm.com>

description: |
  Device-tree bindings for I2C OPAL driver

  Most of the device node and properties layout is specific to the firmware and
  used by the firmware itself for configuring the port. From the Linux
  perspective, the properties of use are "ibm,port-name" and "ibm,opal-id".

properties:
  compatible:
    oneOf:
      - items:
          - enum:
              - ibm,power8-i2c-port
          - const: ibm,opal-i2c
      - items:
          - const: ibm,opal-i2c

  reg:
    items:
      - description: Port-id within a given master

  ibm,opal-id:
    description: Refers to a specific bus and used to identify it when calling
      the relevant OPAL functions.
    $ref: /schemas/types.yaml#/definitions/uint32

  bus-frequency:
    description: Operating frequency of the I2C bus (in Hz). Informational
      for Linux, used by the firmware.
    $ref: /schemas/types.yaml#/definitions/uint32

  ibm,port-name:
    description: Firmware-provided name that uniquely identifies the I2C port.
    $ref: /schemas/types.yaml#/definitions/string

required:
  - compatible
  - reg
  - ibm,opal-id
  - bus-frequency

additionalProperties: false

examples:
  - |
    i2c-bus@0 {
        compatible = "ibm,power8-i2c-port", "ibm,opal-i2c";
        reg = <0x0>;
        bus-frequency = <0x61a80>;
        ibm,opal-id = <0x1>;
        ibm,port-name = "p8_00000000_e1p0";
        #address-cells = <0x1>;
        phandle = <0x10000006>;
        #size-cells = <0x0>;
        linux,phandle = <0x10000006>;
    };
```
