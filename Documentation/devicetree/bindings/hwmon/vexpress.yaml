## Documentation/devicetree/bindings/iio/accel/st,lis3lv02d.yaml
```yaml
# SPDX-License-Identifier: (GPL-2.0-only OR BSD-2-Clause)
# Copyright 2018 Linaro Ltd.
%YAML 1.2
---
$id: http://devicetree.org/schemas/iio/accel/st,lis3lv02d.yaml#
$schema: http://devicetree.org/meta-schemas/core.yaml#

title: ST LIS3LV02D 3-axis accelerometer

maintainers:
  - Linus Walleij <linus.walleij@linaro.org>
  - Lubomir Rintel <lkundrak@v3.sk>
  - Rob Herring <robh@kernel.org>
  - Yu-Chun Lin <eleanor15x@gmail.com>

description: |
  LIS302 accelerometer devicetree bindings

  This device is matched via its bus drivers, and has a number of properties
  that apply on the generic device (independent from the bus).

properties:
  compatible:
    oneOf:
      - items:
          - const: st,lis3lv02d-spi
      - items:
          - const: st,lis3lv02d
      - items:
          - const: st,lis302dl-spi
      - items:
          - const: st,lis331dlh
          - const: st,lis3lv02d

  reg:
    description: SPI chipselect for SPI bus or I²C slave address for I²C bus
    items:
      - description: Register specifier

  spi-max-frequency:
    description: Maximum SPI bus speed in Hz
    $ref: /schemas/types.yaml#/definitions/uint32

  interrupts:
    description: Device interrupt specifier
    items:
      - description: Interrupt specifier

  Vdd-supply:
    description: Supply for device Vdd

  Vdd_IO-supply:
    description: Supply for device Vdd_IO

  st,axis-x:
    description: Axis mapping for the X coordinate; negative values invert the axis
    $ref: /schemas/types.yaml#/definitions/int32

  st,axis-y:
    description: Axis mapping for the Y coordinate; negative values invert the axis
    $ref: /schemas/types.yaml#/definitions/int32

  st,axis-z:
    description: Axis mapping for the Z coordinate; negative values invert the axis
    $ref: /schemas/types.yaml#/definitions/int32

  st,click-click-time-limit:
    description: Click time limit in increments of 0.5 ms
    $ref: /schemas/types.yaml#/definitions/uint32

  st,click-double-x:
    description: Issue an interrupt on double click event on the X axis
    type: boolean

  st,click-double-y:
    description: Issue an interrupt on double click event on the Y axis
    type: boolean

  st,click-double-z:
    description: Issue an interrupt on double click event on the Z axis
    type: boolean

  st,click-latency:
    description: Click latency in ms
    $ref: /schemas/types.yaml#/definitions/uint32

  st,click-single-x:
    description: Issue an interrupt on single click event on the X axis
    type: boolean

  st,click-single-y:
    description: Issue an interrupt on single click event on the Y axis
    type: boolean

  st,click-single-z:
    description: Issue an interrupt on single click event on the Z axis
    type: boolean

  st,click-thresh-x:
    description: Threshold for click on the X axis
    $ref: /schemas/types.yaml#/definitions/uint32

  st,click-thresh-y:
    description: Threshold for click on the Y axis
    $ref: /schemas/types.yaml#/definitions/uint32

  st,click-thresh-z:
    description: Threshold for click on the Z axis
    $ref: /schemas/types.yaml#/definitions/uint32

  st,click-window:
    description: Click window in ms
    $ref: /schemas/types.yaml#/definitions/uint32

  st,default-rate:
    description: Default sampling rate in Hz
    $ref: /schemas/types.yaml#/definitions/uint32

  st,highpass-cutoff-hz:
    description: High-pass filter cutoff frequency in Hz (1, 2, 4 or 8)
    enum: [1, 2, 4, 8]

  st,hipass1-disable:
    description: Disable high-pass filter 1
    type: boolean

  st,hipass2-disable:
    description: Disable high-pass filter 2
    type: boolean

  st,irq1-click:
    description: Raise IRQ 1 on click condition
    type: boolean

  st,irq1-data-ready:
    description: Raise IRQ 1 on data ready condition
    type: boolean

  st,irq1-disable:
    description: Disable IRQ 1
    type: boolean

  st,irq1-ff-wu-1:
    description: Raise IRQ 1 on FF_WU_1 condition
    type: boolean

  st,irq1-ff-wu-2:
    description: Raise IRQ 1 on FF_WU_2 condition
    type: boolean

  st,irq2-click:
    description: Raise IRQ 2 on click condition
    type: boolean

  st,irq2-data-ready:
    description: Raise IRQ 2 on data ready condition
    type: boolean

  st,irq2-disable:
    description: Disable IRQ 2
    type: boolean

  st,irq2-ff-wu-1:
    description: Raise IRQ 2 on FF_WU_1 condition
    type: boolean

  st,irq2-ff-wu-2:
    description: Raise IRQ 2 on FF_WU_2 condition
    type: boolean

  st,irq-active-low:
    description: Make IRQ lines active low
    type: boolean

  st,irq-open-drain:
    description: Consider IRQ lines open-drain
    type: boolean

  st,max-limit-x:
    description: Maximum self-test limit for the X axis
    $ref: /schemas/types.yaml#/definitions/uint32

  st,max-limit-y:
    description: Maximum self-test limit for the Y axis
    $ref: /schemas/types.yaml#/definitions/uint32

  st,max-limit-z:
    description: Maximum self-test limit for the Z axis
    $ref: /schemas/types.yaml#/definitions/uint32

  st,min-limit-x:
    description: Minimum self-test limit for the X axis
    $ref: /schemas/types.yaml#/definitions/uint32

  st,min-limit-y:
    description: Minimum self-test limit for the Y axis
    $ref: /schemas/types.yaml#/definitions/uint32

  st,min-limit-z:
    description: Minimum self-test limit for the Z axis
    $ref: /schemas/types.yaml#/definitions/uint32

  st,wu-duration-1:
    description: Duration register for Free-Fall/Wake-Up interrupt 1
    $ref: /schemas/types.yaml#/definitions/uint32

  st,wu-duration-2:
    description: Duration register for Free-Fall/Wake-Up interrupt 2
    $ref: /schemas/types.yaml#/definitions/uint32

  st,wakeup-threshold:
    description: Wakeup threshold
    $ref: /schemas/types.yaml#/definitions/uint32

  st,wakeup-x-hi:
    description: Wakeup condition on the X axis for upper limit
    type: boolean

  st,wakeup-x-lo:
    description: Wakeup condition on the X axis for lower limit
    type: boolean

  st,wakeup-y-hi:
    description: Wakeup condition on the Y axis for upper limit
    type: boolean

  st,wakeup-y-lo:
    description: Wakeup condition on the Y axis for lower limit
    type: boolean

  st,wakeup-z-hi:
    description: Wakeup condition on the Z axis for upper limit
    type: boolean

  st,wakeup-z-lo:
    description: Wakeup condition on the Z axis for lower limit
    type: boolean

  st,wakeup2-threshold:
    description: Second wakeup threshold
    $ref: /schemas/types.yaml#/definitions/uint32

  st,wakeup2-x-hi:
    description: Wakeup2 condition on the X axis for upper limit
    type: boolean

  st,wakeup2-x-lo:
    description: Wakeup2 condition on the X axis for lower limit
    type: boolean

  st,wakeup2-y-hi:
    description: Wakeup2 condition on the Y axis for upper limit
    type: boolean

  st,wakeup2-y-lo:
    description: Wakeup2 condition on the Y axis for lower limit
    type: boolean

  st,wakeup2-z-hi:
    description: Wakeup2 condition on the Z axis for upper limit
    type: boolean

  st,wakeup2-z-lo:
    description: Wakeup2 condition on the Z axis for lower limit
    type: boolean

additionalProperties: false

examples:
  - |
    accelerometer@0 {
        compatible = "st,lis302dl-spi";
        reg = <0>;
        spi-max-frequency = <1000000>;
        interrupts = <104 0>;

        st,click-single-x;
        st,click-single-y;
        st,click-single-z;
        st,click-thresh-x = <10>;
        st,click-thresh-y = <10>;
        st,click-thresh-z = <10>;
        st,irq1-click;
        st,irq2-click;
        st,wakeup-x-lo;
        st,wakeup-x-hi;
        st,wakeup-y-lo;
        st,wakeup-y-hi;
        st,wakeup-z-lo;
        st,wakeup-z-hi;
    };

  - |
    lis331dlh: accelerometer@18 {
        compatible = "st,lis331dlh", "st,lis3lv02d";
        reg = <0x18>;
        Vdd-supply = <&lis3_reg>;
        Vdd_IO-supply = <&lis3_reg>;

        st,click-single-x;
        st,click-single-y;
        st,click-single-z;
        st,click-thresh-x = <10>;
        st,click-thresh-y = <10>;
        st,click-thresh-z = <10>;
        st,irq1-click;
        st,irq2-click;
        st,wakeup-x-lo;
        st,wakeup-x-hi;
        st,wakeup-y-lo;
        st,wakeup-y-hi;
        st,wakeup-z-lo;
        st,wakeup-z-hi;
        st,min-limit-x = <120>;
        st,min-limit-y = <120>;
        st,min-limit-z = <140>;
        st,max-limit-x = <550>;
        st,max-limit-y = <550>;
        st,max-limit-z = <750>;
    };
```

## Documentation/devicetree/bindings/iio/adc/xlnx,zynq-xadc-1.00.a.yaml
```yaml
# SPDX-License-Identifier: (GPL-2.0-only OR BSD-2-Clause)
%YAML 1.2
---
$id: http://devicetree.org/schemas/iio/adc/xlnx,zynq-xadc-1.00.a.yaml#
$schema: http://devicetree.org/meta-schemas/core.yaml#

title: Xilinx XADC and System Monitor controller
maintainers:
  - Lars-Peter Clausen <lars@metafoo.de>
  - Masanari Iida <standby24x7@gmail.com>
  - Rob Herring <robh@kernel.org>

description: |
  Xilinx XADC device driver

  This binding document describes the bindings for the Xilinx 7 Series XADC as well
  as the UltraScale/UltraScale+ System Monitor.

  The Xilinx XADC is an ADC that can be found in the Series 7 FPGAs from Xilinx.
  The XADC has a DRP interface for communication. Currently two different
  frontends for the DRP interface exist. One that is only available on the ZYNQ
  family as a hardmacro in the SoC portion of the ZYNQ. The other one is available
  on all series 7 platforms and is a softmacro with a AXI interface. This binding
  document describes the bindings for both of them since the bindings are very
  similar.

properties:
  compatible:
    description: List of compatible strings.
    items:
      - enum:
          - "xlnx,zynq-xadc-1.00.a"
          - "xlnx,axi-xadc-1.00.a"
          - "xlnx,system-management-wiz-1.3"
  reg:
    maxItems: 1

  interrupts:
    maxItems: 1

  clocks:
    description: Clock that provides the AXI or PCAP interface clock.
    maxItems: 1

  xlnx,external-mux:
    description: External multiplexer mode.
    $ref: /schemas/types.yaml#/definitions/string
    enum:
      - none
      - single
      - dual
  xlnx,external-mux-channel:
    description: Channel selection for external multiplexer mode.
    $ref: /schemas/types.yaml#/definitions/uint32
  channels:
    description: Configuration of external ADC channels.
    type: object
    additionalProperties: false
    properties:
      '#address-cells':
        const: 1
      '#size-cells':
        const: 0
    patternProperties:
      "^channel@\\d+$":
        description: Channel node configuration.
        type: object
        additionalProperties: false
        properties:
          reg:
            description: Channel number.
            maxItems: 1
          xlnx,bipolar:
            description: Use bipolar mode.
            type: boolean
        required:
          - reg

required:
  - compatible
  - reg
  - interrupts
  - clocks

additionalProperties: false

examples:
  - |
    xadc@f8007100 {
        compatible = "xlnx,zynq-xadc-1.00.a";
        reg = <0xf8007100 0x20>;
        interrupts = <0 7 4>;
        clocks = <&pcap_clk>;
        channels {
            #address-cells = <1>;
            #size-cells = <0>;
            channel@0 {
                reg = <0>;
            };
        };
    };
  - |
    xadc@43200000 {
        compatible = "xlnx,axi-xadc-1.00.a";
        reg = <0x43200000 0x1000>;
        interrupts = <0 53 4>;
        clocks = <&fpga1_clk>;
        channels {
            #address-cells = <1>;
            #size-cells = <0>;
            channel@0 {
                reg = <0>;
                xlnx,bipolar;
            };
        };
    };
  - |
    adc@80000000 {
        compatible = "xlnx,system-management-wiz-1.3";
        reg = <0x80000000 0x1000>;
        interrupts = <0 81 4>;
        clocks = <&fpga1_clk>;
        channels {
            #address-cells = <1>;
            #size-cells = <0>;
            channel@0 {
                reg = <0>;
                xlnx,bipolar;
            };
        };
    };
```
