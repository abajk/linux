## Documentation/devicetree/bindings/infiniband/hisilicon,hns-roce-v1.yaml
```yaml
# SPDX-License-Identifier: (GPL-2.0-only OR BSD-2-Clause)
# Copyright 2025 Linaro Ltd.
%YAML 1.2
---
$id: http://devicetree.org/schemas/infiniband/hisilicon,hns-roce-v1.yaml#
$schema: http://devicetree.org/meta-schemas/core.yaml#

title: Hisilicon HNS RoCE

maintainers:
  - Bhaskar Chowdhury <unixbhaskar@gmail.com>
  - Lijun Ou <oulijun@huawei.com>
  - oulijun <oulijun@huawei.com>
  - Rob Herring <robh@kernel.org>

description: |
  Hisilicon RoCE DT description

  Hisilicon RoCE engine is a part of network subsystem.
  It works depending on other part of network subsystem, such as gmac and
  dsa fabric.

  Additional properties are described here:

properties:
  compatible:
    items:
      - const: hisilicon,hns-roce-v1

  reg:
    items:
      - description: Physical base address of the RoCE driver and length of memory mapped region.

  eth-handle:
    description: References to one or more Ethernet devices.
    $ref: /schemas/types.yaml#/definitions/phandle-array

  dsaf-handle:
    description: Reference to a dsaf device.
    $ref: /schemas/types.yaml#/definitions/phandle

  node-guid:
    description: A number that uniquely identifies a device or component.
    $ref: /schemas/types.yaml#/definitions/uint8-array

  '#address-cells':
    const: 2

  '#size-cells':
    const: 2

  dma-coherent:
    type: boolean
    description: DMA operations are coherent.

  interrupts:
    description: Interrupt specifiers for RoCE completion, async, and overflow events.
    items:
      - description: Completion event IRQ
      - description: Completion event IRQ
      - description: Completion event IRQ
      - description: Completion event IRQ
      - description: Completion event IRQ
      - description: Completion event IRQ
      - description: Completion event IRQ
      - description: Completion event IRQ
      - description: Completion event IRQ
      - description: Completion event IRQ
      - description: Completion event IRQ
      - description: Completion event IRQ
      - description: Completion event IRQ
      - description: Completion event IRQ
      - description: Completion event IRQ
      - description: Completion event IRQ
      - description: Completion event IRQ
      - description: Completion event IRQ
      - description: Completion event IRQ
      - description: Completion event IRQ
      - description: Completion event IRQ
      - description: Completion event IRQ
      - description: Completion event IRQ
      - description: Completion event IRQ
      - description: Completion event IRQ
      - description: Completion event IRQ
      - description: Completion event IRQ
      - description: Completion event IRQ
      - description: Completion event IRQ
      - description: Completion event IRQ
      - description: Completion event IRQ
      - description: Async event IRQ
      - description: Event overflow IRQ

  interrupt-names:
    items:
      - const: hns-roce-comp-0
      - const: hns-roce-comp-1
      - const: hns-roce-comp-2
      - const: hns-roce-comp-3
      - const: hns-roce-comp-4
      - const: hns-roce-comp-5
      - const: hns-roce-comp-6
      - const: hns-roce-comp-7
      - const: hns-roce-comp-8
      - const: hns-roce-comp-9
      - const: hns-roce-comp-10
      - const: hns-roce-comp-11
      - const: hns-roce-comp-12
      - const: hns-roce-comp-13
      - const: hns-roce-comp-14
      - const: hns-roce-comp-15
      - const: hns-roce-comp-16
      - const: hns-roce-comp-17
      - const: hns-roce-comp-18
      - const: hns-roce-comp-19
      - const: hns-roce-comp-20
      - const: hns-roce-comp-21
      - const: hns-roce-comp-22
      - const: hns-roce-comp-23
      - const: hns-roce-comp-24
      - const: hns-roce-comp-25
      - const: hns-roce-comp-26
      - const: hns-roce-comp-27
      - const: hns-roce-comp-28
      - const: hns-roce-comp-29
      - const: hns-roce-comp-30
      - const: hns-roce-comp-31
      - const: hns-roce-async
      - const: hns-roce-common

required:
  - compatible
  - reg
  - eth-handle
  - dsaf-handle
  - node-guid
  - "#address-cells"
  - "#size-cells"

additionalProperties: false

examples:
  - |
    infiniband@c4000000 {
        compatible = "hisilicon,hns-roce-v1";
        reg = <0x0 0xc4000000 0x0 0x100000>;
        dma-coherent;
        eth-handle = <&eth2 &eth3 &eth4 &eth5 &eth6 &eth7>;
        dsaf-handle = <&soc0_dsa>;
        node-guid = [00 9A CD 00 00 01 02 03];
        #address-cells = <2>;
        #size-cells = <2>;
        interrupts = <722 1>,
                     <723 1>,
                     <724 1>,
                     <725 1>,
                     <726 1>,
                     <727 1>,
                     <728 1>,
                     <729 1>,
                     <730 1>,
                     <731 1>,
                     <732 1>,
                     <733 1>,
                     <734 1>,
                     <735 1>,
                     <736 1>,
                     <737 1>,
                     <738 1>,
                     <739 1>,
                     <740 1>,
                     <741 1>,
                     <742 1>,
                     <743 1>,
                     <744 1>,
                     <745 1>,
                     <746 1>,
                     <747 1>,
                     <748 1>,
                     <749 1>,
                     <750 1>,
                     <751 1>,
                     <752 1>,
                     <753 1>,
                     <785 1>,
                     <754 4>;
        interrupt-names = "hns-roce-comp-0",
                          "hns-roce-comp-1",
                          "hns-roce-comp-2",
                          "hns-roce-comp-3",
                          "hns-roce-comp-4",
                          "hns-roce-comp-5",
                          "hns-roce-comp-6",
                          "hns-roce-comp-7",
                          "hns-roce-comp-8",
                          "hns-roce-comp-9",
                          "hns-roce-comp-10",
                          "hns-roce-comp-11",
                          "hns-roce-comp-12",
                          "hns-roce-comp-13",
                          "hns-roce-comp-14",
                          "hns-roce-comp-15",
                          "hns-roce-comp-16",
                          "hns-roce-comp-17",
                          "hns-roce-comp-18",
                          "hns-roce-comp-19",
                          "hns-roce-comp-20",
                          "hns-roce-comp-21",
                          "hns-roce-comp-22",
                          "hns-roce-comp-23",
                          "hns-roce-comp-24",
                          "hns-roce-comp-25",
                          "hns-roce-comp-26",
                          "hns-roce-comp-27",
                          "hns-roce-comp-28",
                          "hns-roce-comp-29",
                          "hns-roce-comp-30",
                          "hns-roce-comp-31",
                          "hns-roce-async",
                          "hns-roce-common";
    };
```

## Documentation/devicetree/bindings/input/brcm,bcm-keypad.yaml
```yaml
# SPDX-License-Identifier: (GPL-2.0-only OR BSD-2-Clause)
# Copyright 2025 Broadcom Ltd.
%YAML 1.2
---
$id: http://devicetree.org/schemas/brcm,bcm-keypad.yaml#
$schema: http://devicetree.org/meta-schemas/core.yaml#

title: Broadcom BCM Keypad Controller
maintainers:
  - Rob Herring <robh@kernel.org>
  - Scott Branden <sbranden@broadcom.com>

description: |
  * Broadcom Keypad Controller device tree bindings

  Broadcom Keypad controller is used to interface a SoC with a matrix-type
  keypad device. The keypad controller supports multiple row and column lines.
  A key can be placed at each intersection of a unique row and a unique column.
  The keypad controller can sense a key-press and key-release and report the
  event using a interrupt to the cpu.

  This binding is based on the matrix-keymap binding with the following
  changes:

  keypad,num-rows and keypad,num-columns are required.

properties:
  compatible:
    items:
      - const: brcm,bcm-keypad

  reg:
    items:
      - description: physical base address of the controller
      - description: length of memory mapped region

  interrupts:
    items:
      - description: The interrupt number to the cpu

  keypad,num-rows:
    description: Number of row lines connected to the keypad controller.
    $ref: /schemas/types.yaml#/definitions/uint32

  keypad,num-columns:
    description: Number of column lines connected to the keypad controller.
    $ref: /schemas/types.yaml#/definitions/uint32

  col-debounce-filter-period:
    description: The debounce period for the Column filter.
    $ref: /schemas/types.yaml#/definitions/uint32
    enum: [0, 1, 2, 3, 4, 5, 6, 7]

  status-debounce-filter-period:
    description: The debounce period for the Status filter.
    $ref: /schemas/types.yaml#/definitions/uint32
    enum: [0, 1, 2, 3, 4, 5, 6, 7]

  row-output-enabled:
    description: An optional property indicating whether the row or column is being used as output.
      If specified the row is being used as the output. Else defaults to column.
    type: boolean

  pull-up-enabled:
    description: An optional property indicating the Keypad scan mode.
      If specified implies the keypad scan pull-up has been enabled.
    type: boolean

  autorepeat:
    description: Enable auto repeat feature of Linux input subsystem.
    type: boolean

  linux,keymap:
    description: The keymap for keys as described in the binding document
      devicetree/bindings/input/matrix-keymap.txt
    items: {}

required:
  - compatible
  - reg
  - interrupts
  - keypad,num-rows
  - keypad,num-columns

additionalProperties: false

examples:
  - |
    #include "dt-bindings/input/input.h"
    / {
        keypad: keypad@180ac000 {
            compatible = "brcm,bcm-keypad";
            reg = <0x180ac000 0x1000>;
            interrupts = <24>;
            keypad,num-rows = <5>;
            keypad,num-columns = <5>;
            linux,keymap = <
                MATRIX_KEY(0x00, 0x02, KEY_F) /* key_forward */
                MATRIX_KEY(0x00, 0x03, KEY_HOME) /* key_home */
                MATRIX_KEY(0x00, 0x04, KEY_M) /* key_message */
                MATRIX_KEY(0x01, 0x00, KEY_A) /* key_contacts */
                MATRIX_KEY(0x01, 0x01, KEY_1) /* key_1 */
                MATRIX_KEY(0x01, 0x02, KEY_2) /* key_2 */
                MATRIX_KEY(0x01, 0x03, KEY_3) /* key_3 */
                MATRIX_KEY(0x01, 0x04, KEY_S) /* key_speaker */
                MATRIX_KEY(0x02, 0x00, KEY_P) /* key_phone */
                MATRIX_KEY(0x02, 0x01, KEY_4) /* key_4 */
                MATRIX_KEY(0x02, 0x02, KEY_5) /* key_5 */
                MATRIX_KEY(0x02, 0x03, KEY_6) /* key_6 */
                MATRIX_KEY(0x02, 0x04, KEY_VOLUMEUP) /* key_vol_up */
                MATRIX_KEY(0x03, 0x00, KEY_C) /* key_call_log */
                MATRIX_KEY(0x03, 0x01, KEY_7) /* key_7 */
                MATRIX_KEY(0x03, 0x02, KEY_8) /* key_8 */
                MATRIX_KEY(0x03, 0x03, KEY_9) /* key_9 */
                MATRIX_KEY(0x03, 0x04, KEY_VOLUMEDOWN) /* key_vol_down */
                MATRIX_KEY(0x04, 0x00, KEY_H) /* key_headset */
                MATRIX_KEY(0x04, 0x01, KEY_KPASTERISK) /* key_* */
                MATRIX_KEY(0x04, 0x02, KEY_0) /* key_0 */
                MATRIX_KEY(0x04, 0x03, KEY_GRAVE) /* key_# */
                MATRIX_KEY(0x04, 0x04, KEY_MUTE) /* key_mute */
            >;
            col-debounce-filter-period = <5>;
            row-output-enabled;
            pull-up-enabled;
        };
    };
```

## Documentation/devicetree/bindings/input/cirrus,ep7209-keypad.yaml
```yaml
# SPDX-License-Identifier: (GPL-2.0-only OR BSD-2-Clause)
# Copyright 2025 Alexander Shiyan <shc_work@mail.ru>
%YAML 1.2
---
$id: http://devicetree.org/schemas/cirrus,ep7209-keypad.yaml#
$schema: http://devicetree.org/meta-schemas/core.yaml#

title: Cirrus Logic CLPS711X matrix keypad

maintainers:
  - Alexander Shiyan <shc_work@mail.ru>

description: |
  * Cirrus Logic CLPS711X matrix keypad device tree bindings

properties:
  compatible:
    oneOf:
      - items:
          - enum:
              - cirrus,ep7312-keypad
          - const: cirrus,ep7209-keypad
      - items:
          - const: cirrus,ep7209-keypad
  row-gpios:
    description: List of GPIOs used as row lines.
    items:
      description: A connection of a 'row' gpio line.
  poll-interval:
    description: Poll interval time in milliseconds.
    $ref: /schemas/types.yaml#/definitions/uint32
  linux,keymap:
    description: The definition can be found at bindings/input/matrix-keymap.txt.
  autorepeat:
    type: boolean
    description: Enable autorepeat feature.

required:
  - compatible
  - row-gpios
  - poll-interval
  - linux,keymap

additionalProperties: false

examples:
  - |
    keypad {
      compatible = "cirrus,ep7312-keypad", "cirrus,ep7209-keypad";
      autorepeat;
      poll-interval = <120>;
      row-gpios = <&porta 0 0>,
                  <&porta 1 0>;
      linux,keymap = <
        MATRIX_KEY(0, 0, KEY_UP)
        MATRIX_KEY(0, 1, KEY_DOWN)
        MATRIX_KEY(1, 0, KEY_LEFT)
        MATRIX_KEY(1, 1, KEY_RIGHT)
      >;
    };
```

## Documentation/devicetree/bindings/input/dlink/dlink,dir685-touchkeys.yaml
```yaml
# SPDX-License-Identifier: (GPL-2.0-only OR BSD-2-Clause)
# Copyright 2018 Linaro Ltd.
%YAML 1.2
---
$id: http://devicetree.org/schemas/dlink,dir685-touchkeys.yaml#
$schema: http://devicetree.org/meta-schemas/core.yaml#

title: D-Link DIR-685 Touchkeys
maintainers:
  - Linus Walleij <linus.walleij@linaro.org>

description: |
  * D-Link DIR-685 Touchkeys

  This is a I2C one-off touchkey controller based on the Cypress Semiconductor
  CY8C214 MCU with some firmware in its internal 8KB flash. The circuit
  board inside the router is named E119921.

  The touchkey device node should be placed inside an I2C bus node.

properties:
  compatible:
    const: dlink,dir685-touchkeys

  reg:
    description: I2C address of the touchkeys
    items:
      - description: I2C 7-bit address

  interrupts:
    description: IRQ line for the touchkey controller
    items:
      - description: Combined interrupt

required:
  - compatible
  - reg
  - interrupts

additionalProperties: false

examples:
  - |
    touchkeys@26 {
        compatible = "dlink,dir685-touchkeys";
        reg = <0x26>;
        interrupts = <17 IRQ_TYPE_EDGE_FALLING>;
    };
```

## Documentation/devicetree/bindings/input/ettus,e3x0-button.yaml
```yaml
# SPDX-License-Identifier: (GPL-2.0-only OR BSD-2-Clause)
%YAML 1.2
---
$id: http://devicetree.org/schemas/ettus,e3x0-button.yaml#
$schema: http://devicetree.org/meta-schemas/core.yaml#

title: National Instruments Ettus Research USRP E3x0 button driver

maintainers:
  - Moritz Fischer <moritz.fischer@ettus.com>
  - Rob Herring <robh@kernel.org>

description: |
  National Instruments Ettus Research USRP E3x0 button driver

  This module is part of the NI Ettus Research USRP E3x0 SDR.

  This module provides a simple power button event via two interrupts.

properties:
  compatible:
    items:
      - const: ettus,e3x0-button
    description: Hardware compatible string for the USRP E3x0 button device.

  interrupts:
    description: Interrupt lines for press and release events.
    items:
      - description: Press interrupt
      - description: Release interrupt

  interrupt-names:
    description: Names for the interrupts.
    items:
      - const: press
      - const: release

required:
  - compatible
  - interrupts
  - interrupt-names

additionalProperties: false

examples:
  - |
    button {
        compatible = "ettus,e3x0-button";
        interrupts = <0 30 1>, <0 31 1>;
        interrupt-names = "press", "release";
    };
```
