## Documentation/devicetree/bindings/i2c/img-scb-i2c.yaml
```yaml
# SPDX-License-Identifier: (GPL-2.0-only OR BSD-2-Clause)
# Copyright 2025 James Hogan <jhogan@kernel.org>
%YAML 1.2
---
$id: http://devicetree.org/schemas/i2c/img-scb-i2c.yaml#
$schema: http://devicetree.org/meta-schemas/core.yaml#

title: IMG Serial Control Bus (SCB) I2C Controller

maintainers:
  - James Hogan <jhogan@kernel.org>

description: |
  IMG Serial Control Bus (SCB) I2C Controller

  Required Properties:
  - compatible: "img,scb-i2c"
  - reg: Physical base address and length of controller registers
  - interrupts: Interrupt number used by the controller
  - clocks: Should contain a clock specifier for each entry in clock-names
  - clock-names: Should contain the following entries:
    - "scb", for the SCB core clock.
    - "sys", for the system clock.
  - clock-frequency: The I2C bus frequency in Hz
  - #address-cells: Should be <1>
  - #size-cells: Should be <0>

properties:
  compatible:
    items:
      - const: img,scb-i2c

  reg:
    description: Physical base address and length of controller registers
    items:
      - description: Physical base address and size

  interrupts:
    description: Interrupt number used by the controller
    items:
      - description: Interrupt specifier consisting of interrupt-parent phandle and IRQ specifier cells

  clocks:
    description: Should contain a clock specifier for each entry in clock-names
    items:
      - description: SCB core clock
      - description: System clock

  clock-names:
    items:
      - const: scb
      - const: sys

  clock-frequency:
    description: The I2C bus frequency in Hz

  '#address-cells':
    const: 1

  '#size-cells':
    const: 0

required:
  - compatible
  - reg
  - interrupts
  - clocks
  - clock-names
  - clock-frequency
  - '#address-cells'
  - '#size-cells'

additionalProperties: false

examples:
  - |
    i2c@18100000 {
      compatible = "img,scb-i2c";
      reg = <0x18100000 0x200>;
      interrupts = <GIC_SHARED 2 IRQ_TYPE_LEVEL_HIGH>;
      clocks = <&i2c0_clk>, <&system_clk>;
      clock-names = "scb", "sys";
      clock-frequency = <400000>;
      #address-cells = <1>;
      #size-cells = <0>;
    };
```

## Documentation/devicetree/bindings/i2c/intel,ce4100-i2c-controller.yaml
```yaml
# SPDX-License-Identifier: (GPL-2.0-only OR BSD-2-Clause)
# Copyright 2025 Geert Uytterhoeven
# Copyright 2025 Wolfram Sang
%YAML 1.2
---
$id: http://devicetree.org/schemas/intel,ce4100-i2c-controller.yaml#
$schema: http://devicetree.org/meta-schemas/core.yaml#

title: Intel CE4100 I2C Controller

maintainers:
  - Geert Uytterhoeven <geert+renesas@glider.be>
  - Wolfram Sang <wolfram@the-dreams.de>

description: |
  CE4100 I2C
  ----------

  CE4100 has one PCI device which is described as the I2C-Controller. This
  PCI device has three PCI-bars, each bar contains a complete I2C
  controller. So we have a total of three independent I2C-Controllers
  which share only an interrupt line.
  The driver is probed via the PCI-ID and is gathering the information of
  attached devices from the device tree.

  Grant Likely recommended to use the ranges property to map the PCI-Bar
  number to its physical address and to use this to find the child nodes
  of the specific I2C controller. This were his exact words:

      Here's where the magic happens.  Each entry in
      ranges describes how the parent pci address space
      (middle group of 3) is translated to the local
      address space (first group of 2) and the size of
      each range (last cell).  In this particular case,
      the first cell of the local address is chosen to be
      1:1 mapped to the BARs, and the second is the
      offset from the base of the BAR (which would be
      non-zero if you had 2 or more devices mapped off
      the same BAR)

      ranges allows the address mapping to be described
      in a way that the OS can interpret without
      requiring custom device driver code.

properties:
  '#address-cells':
    const: 2

  '#size-cells':
    const: 1

  compatible:
    description: PCI device compatible identifiers
    items:
      - const: pci8086,2e68.2
      - const: pci8086,2e68
      - const: pciclass,ff0000
      - const: pciclass,ff00

  reg:
    description: PCI BAR register specification
    items:
      - description: PCI BAR number
      - description: reserved
      - description: reserved
      - description: reserved
      - description: size of mapping

  interrupts:
    description: 'Interrupt specifier: IRQ number and flags'
    items:
      - description: interrupt number
      - description: interrupt flags

  ranges:
    description: PCI BAR mapping ranges, specified as tuples of [bar-number, bar-address, size]
    items:
      - description: bar number
      - description: BAR address
      - description: size of mapping

required:
  - '#address-cells'
  - '#size-cells'
  - compatible
  - reg
  - interrupts
  - ranges

additionalProperties: false

examples:
  - |
    i2c-controller@b,2 {
      #address-cells = <2>;
      #size-cells = <1>;
      compatible = "pci8086,2e68.2", "pci8086,2e68", "pciclass,ff0000", "pciclass,ff00";
      reg = <0x15a00 0x0 0x0 0x0 0x0>;
      interrupts = <16 1>;
      ranges = <0 0 0x02000000 0 0xdffe0500 0x100>,
               <1 0 0x02000000 0 0xdffe0600 0x100>,
               <2 0 0x02000000 0 0xdffe0700 0x100>;
    };
```

## Documentation/devicetree/bindings/i2c/intel,iop3xx-i2c.yaml
```yaml
# SPDX-License-Identifier: (GPL-2.0-only OR BSD-2-Clause)
%YAML 1.2
---
$id: http://devicetree.org/schemas/i2c/intel,iop3xx-i2c.yaml#
$schema: http://devicetree.org/meta-schemas/core.yaml#

title: I2C Controller on XScale platforms such as IOP3xx and IXP4xx

maintainers:
  - Wolfram Sang <wsa@kernel.org>

description: |
  i2c Controller on XScale platforms such as IOP3xx and IXP4xx

properties:
  compatible:
    items:
      - enum:
          - "intel,iop3xx-i2c"
          - "intel,ixp4xx-i2c"

  reg:
    description: Controller register address and size.
    items:
      - description: Base address
      - description: Size of register space

  "#address-cells":
    description: Number of address cells for child nodes.
    const: 1

  "#size-cells":
    description: Number of size cells for child nodes.
    const: 0

  interrupts:
    description: Controller interrupt and trigger type.
    items:
      - description: Interrupt specifier

required:
  - compatible
  - reg
  - "#address-cells"
  - "#size-cells"

additionalProperties: false

examples:
  - |
    i2c@c8011000 {
        compatible = "intel,ixp4xx-i2c";
        reg = <0xc8011000 0x18>;
        interrupts = <33 IRQ_TYPE_LEVEL_LOW>;
    };
```

## Documentation/devicetree/bindings/i2c/lltc,ltc4306.yaml
```yaml
# SPDX-License-Identifier: (GPL-2.0-only OR BSD-2-Clause)
%YAML 1.2
---
$id: http://devicetree.org/schemas/lltc,ltc4306.yaml#
$schema: http://devicetree.org/meta-schemas/core.yaml#

title: Linear Technology / Analog Devices I2C bus switch

maintainers:
  - Michael Hennerich <michael.hennerich@analog.com>
  - Rob Herring <robh@kernel.org>
  - Thierry Reding <treding@nvidia.com>

description: |
  * Linear Technology / Analog Devices I2C bus switch

properties:
  compatible:
    oneOf:
      - items:
          - const: "lltc,ltc4305"
      - items:
          - const: "lltc,ltc4306"

  reg:
    description: The I2C address of the device.
    items:
      - description: I2C address

  enable-gpios:
    description: Reference to the GPIO connected to the enable input.
    maxItems: 1

  i2c-mux-idle-disconnect:
    description: Forces the mux to disconnect all children in idle state.
    type: boolean

  gpio-controller: true

  "#gpio-cells":
    description: "Should be two: first cell is pin number, second cell is flags."
    const: 2

  ltc,downstream-accelerators-enable:
    description: Enables the rise time accelerators on the downstream port.
    type: boolean

  ltc,upstream-accelerators-enable:
    description: Enables the rise time accelerators on the upstream port.
    type: boolean

required:
  - compatible
  - reg

additionalProperties: false

examples:
  - |
      i2c-mux@4a {
          compatible = "lltc,ltc4306";
          #address-cells = <1>;
          #size-cells = <0>;
          reg = <0x4a>;

          i2c@0 {
              #address-cells = <1>;
              #size-cells = <0>;
              reg = <0>;

              eeprom@50 {
                  compatible = "atmel,24c02";
                  reg = <0x50>;
              };
          };

          i2c@1 {
              #address-cells = <1>;
              #size-cells = <0>;
              reg = <1>;

              eeprom@50 {
                  compatible = "atmel,24c02";
                  reg = <0x50>;
              };
          };
      };
```

## Documentation/devicetree/bindings/i2c/lsi,api2c.yaml
```yaml
# SPDX-License-Identifier: (GPL-2.0-only OR BSD-2-Clause)
# Copyright 2018 Linaro Ltd.
%YAML 1.2
---
$id: http://devicetree.org/schemas/i2c/lsi,api2c.yaml#
$schema: http://devicetree.org/meta-schemas/core.yaml#

title: LSI Axxia I2C

maintainers:
  - Anders Berg <anders.berg@avagotech.com>
  - Marco Franchi <marco.franchi@nxp.com>

description: |
  LSI Axxia I2C

properties:
  compatible:
    items:
      - const: lsi,api2c

  device_type:
    const: i2c

  "#address-cells":
    const: 1

  "#size-cells":
    const: 0

  reg:
    items:
      - description: Offset of the register set
      - description: Length of the register set

  interrupts:
    items:
      - description: Interrupt specifier (IRQ and flags)

  clocks:
    maxItems: 1
    description: Phandle to i2c clock

  clock-names:
    items:
      - const: i2c

  clock-frequency:
    description: Desired I2C bus clock frequency in Hz
    enum: [100000, 400000]
    default: 100000

required:
  - compatible
  - device_type
  - "#address-cells"
  - "#size-cells"
  - reg
  - interrupts
  - clocks
  - clock-names

additionalProperties: false

examples:
  - |
    i2c@2010084000 {
        compatible = "lsi,api2c";
        device_type = "i2c";
        #address-cells = <1>;
        #size-cells = <0>;
        reg = <0x20 0x10084000 0x00 0x1000>;
        interrupts = <0 19 4>;
        clocks = <&clk_per>;
        clock-names = "i2c";
        clock-frequency = <400000>;
    };
```

## Documentation/devicetree/bindings/i2c/nxp,pca9564.yaml
```yaml
# SPDX-License-Identifier: (GPL-2.0-only OR BSD-2-Clause)
# Copyright 2025 Allied Telesis
%YAML 1.2
---
$id: http://devicetree.org/schemas/i2c/nxp,pca9564.yaml#
$schema: http://devicetree.org/meta-schemas/core.yaml#

title: NXP PCA PCA9564/PCA9665 I2C controller

maintainers:
  - Chris Packham <chris.packham@alliedtelesis.co.nz>
  - Rob Herring <robh@kernel.org>

description: |
  NXP PCA PCA9564/PCA9665 I2C controller

  The PCA9564/PCA9665 serves as an interface between most standard
  parallel-bus microcontrollers/microprocessors and the serial I2C-bus
  and allows the parallel-bus system to communicate bi-directionally
  with the I2C-bus.

properties:
  compatible:
    items:
      - enum:
          - nxp,pca9564
          - nxp,pca9665

  '#address-cells':
    const: 1

  '#size-cells':
    const: 0

  reg:
    items:
      - description: Offset of the register set
      - description: Length of the register set

  interrupts:
    description: Interrupt number of the I2C controller
    items:
      - description: Interrupt number

  reset-gpios:
    description: GPIO specifier for RESET_N pin; active low
    maxItems: 1

  clock-frequency:
    description: I2C bus frequency, in hertz

additionalProperties: false

required:
  - compatible
  - reg

examples:
  - |
    i2c0: i2c@80000 {
        compatible = "nxp,pca9564";
        #address-cells = <1>;
        #size-cells = <0>;
        reg = <0x80000 0x4>;
        reset-gpios = <&gpio1 0 GPIO_ACTIVE_LOW>;
        clock-frequency = <100000>;
    };
```

## Documentation/devicetree/bindings/i2c/ti,davinci-i2c.yaml
```yaml
# SPDX-License-Identifier: (GPL-2.0-only OR BSD-2-Clause)
%YAML 1.2
---
$id: http://devicetree.org/schemas/ti,davinci-i2c.yaml#
$schema: http://devicetree.org/meta-schemas/core.yaml#

title: TI Davinci/Keystone I2C Controller

maintainers:
  - Alexander Sverdlin <alexander.sverdlin@gmail.com>
  - Franklin S Cooper Jr <fcooper@ti.com>
  - Grygorii Strashko <grygorii.strashko@ti.com>
  - Mauro Carvalho Chehab <mchehab+huawei@kernel.org>
  - Wolfram Sang <wolfram@the-dreams.de>
  - Wolfram Sang <wsa+renesas@sang-engineering.com>

description: |
  * Texas Instruments Davinci/Keystone I2C

  This file provides information about the device node for the
  davinci/keystone i2c interface.

properties:
  compatible:
    description: Supported compatible strings for Davinci/Keystone I2C.
    items:
      - enum:
          - ti,davinci-i2c
          - ti,keystone-i2c
  reg:
    description: Offset and length of the register set for the device.
    items:
      - description: Register region.
  clocks:
    description: I2C functional clock phandle. For 66AK2G this property should be set per binding,
      see Documentation/devicetree/bindings/clock/ti,sci-clk.yaml.
    maxItems: 1
  clock-frequency:
    description: Desired I2C bus clock frequency in Hz.
  interrupts:
    description: Standard interrupt property.
    maxItems: 1
  ti,has-pfunc:
    type: boolean
    description: >
      If defined, indicates that SoC supports PFUNC registers. PFUNC
      registers allow switching I2C pins to GPIO to be toggled manually.
  power-domains:
    description: >
      Should contain a phandle to a PM domain provider node and an args
      specifier containing the I2C device id value. This property is
      as per the binding, Documentation/devicetree/bindings/soc/ti/sci-pm-domain.yaml
    items:
      - description: PM domain phandle and args specifier.
  "#address-cells":
    const: 1
  "#size-cells":
    const: 0

required:
  - compatible
  - reg
  - clocks

allOf:
  - if:
      properties:
        compatible:
          contains:
            const: ti,keystone-i2c
    then:
      required:
        - power-domains

additionalProperties: false

examples:
  - |
    i2c@1c22000 {
      compatible = "ti,davinci-i2c";
      reg = <0x22000 0x1000>;
      clock-frequency = <100000>;
      interrupts = <15>;
      #address-cells = <1>;
      #size-cells = <0>;

      dtt@48 {
        compatible = "national,lm75";
        reg = <0x48>;
      };
    };
```
