## Documentation/devicetree/bindings/pinctrl/atmel,sama5d2-pinctrl.yaml
```yaml
# SPDX-License-Identifier: (GPL-2.0-only OR BSD-2-Clause)
# Copyright 2025 Claudiu Beznea <claudiu.beznea@tuxon.dev>
%YAML 1.2
---
$id: http://devicetree.org/schemas/pinctrl/atmel,sama5d2-pinctrl.yaml#
$schema: http://devicetree.org/meta-schemas/core.yaml#

title: Atmel AT91 PIO4 controller

maintainers:
  - Claudiu Beznea <claudiu.beznea@tuxon.dev>
  - Dharma Balasubiramani <dharma.b@microchip.com>
  - Eugen Hristev <eugen.hristev@linaro.org>
  - Ludovic Desroches <ludovic.desroches@atmel.com>
  - Ludovic Desroches <ludovic.desroches@microchip.com>
  - Ryan Wanner <Ryan.Wanner@microchip.com>

description: |
  * Atmel PIO4 Controller

  The Atmel PIO4 controller is used to select the function of a pin and to
  configure it.

  Please refer to ../gpio/gpio.txt and ../interrupt-controller/interrupts.txt for
  a general description of GPIO and interrupt bindings.

  Please refer to pinctrl-bindings.txt in this directory for details of the
  common pinctrl bindings used by client devices.

  Subnode format
  Each node (or subnode) will list the pins it needs and how to configured these
  pins.

    node {
        pinmux = <PIN_NUMBER_PINMUX>;
        GENERIC_PINCONFIG;
    };

  Required properties:
  - pinmux: integer array. Each integer represents a pin number plus mux and
    ioset settings. Use the macros from boot/dts/<soc>-pinfunc.h file to get the
    right representation of the pin.

  Optional properties:
  - GENERIC_PINCONFIG: generic pinconfig options to use:
      - bias-disable, bias-pull-down, bias-pull-up, drive-open-drain,
        drive-push-pull, input-schmitt-enable, input-debounce, output-low,
        output-high.
      - for microchip,sama7g5-pinctrl only:
          - slew-rate: 0 - disabled, 1 - enabled (default)
  - atmel,drive-strength: 0 or 1 for low drive, 2 for medium drive and 3 for
    high drive. The default value is low drive.

properties:
  compatible:
    items:
      - const: atmel,sama5d2-pinctrl
      - const: microchip,sama7g5-pinctrl
      - const: microchip,sama7g5-pinctrl
  reg:
    items:
      - description: Base address and length of the PIO controller register space.
  interrupts:
    description: Interrupt outputs from the controller, one for each bank.
    items:
      - description: Interrupt specifier (IRQ number, type, flags).
  interrupt-controller: true
  '#interrupt-cells':
    const: 2
  gpio-controller: true
  '#gpio-cells':
    const: 2
  clocks:
    maxItems: 1
    description: PIO controller clock signal.

patternProperties:
  "^pinctrl-.*$":
    description: Pin configuration subnodes.
    type: object
    properties:
      pinmux:
        description: Pin multiplexer settings.
        items:
          $ref: /schemas/types.yaml#/definitions/uint32
      bias-disable:
        description: Disable pin bias.
        type: boolean
      bias-pull-down:
        description: Enable pull-down bias.
        type: boolean
      bias-pull-up:
        description: Enable pull-up bias.
        type: boolean
      drive-open-drain:
        description: Open-drain output.
        type: boolean
      drive-push-pull:
        description: Push-pull output.
        type: boolean
      input-schmitt-enable:
        description: Enable Schmitt trigger at input.
        type: boolean
      input-debounce:
        description: Enable input debounce.
        type: boolean
      output-low:
        description: Force output low.
        type: boolean
      output-high:
        description: Force output high.
        type: boolean
      slew-rate:
        description: Slew rate control (microchip,sama7g5-pinctrl only).
        enum:
          - 0
          - 1
      atmel,drive-strength:
        description: Drive strength.
        enum:
          - 0
          - 1
          - 2
          - 3
    required:
      - pinmux
    additionalProperties: false

additionalProperties: false

examples:
  - |
    pinctrl@fc038000 {
        compatible = "atmel,sama5d2-pinctrl";
        reg = <0xfc038000 0x600>;
        interrupts = <18 IRQ_TYPE_LEVEL_HIGH 7>,
                     <68 IRQ_TYPE_LEVEL_HIGH 7>,
                     <69 IRQ_TYPE_LEVEL_HIGH 7>,
                     <70 IRQ_TYPE_LEVEL_HIGH 7>;
        interrupt-controller;
        #interrupt-cells = <2>;
        gpio-controller;
        #gpio-cells = <2>;
        clocks = <&pioA_clk>;
    };
```

## Documentation/devicetree/bindings/pinctrl/axis,artpec6-pinctrl.yaml
```yaml
# SPDX-License-Identifier: (GPL-2.0-only OR BSD-2-Clause)
# Copyright 2025 Axis AB
%YAML 1.2
---
$id: http://devicetree.org/schemas/pinctrl/axis,artpec6-pinctrl.yaml#
$schema: http://devicetree.org/meta-schemas/core.yaml#

title: Axis ARTPEC-6 Pin Controller
maintainers:
  - Jesper Nilsson <jesper.nilsson@axis.com>
  - Niklas Cassel <niklas.cassel@axis.com>

description: |
  Axis ARTPEC-6 Pin Controller

  A pinctrl node should contain at least one subnode representing the pinctrl
  groups available on the machine. Each subnode will list the mux function
  required and what pin group it will use. Each subnode will also configure the
  drive strength and bias pull-up of the pin group. If either of these options
  is not set, its actual value will be unspecified.

properties:
  compatible:
    const: axis,artpec6-pinctrl

  reg:
    items:
      - description: Base physical address of the pin controller registers
      - description: Length of the register region

  pinctrl-names:
    items:
      - const: default

patternProperties:
  ".*":
    $ref: "#/$defs/group"

additionalProperties: false

$defs:
  group:
    description: Pin controller group settings
    type: object
    additionalProperties: false
    properties:
      function:
        description: Function to mux.
        enum:
          - gpio
          - cpuclkout
          - udlclkout
          - i2c1
          - i2c2
          - i2c3
          - i2s0
          - i2s1
          - i2srefclk
          - spi0
          - spi1
          - pciedebug
          - uart0
          - uart1
          - uart2
          - uart3
          - uart4
          - uart5
          - nand
          - sdio0
          - sdio1
          - ethernet
      groups:
        description: Name of the pin group to use for the function.
        enum:
          - cpuclkoutgrp0
          - udlclkoutgrp0
          - i2c1grp0
          - i2c2grp0
          - i2c3grp0
          - i2s0grp0
          - i2s1grp0
          - i2srefclkgrp0
          - spi0grp0
          - spi1grp0
          - pciedebuggrp0
          - uart0grp0
          - uart0grp1
          - uart0grp2
          - uart1grp0
          - uart1grp1
          - uart2grp0
          - uart2grp1
          - uart2grp2
          - uart3grp0
          - uart4grp0
          - uart4grp1
          - uart5grp0
          - uart5grp1
          - uart5nocts
          - nandgrp0
          - sdio0grp0
          - sdio1grp0
          - ethernetgrp0
      drive-strength:
        description: Drive strength in mA.
        $ref: /schemas/types.yaml#/definitions/uint32
        enum:
          - 4
          - 6
          - 8
          - 9
      bias-pull-up:
        description: Enable bias pull-up.
        type: boolean
      bias-disable:
        description: Disable bias.
        type: boolean
    required:
      - function
      - groups
```

## Documentation/devicetree/bindings/pinctrl/bitmain,bm1880-pinctrl.yaml
```yaml
# SPDX-License-Identifier: (GPL-2.0-only OR BSD-2-Clause)
# Copyright 2025 Manivannan Sadhasivam <manivannan.sadhasivam@linaro.org>
%YAML 1.2
---
$id: http://devicetree.org/schemas/pinctrl/bitmain,bm1880-pinctrl.yaml#
$schema: http://devicetree.org/meta-schemas/core.yaml#

title: Bitmain BM1880 Pin Controller

maintainers:
  - Manivannan Sadhasivam <manivannan.sadhasivam@linaro.org>

description: |
  Bitmain BM1880 Pin Controller

  This binding describes the pin controller found in the BM1880 SoC.

  Please refer to pinctrl-bindings.txt in this directory for details of the
  common pinctrl bindings used by client devices, including the meaning of the
  phrase "pin configuration node".

  The pin configuration nodes act as a container for an arbitrary number of
  subnodes. Each of these subnodes represents some desired configuration for a
  pin, a group, or a list of pins or groups. This configuration for BM1880 SoC
  includes pinmux and various pin configuration parameters, such as pull-up,
  slew rate etc...

  Each configuration node can consist of multiple nodes describing the pinmux
  options. The name of each subnode is not important; all subnodes should be
  enumerated and processed purely based on their content.

properties:
  compatible:
    const: bitmain,bm1880-pinctrl

  reg:
    items:
      - description: Offset and length of pinctrl space in SCTRL.

patternProperties:
  "^(?!compatible$|reg$).*":
    description: A pin configuration node.
    type: object
    additionalProperties: false
    properties:
      pinmux:
        type: object
        description: Pin multiplexing parameters.
        additionalProperties: false
        properties:
          pins:
            $ref: /schemas/types.yaml#/definitions/string-array
            description: >
              List of pins. Valid values are MIO0 through MIO111.
          groups:
            $ref: /schemas/types.yaml#/definitions/string-array
            description: >
              List of pin group names. Valid values are nand_grp, spi_grp,
              emmc_grp, …, spi0_grp.
          function:
            $ref: /schemas/types.yaml#/definitions/string-array
            description: >
              List of pinmux functions. Valid values include nand, spi,
              emmc, …, spi0.
          bias-disable:
            type: boolean
            description: Disable pin bias.
          bias-pull-down:
            type: boolean
            description: Configure pins with pull-down.
          bias-pull-up:
            type: boolean
            description: Configure pins with pull-up.
          input-schmitt-enable:
            type: boolean
            description: Enable schmitt trigger.
          input-schmitt-disable:
            type: boolean
            description: Disable schmitt trigger.
          slew-rate:
            $ref: /schemas/types.yaml#/definitions/uint32
            description: >
              Sets slew rate. Valid values: 0 = Slow, 1 = Fast.
            enum: [0, 1]
          drive-strength:
            $ref: /schemas/types.yaml#/definitions/uint32
            description: >
              Selects drive strength in mA.
            enum: [4, 8, 12, 16, 20, 24, 28, 32]
        required:
          - pins
          - groups
          - function

required:
  - compatible
  - reg

additionalProperties: false

examples:
  - |
    pinctrl: pinctrl@400 {
      compatible = "bitmain,bm1880-pinctrl";
      reg = <0x400 0x120>;

      pinctrl_uart0_default: uart0-default {
        pinmux {
          groups = "uart0_grp";
          function = "uart0";
        };
      };
    };
```

## Documentation/devicetree/bindings/pinctrl/brcm,bcm2835-gpio.yaml
```yaml
# SPDX-License-Identifier: (GPL-2.0-only OR BSD-2-Clause)
%YAML 1.2
---
$id: http://devicetree.org/schemas/pinctrl/brcm,bcm2835-gpio.yaml#
$schema: http://devicetree.org/meta-schemas/core.yaml#

title: Broadcom BCM2835 GPIO (and pinmux) controller
maintainers:
  - Florian Fainelli <f.fainelli@gmail.com>
  - Masanari Iida <standby24x7@gmail.com>
  - Matheus Castello <matheus@castello.eng.br>
  - Simon Arlott <simon@octiron.net>
  - Stefan Wahren <wahrenst@gmx.net>
description: |
  Broadcom BCM2835 GPIO (and pinmux) controller

  The BCM2835 GPIO module is a combined GPIO controller, (GPIO) interrupt
  controller, and pinmux/control device.

  The BCM2835 pin configuration and multiplexing supports the generic bindings.
  For details on each property, refer to pinctrl-bindings.txt in this directory.

properties:
  compatible:
    description: >
      Valid compatible strings for this GPIO controller.
    items:
      - const: brcm,bcm2835-gpio
      - const: brcm,bcm2711-gpio
      - const: brcm,bcm7211-gpio

  reg:
    maxItems: 1

  gpio-controller: true

  '#gpio-cells':
    description: >
      GPIO specifier: pin number and optional polarity flags.
    const: 2

  interrupts:
    description: >
      Interrupt outputs: one per bank, then the combined “all banks” line.
      BCM7211 may specify up to four per-bank wake-up lines and one combined
      wake-up interrupt.
    items:
      description: >
        Interrupt specifier: GPIO number and trigger-type flags.
    minItems: 5
    maxItems: 10

  interrupt-controller: true

  '#interrupt-cells':
    const: 2

  pins:
    $ref: /schemas/pinctrl-bindings.yaml#/definitions/pins

  function:
    $ref: /schemas/pinctrl-bindings.yaml#/definitions/function

  bias-disable:
    $ref: /schemas/pinctrl-bindings.yaml#/definitions/bias-disable

  bias-pull-up:
    $ref: /schemas/pinctrl-bindings.yaml#/definitions/bias-pull-up

  bias-pull-down:
    $ref: /schemas/pinctrl-bindings.yaml#/definitions/bias-pull-down

  output-high:
    $ref: /schemas/pinctrl-bindings.yaml#/definitions/output-high

  output-low:
    $ref: /schemas/pinctrl-bindings.yaml#/definitions/output-low

  brcm,pins:
    description: >
      GPIO pin numbers for legacy configuration (deprecated).
    $ref: /schemas/types.yaml#/definitions/uint32-array

  brcm,function:
    description: >
      Legacy mux function for the pins (0=input, 1=output, 2–7=alt functions).
    $ref: /schemas/types.yaml#/definitions/uint32-array

  brcm,pull:
    description: >
      Legacy pull setting for the pins (0=none, 1=pull-down, 2=pull-up).
    $ref: /schemas/types.yaml#/definitions/uint32-array

additionalProperties: false

examples:
  - |
    gpio: gpio {
      compatible = "brcm,bcm2835-gpio";
      reg = <0x2200000 0xb4>;
      interrupts = <2 17>, <2 19>, <2 18>, <2 20>, <2 21>;
      gpio-controller;
      #gpio-cells = <2>;
      interrupt-controller;
      #interrupt-cells = <2>;
    };
```
