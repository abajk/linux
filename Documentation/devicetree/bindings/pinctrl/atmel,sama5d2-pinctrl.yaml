## Documentation/devicetree/bindings/pinctrl/brcm,cygnus-pinmux.yaml
```yaml
# SPDX-License-Identifier: (GPL-2.0-only OR BSD-2-Clause)
# Copyright 2025 Broadcom
%YAML 1.2
---
$id: http://devicetree.org/schemas/pinctrl/brcm,cygnus-pinmux.yaml#
$schema: http://devicetree.org/meta-schemas/core.yaml#

title: Broadcom Cygnus IOMUX Controller
maintainers:
  - Mathieu Malaterre <malat@debian.org>
  - Ray Jui <rjui@broadcom.com>

description: |
  The Broadcom Cygnus IOMUX controller supports group based mux configuration.
  In addition, certain pins can be muxed to GPIO function individually.

properties:
  compatible:
    items:
      - const: brcm,cygnus-pinmux

  reg:
    items:
      - description: I/O address base and range

  pinctrl-names:
    items:
      - const: default

  pinctrl-0:
    description: Phandle to the default pinmux configuration
    $ref: /schemas/types.yaml#/definitions/phandle

patternProperties:
  '^[A-Za-z0-9,_+-]+$':
    description: Pinmux configuration node
    type: object
    additionalProperties: false
    properties:
      mux:
        type: object
        description: Mux settings for this configuration
        additionalProperties: false
        properties:
          function:
            description: The mux function to select
            items:
              - enum: ["i2s0", "i2s1", "i2s2", "spdif", "pwm0", "pwm1", "pwm2", "pwm3", "pwm4", "pwm5", "key", "audio_dte", "smart_card0", "smart_card1", "spi0", "spi1", "spi2", "spi3", "spi4", "spi5", "sw_led0", "sw_led1", "sw_led2", "d1w", "lcd", "sram", "uart0", "uart1", "uart2", "uart3", "uart4", "qspi", "nand", "sdio0", "sdio1", "can0", "can1", "cam", "bsc1", "pcie_clkreq", "usb0_oc", "usb1_oc", "usb2_oc"]
          groups:
            description: The list of groups to select with a given function
            items:
              - enum: ["i2s0_0_grp", "i2s0_1_grp", "i2s1_0_grp", "i2s1_1_grp", "i2s2_0_grp", "i2s2_1_grp", "i2s2_2_grp", "i2s2_3_grp", "i2s2_4_grp", "spdif_grp", "pwm0_grp", "pwm1_grp", "pwm2_grp", "pwm3_grp", "pwm4_grp", "pwm5_grp", "key0_grp", "key1_grp", "key2_grp", "key3_grp", "key4_grp", "key5_grp", "key6_grp", "key7_grp", "key8_grp", "key9_grp", "key10_grp", "key11_grp", "key12_grp", "key13_grp", "key14_grp", "key15_grp", "audio_dte0_grp", "audio_dte1_grp", "audio_dte2_grp", "audio_dte3_grp", "smart_card0_grp", "smart_card0_fcb_grp", "smart_card1_grp", "smart_card1_fcb_grp", "spi0_grp", "spi1_grp", "spi2_grp", "spi3_grp", "spi4_0_grp", "spi4_1_grp", "spi5_grp", "sw_led0_0_grp", "sw_led0_1_grp", "sw_led1_grp", "sw_led2_0_grp", "sw_led2_1_grp", "d1w_grp", "lcd_grp", "sram_0_grp", "sram_1_grp", "uart0_grp", "uart1_grp", "uart1_dte_grp", "uart2_grp", "uart3_grp", "uart4_grp", "qspi_0_grp", "qspi_1_grp", "nand_grp", "sdio0_grp", "sdio0_cd_grp", "sdio0_mmc_grp", "sdio1_data_0_grp", "sdio1_data_1_grp", "sdio1_cd_grp", "sdio1_led_grp", "sdio1_mmc_grp", "can0_grp", "can1_grp", "cam_led_grp", "cam_0_grp", "cam_1_grp", "bsc1_grp", "pcie_clkreq_grp", "usb0_oc_grp", "usb1_oc_grp", "usb2_oc_grp"]

additionalProperties: false

examples:
  - |
    pinmux@0301d0c8 {
      compatible = "brcm,cygnus-pinmux";
      reg = <0x0301d0c8 0x1b0>;

      pinctrl-names = "default";
      pinctrl-0 = <&i2s0_default>;

      i2s0_default: i2s0_default {
        mux {
          function = "i2s0";
          groups = "i2s0_0_grp", "i2s0_1_grp";
        };
      };
    };
```

## Documentation/devicetree/bindings/pinctrl/brcm,iproc-gpio.yaml
```yaml
# SPDX-License-Identifier: (GPL-2.0-only OR BSD-2-Clause)
%YAML 1.2
---
$id: http://devicetree.org/schemas/pinctrl/brcm,iproc-gpio.yaml#
$schema: http://devicetree.org/meta-schemas/core.yaml#

title: Broadcom iProc GPIO/PINCONF Controller
maintainers:
  - Pramod Kumar <pramodku@broadcom.com>
  - Ray Jui <ray.jui@broadcom.com>

description: |
  Broadcom iProc GPIO/PINCONF Controller

properties:
  compatible:
    description: |
      "brcm,iproc-gpio" for the generic iProc based GPIO controller IP that
      supports full-featured pinctrl and GPIO functions used in various iProc
      based SoCs.
      May contain an SoC-specific compatibility string to accommodate any SoC-
      specific features:
      "brcm,cygnus-ccm-gpio", "brcm,cygnus-asiu-gpio", or
      "brcm,cygnus-crmu-gpio" for Cygnus SoCs.
      "brcm,iproc-nsp-gpio" for the iProc NSP SoC that has drive strength
      support disabled.
      "brcm,iproc-stingray-gpio" for the iProc Stingray SoC that has the
      general pinctrl support completely disabled in this IP block. In
      Stingray, a different IP block is used to handle pinctrl related
      functions.
    items:
      - enum:
          - brcm,iproc-gpio
          - brcm,cygnus-ccm-gpio
          - brcm,cygnus-asiu-gpio
          - brcm,cygnus-crmu-gpio
          - brcm,iproc-nsp-gpio
          - brcm,iproc-stingray-gpio

  reg:
    maxItems: 1

  ngpios:
    description: Total number of in-use slots in GPIO controller.

  "#gpio-cells":
    description: |
      Must be two. The first cell is the GPIO pin number (within the
      controller's pin space) and the second cell is used for the following:
      bit[0]: polarity (0 for active high and 1 for active low).
    const: 2

  gpio-controller: true

  interrupts:
    maxItems: 1

  interrupt-controller: true

  gpio-ranges:
    description: |
      Specifies the mapping between GPIO controller and pin-controller
      pins. Each entry is a phandle-array cell list of four integers:
        1. Phandle of pin-controller.
        2. GPIO base pin offset.
        3. Pin-control base pin offset.
        4. Number of GPIO pins which are linearly mapped from pin base.
    $ref: /schemas/types.yaml#/definitions/phandle-array

required:
  - compatible
  - reg
  - ngpios
  - "#gpio-cells"
  - gpio-controller

additionalProperties: false

patternProperties:
  ".*":
    description: Pin configuration child node.
    type: object
    additionalProperties: false
    properties:
      pins:
        description: The list of pins (within the controller's own pin space)
          that properties in the node apply to. Pin names are "gpio-<pin>".
        $ref: /schemas/types.yaml#/definitions/string-array
      bias-disable:
        description: Disable pin bias.
        type: boolean
      bias-pull-up:
        description: Enable internal pull-up resistor.
        type: boolean
      bias-pull-down:
        description: Enable internal pull-down resistor.
        type: boolean
      drive-strength:
        description: Valid drive strength values include 2, 4, 6, 8, 10, 12,
          14, 16 (mA).
        $ref: /schemas/types.yaml#/definitions/uint32
    required:
      - pins

examples:
  - |
    gpio_ccm: gpio@1800a000 {
        compatible = "brcm,cygnus-ccm-gpio";
        reg = <0x1800a000 0x50>,
              <0x0301d164 0x20>;
        ngpios = <24>;
        #gpio-cells = <2>;
        gpio-controller;
        interrupts = <GIC_SPI 84 IRQ_TYPE_LEVEL_HIGH>;
        interrupt-controller;

        touch_pins: touch_pins {
            pwr: pwr {
                pins = "gpio-0";
                drive-strength = <16>;
            };

            event: event {
                pins = "gpio-1";
                bias-pull-up;
            };
        };
    };

    gpio_asiu: gpio@180a5000 {
        compatible = "brcm,cygnus-asiu-gpio";
        reg = <0x180a5000 0x668>;
        ngpios = <146>;
        #gpio-cells = <2>;
        gpio-controller;
        interrupts = <GIC_SPI 174 IRQ_TYPE_LEVEL_HIGH>;
        interrupt-controller;
        gpio-ranges = <&pinctrl 0 42 1>,
                      <&pinctrl 1 44 3>;
    };
```

## Documentation/devicetree/bindings/pinctrl/brcm,ns2-pinmux.yaml
```yaml
# SPDX-License-Identifier: (GPL-2.0-only OR BSD-2-Clause)
# Copyright 2025 Broadcom Ltd.
%YAML 1.2
---
$id: http://devicetree.org/schemas/pinctrl/brcm,ns2-pinmux.yaml#
$schema: http://devicetree.org/meta-schemas/core.yaml#

title: Broadcom Northstar2 IOMUX Controller

maintainers:
  - Geert Uytterhoeven <geert+renesas@glider.be>
  - Yendapally Reddy Dhananjaya Reddy <yendapally.reddy@broadcom.com>

description: |
  Broadcom Northstar2 IOMUX Controller

  The Northstar2 IOMUX controller supports group based mux configuration. There
  are some individual pins that support modifying the pinconf parameters.

  For more details, refer to Documentation/devicetree/bindings/pinctrl/pinctrl-bindings.txt

properties:
  compatible:
    const: brcm,ns2-pinmux

  reg:
    maxItems: 1

patternProperties:
  "^[a-z0-9,-]+$":
    description: Pin group node properties
    type: object
    additionalProperties: false
    properties:
      function:
        description: The mux function to select
        $ref: /schemas/types.yaml#/definitions/string
      groups:
        description: List of groups to select with a given function
        items:
          enum: [
            nand_grp, nor_data_grp, nor_adv_grp, nor_addr_0_3_grp,
            nor_addr_4_5_grp, nor_addr_6_7_grp, nor_addr_8_9_grp,
            nor_addr_10_11_grp, nor_addr_12_15_grp,
            gpio_0_1_grp, gpio_2_5_grp, gpio_6_7_grp, gpio_8_9_grp,
            gpio_10_11_grp, gpio_12_13_grp, gpio_14_17_grp,
            gpio_18_19_grp, gpio_20_21_grp, gpio_22_23_grp,
            gpio_24_25_grp, gpio_26_27_grp, gpio_28_29_grp,
            gpio_30_31_grp,
            pcie_ab1_clk_wak_grp, pcie_a3_clk_wak_grp,
            pcie_b3_clk_wak_grp, pcie_b2_clk_wak_grp, pcie_a2_clk_wak_grp,
            uart0_modem_grp, uart0_rts_cts_grp, uart0_in_out_grp,
            uart1_ext_clk_grp, uart1_dcd_dsr_grp, uart1_ri_dtr_grp,
            uart1_rts_cts_grp, uart1_in_out_grp, uart2_rts_cts_grp,
            pwm_0_grp, pwm_1_grp, pwm_2_grp, pwm_3_grp
          ]
      pins:
        description: List of pin names to change configuration
        items:
          enum: [
            qspi_wp, qspi_hold, qspi_cs, qspi_sck, uart3_sin,
            uart3_sout, qspi_mosi, qspi_miso, spi0_fss, spi0_rxd,
            spi0_txd, spi0_sck, spi1_fss, spi1_rxd, spi1_txd,
            spi1_sck, sdio0_data7, sdio0_emmc_rst, sdio0_led_on,
            sdio0_wp, sdio0_data3, sdio0_data4, sdio0_data5,
            sdio0_data6, sdio0_cmd, sdio0_data0, sdio0_data1,
            sdio0_data2, sdio1_led_on, sdio1_wp, sdio0_cd_l,
            sdio0_clk, sdio1_data5, sdio1_data6, sdio1_data7,
            sdio1_emmc_rst, sdio1_data1, sdio1_data2, sdio1_data3,
            sdio1_data4, sdio1_cd_l, sdio1_clk, sdio1_cmd,
            sdio1_data0, ext_mdio_0, ext_mdc_0, usb3_p1_vbus_ppc,
            usb3_p1_overcurrent, usb3_p0_vbus_ppc,
            usb3_p0_overcurrent, usb2_presence_indication, usb2_vbus_present,
            usb2_vbus_ppc, usb2_overcurrent, sata_led1, sata_led0
          ]
      bias-disable: true
      bias-pull-down: true
      bias-pull-up: true
      drive-strength: true
      slew-rate: true
      input-enable: true
      input-disable: true
    required:
      - function
      - groups
      - pins

required:
  - compatible
  - reg
  - pinctrl-names

additionalProperties: false

examples:
  - |
    pinctrl: pinctrl@6501d130 {
        compatible = "brcm,ns2-pinmux";
        reg = <0x6501d130 0x08>,
              <0x660a0028 0x04>,
              <0x660009b0 0x40>;

        pinctrl-names = "default";
        pinctrl-0 = <&nand_sel>, <&uart3_rx>, <&sdio0_d4>;

        /* Select nand function */
        nand_sel: nand_sel {
            function = "nand";
            groups = "nand_grp";
        };

        /* Pull up the uart3 rx pin */
        uart3_rx: uart3_rx {
            pins = "uart3_sin";
            bias-pull-up;
        };

        /* Set the drive strength of sdio d4 pin */
        sdio0_d4: sdio0_d4 {
            pins = "sdio0_data4";
            drive-strength = <8>;
        };
    };
```

## Documentation/devicetree/bindings/pinctrl/brcm,nsp-gpio-a.yaml
```yaml
# SPDX-License-Identifier: (GPL-2.0-only OR BSD-2-Clause)
---
$schema: http://devicetree.org/meta-schemas/core.yaml#
$id: http://devicetree.org/schemas/pinctrl/brcm,nsp-gpio-a.yaml#

title: Broadcom Northstar plus (NSP) GPIO/PINCONF Controller

maintainers:
  - Yendapally Reddy Dhananjaya Reddy <yrdreddy@broadcom.com>

description: |
  Broadcom Northstar plus (NSP) GPIO/PINCONF Controller

  Required properties:
    - compatible: Must be "brcm,nsp-gpio-a"
    - reg: Register physical address and length for GPIO base and IO control registers
    - #gpio-cells: Must be two
    - gpio-controller: Specifies that the node is a GPIO controller
    - ngpios: Number of GPIOs supported (58x25 supports 32 and 58x23 supports 24)

  Optional properties:
    - interrupts: Interrupt ID(s)
    - interrupt-controller: Specifies that the node is an interrupt controller
    - gpio-ranges: Mapping between GPIO controller and pin-controller pins

properties:
  compatible:
    items:
      - const: brcm,nsp-gpio-a

  reg:
    description: Register physical address and length for GPIO base and IO control registers
    items:
      - description: GPIO base registers
      - description: IO control registers

  "#gpio-cells":
    const: 2

  gpio-controller: true

  ngpios:
    $ref: /schemas/types.yaml#/definitions/uint32
    description: Number of GPIOs supported (e.g., 32 for NSP-58x25, 24 for NSP-58x23)

  gpio-ranges:
    description: Mapping between GPIO controller and pin-controller pins
    items:
      - description: Phandle of pin-controller
      - description: GPIO base pin offset
      - description: Pin-control base pin offset
      - description: Number of GPIO pins mapped

  interrupt-controller: true

  interrupts:
    description: Interrupt ID(s)
    items:
      - description: Interrupt specifier

# Generic PINCONF child nodes for pin settings
definitions:
  child-nodes:
    description: Child nodes for pin configuration
    type: object
    additionalProperties: false
    properties:
      pins:
        $ref: /schemas/types.yaml#/definitions/string-array
        description: List of pins this setting applies to
      bias-disable: true
      bias-pull-up: true
      bias-pull-down: true
      drive-strength:
        $ref: /schemas/types.yaml#/definitions/uint32
        enum: [2, 4, 6, 8, 10, 12, 14, 16]
    required: [pins]

dependencies:
  gpio-controller: [ '#gpio-cells' ]
additionalProperties: false

examples:
  - |
    gpioa: gpio@18000020 {
        compatible = "brcm,nsp-gpio-a";
        reg = <0x18000020 0x100>,
              <0x1803f1c4 0x1c>;
        #gpio-cells = <2>;
        gpio-controller;
        ngpios = <32>;
        gpio-ranges = <&pinctrl 0 0 31>;
        interrupt-controller;
        interrupts = <GIC_SPI 85 IRQ_TYPE_LEVEL_HIGH>;

        /* Hog a few default settings */
        pinctrl-names = "default";
        pinctrl-0 = <&led>;
        led: led {
            pins = "gpio-1";
            bias-pull-up;
        };

        pwr: pwr {
            gpio-hog;
            gpios = <3 1>;
            output-high;
        };
    };
```
