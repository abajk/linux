## Documentation/devicetree/bindings/pinctrl/lantiq,pinctrl-falcon.yaml
```yaml
# SPDX-License-Identifier: (GPL-2.0-only OR BSD-2-Clause)
%YAML 1.2
---
$id: http://devicetree.org/schemas/lantiq,pinctrl-falcon.yaml#
$schema: http://devicetree.org/meta-schemas/core.yaml#
title: Lantiq FALCON pinmux controller
maintainers:
  - Thomas Langer <thomas.langer@lantiq.com>
description: |
  Lantiq FALCON pinmux controller

  Lantiq's pin configuration nodes act as a container for an arbitrary number of
  subnodes. Each of these subnodes represents some desired configuration for a
  pin, a group, or a list of pins or groups. This configuration can include the
  mux function to select on those group(s), and two pin configuration parameters:
  pull-up and open-drain

  The name of each subnode is not important as long as it is unique; all subnodes
  should be enumerated and processed purely based on their content.

  Each subnode only affects those parameters that are explicitly listed. In
  other words, a subnode that lists a mux function but no pin configuration
  parameters implies no information about any pin configuration parameters.
  Similarly, a pin subnode that describes a pullup parameter implies no
  information about e.g. the mux function.

  We support 2 types of nodes.

  Definition of mux function groups:

  Required subnode-properties:
  - lantiq,groups : An array of strings. Each string contains the name of a
    group. Valid values for these names are listed below.
  - lantiq,function: A string containing the name of the function to mux to
    the group. Valid values for function names are listed below.

  Valid values for group names:
    por
    ntr
    ntr8k
    hrst
    mdio
    bootled
    asc0
    spi
    spi cs0
    spi cs1
    i2c
    jtag
    slic
    pcm
    asc1

  Valid values for function names:
    rst
    ntr
    mdio
    led
    asc
    spi
    i2c
    jtag
    slic
    pcm

  Definition of pin configurations:

  Required subnode-properties:
  - lantiq,pins : An array of strings. Each string contains the name of a
    pin. Valid values for these names are listed in hardware docs.

  Optional subnode-properties:
  - lantiq,pull: Integer, representing the pull-down/up to apply to the pin.
      0: none, 1: down
  - lantiq,drive-current: Boolean, enables drive-current
  - lantiq,slew-rate: Boolean, enables slew-rate

properties:
  compatible:
    items:
      - const: lantiq,pinctrl-falcon

  reg:
    description: Register range for GPIO/pinmux controller
    items:
      - description: Base address
      - description: Length

patternProperties:
  ".*":
    oneOf:
      - type: object
        required:
          - lantiq,groups
          - lantiq,function
        properties:
          lantiq,groups:
            description: One or more mux group names
            $ref: /schemas/types.yaml#/definitions/string-array
            items:
              - enum: [por]
              - enum: [ntr]
              - enum: [ntr8k]
              - enum: [hrst]
              - enum: [mdio]
              - enum: [bootled]
              - enum: [asc0]
              - enum: [spi]
              - enum: [spi cs0]
              - enum: [spi cs1]
              - enum: [i2c]
              - enum: [jtag]
              - enum: [slic]
              - enum: [pcm]
              - enum: [asc1]
          lantiq,function:
            description: Function to mux to group
            enum: [rst, ntr, mdio, led, asc, spi, i2c, jtag, slic, pcm]
        additionalProperties: false

      - type: object
        required:
          - lantiq,pins
        properties:
          lantiq,pins:
            description: One or more pin names
            $ref: /schemas/types.yaml#/definitions/string-array
          lantiq,pull:
            description: Pull-down/up to apply to the pin (0=none, 1=down)
            $ref: /schemas/types.yaml#/definitions/uint32
            enum: [0, 1]
          lantiq,drive-current:
            description: Enable drive-current
            type: boolean
          lantiq,slew-rate:
            description: Enable slew-rate
            type: boolean
        additionalProperties: false

additionalProperties: false

examples:
  - |
    pinmux0 {
        compatible = "lantiq,pinctrl-falcon";
        reg = <0x... 0x...>;
        pinctrl-names = "default";
        pinctrl-0 = <&state_default>;

        state_default: pinmux {
            asc0 {
                lantiq,groups = "asc0";
                lantiq,function = "asc";
            };
            ntr {
                lantiq,groups = "ntr8k";
                lantiq,function = "ntr";
            };
            i2c {
                lantiq,groups = "i2c";
                lantiq,function = "i2c";
            };
            hrst {
                lantiq,groups = "hrst";
                lantiq,function = "rst";
            };
        };
    };
```

## Documentation/devicetree/bindings/pinctrl/lantiq,pinctrl-xway.yaml
```yaml
# SPDX-License-Identifier: (GPL-2.0-only OR BSD-2-Clause)
# Copyright 2025 Linaro Ltd.
---
$id: http://devicetree.org/schemas/pinctrl/lantiq,pinctrl-xway.yaml#
$schema: http://devicetree.org/meta-schemas/core.yaml#

title: Lantiq XWAY pinmux controller

maintainers:
  - Aleksander Jan Bajkowski <olek2@wp.pl>
  - Martin Schiller <mschiller@tdt.de>
  - Rob Herring <robh@kernel.org>
  - Thomas Langer <thomas.langer@lantiq.com>

description: |
  Please refer to pinctrl-bindings.txt in this directory for details of the
  common pinctrl bindings used by client devices, including the meaning of the
  phrase "pin configuration node".

  Lantiq's pin configuration nodes act as a container for an arbitrary number of
  subnodes. Each of these subnodes represents some desired configuration for a
  pin, a group, or a list of pins or groups. This configuration can include the
  mux function to select on those group(s), and two pin configuration parameters:
  pull-up and open-drain

  The name of each subnode is not important as long as it is unique; all subnodes
  should be enumerated and processed purely based on their content.

  Each subnode only affects those parameters that are explicitly listed. In
  other words, a subnode that lists a mux function but no pin configuration
  parameters implies no information about any pin configuration parameters.
  Similarly, a pin subnode that describes a pullup parameter implies no
  information about e.g. the mux function.

  We support 2 types of nodes.

  Definition of mux function groups:

  Required subnode-properties:
  - lantiq,groups : An array of strings. Each string contains the name of a group.
    Valid values for these names are listed below.
  - lantiq,function: A string containing the name of the function to mux to the
    group. Valid values for function names are listed below.

  Valid values for group and function names:

  AMAZON:
    mux groups: exin0, exin1, exin2, jtag, spi_di, spi_do, spi_clk, spi_cs1,
      spi_cs2, spi_cs3, spi_cs4, spi_cs5, spi_cs6, asc, stp, gpt1, gpt2,
      gpt3, clkout0, clkout1, clkout2, mdio, dfe led0, dfe led1, ephy led0,
      ephy led1, ephy led2
    functions: spi, asc, cgu, jtag, exin, stp, gpt, mdio, ephy, dfe

  DANUBE:
    mux groups: exin0, exin1, exin2, jtag, ebu a23, ebu a24, ebu a25, ebu clk,
      ebu cs1, ebu wait, nand ale, nand cs1, nand cle, spi_di, spi_do,
      spi_clk, spi_cs1, spi_cs2, spi_cs3, spi_cs4, spi_cs5, spi_cs6, asc0,
      asc0 cts rts, stp, nmi, gpt1, gpt2, gpt3, clkout0, clkout1, clkout2,
      clkout3, gnt1, gnt2, gnt3, req1, req2, req3, dfe led0, dfe led1
    functions: spi, asc, cgu, jtag, exin, stp, gpt, nmi, pci, ebu, dfe

  xRX100:
    mux groups: exin0, exin1, exin2, exin3, exin4, ebu a23, ebu a24, ebu a25,
      ebu clk, ebu cs1, ebu wait, nand ale, nand cs1, nand cle, nand rdy,
      nand rd, spi_di, spi_do, spi_clk, spi_cs1, spi_cs2, spi_cs3, spi_cs4,
      spi_cs5, spi_cs6, asc0, asc0 cts rts, stp, nmi, gpt1, gpt2, gpt3,
      clkout0, clkout1, clkout2, clkout3, gnt1, gnt2, gnt3, gnt4, req1,
      req2, req3, req4, mdio, dfe led0, dfe led1
    functions: spi, asc, cgu, exin, stp, gpt, nmi, pci, ebu, mdio, dfe

  xRX200:
    mux groups: exin0, exin1, exin2, exin3, exin4, ebu a23, ebu a24, ebu a25,
      ebu clk, ebu cs1, ebu wait, nand ale, nand cs1, nand cle, nand rdy,
      nand rd, spi_di, spi_do, spi_clk, spi_cs1, spi_cs2, spi_cs3, spi_cs4,
      spi_cs5, spi_cs6, usif uart_rx, usif uart_tx, usif uart_rts,
      usif uart_cts, usif uart_dtr, usif uart_dsr, usif uart_dcd,
      usif uart_ri, usif spi_di, usif spi_do, usif spi_clk, usif spi_cs0,
      usif spi_cs1, usif spi_cs2, stp, nmi, gpt1, gpt2, gpt3, clkout0,
      clkout1, clkout2, clkout3, gnt1, gnt2, gnt3, gnt4, req1, req2,
      req3, req4, mdio, dfe led0, dfe led1, gphy0 led0, gphy0 led1,
      gphy0 led2, gphy1 led0, gphy1 led1, gphy1 led2
    functions: spi, usif, cgu, exin, stp, gpt, nmi, pci, ebu, mdio, dfe, gphy

  xRX300:
    mux groups: exin0, exin1, exin2, exin4, nand ale, nand cs0, nand cs1,
      nand cle, nand rdy, nand rd, nand_d0, nand_d1, nand_d2, nand_d3,
      nand_d4, nand_d5, nand_d6, nand_d7, nand_d1, nand wr, nand wp, nand se,
      spi_di, spi_do, spi_clk, spi_cs1, spi_cs4, spi_cs6, usif uart_rx,
      usif uart_tx, usif spi_di, usif spi_do, usif spi_clk, usif spi_cs0,
      stp, clkout2, mdio, dfe led0, dfe led1, ephy0 led0, ephy0 led1,
      ephy1 led0, ephy1 led1
    functions: spi, usif, cgu, exin, stp, ebu, mdio, dfe, ephy

  Definition of pin configurations:

  Required subnode-properties:
  - lantiq,pins : An array of strings. Each string contains the name of a pin.
    Valid values for these names are listed below.

  Optional subnode-properties:
  - lantiq,pull: Integer, representing the pull-down/up to apply to the pin.
      0: none, 1: down, 2: up.
  - lantiq,open-drain: Boolean, enables open-drain on the defined pin.

  Valid values for AMAZON pin names: io0-io31.
  Valid values for DANUBE pin names: io0-io31.
  Valid values for xRX100 pin names: io0-io55.
  Valid values for xRX200 pin names: io0-io49.
  Valid values for xRX300 pin names: io0-io1, io3-io6, io8-io11, io13-io19,
    io23-io27, io34-io36, io42-io43, io48-io61.

properties:
  compatible:
    description: Compatible strings for Lantiq XWAY pinmux controllers.
    oneOf:
      - enum:
          - lantiq,ase-pinctrl
          - lantiq,danube-pinctrl
          - lantiq,xrx100-pinctrl
          - lantiq,xrx200-pinctrl
          - lantiq,xrx300-pinctrl
      - $ref: /schemas/types.yaml#/definitions/string-array
        items:
          enum:
            - lantiq,ase-pinctrl
            - lantiq,danube-pinctrl
            - lantiq,xrx100-pinctrl
            - lantiq,xrx200-pinctrl
            - lantiq,xrx300-pinctrl

  reg:
    description: Physical address and length of the gpio/pinmux register range.
    items:
      - description: Base address of the register range.
      - description: Length of the register range.

  pinctrl-names:
    description: Names for pinctrl configuration states.
    $ref: /schemas/types.yaml#/definitions/string-array

  pinctrl-0:
    description: Default pinctrl state phandle list.
    $ref: /schemas/types.yaml#/definitions/phandle-array

  '#gpio-cells':
    description: Number of cells in a GPIO specifier.
    const: 2

  gpio-controller:
    description: Indicates this device provides GPIO controller functionality.
    type: boolean

patternProperties:
  "^[a-zA-Z0-9_,-]+$":
    description: Pinmux configuration state subnodes (any name).
    type: object
    additionalProperties: false
    anyOf:
      - required: ["lantiq,groups", "lantiq,function"]
      - required: ["lantiq,pins"]
    properties:
      lantiq,groups:
        description: Mux groups to configure.
        $ref: /schemas/types.yaml#/definitions/string-array
        items:
          enum:
            - exin0
            - exin1
            - exin2
            - jtag
            - spi_di
            - spi_do
            - spi_clk
            - spi_cs1
            - spi_cs2
            - spi_cs3
            - spi_cs4
            - spi_cs5
            - spi_cs6
            - asc
            - stp
            - gpt1
            - gpt2
            - gpt3
            - clkout0
            - clkout1
            - clkout2
            - mdio
            - dfe led0
            - dfe led1
            - ephy led0
            - ephy led1
            - ephy led2
            - ebu a23
            - ebu a24
            - ebu a25
            - ebu clk
            - ebu cs1
            - ebu wait
            - nand ale
            - nand cs1
            - nand cle
            - asc0
            - asc0 cts rts
            - nmi
            - pci
            - req1
            - req2
            - req3
            - req4
            - gnt1
            - gnt2
            - gnt3
            - gnt4
            - usif uart_rx
            - usif uart_tx
            - usif spi_di
            - usif spi_do
            - usif spi_clk
            - usif spi_cs0
            - usif spi_cs1
            - usif spi_cs2
            - usif uart_rts
            - usif uart_cts
            - usif uart_dtr
            - usif uart_dsr
            - usif uart_dcd
            - usif uart_ri
            - nand rdy
            - nand rd
            - nand_cs0
            - nand_d0
            - nand_d1
            - nand_d2
            - nand_d3
            - nand_d4
            - nand_d5
            - nand_d6
            - nand_d7
      lantiq,function:
        description: Function to mux the specified groups to.
        enum:
          - spi
          - asc
          - cgu
          - jtag
          - exin
          - stp
          - gpt
          - mdio
          - ephy
          - dfe
          - pci
          - ebu
          - nmi
          - usif
          - gphy

      lantiq,pins:
        description: Pins to configure.
        $ref: /schemas/types.yaml#/definitions/string-array
        items:
          pattern: "^io(\\d|[1-5]\\d|6[0-1])$"

      lantiq,pull:
        description: |
          Pull-up/down setting: 0=none, 1=down, 2=up.
        $ref: /schemas/types.yaml#/definitions/uint32
        enum: [0, 1, 2]

      lantiq,open-drain:
        description: Enable open-drain on the pin.
        type: boolean

additionalProperties: false

examples:
  - |
    pinctrl: pinmux@e100b10 {
      compatible = "lantiq,danube-pinctrl";
      pinctrl-names = "default";
      pinctrl-0 = <&state_default>;

      #gpio-cells = <2>;
      gpio-controller;

      reg = <0xE100B10 0xA0>;

      state_default {
        stp {
          lantiq,groups = "stp";
          lantiq,function = "stp";
        };
        pci {
          lantiq,groups = "gnt1";
          lantiq,function = "pci";
        };
        conf_out {
          lantiq,pins = "io4", "io5", "io6";
          lantiq,open-drain;
          lantiq,pull = <0>;
        };
      };
    };
```
