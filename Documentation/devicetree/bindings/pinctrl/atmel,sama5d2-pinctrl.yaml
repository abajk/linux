## Documentation/devicetree/bindings/pinctrl/marvell,orion-pinctrl.yaml
```yaml
# SPDX-License-Identifier: (GPL-2.0-only OR BSD-2-Clause)
%YAML 1.2
---
$id: http://devicetree.org/schemas/pinctrl/marvell,orion-pinctrl.yaml#
$schema: http://devicetree.org/meta-schemas/core.yaml#

title: Marvell Orion pinctrl driver for mpp
maintainers:
  - Jamie Lentin <jm@lentin.co.uk>
  - Thomas Petazzoni <thomas.petazzoni@free-electrons.com>

description: |
  Marvell Orion SoC pinctrl driver for mpp

  Please refer to marvell,mvebu-pinctrl.txt in this directory for common binding
  part and usage.

  Available mpp pins/groups and functions:
  Note: brackets (x) are not part of the mpp name for marvell,function and given
  only for more detailed description in this document.

  * Marvell Orion 88f5181l

  name          pins     functions
  ================================================================================================
  mpp0          0        pcie(rstout), pci(req2), gpio
  mpp1          1        gpio, pci(gnt2)
  mpp2          2        gpio, pci(req3), pci-1(pme)
  mpp3          3        gpio, pci(gnt3)
  mpp4          4        gpio, pci(req4)
  mpp5          5        gpio, pci(gnt4)
  mpp6          6        gpio, pci(req5), pci-1(clk)
  mpp7          7        gpio, pci(gnt5), pci-1(clk)
  mpp8          8        gpio, ge(col)
  mpp9          9        gpio, ge(rxerr)
  mpp10         10       gpio, ge(crs)
  mpp11         11       gpio, ge(txerr)
  mpp12         12       gpio, ge(txd4)
  mpp13         13       gpio, ge(txd5)
  mpp14         14       gpio, ge(txd6)
  mpp15         15       gpio, ge(txd7)
  mpp16         16       ge(rxd4)
  mpp17         17       ge(rxd5)
  mpp18         18       ge(rxd6)
  mpp19         19       ge(rxd7)

  * Marvell Orion 88f5182

  name          pins     functions
  ================================================================================================
  mpp0          0        pcie(rstout), pci(req2), gpio
  mpp1          1        gpio, pci(gnt2)
  mpp2          2        gpio, pci(req3), pci-1(pme)
  mpp3          3        gpio, pci(gnt3)
  mpp4          4        gpio, pci(req4), bootnand(re), sata0(prsnt)
  mpp5          5        gpio, pci(gnt4), bootnand(we), sata1(prsnt)
  mpp6          6        gpio, pci(req5), nand(re0), sata0(act)
  mpp7          7        gpio, pci(gnt5), nand(we0), sata1(act)
  mpp8          8        gpio, ge(col)
  mpp9          9        gpio, ge(rxerr)
  mpp10         10       gpio, ge(crs)
  mpp11         11       gpio, ge(txerr)
  mpp12         12       gpio, ge(txd4), nand(re1), sata0(ledprsnt)
  mpp13         13       gpio, ge(txd5), nand(we1), sata1(ledprsnt)
  mpp14         14       gpio, ge(txd6), nand(re2), sata0(ledact)
  mpp15         15       gpio, ge(txd7), nand(we2), sata1(ledact)
  mpp16         16       uart1(rxd), ge(rxd4), gpio
  mpp17         17       uart1(txd), ge(rxd5), gpio
  mpp18         18       uart1(cts), ge(rxd6), gpio
  mpp19         19       uart1(rts), ge(rxd7), gpio

  * Marvell Orion 88f5281

  name          pins     functions
  ================================================================================================
  mpp0          0        pcie(rstout), pci(req2), gpio
  mpp1          1        gpio, pci(gnt2)
  mpp2          2        gpio, pci(req3), pci(pme)
  mpp3          3        gpio, pci(gnt3)
  mpp4          4        gpio, pci(req4), bootnand(re)
  mpp5          5        gpio, pci(gnt4), bootnand(we)
  mpp6          6        gpio, pci(req5), nand(re0)
  mpp7          7        gpio, pci(gnt5), nand(we0)
  mpp8          8        gpio, ge(col)
  mpp9          9        gpio, ge(rxerr)
  mpp10         10       gpio, ge(crs)
  mpp11         11       gpio, ge(txerr)
  mpp12         12       gpio, ge(txd4), nand(re1)
  mpp13         13       gpio, ge(txd5), nand(we1)
  mpp14         14       gpio, ge(txd6), nand(re2)
  mpp15         15       gpio, ge(txd7), nand(we2)
  mpp16         16       uart1(rxd), ge(rxd4)
  mpp17         17       uart1(txd), ge(rxd5)
  mpp18         18       uart1(cts), ge(rxd6)
  mpp19         19       uart1(rts), ge(rxd7)

properties:
  compatible:
    description: >
      Device compatibility for Marvell Orion SoCs pinctrl.
    items:
      - enum:
          - marvell,88f5181-pinctrl
          - marvell,88f5181l-pinctrl
          - marvell,88f5182-pinctrl
          - marvell,88f5281-pinctrl

  reg:
    description: >
      Two register areas defining the MPP registers.
    items:
      - description: First two contiguous MPP registers
      - description: Single final MPP register

required:
  - compatible
  - reg

additionalProperties: false

examples:
  - |
    pinctrl: pinctrl@ffa00000 {
        compatible = "marvell,88f5181-pinctrl";
        reg = <0x... 0x...>,
              <0x... 0x...>;
    };
```

## Documentation/devicetree/bindings/pinctrl/microchip,pic32-pinctrl.yaml
```yaml
# SPDX-License-Identifier: (GPL-2.0-only OR BSD-2-Clause)
%YAML 1.2
---
$id: http://devicetree.org/schemas/pinctrl/microchip,pic32-pinctrl.yaml#
$schema: http://devicetree.org/meta-schemas/core.yaml#

title: Microchip PIC32 Pin Controller

maintainers:
  - Geert Uytterhoeven <geert+renesas@glider.be>
  - Joshua Henderson <joshua.henderson@microchip.com>
  - Purna Chandra Mandal <purna.mandal@microchip.com>

description: |
  * Microchip PIC32 Pin Controller

  Please refer to pinctrl-bindings.txt, ../gpio/gpio.txt, and
  ../interrupt-controller/interrupts.txt for generic information regarding
  pin controller, GPIO, and interrupt bindings.

  PIC32 'pin configuration node' is a node of a group of pins which can be
  used for a specific device or function. This node represents configurations of
  pins, optional function, and optional mux related configuration.

properties:
  compatible:
    items:
      - enum: [microchip, pic32mada-pinctrl]
      - enum: [microchip, pic32mzda-pinctrl]
  reg:
    maxItems: 1

  clocks:
    maxItems: 1

  '#address-cells':
    const: 1

  '#size-cells':
    const: 1


required:
  - compatible
  - reg
  - clocks

definitions:
  pin-config:
    type: object
    description: Pin configuration sub-node
    properties:
      pins:
        $ref: /schemas/types.yaml#/definitions/string-array
        description: List of pins to which the configuration applies.
      function:
        $ref: /schemas/types.yaml#/definitions/string
        description: Mux function for the specified pins.
      bias-pull-up:
        type: boolean
        description: Enable weak pull-up.
      bias-pull-down:
        type: boolean
        description: Enable weak pull-down.
      input-enable:
        type: boolean
        description: Set the pin as an input.
      output-low:
        type: boolean
        description: Set the pin as an output level low.
      output-high:
        type: boolean
        description: Set the pin as an output level high.
      microchip,digital:
        type: boolean
        description: Enable digital I/O.
      microchip,analog:
        type: boolean
        description: Enable analog I/O.
    required:
      - pins
    additionalProperties: false

additionalProperties:
  $ref: '#/definitions/pin-config'

examples:
  - |
    pic32_pinctrl: pinctrl@1f801400 {
        #address-cells = <1>;
        #size-cells = <1>;
        compatible = "microchip,pic32mzda-pinctrl";
        reg = <0x1f801400 0x400>;
        clocks = <&rootclk PB1CLK>;

        pinctrl_uart2: pinctrl_uart2 {
            uart2-tx {
                pins = "G9";
                function = "U2TX";
                microchip,digital;
                output-low;
            };
            uart2-rx {
                pins = "B0";
                function = "U2RX";
                microchip,digital;
                input-enable;
            };
        };
    };

    uart2: serial@1f822200 {
        compatible = "microchip,pic32mzda-uart";
        reg = <0x1f822200 0x50>;
        pinctrl-names = "default";
        pinctrl-0 = <&pinctrl_uart2>;
    };
```

## Documentation/devicetree/bindings/pinctrl/nuvoton,npcm750-pinctrl.yaml
```yaml
# SPDX-License-Identifier: (GPL-2.0-only OR BSD-2-Clause)
---
$id: http://devicetree.org/schemas/nuvoton,npcm750-pinctrl.yaml#
$schema: http://devicetree.org/meta-schemas/core.yaml#

title: Nuvoton NPCM7XX Pin Controller
maintainers:
  - Geert Uytterhoeven <geert+renesas@glider.be>
  - Tomer Maimon <tmaimon77@gmail.com>

description: |
  Nuvoton NPCM7XX Pin Controllers

  The Nuvoton BMC NPCM7XX Pin Controller multi-function routed through
  the multiplexing block. Each pin supports GPIO functionality (GPIOx)
  and multiple functions that directly connect the pin to different
  hardware blocks.

properties:
  "#address-cells":
    const: 1
    description: Number of address cells for the pin controller node.
  "#size-cells":
    const: 1
    description: Number of size cells for the pin controller node.
  compatible:
    items:
      - const: nuvoton,npcm750-pinctrl
    description: The compatible string for the NPCM7XX pin controller.
  ranges:
    description: Mapping ranges between the pin controller register space and GPIO bank register spaces.
    items:
      - description: Offset within the controller register space.
      - description: Offset within the GPIO bank register space.
      - description: Size of the GPIO bank register space.

required:
  - "#address-cells"
  - "#size-cells"
  - compatible
  - ranges

additionalProperties: false

examples:
  - |
    pinctrl: pinctrl@f0800000 {
      #address-cells = <1>;
      #size-cells = <1>;
      compatible = "nuvoton,npcm750-pinctrl";
      ranges = <0 0xf0010000 0x8000>;

      gpio0: gpio@f0010000 {
        gpio-controller;
        #gpio-cells = <2>;
        reg = <0x0 0x80>;
        interrupts = <GIC_SPI 116 IRQ_TYPE_LEVEL_HIGH>;
        gpio-ranges = <&pinctrl 0 0 32>;
      };

      ...

      gpio7: gpio@f0017000 {
        gpio-controller;
        #gpio-cells = <2>;
        reg = <0x7000 0x80>;
        interrupts = <GIC_SPI 123 IRQ_TYPE_LEVEL_HIGH>;
        gpio-ranges = <&pinctrl 0 224 32>;
      };

      gpio0_iox1d1_pin: gpio0-iox1d1-pin {
        pins = "GPIO0/IOX1DI";
        output-high;
      };

      iox1_pins: iox1-pins {
        groups = "iox1";
        function = "iox1";
      };
      iox2_pins: iox2-pins {
        groups = "iox2";
        function = "iox2";
      };

      ...

      clkreq_pins: clkreq-pins {
        groups = "clkreq";
        function = "clkreq";
      };
    };
```
