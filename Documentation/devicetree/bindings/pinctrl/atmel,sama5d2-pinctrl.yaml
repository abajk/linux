## Documentation/devicetree/bindings/pinctrl/brcm,nsp-pinmux.yaml
```yaml
# SPDX-License-Identifier: (GPL-2.0-only OR BSD-2-Clause)
# Copyright 2025 Broadcom Corporation
%YAML 1.2
---
$id: http://devicetree.org/schemas/pinctrl/brcm,nsp-pinmux.yaml#
# $schema is the meta-schema this schema should be validated with.
$schema: http://devicetree.org/meta-schemas/core.yaml#

title: Broadcom NSP (Northstar plus) IOMUX Controller
maintainers:
  - Geert Uytterhoeven <geert+renesas@glider.be>
  - Yendapally Reddy Dhananjaya Reddy <yendapally.reddy@broadcom.com>

description: |
  Broadcom NSP (Northstar plus) IOMUX Controller

  The NSP IOMUX controller supports group based mux configuration. In
  addition, certain pins can be muxed to GPIO function individually.

  For more details, refer to
  Documentation/devicetree/bindings/pinctrl/pinctrl-bindings.txt

  List of supported functions and groups in Northstar Plus:

  "spi": "spi_grp"

  "i2c": "i2c_grp"

  "mdio": "mdio_grp"

  "pwm": "pwm0_grp", "pwm1_grp", "pwm2_grp", "pwm3_grp"

  "gpio_b": "gpio_b_0_grp", "gpio_b_1_grp", "gpio_b_2_grp", "gpio_b_3_grp"

  "uart1": "uart1_grp"

  "uart2": "uart2_grp"

  "synce": "synce_grp"

  "sata_led_grps": "sata0_led_grp", "sata1_led_grp"

  "xtal_out": "xtal_out_grp"

  "sdio": "sdio_pwr_grp", "sdio_1p8v_grp"

  "switch_led": "switch_p05_led0_grp", "switch_p05_led1_grp"

  "nand": "nand_grp"

  "emmc": "emmc_grp"

properties:
  compatible:
    items:
      - const: brcm,nsp-pinmux

  reg:
    description: IOMUX controller register blocks
    items:
      - description: GPIO_CONTROL0 register
      - description: GP_AUX_SEL register
      - description: IPROC_CONFIG IOMUX register

  pinctrl-names:
    description: Names for pinctrl configurations
    $ref: /schemas/types.yaml#/definitions/string-array
    items:
      - const: default

  pinctrl-0:
    description: Phandles for pinctrl default configuration
    $ref: /schemas/types.yaml#/definitions/phandle-array

patternProperties:
  "^.+$":
    type: object
    description: Pinmux function selector nodes
    properties:
      function:
        description: The mux function to select
        $ref: /schemas/types.yaml#/definitions/string
        enum:
          - spi
          - i2c
          - mdio
          - pwm
          - gpio_b
          - uart1
          - uart2
          - synce
          - sata_led_grps
          - xtal_out
          - sdio
          - switch_led
          - nand
          - emmc

      groups:
        description: The list of groups to select with a given function
        $ref: /schemas/types.yaml#/definitions/string-array
        items:
          - enum:
              - spi_grp
              - i2c_grp
              - mdio_grp
              - pwm0_grp
              - pwm1_grp
              - pwm2_grp
              - pwm3_grp
              - gpio_b_0_grp
              - gpio_b_1_grp
              - gpio_b_2_grp
              - gpio_b_3_grp
              - uart1_grp
              - uart2_grp
              - synce_grp
              - sata0_led_grp
              - sata1_led_grp
              - xtal_out_grp
              - sdio_pwr_grp
              - sdio_1p8v_grp
              - switch_p05_led0_grp
              - switch_p05_led1_grp
              - nand_grp
              - emmc_grp

    required:
      - function
      - groups

required:
  - compatible
  - reg

additionalProperties: false

examples:
  - |
    pinmux: pinmux@1803f1c0 {
      compatible = "brcm,nsp-pinmux";
      reg = <0x1803f1c0 0x04>,
            <0x18030028 0x04>,
            <0x1803f408 0x04>;

      pinctrl-names = "default";
      pinctrl-0 = <&pwm>, <&gpio_b>, <&nand_sel>;

      pwm: pwm {
        function = "pwm";
        groups = "pwm0_grp", "pwm1_grp";
      };

      gpio_b: gpio_b {
        function = "gpio_b";
        groups = "gpio_b_0_grp", "gpio_b_1_grp";
      };

      nand_sel: nand_sel {
        function = "nand";
        groups = "nand_grp";
      };
    };
```

## Documentation/devicetree/bindings/pinctrl/cnxt,cx92755-pinctrl.yaml
```yaml
# SPDX-License-Identifier: (GPL-2.0-only OR BSD-2-Clause)
# Copyright 2025 Baruch Siach <baruch@tkos.co.il>
%YAML 1.2
---
$id: http://devicetree.org/schemas/pinctrl/cnxt,cx92755-pinctrl.yaml#
$schema: http://devicetree.org/meta-schemas/core.yaml#

title: Conexant Digicolor CX92755 Pin Controller
maintainers:
  - Baruch Siach <baruch@tkos.co.il>

description: |
  Conexant Digicolor CX92755 General Purpose Pin Mapping

  This document describes the device tree binding of the pin mapping hardware
  modules in the Conexant Digicolor CX92755 SoCs. The CX92755 in one of the
  Digicolor series of SoCs.

properties:
  compatible:
    items:
      - const: cnxt,cx92755-pinctrl

  reg:
    description: Base address of the General Purpose Pin Mapping register block and the size of the block.
    items:
      - description: Base address
      - description: Size of the register block

  gpio-controller: true

  '#gpio-cells':
    const: 2

additionalProperties: false

examples:
  - |
    pinctrl: pinctrl@f0000e20 {
        compatible = "cnxt,cx92755-pinctrl";
        reg = <0xf0000e20 0x100>;
        gpio-controller;
        #gpio-cells = <2>;
    };
  - |
    pinctrl: pinctrl@f0000e20 {
        compatible = "cnxt,cx92755-pinctrl";
        reg = <0xf0000e20 0x100>;

        uart0_default: uart0_active {
            data_signals {
                pins = "GP_O0", "GP_O1";
                function = "client_b";
            };
        };
    };

    uart0: uart@f0000740 {
        compatible = "cnxt,cx92755-usart";
        ...
        pinctrl-0 = <&uart0_default>;
        pinctrl-names = "default";
    };
```

## Documentation/devicetree/bindings/pinctrl/cortina,gemini-pinctrl.yaml
```yaml
# SPDX-License-Identifier: (GPL-2.0-only OR BSD-2-Clause)
%YAML 1.2
---
$id: http://devicetree.org/schemas/cortina,gemini-pinctrl.yaml#
$schema: http://devicetree.org/meta-schemas/core.yaml#

title: Cortina Systems Gemini pin controller

maintainers:
  - Linus Walleij <linus.walleij@linaro.org>

description: |
  Cortina Systems Gemini pin controller

  This pin controller is found in the Cortina Systems Gemini SoC family,
  see further arm/gemini.txt. It is a purely group-based multiplexing pin
  controller.

  The pin controller node must be a subnode of the system controller node.

  Subnodes of the pin controller contain pin control multiplexing set-up
  and pin configuration of individual pins.

  Please refer to pinctrl-bindings.txt for generic pin multiplexing nodes
  and generic pin config nodes.

  Supported configurations:
  - skew-delay is supported on the Ethernet pins
  - drive-strength with 4, 8, 12 or 16 mA as argument is supported for
    entire groups on the groups "idegrp", "gmii_gmac0_grp", "gmii_gmac1_grp"
    and "pcigrp".

properties:
  compatible:
    items:
      - const: cortina,gemini-pinctrl

  pinctrl-names:
    description: Names for pin control states.
    $ref: /schemas/types.yaml#/definitions/string-array

patternProperties:
  "^pinctrl-\\d+$":
    description: Pin control phandles for each state as defined in "pinctrl-names".
    $ref: /schemas/types.yaml#/definitions/phandle-array

required:
  - compatible

additionalProperties: false

examples:
  - |
    pinctrl {
        compatible = "cortina,gemini-pinctrl";
        pinctrl-names = "default";
        pinctrl-0 = <&dram_default_pins>, <&system_default_pins>,
            <&vcontrol_default_pins>;
    };
```

## Documentation/devicetree/bindings/pinctrl/fsl,imx-pinctrl.yaml
```yaml
---
$id: http://devicetree.org/schemas/pinctrl/fsl,imx-pinctrl.yaml#
$schema: http://devicetree.org/meta-schemas/core.yaml#

title: Freescale i.MX IOMUX Controller pinctrl
maintainers:
  - Dirk Behme <dirk.behme@de.bosch.com>
  - Dong Aisheng <dong.aisheng@linaro.org>
  - Marco Franchi <marco.franchi@nxp.com>
  - Rob Herring <robh@kernel.org>
  - Shawn Guo <shawn.guo@linaro.org>

description: |
  * Freescale IOMUX Controller (IOMUXC) for i.MX

  The IOMUX Controller (IOMUXC), together with the IOMUX, enables the IC
  to share one PAD to several functional blocks. The sharing is done by
  multiplexing the PAD input/output signals. For each PAD there are up to
  8 muxing options (called ALT modes). Since different modules require
  different PAD settings (like pull up, keeper, etc) the IOMUXC controls
  also the PAD settings parameters.

  Please refer to pinctrl-bindings.txt in this directory for details of the
  common pinctrl bindings used by client devices, including the meaning of the
  phrase "pin configuration node".

  Freescale IMX pin configuration node is a node of a group of pins which can be
  used for a specific device or function. This node represents both mux and config
  of the pins in that group. The 'mux' selects the function mode (also named mux
  mode) this pin can work on and the 'config' configures various pad settings
  such as pull-up, open drain, drive strength, etc.

  Bits used for CONFIG:
  NO_PAD_CTL (1 << 31): indicate this pin does not need config.

  SION (1 << 30): Software Input On Field.
  Force the selected mux mode input path no matter of MUX_MODE functionality.
  By default the input path is determined by functionality of the selected
  mux mode (regular).

  Other bits are used for PAD setting.
  Please refer to each fsl,<soc>-pinctrl.txt binding doc for SoC specific part
  of bits definitions.

  NOTE:
    1. We have pin function node defined under iomux controller node to represent
       what pinmux functions this SoC supports.
    2. The pin configuration node intended to work on a specific function should
       be defined under that specific function node.
    3. The driver can use the function node’s name and pin configuration node’s
       name to describe the pin function and group hierarchy.
    4. Each pin configuration node should have a phandle; devices set pins
       configurations by referring to this phandle.

properties:
  compatible:
    description: IOMUX controller compatible string
    items:
      - pattern: '^fsl,imx.*-iomuxc$'
  reg:
    description: IOMUXC controller register region
    items:
      - description: base address of IOMUXC registers
      - description: size of IOMUXC register region

additionalProperties
  description: Pin configuration subnode for a function group
  type: object
  properties:
    fsl,pins:
      description: >
        Each entry is a tuple of six integers: a PIN_FUNC_ID macro encoding
        mux_reg, conf_reg, input_reg, mux_val, input_val, and the CONFIG
        pad setting value.
      $ref: /schemas/types.yaml#/definitions/uint32-matrix
      items:
        minItems: 6
        maxItems: 6
  required:
    - fsl,pins
  additionalProperties: false

required:
  - compatible
  - reg

examples:
  - |
    iomuxc@20e0000 {
      compatible = "fsl,imx6q-iomuxc";
      reg = <0x020e0000 0x4000>;

      /* shared pinctrl settings */
      usdhc4 {
        pinctrl_usdhc4_1: usdhc4grp-1 {
          fsl,pins = <
            MX6QDL_PAD_SD4_CMD__SD4_CMD    0x17059
            MX6QDL_PAD_SD4_CLK__SD4_CLK    0x10059
            MX6QDL_PAD_SD4_DAT0__SD4_DATA0 0x17059
            MX6QDL_PAD_SD4_DAT1__SD4_DATA1 0x17059
            MX6QDL_PAD_SD4_DAT2__SD4_DATA2 0x17059
            MX6QDL_PAD_SD4_DAT3__SD4_DATA3 0x17059
            MX6QDL_PAD_SD4_DAT4__SD4_DATA4 0x17059
            MX6QDL_PAD_SD4_DAT5__SD4_DATA5 0x17059
            MX6QDL_PAD_SD4_DAT6__SD4_DATA6 0x17059
            MX6QDL_PAD_SD4_DAT7__SD4_DATA7 0x17059
          >;
        };
      };
    };
```
