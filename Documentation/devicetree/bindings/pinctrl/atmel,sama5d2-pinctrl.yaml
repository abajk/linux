## Documentation/devicetree/bindings/pinctrl/marvell,armada-37xx-pinctrl.yaml
```yaml
# SPDX-License-Identifier: (GPL-2.0-only OR BSD-2-Clause)
%YAML 1.2
---
$id: http://devicetree.org/schemas/pinctrl/marvell,armada-37xx-pinctrl.yaml#
$schema: http://devicetree.org/meta-schemas/core.yaml#

title: Marvell Armada 37xx SoC pin and gpio controller

maintainers:
  - Gregory CLEMENT <gregory.clement@bootlin.com>
  - Marek Behún <kabel@kernel.org>
  - Miquel Raynal <miquel.raynal@bootlin.com>

description: |
  * Marvell Armada 37xx SoC pin and gpio controller

  Each Armada 37xx SoC come with two pin and gpio controller one for the
  south bridge and the other for the north bridge.

  Inside this set of register the gpio latch allows exposing some
  configuration of the SoC and especially the clock frequency of the
  xtal. Hence, this node is a represent as syscon allowing sharing the
  register between multiple hardware block.

  GPIO and pin controller:
  ------------------------

  Main node:

  Refer to pinctrl-bindings.txt in this directory for details of the
  common pinctrl bindings used by client devices, including the meaning
  of the phrase "pin configuration node".

properties:
  compatible:
    # Must list the pinctrl controller and the two framework bindings
    items:
      - enum:
          - marvell,armada3710-sb-pinctrl
          - marvell,armada3710-nb-pinctrl
      - const: syscon
      - const: simple-mfd

  reg:
    items:
      - description: pinctrl and GPIO controller registers
      - description: interrupt controller registers

  interrupts:
    description: List of interrupts used by the GPIO controller

  '#interrupt-cells':
    const: 2

  interrupt-controller: true

  gpio:
    description: GPIO controller subnode
    type: object
    additionalProperties: false
    properties:
      '#gpio-cells':
        const: 2
      gpio-ranges:
        description: Range of pins managed by the GPIO controller
      gpio-controller: true
      interrupts:
        description: List of interrupt specifiers for the GPIO controller
    required:
      - '#gpio-cells'
      - gpio-ranges
      - gpio-controller
      - interrupts

required:
  - compatible
  - reg
  - interrupts
  - '#interrupt-cells'
  - interrupt-controller

additionalProperties: false

examples:
  - |
    pinctrl_sb: pinctrl-sb@18800 {
        compatible = "marvell,armada3710-sb-pinctrl", "syscon", "simple-mfd";
        reg = <0x18800 0x100>, <0x18C00 0x20>;
        gpio {
            #gpio-cells = <2>;
            gpio-ranges = <&pinctrl_sb 0 0 29>;
            gpio-controller;
            interrupts =
                <GIC_SPI 160 IRQ_TYPE_LEVEL_HIGH>,
                <GIC_SPI 159 IRQ_TYPE_LEVEL_HIGH>,
                <GIC_SPI 158 IRQ_TYPE_LEVEL_HIGH>,
                <GIC_SPI 157 IRQ_TYPE_LEVEL_HIGH>,
                <GIC_SPI 156 IRQ_TYPE_LEVEL_HIGH>;
        };
    };
```

## Documentation/devicetree/bindings/pinctrl/marvell,berlin2-soc-pinctrl.yaml
```yaml
# SPDX-License-Identifier: (GPL-2.0-only OR BSD-2-Clause)
%YAML 1.2
---
$id: http://devicetree.org/schemas/pinctrl/marvell,berlin2-soc-pinctrl.yaml#
$schema: http://devicetree.org/meta-schemas/core.yaml#
title: Marvell Berlin pin-controller driver
maintainers:
  - Antoine Tenart <atenart@kernel.org>
  - Jisheng Zhang <jszhang@kernel.org>
description: |
  Pin-controller driver for the Marvell Berlin SoCs

  Pin control registers are part of both chip controller and system
  controller register sets. Pin controller nodes should be a sub-node of
  either the chip controller or system controller node. The pins
  controlled are organized in groups, so no actual pin information is
  needed.

  A pin-controller node should contain subnodes representing the pin group
  configurations, one per function. Each subnode has the group name and
  the muxing function used.

  Be aware the Marvell Berlin datasheets use the keyword 'mode' for what
  is called a 'function' in the pin-controller subsystem.

properties:
  compatible:
    description: |
      Driver compatible strings.
    $ref: /schemas/types.yaml#/definitions/string-array
    items:
      - enum:
          - marvell,berlin2-soc-pinctrl
          - marvell,berlin2-system-pinctrl
          - marvell,berlin2cd-soc-pinctrl
          - marvell,berlin2cd-system-pinctrl
          - marvell,berlin2q-soc-pinctrl
          - marvell,berlin2q-system-pinctrl
          - marvell,berlin4ct-avio-pinctrl
          - marvell,berlin4ct-soc-pinctrl
          - marvell,berlin4ct-system-pinctrl
          - syna,as370-soc-pinctrl

  pinctrl-0:
    description: Pin controller phandle to the group configuration.
    $ref: /schemas/types.yaml#/definitions/phandle-array

  pinctrl-names:
    description: Pin controller phandle names.
    $ref: /schemas/types.yaml#/definitions/string-array

patternProperties:
  ".*":
    description: Pin group configuration subnode.
    type: object
    required:
      - groups
      - function
    properties:
      groups:
        description: List of pin group names.
        $ref: /schemas/types.yaml#/definitions/string-array
      function:
        description: Function used to mux the group.
        $ref: /schemas/types.yaml#/definitions/string
    additionalProperties: false

additionalProperties: false

examples:
  - |
    sys_pinctrl: pin-controller {
        compatible = "marvell,berlin2q-system-pinctrl";

        uart0_pmux: uart0-pmux {
            groups = "GSM12";
            function = "uart0";
        };
    };

    &uart0 {
        pinctrl-0 = <&uart0_pmux>;
        pinctrl-names = "default";
    };
```

## Documentation/devicetree/bindings/pinctrl/marvell,dove-pinctrl.yaml
```yaml
# SPDX-License-Identifier: (GPL-2.0-only OR BSD-2-Clause)
# Copyright 2025 Sebastian Hesselbarth <sebastian.hesselbarth@gmail.com>
%YAML 1.2
---
$id: http://devicetree.org/schemas/pinctrl/marvell,dove-pinctrl.yaml#
$schema: http://devicetree.org/meta-schemas/core.yaml#

title: Marvell Dove pinctrl

maintainers:
  - Sebastian Hesselbarth <sebastian.hesselbarth@gmail.com>

description: |
  Marvell Dove SoC pinctrl driver for mpp

  Please refer to marvell,mvebu-pinctrl.txt in this directory for common binding
  part and usage.

  Notes:
  Note: brackets (x) are not part of the mpp name for marvell,function and given
  only for more detailed description in this document.
  Note: pmu* also allows for Power Management functions listed below

  Power Management functions (pmu*):
    pmu-nc               Pin not driven by any PM function
    pmu-low              Pin driven low (0)
    pmu-high             Pin driven high (1)
    pmic(sdi)            Pin is used for PMIC SDI
    cpu-pwr-down         Pin is used for CPU_PWRDWN
    standby-pwr-down     Pin is used for STBY_PWRDWN
    core-pwr-good        Pin is used for CORE_PWR_GOOD (Pins 0-7 only)
    cpu-pwr-good         Pin is used for CPU_PWR_GOOD (Pins 8-15 only)
    bat-fault            Pin is used for BATTERY_FAULT
    ext0-wakeup          Pin is used for EXT0_WU
    ext1-wakeup          Pin is used for EXT1_WU
    ext2-wakeup          Pin is used for EXT2_WU
    pmu-blink            Pin is used for blink function

  Notes:
  * group "mpp_audio1" allows the following functions and gpio pins:
    - gpio          : gpio on pins 52-57
    - i2s1/spdifo   : audio1 i2s on pins 52-55 and spdifo on 57, no gpios
    - i2s1          : audio1 i2s on pins 52-55, gpio on pins 56,57
    - spdifo        : spdifo on pin 57, gpio on pins 52-55
    - twsi          : twsi on pins 56,57, gpio on pins 52-55
    - ssp/spdifo    : ssp on pins 52-55, spdifo on pin 57, no gpios
    - ssp           : ssp on pins 52-55, gpio on pins 56,57
    - ssp/twsi      : ssp on pins 52-55, twsi on pins 56,57, no gpios
  * group "audio0" internally muxes i2s0 or ac97 controller to the dedicated
    audio0 pins.
  * group "twsi" internally muxes twsi controller to the dedicated or option
    pins.

properties:
  compatible:
    oneOf:
      - items:
          - enum:
              - marvell,dove-pinctrl

  clocks:
    description: Optional pdma clock
    items:
      $ref: /schemas/types.yaml#/definitions/phandle

  clock-names:
    items:
      - const: pdma

  reg:
    description: Register specifiers of MPP, MPP4, and PMU MPP registers
    items:
      - description: MPP registers
      - description: MPP4 registers
      - description: PMU MPP registers

  reg-names:
    items:
      - const: mpp
      - const: mpp4
      - const: pmu-mpp

required:
  - compatible
  - reg

examples:
  - |
    pinctrl: pinctrl@ff400000 {
        compatible = "marvell,dove-pinctrl";
        clocks = <&pdma_clk>;
        clock-names = "pdma";
        reg = <0x0 0x100>, <0x100 0x100>, <0x200 0x100>;
        reg-names = "mpp", "mpp4", "pmu-mpp";
    };

additionalProperties: false
```

## Documentation/devicetree/bindings/pinctrl/marvell,kirkwood-pinctrl.yaml
```yaml
# SPDX-License-Identifier: (GPL-2.0-only OR BSD-2-Clause)
# Copyright 2018 Linaro Ltd.

%YAML 1.2
---
$id: http://devicetree.org/schemas/pinctrl/marvell,kirkwood-pinctrl.yaml#
$schema: http://devicetree.org/meta-schemas/core.yaml#

title: Marvell Kirkwood SoC pinctrl driver for mpp

maintainers:
  - Andreas Klinger <ak@it-klinger.de>
  - Chris Packham <chris.packham@alliedtelesis.co.nz>
  - Sebastian Hesselbarth <sebastian.hesselbarth@gmail.com>
  - Valentin Longchamp <valentin.longchamp@keymile.com>

description: |
  Marvell Kirkwood SoC pinctrl driver for mpp

  Please refer to marvell,mvebu-pinctrl.txt in this directory for common binding
  part and usage.

  This driver supports all kirkwood variants, i.e. 88f6180, 88f619x, and 88f628x.
  It also supports the 88f6281-based variant in the 98dx412x Bobcat SoCs.

properties:
  compatible:
    description: List of compatible strings for Kirkwood pinctrl driver.
    items:
      - enum:
          - "marvell,88f6180-pinctrl"
          - "marvell,88f6190-pinctrl"
          - "marvell,88f6192-pinctrl"
          - "marvell,88f6281-pinctrl"
          - "marvell,88f6282-pinctrl"
          - "marvell,98dx4122-pinctrl"
          - "marvell,98dx1135-pinctrl"
  reg:
    description: Register specifier of MPP registers.
    items:
      - description: Register base address.
      - description: Register block size.

required:
  - compatible
  - reg

additionalProperties: false

examples:
  - |
    pinctrl@1000 {
      compatible = "marvell,88f6281-pinctrl";
      reg = <0x1000 0x1000>;
    };
```

## Documentation/devicetree/bindings/pinctrl/marvell,mvebu-pinctrl.yaml
```yaml
# SPDX-License-Identifier: (GPL-2.0-only OR BSD-2-Clause)
# Copyright 2025 Sebastian Hesselbarth
%YAML 1.2
---
$id: http://devicetree.org/schemas/pinctrl/marvell,mvebu-pinctrl.yaml#
$schema: http://devicetree.org/meta-schemas/core.yaml#

title: Marvell MVEBU SoC pinctrl controller
maintainers:
  - Sebastian Hesselbarth <sebastian.hesselbarth@gmail.com>

description: |
  * Marvell SoC pinctrl core driver for mpp

  The pinctrl driver enables Marvell SoCs to configure the multi-purpose pins
  (mpp) to a specific function. For each SoC family there is a SoC specific
  driver using this core driver.

  Please refer to pinctrl-bindings.txt in this directory for details of the
  common pinctrl bindings used by client devices, including the meaning of the
  phrase "pin configuration node".

  A Marvell SoC pin configuration node is a node of a group of pins which can
  be used for a specific device or function. Each node requires one or more
  mpp pins or group of pins and a mpp function common to all pins.

properties:
  compatible:
    items:
      - pattern: '^marvell,[a-z0-9-]+-pinctrl$'
    description: Device compatible string for the SoC pinctrl controller.

  reg:
    # The core schema already checks that reg values are numbers, so device
    # specific schema don't need to do those checks.
    # The description of each element defines the order and implicitly defines
    # the number of reg entries.
    items:
      - description: MPP controller register bank 0.
      - description: MPP controller register bank 1.
      - description: MPP controller register bank 2.
    # minItems/maxItems equal to 3 is implied

  child-nodes:
    description: Pin configuration subnodes defining groups of MPP pins and their function.
    type: object
    additionalProperties: false
    patternProperties:
      "^[a-zA-Z0-9,_+-]+$":
        type: object
        description: Pin configuration node.
        additionalProperties: false
        required:
          - marvell,pins
          - marvell,function
        properties:
          marvell,pins:
            description: List of MPP pins or pin groups to be muxed.
            $ref: /schemas/types.yaml#/definitions/string-array
            items:
              - description: MPP pin or pin group to be muxed.
          marvell,function:
            description: Function name to mux onto the pins.
            $ref: /schemas/types.yaml#/definitions/string

required:
  - compatible
  - reg

additionalProperties: false

examples:
  - |
    pinctrl: pinctrl@d0200 {
        compatible = "marvell,dove-pinctrl";
        reg = <0xd0200 0x14>, <0xd0440 0x04>, <0xd802c 0x08>;

        pmx_uart1_sw: pmx-uart1-sw {
            marvell,pins = "mpp_uart1";
            marvell,function = "uart1";
        };
    };
```
