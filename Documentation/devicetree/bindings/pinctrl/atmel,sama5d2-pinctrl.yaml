## Documentation/devicetree/bindings/pinctrl/fsl,imx23-pinctrl.yaml
```yaml
# SPDX-License-Identifier: (GPL-2.0-only OR BSD-2-Clause)
# Schema for Freescale MXS Pin Controller
%YAML 1.2
---
$id: http://devicetree.org/schemas/fsl,imx23-pinctrl.yaml#
$schema: http://devicetree.org/meta-schemas/core.yaml#

title: Freescale MXS Pin Controller

maintainers:
  - Alexandre Belloni <alexandre.belloni@bootlin.com>
  - Lothar Waßmann <LW@KARO-electronics.de>
  - Shawn Guo <shawn.guo@linaro.org>

description: |
  * Freescale MXS Pin Controller

  The pins controlled by mxs pin controller are organized in banks, each bank
  has 32 pins.  Each pin has 4 multiplexing functions, and generally, the 4th
  function is GPIO.  The configuration on the pins includes drive strength,
  voltage and pull-up.

  Please refer to pinctrl-bindings.txt in this directory for details of the
  common pinctrl bindings used by client devices.

  The node of mxs pin controller acts as a container for an arbitrary number of
  subnodes.  Each of these subnodes represents some desired configuration for
  a group of pins, and only affects those parameters that are explicitly listed.
  In other words, a subnode that describes a drive strength parameter implies no
  information about pull-up. For this reason, even seemingly boolean values are
  actually tristates in this binding: unspecified, off, or on. Unspecified is
  represented as an absent property, and off/on are represented as integer
  values 0 and 1.

  Those subnodes under mxs pin controller node will fall into two categories.
  One is to set up a group of pins for a function, both mux selection and pin
  configurations, and it's called group node in the binding document. The other
  one is to adjust the pin configuration for some particular pins that need a
  different configuration than what is defined in group node. The binding
  document calls this type of node config node.

  On mxs, there is no hardware pin group. The pin group in this binding only
  means a group of pins put together for particular peripheral to work in
  particular function, like SSP0 functioning as mmc0-8bit. That said, the
  group node should include all the pins needed for one function rather than
  having these pins defined in several group nodes. It also means each of
  "pinctrl-*" phandle in client device node should only have one group node
  pointed in there, while the phandle can have multiple config node referenced
  there to adjust configurations for some pins in the group.

properties:
  compatible:
    items:
      - enum:
          - fsl,imx23-pinctrl
          - fsl,imx28-pinctrl
    description: |
      Compatible string identifying this pin controller.

  reg:
    maxItems: 1

patternProperties:
  "^.*$":
    description: Configuration group or adjustment node for a set of pins.
    type: object
    additionalProperties: false
    properties:
      reg:
        description: Should be the index of the group nodes for same function. Required only for group nodes.
        maxItems: 1
        
      fsl,pinmux-ids:
        description: >
          Each integer in the array specifies a pin with given mux function,
          with bank, pin and mux packed as [15..12]: bank, [11..4]: pin, [3..0]: mux.
        $ref: /schemas/types.yaml#/definitions/uint32-array
      fsl,drive-strength:
        description: >
          Drive strength of pins: 0=MXS_DRIVE_4mA, 1=MXS_DRIVE_8mA, 2=MXS_DRIVE_12mA, 3=MXS_DRIVE_16mA.
        $ref: /schemas/types.yaml#/definitions/uint32
        enum: [0, 1, 2, 3]
      fsl,voltage:
        description: >
          Voltage selection: 0=MXS_VOLTAGE_LOW (1.8V), 1=MXS_VOLTAGE_HIGH (3.3V).
        $ref: /schemas/types.yaml#/definitions/uint32
        enum: [0, 1]
      fsl,pull-up:
        description: >
          Pull-up configuration: 0=MXS_PULL_DISABLE, 1=MXS_PULL_ENABLE.
        $ref: /schemas/types.yaml#/definitions/uint32
        enum: [0, 1]
    required:
      - fsl,pinmux-ids

required:
  - compatible
  - reg

additionalProperties: false

examples:
  - |
    pinctrl@80018000 {
        compatible = "fsl,imx28-pinctrl";
        reg = <0x80018000 2000>;

        mmc0_8bit_pins_a: mmc0-8bit@0 {
            reg = <0>;
            fsl,pinmux-ids = <
                MX28_PAD_SSP0_DATA0__SSP0_D0
                MX28_PAD_SSP0_DATA1__SSP0_D1
                MX28_PAD_SSP0_DATA2__SSP0_D2
                MX28_PAD_SSP0_DATA3__SSP0_D3
                MX28_PAD_SSP0_DATA4__SSP0_D4
                MX28_PAD_SSP0_DATA5__SSP0_D5
                MX28_PAD_SSP0_DATA6__SSP0_D6
                MX28_PAD_SSP0_DATA7__SSP0_D7
                MX28_PAD_SSP0_CMD__SSP0_CMD
                MX28_PAD_SSP0_DETECT__SSP0_CARD_DETECT
                MX28_PAD_SSP0_SCK__SSP0_SCK
            >;
            fsl,drive-strength = <0>;
            fsl,voltage = <1>;
            fsl,pull-up = <1>;
        };

        mmc_cd_cfg: mmc-cd-cfg {
            fsl,pinmux-ids = <MX28_PAD_SSP0_DETECT__SSP0_CARD_DETECT>;
            fsl,pull-up = <0>;
        };

        mmc_sck_cfg: mmc-sck-cfg {
            fsl,pinmux-ids = <MX28_PAD_SSP0_SCK__SSP0_SCK>;
            fsl,drive-strength = <2>;
            fsl,pull-up = <0>;
        };
    };
```

## Documentation/devicetree/bindings/pinctrl/fsl,imx27-iomuxc.yaml
```yaml
# SPDX-License-Identifier: (GPL-2.0-only OR BSD-2-Clause)
# Copyright 2025 BayLibre

%YAML 1.2
---
$id: http://devicetree.org/schemas/pinctrl/fsl,imx27-iomuxc.yaml#
$schema: http://devicetree.org/meta-schemas/core.yaml#

title: Freescale IMX27 IOMUX Controller

maintainers:
  - Markus Schneider-Pargmann <msp@baylibre.com>

description: |
  Freescale IMX27 IOMUX Controller

  The iomuxc driver node should define subnodes containing pinctrl
  configuration subnodes.

  The iomux controller has gpio child nodes which are embedded in
  the iomux control registers. They have to be defined as child nodes
  of the iomux device node. If gpio subnodes are defined
  "#address-cells", "#size-cells" and "ranges" properties for the iomux
  device node are required.

  For convenience there are macros defined in imx27-pinfunc.h which
  provide PIN and MUX_ID. They are structured as
  MX27_PAD_<Pad name>__<Signal name>. The names are defined in the
  i.MX27 reference manual.

properties:
  compatible:
    description: Must be "fsl,imx27-iomuxc"
    items:
      - const: fsl,imx27-iomuxc

  reg:
    description: Register address and size of the iomux controller
    items:
      - description: Base address of the iomuxc registers
      - description: Size of the iomuxc register region

  "#address-cells":
    description: Number of address cells for subordinate nodes
    const: 1

  "#size-cells":
    description: Number of size cells for subordinate nodes
    const: 1

  ranges:
    description: Address translation ranges

  fsl,pins:
    description: |
      Sequence of PIN, MUX_ID and CONFIG tuples.
      PIN is an integer between 0 and 0xbf.
      MUX_ID is a bitfield selecting function, direction and GPIO
      submodule settings.
      CONFIG is 0 (pullup disable) or 1 (pullup enable).
    items:
      - description: PIN (PORT * 32 + PORT_PIN)
        $ref: /schemas/types.yaml#/definitions/uint32
      - description: MUX_ID bitfield
        $ref: /schemas/types.yaml#/definitions/uint32
      - description: CONFIG value
        $ref: /schemas/types.yaml#/definitions/uint32

required:
  - compatible
  - reg

additionalProperties: false

examples:
  - |
    iomuxc: iomuxc@10015000 {
      compatible = "fsl,imx27-iomuxc";
      reg = <0x10015000 0x600>;
      #address-cells = <1>;
      #size-cells = <1>;
      ranges;

      gpio1: gpio@10015000 {
        /* ... */
      };

      uart {
        pinctrl_uart1: uart-1 {
          fsl,pins = <
            MX27_PAD_UART1_TXD__UART1_TXD 0x0
            MX27_PAD_UART1_RXD__UART1_RXD 0x0
            MX27_PAD_UART1_CTS__UART1_CTS 0x0
            MX27_PAD_UART1_RTS__UART1_RTS 0x0
          >;
        };
      };
    };
```

## Documentation/devicetree/bindings/pinctrl/img,pistachio-system-pinctrl.yaml
```yaml
# SPDX-License-Identifier: (GPL-2.0-only OR BSD-2-Clause)
%YAML 1.2
---
$id: http://devicetree.org/schemas/pinctrl/img,pistachio-system-pinctrl.yaml#
$schema: http://devicetree.org/meta-schemas/core.yaml#

title: Imagination Technologies Pistachio SoC system pin controller

maintainers:
  - Andrew Bresticker <abrestic@chromium.org>
  - Govindraj Raja <Govindraj.Raja@imgtec.com>
  - Rob Herring <robh@kernel.org>

description: |
  Imagination Technologies Pistachio SoC pin controllers

  The pin controllers on Pistachio are a combined GPIO controller, (GPIO)
  interrupt controller, and pinmux + pinconf device. The system ("east") pin
  controller on Pistachio has 99 pins, 90 of which are MFIOs which can be
  configured as GPIOs. The 90 GPIOs are divided into 6 banks of up to 16 GPIOs
  each. The GPIO banks are represented as sub-nodes of the pad controller node.

  Please refer to pinctrl-bindings.txt, ../gpio/gpio.txt, and
  ../interrupt-controller/interrupts.txt for generic information regarding
  pin controller, GPIO, and interrupt bindings.

properties:
  compatible:
    const: img,pistachio-system-pinctrl

  reg:
    maxItems: 1

patternProperties:
  '^gpio[0-9]+$':
    description: GPIO bank sub-nodes.
    type: object
    properties:
      interrupts:
        maxItems: 1

      gpio-controller: true

      '#gpio-cells':
        const: 2

      interrupt-controller: true

      '#interrupt-cells':
        const: 2
        description: >
          Must be two: the first cell is the GPIO pin number; the second cell encodes the interrupt flags.
    required:
      - interrupts
      - gpio-controller
      - '#gpio-cells'
      - interrupt-controller
      - '#interrupt-cells'
    additionalProperties: false

  '^.*$':
    description: Pin configuration sub-nodes.
    type: object
    $ref: /schemas/pinctrl/pincfg-node.yaml#

    properties:
      pins:
        $ref: /schemas/types.yaml#/definitions/string-array
        description: List of pins to which the configuration applies.
        items:
          pattern: "^(mfio([0-9]|[1-8][0-9])|tck|trstn|tdi|tms|tdo|jtag_comply|safe_mode|por_disable|resetn)$"

      function:
        $ref: /schemas/types.yaml#/definitions/string
        description: Mux function for the specified pins.
        enum:
          - spim1
          - spim0
          - uart1
          - spis
          - sdhost
          - mips_trace_clk
          - mips_trace_data
          - mips_trace_dint
          - mips_trace_trigout
          - mips_trace_trigin
          - mips_trace_dm
          - mips_trace_probe_n
          - i2c0
          - i2c1
          - i2c2
          - i2c3
          - i2s_out
          - audio_clk_in
          - debug_raw_cca_ind
          - debug_ed_sec20_cca_ind
          - debug_ed_sec40_cca_ind
          - debug_agc_done_0
          - debug_agc_done_1
          - debug_ed_cca_ind
          - debug_s2l_done
          - i2s_dac_clk
          - audio_sync
          - audio_trigger
          - i2s_in
          - spdif_in
          - uart0
          - spdif_out
          - eth
          - ir
          - pwmpdm
          - sram_debug
          - rom_debug
          - mdc_debug
          - rpu_debug
          - ddr_debug
          - mips_debug
          - eth_debug
          - mips_pll_lock
          - usb_debug
          - audio_pll_lock
          - rpu_v_pll_lock
          - rpu_l_pll_lock
          - sys_pll_lock
          - wifi_pll_lock
          - bt_pll_lock
          - dreq0
          - dreq1
          - dreq2
          - dreq3
          - dreq4
          - dreq5

      bias-high-impedance: true
      bias-pull-up: true
      bias-pull-down: true
      bias-bus-hold: true

      drive-strength:
        description: Drive strength in mA.
        enum:
          - 2
          - 4
          - 8
          - 12

      input-schmitt-enable: true
      input-schmitt-disable: true

      slew-rate:
        description: Slew rate control. 0 for slow, 1 for fast.
        enum:
          - 0
          - 1

    required:
      - pins

    additionalProperties: false

required:
  - compatible
  - reg

additionalProperties: false

examples:
  - |
    pinctrl@18101c00 {
      compatible = "img,pistachio-system-pinctrl";
      reg = <0x18101C00 0x400>;

      gpio0: gpio0 {
        interrupts = <GIC_SHARED 71 IRQ_TYPE_LEVEL_HIGH>;

        gpio-controller;
        #gpio-cells = <2>;

        interrupt-controller;
        #interrupt-cells = <2>;
      };

      gpio5: gpio5 {
        interrupts = <GIC_SHARED 76 IRQ_TYPE_LEVEL_HIGH>;

        gpio-controller;
        #gpio-cells = <2>;

        interrupt-controller;
        #interrupt-cells = <2>;
      };

      uart0_xfer: uart0-xfer {
        uart0-rxd {
          pins = "mfio55";
          function = "uart0";
        };
        uart0-txd {
          pins = "mfio56";
          function = "uart0";
        };
      };

      uart0_rts_cts: uart0-rts-cts {
        uart0-rts {
          pins = "mfio57";
          function = "uart0";
        };
        uart0-cts {
          pins = "mfio58";
          function = "uart0";
        };
      };
    };
```
