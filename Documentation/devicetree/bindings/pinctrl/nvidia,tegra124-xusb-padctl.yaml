## Documentation/devicetree/bindings/pinctrl/nvidia,tegra124-xusb-padctl.yaml
```yaml
# SPDX-License-Identifier: (GPL-2.0-only OR BSD-2-Clause)
# Copyright 2025 NVIDIA Corporation
%YAML 1.2
---
$id: http://devicetree.org/schemas/pinctrl/nvidia,tegra124-xusb-padctl.yaml#
$schema: http://devicetree.org/meta-schemas/core.yaml#

title: NVIDIA Tegra124 XUSB Pad Controller

maintainers:
  - Marco Franchi <marco.franchi@nxp.com>
  - Paul Walmsley <paul@pwsan.com>
  - Thierry Reding <treding@nvidia.com>

description: |
  Device tree binding for NVIDIA Tegra XUSB pad controller
  ========================================================

  NOTE: It turns out that this binding isn't an accurate description of the XUSB
  pad controller. While the description is good enough for the functional subset
  required for PCIe and SATA, it lacks the flexibility to represent the features
  needed for USB. For the new binding, see ../phy/nvidia,tegra-xusb-padctl.txt.
  The binding described in this file is deprecated and should not be used.

  The Tegra XUSB pad controller manages a set of lanes, each of which can be
  assigned to one out of a set of different pads. Some of these pads have an
  associated PHY that must be powered up before the pad can be used.

  This document defines the device-specific binding for the XUSB pad controller.

  Refer to pinctrl-bindings.txt in this directory for generic information about
  pin controller device tree bindings and ../phy/phy-bindings.txt for details on
  how to describe and reference PHYs in device trees.

  Lane muxing:

  Child nodes contain the pinmux configurations following the conventions from
  the pinctrl-bindings.txt document. Typically a single, static configuration is
  given and applied at boot time.

  Each subnode describes groups of lanes along with parameters and pads that
  they should be assigned to. The name of these subnodes is not important. All
  subnodes should be parsed solely based on their content.

  Each subnode only applies the parameters that are explicitly listed. In other
  words, if a subnode that lists a function but no pin configuration parameters
  implies no information about any pin configuration parameters. Similarly, a
  subnode that describes only an IDDQ parameter implies no information about
  what function the pins are assigned to. For this reason even seemingly boolean
  values are actually tristates in this binding: unspecified, off or on.
  Unspecified is represented as an absent property, and off/on are represented
  as integer values 0 and 1.

properties:
  compatible:
    oneOf:
      - items:
          - const: nvidia,tegra124-xusb-padctl
      - items:
          - enum:
              - nvidia,tegra132-xusb-padctl
              - nvidia,tegra210-xusb-padctl
          - const: nvidia-tegra124-xusb-padctl

  reg:
    description: Physical base address and size of the controller registers
    items:
      - description: Physical base address
      - description: Length of register region

  resets:
    description: Reset signals for the controller
    $ref: /schemas/types.yaml#/definitions/phandle-array

  reset-names:
    description: Names for each reset signal
    items:
      - const: padctl

  '#phy-cells':
    description: Number of PHY specifier cells
    const: 1

  pinctrl-0:
    description: Pin controller state phandles
    $ref: /schemas/types.yaml#/definitions/phandle-array

  pinctrl-names:
    description: Names for pin controller states
    $ref: /schemas/types.yaml#/definitions/string-array

additionalProperties: false

patternProperties:
  ".*":
    description: Pinmux subnode
    type: object
    additionalProperties: false
    properties:
      nvidia,lanes:
        description: Names of lanes in this group
        $ref: /schemas/types.yaml#/definitions/string-array
        items:
          enum:
            - otg-0
            - otg-1
            - otg-2
            - ulpi-0
            - hsic-0
            - hsic-1
            - pcie-0
            - pcie-1
            - pcie-2
            - pcie-3
            - pcie-4
            - sata-0

      nvidia,function:
        description: Function assigned to lanes
        enum:
          - snps
          - xusb
          - uart
          - rsvd
          - pcie
          - usb3
          - sata

      nvidia,iddq:
        description: 'IDDQ mode of the lanes (0: off, 1: on)'
        enum:
          - 0
          - 1

    required:
      - nvidia,lanes

examples:
  - |
    padctl@7009f000 {
      compatible = "nvidia,tegra124-xusb-padctl";
      reg = <0x7009f000 0x1000>;
      resets = <&tegra_car 142>;
      reset-names = "padctl";
      #phy-cells = <1>;
      pinctrl-0 = <&padctl_default>;
      pinctrl-names = "default";
    };
    padctl_default: pinmux {
      usb3 {
        nvidia,lanes = "pcie-0", "pcie-1";
        nvidia,function = "usb3";
        nvidia,iddq = <0>;
      };
      pcie {
        nvidia,lanes = "pcie-2", "pcie-3", "pcie-4";
        nvidia,function = "pcie";
        nvidia,iddq = <0>;
      };
      sata {
        nvidia,lanes = "sata-0";
        nvidia,function = "sata";
        nvidia,iddq = <0>;
      };
    };
```

## Documentation/devicetree/bindings/pinctrl/rockchip,rk805.yaml
```yaml
# SPDX-License-Identifier: (GPL-2.0-only OR BSD-2-Clause)
%YAML 1.2
---
$id: http://devicetree.org/schemas/pinctrl/rockchip,rk805.yaml#
$schema: http://devicetree.org/meta-schemas/core.yaml#

title: Rockchip RK805 Pin Controller

maintainers:
  - Bjorn Helgaas <bhelgaas@google.com>
  - Joseph Chen <chenjh@rock-chips.com>
  - Mauro Carvalho Chehab <mchehab@kernel.org>
  - Mauro Carvalho Chehab <mchehab+samsung@kernel.org>

description: |
  Pincontrol driver for RK805 Power management IC.

  RK805 has 2 pins which can be configured as GPIO output only.

  Please refer file <devicetree/bindings/pinctrl/pinctrl-bindings.txt>
  for details of the common pinctrl bindings used by client devices,
  including the meaning of the phrase "pin configuration node".

properties:
  compatible:
    items:
      - const: rockchip,rk805

  '#gpio-cells':
    const: 2
    description: The first cell is the pin number and the second is the GPIO flags.

  gpio-controller:
    description: Marks this node as a GPIO controller.
    type: boolean

  pinctrl-names:
    $ref: /schemas/types.yaml#/definitions/string-array
    description: List of pinctrl states.

  pinctrl-0:
    $ref: /schemas/types.yaml#/definitions/phandle-array
    description: Phandle list for the default pinctrl state.

patternProperties:
  '^.+$':
    description: Pin configuration sub-node.
    type: object
    properties:
      pins:
        $ref: /schemas/types.yaml#/definitions/string-array
        description: List of pins to configure. Valid values are "gpio0" or "gpio1".
        items:
          - enum: [gpio0]
          - enum: [gpio1]
      function:
        $ref: /schemas/types.yaml#/definitions/string
        description: Pin function. Must be "gpio".
        enum: [gpio]
      output-low:
        type: boolean
        description: Drive the pin low.
      output-high:
        type: boolean
        description: Drive the pin high.
    required:
      - pins
      - function
    additionalProperties: false

required:
  - compatible
  - gpio-controller
  - '#gpio-cells'

additionalProperties: false

examples:
  - |
    rk805: rk805@18 {
        compatible = "rockchip,rk805";
        gpio-controller;
        #gpio-cells = <2>;

        pinctrl-names = "default";
        pinctrl-0 = <&pmic_int_l>, <&rk805_default>;

        rk805_default: pinmux {
            gpio01 {
                pins = "gpio0", "gpio1";
                function = "gpio";
                output-high;
            };
        };
    };
```

## Documentation/devicetree/bindings/pinctrl/sirf,prima2-pinctrl.yaml
```yaml
# SPDX-License-Identifier: (GPL-2.0-only OR BSD-2-Clause)
# Copyright 2025 Barry Song <baohua@kernel.org>
#               Mathieu Malaterre <malat@debian.org>
#               Soren Brinkmann <soren.brinkmann@xilinx.com>
%YAML 1.2
---
$id: http://devicetree.org/schemas/sirf,prima2-pinctrl.yaml#
$schema: http://devicetree.org/meta-schemas/core.yaml#

title: CSR SiRFprimaII pinmux controller

maintainers:
  - Barry Song <baohua@kernel.org>
  - Mathieu Malaterre <malat@debian.org>
  - Soren Brinkmann <soren.brinkmann@xilinx.com>

description: |
  CSR SiRFprimaII pinmux controller

  Please refer to pinctrl-bindings.txt in this directory for details of the common
  pinctrl bindings used by client devices.

  SiRFprimaII's pinmux nodes act as a container for an arbitrary number of subnodes.
  Each of these subnodes represents some desired configuration for a group of pins.

properties:
  compatible:
    const: sirf,prima2-pinctrl

  reg:
    description: Address range of the pinctrl registers
    items:
      - description: Address range of the pinctrl registers

  interrupts:
    description: Interrupts used by every GPIO group
    items:
      - description: Interrupts used by every GPIO group

  gpio-controller: true
  '#gpio-cells':
    const: 2
  interrupt-controller: true

  sirf,pullups:
    description: if n-th bit of m-th bank is set, set a pullup on GPIO-n of bank m
    $ref: /schemas/types.yaml#/definitions/uint32-array

  sirf,pulldowns:
    description: if n-th bit of m-th bank is set, set a pulldown on GPIO-n of bank m
    $ref: /schemas/types.yaml#/definitions/uint32-array

additionalProperties: false

definitions:
  sirf,prima2-pinctrl-group:
    description: A subnode describing a group of pins to mux.
    type: object
    additionalProperties: false
    properties:
      sirf,pins:
        description: An array of strings. Each string contains the name of a group.
        $ref: /schemas/types.yaml#/definitions/string-array
      sirf,function:
        description: A string containing the name of the function to mux to the group.
        type: string
    required:
      - sirf,pins
      - sirf,function

patternProperties:
  "^.*$":
    $ref: "#/definitions/sirf,prima2-pinctrl-group"

examples:
  - |
    For example, pinctrl might have subnodes like the following:
        uart2_pins_a: uart2@0 {
            uart {
                sirf,pins = "uart2grp";
                sirf,function = "uart2";
            };
        };
        uart2_noflow_pins_a: uart2@1 {
            uart {
                sirf,pins = "uart2_nostreamctrlgrp";
                sirf,function = "uart2_nostreamctrl";
            };
        };

  - |
    For a specific board, if it wants to use uart2 without hardware flow control,
    it can add the following to its board-specific .dts file.
    uart2: uart@b0070000 {
        pinctrl-names = "default";
        pinctrl-0 = <&uart2_noflow_pins_a>;
    }
```

## Documentation/devicetree/bindings/pinctrl/sprd,sc9860-pinctrl.yaml
```yaml
# SPDX-License-Identifier: (GPL-2.0-only OR BSD-2-Clause)
%YAML 1.2
---
$id: http://devicetree.org/schemas/pinctrl/sprd,sc9860-pinctrl.yaml#
$schema: http://devicetree.org/meta-schemas/core.yaml#

title: Spreadtrum SC9860 Pin Controller
maintainers:
  - Baolin Wang <baolin.wang@linux.alibaba.com>

description: |
  Spreadtrum SC9860 Pin Controller

  Please refer to sprd,pinctrl.txt in this directory for common binding part
  and usage.

properties:
  compatible:
    items:
      - enum:
          - sprd,sc9860-pinctrl

  reg:
    items:
      - description: Register address and size.

  pins:
    description: Names of pins to configure.
    $ref: /schemas/types.yaml#/definitions/string-array

  function:
    description: Function to assign to the pins.
    enum:
      - func1
      - func2
      - func3
      - func4

  drive-strength:
    description: Drive strength in mA.
    $ref: /schemas/types.yaml#/definitions/uint32
    enum: [2, 4, 6, 8, 10, 12, 14, 16, 20, 21, 24, 25, 27, 29, 31, 33]

  input-schmitt-disable:
    description: Enable schmitt-trigger mode.
    type: boolean

  input-schmitt-enable:
    description: Disable schmitt-trigger mode.
    type: boolean

  bias-disable:
    description: Disable pin bias.
    type: boolean

  bias-pull-down:
    description: Pull down on pin.
    type: boolean

  bias-pull-up:
    description: Pull up on pin.
    $ref: /schemas/types.yaml#/definitions/uint32
    enum: [20000, 4700]

  input-enable:
    description: Enable pin input.
    type: boolean

  input-disable:
    description: Enable pin output.
    type: boolean

  output-high:
    description: Set the pin as an output level high.
    type: boolean

  output-low:
    description: Set the pin as an output level low.
    type: boolean

  sleep-hardware-state:
    description: Indicate these configs in sleep related state.
    type: boolean

  sprd,control:
    description: Control values referring to databook for global control pins.
    $ref: /schemas/types.yaml#/definitions/uint32

  sprd,sleep-mode:
    description: Pin sleep mode selection.
    $ref: /schemas/types.yaml#/definitions/uint32

required:
  - compatible
  - reg
  - pins

additionalProperties: false

examples:
  - |
    pin_controller: pinctrl@402a0000 {
        compatible = "sprd,sc9860-pinctrl";
        reg = <0x402a0000 0x10000>;

        grp1: sd0 {
            pins = "SC9860_VIO_SD2_IRTE", "SC9860_VIO_SD0_IRTE";
            sprd,control = <0x1>;
        };

        grp2: rfctl_33 {
            pins = "SC9860_RFCTL33";
            function = "func2";
            sprd,sleep-mode = <AP_SLEEP | PUBCP_SLEEP>;
            grp2_sleep_mode: rfctl_33_sleep {
                pins = "SC9860_RFCTL33";
                sleep-hardware-state;
                output-low;
            };
        };

        grp3: rfctl_misc_20 {
            pins = "SC9860_RFCTL20_MISC";
            drive-strength = <10>;
            bias-pull-up = <4700>;
            grp3_sleep_mode: rfctl_misc_sleep {
                pins = "SC9860_RFCTL20_MISC";
                sleep-hardware-state;
                bias-pull-up;
            };
        };
    };
```
