## Documentation/devicetree/bindings/power/reset/qnap,power-off.yaml
```yaml
# SPDX-License-Identifier: (GPL-2.0-only OR BSD-2-Clause)
%YAML 1.2
---
$id: http://devicetree.org/schemas/power/reset/qnap,power-off.yaml#
$schema: http://devicetree.org/meta-schemas/core.yaml#

title: QNAP and Synology NAS power-off microcontroller

maintainers:
  - Guenter Roeck <linux@roeck-us.net>
  - Sebastian Reichel <sre@kernel.org>

description: |
  QNAP NAS devices have a microcontroller controlling the main power
  supply. This microcontroller is connected to UART1 of the Kirkwood and
  Orion5x SoCs. Sending the character 'A', at 19200 baud, tells the
  microcontroller to turn the power off.

  Synology NAS devices use a similar scheme, but a different baud rate,
  9600, and a different character, '1'.

properties:
  compatible:
    description: List of supported compatible strings.
    items:
      - enum:
          - qnap,power-off
          - synology,power-off

  reg:
    description: Register address and length for the UART1 power-off controller.
    items:
      - description: UART1 register bank address and size.

  reg-names:
    description: Name of the register bank.
    items:
      - const: uart1

  clocks:
    description: Clock input for the tclk signal.
    items:
      - description: tclk clock

  clock-names:
    description: Name of the clock.
    items:
      - const: tclk

required:
  - compatible
  - reg
  - clocks

additionalProperties: false

examples:
  - |
    node@1000 {
        compatible = "qnap,power-off";
        reg = <0x1000 0x8>;
        reg-names = "uart1";
        clocks = <&tclk>;
        clock-names = "tclk";
    };
  - |
    node@2000 {
        compatible = "synology,power-off";
        reg = <0x2000 0x8>;
        reg-names = "uart1";
        clocks = <&tclk>;
        clock-names = "tclk";
    };
```

## Documentation/devicetree/bindings/power/reset/restart-poweroff.yaml
```yaml
# SPDX-License-Identifier: (GPL-2.0-only OR BSD-2-Clause)
%YAML 1.2
---
$id: http://devicetree.org/schemas/power/reset/restart-poweroff.yaml#
$schema: http://devicetree.org/meta-schemas/core.yaml#

title: Restart Power Off

maintainers:
  - Sebastian Reichel <sre@kernel.org>

description: |
  Buffalo Linkstation LS-XHL and LS-CHLv2, and other devices power off
  by restarting and letting u-boot keep hold of the machine until the
  user presses a button.

properties:
  compatible:
    items:
      - const: restart-poweroff

required:
  - compatible

additionalProperties: false

examples:
  - |
    node {
        compatible = "restart-poweroff";
    };
```

## Documentation/devicetree/bindings/power/reset/st,stih407-restart.yaml
```yaml
# SPDX-License-Identifier: (GPL-2.0-only OR BSD-2-Clause)
%YAML 1.2
---
$id: http://devicetree.org/schemas/power/reset/st,stih407-restart.yaml#
$schema: http://devicetree.org/meta-schemas/core.yaml#

title: ST SW reset controller for STIH407

maintainers:
  - Lee Jones <lee@kernel.org>
  - Peter Griffin <peter.griffin@linaro.org>
  - Rob Herring <robh@kernel.org>

description: |
  *Device-Tree bindings for ST SW reset functionality

properties:
  compatible:
    items:
      - const: st,stih407-restart
    description: ST SW reset controller compatible string.
  st,syscfg:
    description: Phandle to the ST syscfg register block controlling resets.
    $ref: /schemas/types.yaml#/definitions/phandle

required:
  - compatible
  - st,syscfg

additionalProperties: false

examples:
  - |
    restart {
      compatible = "st,stih407-restart";
      st,syscfg = <&syscfg_sbc_reg>;
    };
```

## Documentation/devicetree/bindings/power/reset/ti,keystone-reset.yaml
```yaml
# SPDX-License-Identifier: (GPL-2.0-only OR BSD-2-Clause)
# Copyright 2025 Texas Instruments Incorporated

%YAML 1.2
---
$id: http://devicetree.org/schemas/power/reset/ti,keystone-reset.yaml#
$schema: http://devicetree.org/meta-schemas/core.yaml#

title: TI Keystone Reset Controller

maintainers:
  - Ivan Khoronzhuk <ivan.khoronzhuk@ti.com>
  - Marco Franchi <marco.franchi@nxp.com>

description: |
  * Device tree bindings for Texas Instruments keystone reset

  This node is intended to allow SoC reset in case of software reset
  of selected watchdogs.

  The Keystone SoCs can contain up to 4 watchdog timers to reset
  SoC. Each watchdog timer event input is connected to the Reset Mux
  block. The Reset Mux block can be configured to cause reset or not.

  Additionally soft or hard reset can be configured.

properties:
  compatible:
    description: Must be "ti,keystone-reset".
    items:
      - const: ti,keystone-reset

  ti,soft-reset:
    description: Boolean option indicating soft reset; if absent hard reset is used.
    type: boolean

  ti,syscon-dev:
    description: Phandle and offset pair for device state control registers.
    items:
      - $ref: /schemas/types.yaml#/definitions/phandle
      - type: integer

  ti,syscon-pll:
    description: Phandle and offset pair for PLL controller registers.
    items:
      - $ref: /schemas/types.yaml#/definitions/phandle
      - type: integer

  ti,wdt-list:
    description: List of watchdog timers that can trigger SoC reset.
    $ref: /schemas/types.yaml#/definitions/uint32-array
    items:
      minimum: 0
      maximum: 3

required:
  - compatible
  - ti,syscon-pll
  - ti,syscon-dev

additionalProperties: false

examples:
  - |
    pllctrl: pll-controller@2310000 {
      compatible = "ti,keystone-pllctrl", "syscon";
      reg = <0x02310000 0x200>;
    };

    devctrl: device-state-control@2620000 {
      compatible = "ti,keystone-devctrl", "syscon";
      reg = <0x02620000 0x1000>;
    };

    rstctrl: reset-controller {
      compatible = "ti,keystone-reset";
      ti,syscon-pll = <&pllctrl 0xe4>;
      ti,syscon-dev = <&devctrl 0x328>;
      ti,wdt-list = <0>;
    };

  - |
    rstctrl: reset-controller {
      compatible = "ti,keystone-reset";
      ti,syscon-pll = <&pllctrl 0xe4>;
      ti,syscon-dev = <&devctrl 0x328>;
      ti,wdt-list = <0>, <2>;
      ti,soft-reset;
    };
```

## Documentation/devicetree/bindings/power/ti,omap3-smartreflex-core.yaml
```yaml
# SPDX-License-Identifier: (GPL-2.0-only OR BSD-2-Clause)
# Copyright 2025 Tony Lindgren <tony@atomide.com>

%YAML 1.2
---
$id: http://devicetree.org/schemas/power/ti,omap3-smartreflex-core.yaml#
$schema: http://devicetree.org/meta-schemas/core.yaml#

title: TI SmartReflex
maintainers:
  - Tony Lindgren <tony@atomide.com>

description: |
  Texas Instruments SmartReflex binding

  SmartReflex is used to set and adjust the SoC operating points.

properties:
  compatible:
    oneOf:
      - items:
          - enum:
              - ti,omap3-smartreflex-core
              - ti,omap3-smartreflex-mpu-iva
              - ti,omap4-smartreflex-core
              - ti,omap4-smartreflex-mpu
              - ti,omap4-smartreflex-iva
  reg:
    items:
      - description: SmartReflex module register window
  interrupts:
    items:
      - description: SmartReflex module interrupt
  ti,hwmods:
    description: TI interconnect module name for SmartReflex
    $ref: /schemas/types.yaml#/definitions/string

required:
  - compatible
  - reg
  - interrupts

additionalProperties: false

examples:
  - |
    smartreflex_iva: smartreflex@4a0db000 {
        compatible = "ti,omap4-smartreflex-iva";
        reg = <0x4a0db000 0x80>;
        interrupts = <GIC_SPI 102 IRQ_TYPE_LEVEL_HIGH>;
        ti,hwmods = "smartreflex_iva";
    };

    smartreflex_core: smartreflex@4a0dd000 {
        compatible = "ti,omap4-smartreflex-core";
        reg = <0x4a0dd000 0x80>;
        interrupts = <GIC_SPI 19 IRQ_TYPE_LEVEL_HIGH>;
        ti,hwmods = "smartreflex_core";
    };

    smartreflex_mpu: smartreflex@4a0d9000 {
        compatible = "ti,omap4-smartreflex-mpu";
        reg = <0x4a0d9000 0x80>;
        interrupts = <GIC_SPI 18 IRQ_TYPE_LEVEL_HIGH>;
        ti,hwmods = "smartreflex_mpu";
    };
```

## Documentation/devicetree/bindings/powerpc/4xx/ibm,476gtr-hsta-msi.yaml
```yaml
# SPDX-License-Identifier: (GPL-2.0-only OR BSD-2-Clause)
%YAML 1.2
---
$id: http://devicetree.org/schemas/powerpc/4xx/ibm,476gtr-hsta-msi.yaml#
$schema: http://devicetree.org/meta-schemas/core.yaml#

title: ppc476gtr High Speed Serial Assist (HSTA) node

maintainers:
  - Alistair Popple <alistair@popple.id.au>
  - Rob Herring <robh@kernel.org>

description: |
  The 476gtr SoC contains a high speed serial assist module attached
  between the plb4 and plb6 system buses to provide high speed data
  transfer between memory and system peripherals as well as support for
  PCI message signalled interrupts.

  Currently only the MSI support is used by Linux using the following
  device tree entries:

properties:
  compatible:
    oneOf:
      - items:
          - const: ibm,476gtr-hsta-msi
      - items:
          - const: ibm,hsta-msi
    description: Node compatible strings for HSTA MSI support.

  reg:
    description: Register mapping for the HSTA MSI space.
    items:
      - description: HSTA MSI register space

  interrupts:
    description: |
      Ordered interrupt mapping for each MSI in the register space. The first
      interrupt should be associated with a register offset of 0x00, the second
      to be 0x10, etc.
    minItems: 1
    maxItems: 2

required:
  - compatible
  - reg
  - interrupts

additionalProperties: false

examples:
  - |
    hsta@1000 {
        compatible = "ibm,476gtr-hsta-msi";
        reg = <0x1000 0x100>;
        interrupts = <32>;
    };
```
