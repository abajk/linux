## Documentation/devicetree/bindings/pinctrl/via,vt8500-pinctrl.yaml
```yaml
# SPDX-License-Identifier: (GPL-2.0-only OR BSD-2-Clause)
%YAML 1.2
---
$id: http://devicetree.org/schemas/bindings/pinctrl/via,vt8500-pinctrl.yaml#
$schema: http://devicetree.org/meta-schemas/core.yaml#

title: VIA VT8500 and WM8xxx-series pinmux/gpio controller

maintainers:
  - Tony Prisk <linux@prisktech.co.nz>

description: |
  VIA VT8500 and Wondermedia WM8xxx-series pinmux/gpio controller

  These SoCs contain a combined Pinmux/GPIO module. Each pin may operate as
  either a GPIO in, GPIO out or as an alternate function (I2C, SPI etc).

  Please refer to ../gpio/gpio.txt for a general description of GPIO bindings.

  Please refer to pinctrl-bindings.txt in this directory for details of the
  common pinctrl bindings used by client devices, including the meaning of the
  phrase "pin configuration node".

  Each pin configuration node lists the pin(s) to which it applies, and one or
  more of the mux functions to select on those pin(s), and pull-up/down
  configuration. Each subnode only affects those parameters that are explicitly
  listed. In other words, a subnode that lists only a mux function implies no
  information about any pull configuration. Similarly, a subnode that lists only
  a pull parameter implies no information about the mux function.

properties:
  compatible:
    items:
      - const: via,vt8500-pinctrl
      - const: wm,wm8505-pinctrl
      - const: wm,wm8650-pinctrl
      - const: wm,wm8750-pinctrl
      - const: wm,wm8850-pinctrl

  reg:
    maxItems: 1

  interrupt-controller: true

  '#interrupt-cells':
    const: 2

  gpio-controller: true

  '#gpio-cells':
    const: 2

  # Pin configuration subnodes
  pin-configuration:
    type: object
    additionalProperties: false
    properties:
      wm,pins:
        description: Array of pin IDs to configure.
        $ref: /schemas/types.yaml#/definitions/uint32-array
      wm,function:
        description: "Function to mux to the pin(s): 0 = GPIO in, 1 = GPIO out, 2 = alternate."
        $ref: /schemas/types.yaml#/definitions/uint32-array
      wm,pull:
        description: "Pull configuration for the pin(s): 0 = none, 1 = down, 2 = up."
        $ref: /schemas/types.yaml#/definitions/uint32-array
    required:
      - wm,pins

required:
  - compatible
  - reg
  - interrupt-controller
  - '#interrupt-cells'
  - gpio-controller
  - '#gpio-cells'

additionalProperties: false

examples:
  - |
    pinctrl: pinctrl {
        compatible = "wm,wm8505-pinctrl";
        reg = <0xD8110000 0x10000>;
        interrupt-controller;
        #interrupt-cells = <2>;
        gpio-controller;
        #gpio-cells = <2>;
    };
```

## Documentation/devicetree/bindings/power/actions,owl-sps.yaml
```yaml
# SPDX-License-Identifier: (GPL-2.0-only OR BSD-2-Clause)
# Copyright 2025 Andreas Färber
%YAML 1.2
---
$id: http://devicetree.org/schemas/power/actions,owl-sps.yaml#
$schema: http://devicetree.org/meta-schemas/core.yaml#

title: Actions Semi Owl Smart Power System (SPS)

maintainers:
  - Andreas Färber <afaerber@suse.de>
  - Manivannan Sadhasivam <manivannan.sadhasivam@linaro.org>

description: |
  Actions Semi Owl Smart Power System (SPS)

properties:
  compatible:
    description: >
      Device compatible string. Should be one of:
      actions, s500-sps (S500), actions, s700-sps (S700), actions, s900-sps (S900).
    items:
      - enum: ["actions,s500-sps", "actions,s700-sps", "actions,s900-sps"]

  reg:
    description: Register base address and size.
    items:
      - description: Register base address.
      - description: Register length.

  '#power-domain-cells':
    description: >
      Number of power-domain cells for the device. Must be 1.
    const: 1

required:
  - compatible
  - reg
  - '#power-domain-cells'

additionalProperties: false

examples:
  - |
    sps: power-controller@b01b0100 {
        compatible = "actions,s500-sps";
        reg = <0xb01b0100 0x100>;
        #power-domain-cells = <1>;
    };
```

## Documentation/devicetree/bindings/power/active-semi,act8846.yaml
```yaml
# SPDX-License-Identifier: (GPL-2.0-only OR BSD-2-Clause)
# Copyright 2018 Linaro Ltd.
%YAML 1.2
---
$id: http://devicetree.org/schemas/active-semi,act8846.yaml#
$schema: http://devicetree.org/meta-schemas/core.yaml#

title: Generic system power controller

maintainers:
  - Rob Herring <robh@kernel.org>
  - Romain Perier <romain.perier@gmail.com>

description: |
  * Generic system power control capability

  Power-management integrated circuits or miscellaneous hardware components are
  sometimes able to control the system power. The device driver associated with these
  components might need to define this capability, which tells the kernel that
  it can be used to switch off the system. The corresponding device must have the
  standard property "system-power-controller" in its device node. This property
  marks the device as able to control the system power. In order to test if this
  property is found programmatically, use the helper function
  "of_device_is_system_power_controller" from of.h .

properties:
  compatible:
    items:
      - enum: [active-semi, act8846]
  system-power-controller:
    description: Device is a system power controller and can switch off the system.
    type: boolean

required:
  - compatible
  - system-power-controller

additionalProperties: false

examples:
  - |
    act8846: act8846@5 {
        compatible = "active-semi,act8846";
        system-power-controller;
    };
```

## Documentation/devicetree/bindings/power/amlogic,meson-gx-pwrc-vpu.yaml
```yaml
# SPDX-License-Identifier: (GPL-2.0-only OR BSD-2-Clause)
# Copyright 2025 Linaro Ltd.
%YAML 1.2
---
$id: http://devicetree.org/schemas/power/amlogic,meson-gx-pwrc-vpu.yaml#
$schema: http://devicetree.org/meta-schemas/core.yaml#

title: Amlogic Meson Power Controller VPU Power Domain

maintainers:
  - Krzysztof Kozlowski <krzk@kernel.org>
  - Neil Armstrong <neil.armstrong@linaro.org>

description: |
  Amlogic Meson Power Controller (deprecated)

  The Amlogic Meson SoCs embeds an internal Power domain controller.

  VPU Power Domain

  The Video Processing Unit power domain is controlled by this power controller,
  but the domain requires some external resources to meet the correct power
  sequences. The bindings must respect the power domain bindings as described
  in the file power-domain.yaml

properties:
  compatible:
    description: Device compatibility strings.
    oneOf:
      - items:
          - const: amlogic,meson-gx-pwrc-vpu
          - const: amlogic,meson-g12a-pwrc-vpu

  '#power-domain-cells':
    description: Number of power-domain cells.
    const: 0

  amlogic,hhi-sysctrl:
    description: Phandle to the HHI sysctrl node.
    $ref: /schemas/types.yaml#/definitions/phandle

  resets:
    description: >
      Phandles to the reset lines needed for this power domain sequence as
      described in ../reset/reset.yaml
    items:
      - $ref: /schemas/types.yaml#/definitions/phandle
        description: RESET_VIU
      - $ref: /schemas/types.yaml#/definitions/phandle
        description: RESET_VENC
      - $ref: /schemas/types.yaml#/definitions/phandle
        description: RESET_VCBUS
      - $ref: /schemas/types.yaml#/definitions/phandle
        description: RESET_BT656
      - $ref: /schemas/types.yaml#/definitions/phandle
        description: RESET_DVIN_RESET
      - $ref: /schemas/types.yaml#/definitions/phandle
        description: RESET_RDMA
      - $ref: /schemas/types.yaml#/definitions/phandle
        description: RESET_VENCI
      - $ref: /schemas/types.yaml#/definitions/phandle
        description: RESET_VENCP
      - $ref: /schemas/types.yaml#/definitions/phandle
        description: RESET_VDAC
      - $ref: /schemas/types.yaml#/definitions/phandle
        description: RESET_VDI6
      - $ref: /schemas/types.yaml#/definitions/phandle
        description: RESET_VENCL
      - $ref: /schemas/types.yaml#/definitions/phandle
        description: RESET_VID_LOCK

  clocks:
    description: Clocks for the VPU and VAPB domains.
    items:
      - $ref: /schemas/types.yaml#/definitions/phandle
        description: VPU clock
      - $ref: /schemas/types.yaml#/definitions/phandle
        description: VAPB clock

  clock-names:
    description: Names for the VPU and VAPB clocks.
    items:
      - const: vpu
      - const: vapb

required:
  - compatible
  - '#power-domain-cells'
  - amlogic,hhi-sysctrl
  - resets
  - clocks
  - clock-names

additionalProperties: false

examples:
  - |
    ao_sysctrl: sys-ctrl@0 {
        compatible = "amlogic,meson-gx-ao-sysctrl", "syscon", "simple-mfd";
        reg =  <0x0 0x0 0x0 0x100>;

        pwrc_vpu: power-controller-vpu {
            compatible = "amlogic,meson-gx-pwrc-vpu";
            #power-domain-cells = <0>;
            amlogic,hhi-sysctrl = <&sysctrl>;
            resets = <&reset RESET_VIU>,
                     <&reset RESET_VENC>,
                     <&reset RESET_VCBUS>,
                     <&reset RESET_BT656>,
                     <&reset RESET_DVIN_RESET>,
                     <&reset RESET_RDMA>,
                     <&reset RESET_VENCI>,
                     <&reset RESET_VENCP>,
                     <&reset RESET_VDAC>,
                     <&reset RESET_VDI6>,
                     <&reset RESET_VENCL>,
                     <&reset RESET_VID_LOCK>;
            clocks = <&clkc CLKID_VPU>,
                     <&clkc CLKID_VAPB>;
            clock-names = "vpu", "vapb";
        };
    };
```

## Documentation/devicetree/bindings/power/reset/cortina,gemini-power-controller.yaml
```yaml
# SPDX-License-Identifier: (GPL-2.0-only OR BSD-2-Clause)
# Copyright 2025 Linus Walleij <linus.walleij@linaro.org>
%YAML 1.2
---
$id: http://devicetree.org/schemas/power/reset/cortina,gemini-power-controller.yaml#
# $schema is the meta-schema this schema should be validated with.
$schema: http://devicetree.org/meta-schemas/core.yaml#
title: Cortina Systems Gemini Poweroff
maintainers:
  - Linus Walleij <linus.walleij@linaro.org>
description: |
  * Device-Tree bindings for Cortina Systems Gemini Poweroff

  This is a special IP block in the Cortina Gemini SoC that only
  deals with different ways to power the system down.
properties:
  compatible:
    items:
      - const: cortina,gemini-power-controller
  reg:
    items:
      - description: Physical memory base address of the controller registers
      - description: Size of the controller register space
  interrupts:
    items:
      - description: Power management interrupt
required:
  - compatible
  - reg
  - interrupts
additionalProperties: false
examples:
  - |
    power-controller@4b000000 {
        compatible = "cortina,gemini-power-controller";
        reg = <0x4b000000 0x100>;
        interrupts = <26 IRQ_TYPE_EDGE_FALLING>;
    };
```

## Documentation/devicetree/bindings/power/reset/lltc,ltc2952.yaml
```yaml
# SPDX-License-Identifier: (GPL-2.0-only OR BSD-2-Clause)
%YAML 1.2
---
$id: http://devicetree.org/schemas/power/reset/lltc,ltc2952.yaml#
$schema: http://devicetree.org/meta-schemas/core.yaml#

title: LTC2952 PowerPath controller

maintainers:
  - Frans Klaver <frans.klaver@xsens.com>
  - Marek Czerski <ma.czerski@gmail.com>
  - René Moll <Rene.Moll@xsens.com>

description: |
  Binding for the LTC2952 PowerPath controller

  This chip is used to externally trigger a system shut down. Once the trigger has
  been sent, the chip's watchdog has to be reset to gracefully shut down.
  A full powerdown can be triggered via the kill signal.

properties:
  compatible:
    description: Compatibility string for the LTC2952 PowerPath controller.
    items:
      - const: "lltc,ltc2952"
  kill-gpios:
    description: GPIO connected to the chip's kill line.
  trigger-gpios:
    description: GPIO connected to the chip's trigger line. If this property
      is not set, the trigger function is ignored and the chip is kept alive
      until an explicit kill signal is received.
  watchdog-gpios:
    description: GPIO connected to the chip's watchdog line.
  trigger-delay-ms:
    description: The number of milliseconds to wait after trigger line assertion
      before executing the shut down procedure.
    default: 2500

required:
  - compatible
  - kill-gpios
  - watchdog-gpios

additionalProperties: false

examples:
  - |
    ltc2952 {
        compatible = "lltc,ltc2952";
        kill-gpios = <&gpio0 2 GPIO_ACTIVE_LOW>;
        trigger-gpios = <&gpio0 1 GPIO_ACTIVE_LOW>;
        watchdog-gpios = <&gpio1 2 GPIO_ACTIVE_HIGH>;
        trigger-delay-ms = <2000>;
    };
```

## Documentation/devicetree/bindings/power/reset/lsi,axm55xx-reset.yaml
```yaml
%YAML 1.2
---
$id: http://devicetree.org/schemas/lsi,axm55xx-reset.yaml#
$schema: http://devicetree.org/meta-schemas/core.yaml#

title: Axxia Restart Driver

maintainers:
  - Sebastian Reichel <sre@kernel.org>

description: |
  This driver can do reset of the Axxia SoC. It uses the registers in the syscon
  block to initiate a chip reset.

properties:
  compatible:
    description: |
      Compatible string for this reset driver.
    items:
      - const: lsi,axm55xx-reset
  syscon:
    description: |
      Phandle to the syscon node containing the reset control registers.
    $ref: /schemas/types.yaml#/definitions/phandle

required:
  - compatible
  - syscon

additionalProperties: false

examples:
  - |
    syscon: syscon@2010030000 {
        compatible = "lsi,axxia-syscon", "syscon";
        reg = <0x20 0x10030000 0 0x2000>;
    };

    reset: reset@2010031000 {
        compatible = "lsi,axm55xx-reset";
        syscon = <&syscon>;
    };
```

## Documentation/devicetree/bindings/power/reset/mscc,ocelot-chip-reset.yaml
```yaml
# SPDX-License-Identifier: (GPL-2.0-only OR BSD-2-Clause)
%YAML 1.2
---
$id: http://devicetree.org/schemas/power/reset/mscc,ocelot-chip-reset.yaml#
$schema: http://devicetree.org/meta-schemas/core.yaml#

title: Microsemi Ocelot Reset Controller

maintainers:
  - Alexandre Belloni <alexandre.belloni@bootlin.com>
  - Gregory CLEMENT <gregory.clement@bootlin.com>
  - Lars Povlsen <lars.povlsen@microchip.com>

description: |
  Microsemi Ocelot reset controller

  The DEVCPU_GCB:CHIP_REGS have a SOFT_RST register that can be used to reset the
  SoC core.

  The reset registers are both present in the MSCC vcoreiii MIPS and
  microchip Sparx5 armv8 SoC's.

properties:
  compatible:
    description: The list of supported compatible strings.
    items:
      - enum:
          - mscc,ocelot-chip-reset
          - mscc,luton-chip-reset
          - mscc,jaguar2-chip-reset
          - microchip,sparx5-chip-reset

  reg:
    description: Reset controller register base address and size.
    items:
      - description: Register base address.
      - description: Register size.

required:
  - compatible
  - reg

additionalProperties: false

examples:
  - |
    reset@1070008 {
        compatible = "mscc,ocelot-chip-reset";
        reg = <0x1070008 0x4>;
    };
```
