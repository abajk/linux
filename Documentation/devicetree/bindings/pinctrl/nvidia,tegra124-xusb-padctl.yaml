## Documentation/devicetree/bindings/pinctrl/stericsson,db8500-pinctrl.yaml
```yaml
# SPDX-License-Identifier: (GPL-2.0-only OR BSD-2-Clause)
# Copyright 2025 ST Ericsson
%YAML 1.2
---
$id: http://devicetree.org/schemas/stericsson,db8500-pinctrl.yaml#
$schema: http://devicetree.org/meta-schemas/core.yaml#

title: ST Ericsson Nomadik pinmux controller

maintainers:
  - Gabriel Fernandez <gabriel.fernandez@stericsson.com>
  - Lee Jones <lee@kernel.org>
  - Linus Walleij <linus.walleij@linaro.org>

description: |
  ST Ericsson Nomadik pinmux controller

  Required properties:
    - compatible: "stericsson,db8500-pinctrl", "stericsson,db8540-pinctrl", or "stericsson,stn8815-pinctrl"
    - nomadik-gpio-chips: phandles to the GPIO chips (these carry the register ranges used by the controller)
    - prcm: phandle to the PRCMU managing the back end of this pin controller

properties:
  compatible:
    items:
      - enum:
          - stericsson,db8500-pinctrl
          - stericsson,db8540-pinctrl
          - stericsson,stn8815-pinctrl

  nomadik-gpio-chips:
    $ref: /schemas/types.yaml#/definitions/phandle-array
    description: |
      Phandles to the corresponding GPIO chips.
      These have the register ranges used by the pin controller.

  prcm:
    $ref: /schemas/types.yaml#/definitions/phandle
    description: Phandle to the PRCMU managing the back end of this pin controller.

  pinctrl-names:
    $ref: /schemas/types.yaml#/definitions/string-array
    description: Names for pinctrl states.

  function:
    $ref: /schemas/types.yaml#/definitions/string
    description: Function to mux to the pin or group.

  groups:
    $ref: /schemas/types.yaml#/definitions/string-array
    description: Pin groups to use for the function.

  pins:
    $ref: /schemas/types.yaml#/definitions/string-array
    description: Pins affected by the configuration in the node.

  ste,config:
    $ref: /schemas/types.yaml#/definitions/phandle
    description: Handle of pin configuration node.

  ste,input:
    $ref: /schemas/types.yaml#/definitions/uint32
    enum: [0, 1, 2]
    description: |
      0: input with no pull,
      1: input with pull up,
      2: input with pull down.

  ste,output:
    $ref: /schemas/types.yaml#/definitions/uint32
    enum: [0, 1, 2]
    description: |
      0: output low,
      1: output high,
      2: output (value not specified).

  ste,sleep:
    $ref: /schemas/types.yaml#/definitions/uint32
    enum: [0, 1]
    description: |
      0: sleep mode disable,
      1: sleep mode enable.

  ste,sleep-input:
    $ref: /schemas/types.yaml#/definitions/uint32
    enum: [0, 1, 2, 3]
    description: |
      0: sleep input with no pull,
      1: sleep input with pull up,
      2: sleep input with pull down,
      3: sleep input and keep last input configuration.

  ste,sleep-output:
    $ref: /schemas/types.yaml#/definitions/uint32
    enum: [0, 1, 2]
    description: |
      0: sleep output low,
      1: sleep output high,
      2: sleep output (value not specified).

  ste,sleep-gpio:
    $ref: /schemas/types.yaml#/definitions/uint32
    enum: [0, 1]
    description: |
      0: disable sleep GPIO mode,
      1: enable sleep GPIO mode.

  ste,sleep-wakeup:
    $ref: /schemas/types.yaml#/definitions/uint32
    enum: [0, 1]
    description: |
      0: wake-up detection enabled,
      1: wake-up detection disabled.

  ste,sleep-pull-disable:
    $ref: /schemas/types.yaml#/definitions/uint32
    enum: [0, 1]
    description: |
      0: GPIO pull-up or pull-down resistor enabled when pin is an input,
      1: GPIO pull-up and pull-down resistor disabled.

required:
  - compatible
  - nomadik-gpio-chips
  - prcm

additionalProperties: false

examples:
  - |
    pinctrl@80157000 {
        compatible = "stericsson,db8500-pinctrl";
        nomadik-gpio-chips = <&gpio0>, <&gpio1>, <&gpio2>, <&gpio3>;
        prcm = <&prcmu>;

        pinctrl-names = "default";

        slpm_in_wkup_pdis: slpm_in_wkup_pdis {
            ste,sleep = <1>;
            ste,sleep-input = <3>;
            ste,sleep-wakeup = <1>;
            ste,sleep-pull-disable = <0>;
        };

        slpm_out_hi_wkup_pdis: slpm_out_hi_wkup_pdis {
            ste,sleep = <1>;
            ste,sleep-output = <1>;
            ste,sleep-wakeup = <1>;
            ste,sleep-pull-disable = <0>;
        };

        slpm_out_wkup_pdis: slpm_out_wkup_pdis {
            ste,sleep = <1>;
            ste,sleep-output = <2>;
            ste,sleep-wakeup = <1>;
            ste,sleep-pull-disable = <0>;
        };

        uart0 {
            uart0_default_mux: uart0_mux {
                u0_default_mux {
                    function = "u0";
                    pins = "u0_a_1";
                };
            };
            uart0_default_mode: uart0_default {
                uart0_default_cfg1 {
                    pins = "GPIO0", "GPIO2";
                    ste,input = <1>;
                };

                uart0_default_cfg2 {
                    pins = "GPIO1", "GPIO3";
                    ste,output = <1>;
                };
            };
            uart0_sleep_mode: uart0_sleep {
                uart0_sleep_cfg1 {
                    pins = "GPIO0", "GPIO2";
                    ste,config = <&slpm_in_wkup_pdis>;
                };
                uart0_sleep_cfg2 {
                    pins = "GPIO1";
                    ste,config = <&slpm_out_hi_wkup_pdis>;
                };
                uart0_sleep_cfg3 {
                    pins = "GPIO3";
                    ste,config = <&slpm_out_wkup_pdis>;
                };
            };
        };
    };

    uart@80120000 {
        compatible = "arm,pl011", "arm,primecell";
        reg = <0x80120000 0x1000>;
        interrupts = <0 11 0x4>;

        pinctrl-names = "default","sleep";
        pinctrl-0 = <&uart0_default_mux>, <&uart0_default_mode>;
        pinctrl-1 = <&uart0_sleep_mode>;
    };
```

## Documentation/devicetree/bindings/pinctrl/ti,da850-pupd.yaml
```yaml
# SPDX-License-Identifier: (GPL-2.0-only OR BSD-2-Clause)
# Copyright 2025 David Lechner <david@lechnology.com>
%YAML 1.2
---
$id: http://devicetree.org/schemas/pinctrl/ti,da850-pupd.yaml#
$schema: http://devicetree.org/meta-schemas/core.yaml#

title: TI DA850 Pullup/Down Pin Controller
maintainers:
  - David Lechner <david@lechnology.com>

description: |
  * Pin configuration for TI DA850/OMAP-L138/AM18x

  These SoCs have a separate controller for setting bias (internal pullup/down).
  Bias can only be selected for groups rather than individual pins.

  The controller node also acts as a container for pin group configuration nodes.
  The names of these groups are ignored.

  The pin configuration parameters use the generic pinconf bindings defined in
  pinctrl-bindings.txt in this directory. The supported parameters are
  bias-disable, bias-pull-up, bias-pull-down.

properties:
  compatible:
    items:
      - const: ti,da850-pupd

  reg:
    description: >
      Base address and length of the memory resource used by the pullup/down
      controller hardware module.
    items:
      - description: Base address of the pullup/down controller
      - description: Length of the pullup/down controller register space

patternProperties:
  '^(?P<name>.*)$':
    description: Pin group configuration node
    type: object
    additionalProperties: false
    properties:
      groups:
        description: List of pin group names to apply this configuration
        $ref: /schemas/types.yaml#/definitions/string-array
        items:
          - enum:
              - cp0
              - cp1
              - cp2
              - cp3
              - cp4
              - cp5
              - cp6
              - cp7
              - cp8
              - cp9
              - cp10
              - cp11
              - cp12
              - cp13
              - cp14
              - cp15
              - cp16
              - cp17
              - cp18
              - cp19
              - cp20
              - cp21
              - cp22
              - cp23
              - cp24
              - cp25
              - cp26
              - cp27
              - cp28
              - cp29
              - cp30
              - cp31
      bias-disable:
        type: boolean
        description: Disable internal pull-up/down on the specified pin groups
      bias-pull-up:
        type: boolean
        description: Enable internal pull-up on the specified pin groups
      bias-pull-down:
        type: boolean
        description: Enable internal pull-down on the specified pin groups
    required:
      - groups

required:
  - compatible
  - reg

additionalProperties: false

examples:
  - |
    pinconf: pin-controller@22c00c {
        compatible = "ti,da850-pupd";
        reg = <0x22c00c 0x8>;
    };
  - |
    &pinconf {
        pinctrl-0 = <&pinconf_bias_groups>;
        pinctrl-names = "default";

        pinconf_bias_groups: bias-groups {
            pull-up {
                groups = "cp30", "cp31";
                bias-pull-up;
            };
            pull-down {
                groups = "cp29", "cp28";
                bias-pull-down;
            };
            disable {
                groups = "cp27", "cp26";
                bias-disable;
            };
        };
    };
```

## Documentation/devicetree/bindings/pinctrl/ti,dra7-iodelay.yaml
```yaml
# SPDX-License-Identifier: (GPL-2.0-only OR BSD-2-Clause)
# Copyright 2025 Texas Instruments, Inc.

%YAML 1.2
---
$id: http://devicetree.org/schemas/pinctrl/ti,dra7-iodelay.yaml#
$schema: http://devicetree.org/meta-schemas/core.yaml#

title: TI DRA7 IODELAY Controller
maintainers:
  - Nishanth Menon <nm@ti.com>

description: |
  Pin configuration for TI IODELAY controller

  TI DRA7 based SoCs such as AM57xx have a controller for setting the IO delay
  for each pin. For most part the IO delay values are programmed by the bootloader,
  but some pins need to be configured dynamically by the kernel such as the
  MMC pins.

properties:
  compatible:
    const: ti,dra7-iodelay

  reg:
    items:
      - description: Base address of the memory resource
      - description: Length of the memory resource

  "#address-cells":
    description: Number of address cells

  "#size-cells":
    description: Number of size cells

  "#pinctrl-cells":
    description: Number of pinctrl cells (must be 2)

  pinctrl-pin-array:
    description: Array of pin delay configurations. Each entry is a tuple
      of <offset, A_DELAY_PS, G_DELAY_PS>.
    $ref: /schemas/types.yaml#/definitions/uint32-array

additionalProperties: false

examples:
  - |
    &dra7_iodelay_core {
        mmc2_iodelay_3v3_conf: mmc2_iodelay_3v3_conf {
            pinctrl-pin-array = <
                0x18c A_DELAY_PS(0) G_DELAY_PS(120)    /* CFG_GPMC_A19_IN */
                0x1a4 A_DELAY_PS(265) G_DELAY_PS(360)  /* CFG_GPMC_A20_IN */
                0x1b0 A_DELAY_PS(0) G_DELAY_PS(120)    /* CFG_GPMC_A21_IN */
                0x1bc A_DELAY_PS(0) G_DELAY_PS(120)    /* CFG_GPMC_A22_IN */
                0x1c8 A_DELAY_PS(287) G_DELAY_PS(420)  /* CFG_GPMC_A23_IN */
                0x1d4 A_DELAY_PS(144) G_DELAY_PS(240)  /* CFG_GPMC_A24_IN */
                0x1e0 A_DELAY_PS(0) G_DELAY_PS(0)      /* CFG_GPMC_A25_IN */
                0x1ec A_DELAY_PS(120) G_DELAY_PS(0)    /* CFG_GPMC_A26_IN */
                0x1f8 A_DELAY_PS(120) G_DELAY_PS(180)  /* CFG_GPMC_A27_IN */
                0x360 A_DELAY_PS(0) G_DELAY_PS(0)      /* CFG_GPMC_CS1_IN */
            >;
        };
    };
```

## Documentation/devicetree/bindings/pinctrl/ti,palmas-pinctrl.yaml
```yaml
# SPDX-License-Identifier: (GPL-2.0-only OR BSD-2-Clause)
# Copyright 2025 Texas Instruments
%YAML 1.2
---
$id: http://devicetree.org/schemas/pinctrl/ti,palmas-pinctrl.yaml#
$schema: http://devicetree.org/meta-schemas/core.yaml#

title: TI Palmas Pincontrol

maintainers:
  - Keerthy <j-keerthy@ti.com>
  - Laxman Dewangan <ldewangan@nvidia.com>

description: |
  Palmas Pincontrol bindings

  The pins of Palmas device can be set on different option and provides
  the configuration for Pull UP/DOWN, open drain etc.

  Please refer to pinctrl-bindings.txt in this directory for details of the
  common pinctrl bindings used by client devices, including the meaning of the
  phrase "pin configuration node".

  Palmas's pin configuration nodes act as a container for an arbitrary number of
  subnodes. Each of these subnodes represents some desired configuration for a
  list of pins. This configuration can include the mux function to select on
  those pin(s), and various pin configuration parameters, such as pull-up,
  open drain.

  The name of each subnode is not important; all subnodes should be enumerated
  and processed purely based on their content.

  Each subnode only affects those parameters that are explicitly listed. In
  other words, a subnode that lists a mux function but no pin configuration
  parameters implies no information about any pin configuration parameters.
  Similarly, a pin subnode that describes a pullup parameter implies no
  information about e.g. the mux function.

  Note that many of these properties are only valid for certain specific
  pins. See the Palmas device datasheet for complete details regarding which
  pins support which functionality.

  There are 4 special functions: opt0, opt1, opt2 and opt3. If any of these
  functions is selected then directly pins register will be written with 0, 1,
  2 or 3 respectively if it is valid for that pins or list of pins.

properties:
  compatible:
    description: Must be one of the Palmas pincontrol compatible strings.
    items:
      - enum:
          - "ti,palmas-pinctrl"
          - "ti,tps65913-pinctrl"
          - "ti,tps80036-pinctrl"

  ti,palmas-enable-dvfs1:
    type: boolean
    description: Enable DVFS1 mode; configure pins for the DVFS1 I2C2_SCL_SCE and I2C2_SDA_SDO interface.

  ti,palmas-enable-dvfs2:
    type: boolean
    description: Enable DVFS2 mode; configure pins for the DVFS2 GPADC_START and SYSEN2 interface.

  ti,palmas-override-powerhold:
    type: boolean
    description: Override POWERHOLD setting on GPIO7 to allow PMIC shutdown in power-off scenarios.

  pinctrl-names:
    $ref: /schemas/types.yaml#/definitions/string-array
    description: Names for the pin control states.

patternProperties:
  '^pinctrl-[0-9]+$':
    maxItems: 1
    description: Reference to a pin control state subnode.

required:
  - compatible

additionalProperties: false

examples:
  - |
    palmas: tps65913 {
      pinctrl {
        compatible = "ti,tps65913-pinctrl";
        ti,palmas-enable-dvfs1;
        pinctrl-names = "default";
        pinctrl-0 = <&palmas_pins_state>;
      };
    };
```
