## Documentation/devicetree/bindings/pinctrl/sprd-pinctrl.yaml
```yaml
# SPDX-License-Identifier: (GPL-2.0-only OR BSD-2-Clause)
%YAML 1.2
---
$id: http://devicetree.org/schemas/pinctrl/sprd-pinctrl.yaml#
$schema: http://devicetree.org/meta-schemas/core.yaml#

title: Spreadtrum Pin Controller

maintainers:
  - Baolin Wang <baolin.wang@linux.alibaba.com>
  - Bjorn Helgaas <bhelgaas@google.com>

description: |
  * Spreadtrum Pin Controller

  The Spreadtrum pin controller are organized in 3 blocks (types).

  The first block comprises some global control registers, and each
  register contains several bit fields with one bit or several bits
  to configure for some global common configuration, such as domain
  pad driving level, system control select and so on ("domain pad
  driving level": One pin can output 3.0v or 1.8v, depending on the
  related domain pad driving selection, if the related domain pad
  select 3.0v, then the pin can output 3.0v. "system control" is used
  to choose one function (like: UART0) for which system, since we
  have several systems (AP/CP/CM4) on one SoC.).

  There are too much various configuration that we can not list all
  of them, so we can not make every Spreadtrum-special configuration
  as one generic configuration, and maybe it will add more strange
  global configuration in future. Then we add one "sprd,control" to
  set these various global control configuration, and we need use
  magic number for this property.

  Moreover we recognise every fields comprising one bit or several
  bits in one global control register as one pin, thus we should
  record every pin's bit offset, bit width and register offset to
  configure this field (pin).

  The second block comprises some common registers which have unified
  register definition, and each register described one pin is used
  to configure the pin sleep mode, function select and sleep related
  configuration.

  Now we have 4 systems for sleep mode on SC9860 SoC: AP system,
  PUBCP system, TGLDSP system and AGDSP system. And the pin sleep
  related configuration are:
    - input-enable
    - input-disable
    - output-high
    - output-low
    - bias-pull-up
    - bias-pull-down

  In some situation we need set the pin sleep mode and pin sleep related
  configuration, to set the pin sleep related configuration automatically
  by hardware when the system specified by sleep mode goes into deep
  sleep mode. For example, if we set the pin sleep mode as PUBCP_SLEEP
  and set the pin sleep related configuration as "input-enable", which
  means when PUBCP system goes into deep sleep mode, this pin will be set
  input enable automatically.

  Moreover we can not use the "sleep" state, since some systems (like:
  PUBCP system) do not run linux kernel OS (only AP system run linux
  kernel on SC9860 platform), then we can not select "sleep" state
  when the PUBCP system goes into deep sleep mode. Thus we introduce
  "sprd,sleep-mode" property to set pin sleep mode.

  The last block comprises some misc registers which also have unified
  register definition, and each register described one pin is used to
  configure drive strength, pull up/down and so on. Especially for pull
  up, we have two kind pull up resistor: 20K and 4.7K.

properties:
  compatible:
    items:
      - pattern: "^sprd,.*-pinctrl$"

  reg:
    description: The register address of pin controller device.
    items:
      - description: Register base address.

  pins:
    description: A list of pin names.
    $ref: /schemas/types.yaml#/definitions/string-array

  function:
    description: Specified the function name.
    $ref: /schemas/types.yaml#/definitions/string

  drive-strength:
    description: Drive strength in mA.
    $ref: /schemas/types.yaml#/definitions/uint32

  input-schmitt-disable:
    description: Disable Schmitt-trigger mode.
    type: boolean

  input-schmitt-enable:
    description: Enable Schmitt-trigger mode.
    type: boolean

  bias-disable:
    description: Disable pin bias.
    type: boolean

  bias-pull-down:
    description: Pull down on pin.
    type: boolean

  bias-pull-up:
    description: Pull up on pin.
    type: boolean

  input-enable:
    description: Enable pin input.
    type: boolean

  input-disable:
    description: Enable pin output.
    type: boolean

  output-high:
    description: Set the pin as an output level high.
    type: boolean

  output-low:
    description: Set the pin as an output level low.
    type: boolean

  sleep-hardware-state:
    description: Indicate configurations in sleep hardware state.
    type: boolean

  sprd,control:
    description: Control values referring to databook for global control pins.
    $ref: /schemas/types.yaml#/definitions/uint32-array

  sprd,sleep-mode:
    description: Sleep mode selection.
    $ref: /schemas/types.yaml#/definitions/string

required:
  - compatible
  - reg
  - pins

additionalProperties: false
```

## Documentation/devicetree/bindings/pinctrl/st,spear300-pinmux.yaml
```yaml
# SPDX-License-Identifier: (GPL-2.0-only OR BSD-2-Clause)
%YAML 1.2
---
$id: http://devicetree.org/schemas/pinctrl/st,spear300-pinmux.yaml#
$schema: http://devicetree.org/meta-schemas/core.yaml#

title: ST SPEAr pinmux controller

maintainers:
  - Soren Brinkmann <soren.brinkmann@xilinx.com>
  - Viresh Kumar <vireshk@kernel.org>

description: |
  ST Microelectronics, SPEAr pinmux controller

  Please refer to pinctrl-bindings.txt in this directory for details of the common
  pinctrl bindings used by client devices.

  SPEAr's pinmux nodes act as a container for an arbitrary number of subnodes.
  Each of these subnodes represents muxing for a pin, a group, or a list of pins
  or groups.

  The name of each subnode is not important; all subnodes should be enumerated
  and processed purely based on their content.

properties:
  compatible:
    description: DT compatible strings for SPEAr pinmux controllers
    $ref: /schemas/types.yaml#/definitions/string-array
    items:
      - enum:
          - st,spear300-pinmux
          - st,spear310-pinmux
          - st,spear320-pinmux
          - st,spear1310-pinmux
          - st,spear1340-pinmux

  reg:
    description: Address range of the pinctrl registers
    items:
      - description: Start address of the pinctrl registers
      - description: Size of the pinctrl register range

  st,pinmux-mode:
    description: >
      Pinmux mode for SPEAr300 and SPEAr320 machines. Mandatory for SPEAr300
      and SPEAr320 and invalid for other machines.
    enum:
      - 0
      - 1
      - 2
      - 3
      - 4
      - 5
      - 6
      - 7
      - 8
      - 9
      - 10
      - 11
      - 12

additionalProperties: false

required:
  - compatible
  - reg

allOf:
  - if:
      properties:
        compatible:
          contains:
            enum:
              - st,spear300-pinmux
              - st,spear320-pinmux
    then:
      required:
        - st,pinmux-mode
    else:
      properties:
        st,pinmux-mode: false

patternProperties:
  ".*":
    type: object
    description: SPEAr pinmux child node
    additionalProperties: false
    properties:
      st,pins:
        description: An array of pin or group names to mux.
        items:
          type: string
      st,function:
        description: >
          A string containing the name of the function to mux to the pin or
          group. See the SPEAr's TRM to determine which are valid for each pin
          or group.
        $ref: /schemas/types.yaml#/definitions/string
    required:
      - st,pins
      - st,function

examples:
  - |
    pinctrl: pinmux {
        compatible = "st,spear300-pinmux";
        reg = <0x01c20000 0x1000>;
        st,pinmux-mode = <2>;
        child0 {
            st,pins = <"gpio0_pin0_grp">;
            st,function = "gpio0";
        };
    };
```

## Documentation/devicetree/bindings/pinctrl/st,stih407-pinctrl.yaml
```yaml
# SPDX-License-Identifier: (GPL-2.0-only OR BSD-2-Clause)
%YAML 1.2
---
$id: http://devicetree.org/schemas/pinctrl/st,stih407-pinctrl.yaml#
$schema: http://devicetree.org/meta-schemas/core.yaml#

title: ST PIO-multiplexing pin controller

maintainers:
  - Geert Uytterhoeven <geert+renesas@glider.be>
  - Marco Franchi <marco.franchi@nxp.com>
  - Patrice Chotard <patrice.chotard@st.com>
  - Peter Griffin <peter.griffin@linaro.org>
  - Srinivas Kandagatla <srinivas.kandagatla@st.com>
  - Srinivas KANDAGATLA <srinivas.kandagatla@st.com>

description: |
  ST pin controller

  Each multi-function pin is controlled, driven and routed through the
  PIO multiplexing block. Each pin supports GPIO functionality (ALT0) and
  multiple alternate functions (ALT1–ALTx) that directly connect the pin
  to different hardware blocks.

  When a pin is in GPIO mode, Output Enable (OE), Open Drain (OD), and
  Pull Up (PU) are driven by the related PIO block.

  The ST pinctrl driver controls the PIO multiplexing block and also
  interacts with the GPIO driver to configure pins.

  A GPIO bank can have one of two interrupt wirings:
  • Shared via irqmux: a single interrupt is used by multiple GPIO banks,
    reducing the number of required interrupt lines.
  • Dedicated per bank: each GPIO bank has its own interrupt line.

  Related macros: include/dt-bindings/interrupt-controller/irq.h

properties:
  compatible:
    items:
      - pattern: "^st,stih407-[^,]+-pinctrl$"

  st,syscfg:
    description: Phandle of the syscfg controller
    $ref: /schemas/types.yaml#/definitions/phandle

  st,retime-pin-mask:
    description: Mask specifying which pins can be retimed
    $ref: /schemas/types.yaml#/definitions/uint32

  ranges:
    description: Map parent PIO address to child GPIO bank address and size

  interrupts:
    maxItems: 1

  reg:
    maxItems: 1

  reg-names:
    items:
      - const: irqmux

  interrupt-names:
    items:
      - const: irqmux

definitions:
  pinctrl-subnode:
    description: A GPIO configuration subnode
    type: object
    additionalProperties: false
    properties:
      st,pins:
        description: List of pin configurations (bank, offset, mux, mode, retime, delay, clk)
        type: array
        items:
          type: array
          items:
            - description: Bank phandle
              $ref: /schemas/types.yaml#/definitions/phandle
            - description: Pin offset within bank
              $ref: /schemas/types.yaml#/definitions/uint32
            - description: Multiplexing mode index
              $ref: /schemas/types.yaml#/definitions/uint32
            - description: Direction/pull setting
              enum: [IN, IN_PU, OUT, BIDIR, BIDIR_PU]
            - description: Retiming type
              enum: [NICLK, ICLK_IO, BYPASS, DE_IO, SE_ICLK_IO, SE_NICLK_IO]
            - description: Retiming delay (ps)
              $ref: /schemas/types.yaml#/definitions/uint32
            - description: Retiming clock source
              enum: [CLK_A, CLK_B, CLK_C, CLK_D]
        minItems: 7
    required:
      - st,pins

additionalProperties: false

examples:
  - |
    pin-controller-sbc {
        compatible = "st,stih407-sbc-pinctrl";
        st,syscfg = <&syscfg_sbc>;
        ranges = <0 0x09610000 0x6000>;
        reg = <0x0961f080 0x4>;
        reg-names = "irqmux";
        interrupts = <GIC_SPI 188 IRQ_TYPE_NONE>;
        interrupt-names = "irqmux";

        pio0: gpio@9610000 {
            gpio-controller;
            #gpio-cells = <2>;
            interrupt-controller;
            #interrupt-cells = <2>;
            reg = <0x0 0x100>;
            st,bank-name = "PIO0";
        };
    };
```
