## Documentation/devicetree/bindings/arm/cavium-thunder-88xx.yaml
```yaml
# SPDX-License-Identifier: (GPL-2.0-only OR BSD-2-Clause)
# Copyright 2025 Cavium
%YAML 1.2
---
$id: http://devicetree.org/schemas/arm/cavium-thunder-88xx.yaml#
$schema: http://devicetree.org/meta-schemas/core.yaml#

title: Cavium Thunder platform device
maintainers:
  - Radha Mohan Chintakuntla <rchintakuntla@cavium.com>

description: |
  Cavium Thunder platform device tree bindings

  Boards with Cavium's Thunder SoC shall have following properties.

  Root Node
  ---------

properties:
  compatible:
    items:
      - const: cavium,thunder-88xx

required:
  - compatible

additionalProperties: false
```

## Documentation/devicetree/bindings/arm/firmware/arm,sdei-1.0.yaml
```yaml
# SPDX-License-Identifier: (GPL-2.0-only OR BSD-2-Clause)
# Copyright 2025 James Morse
%YAML 1.2
---
$id: http://devicetree.org/schemas/arm/firmware/arm,sdei-1.0.yaml#
$schema: http://devicetree.org/meta-schemas/core.yaml#

title: ARM Software Delegated Exception Interface (SDEI)

maintainers:
  - James Morse <james.morse@arm.com>

description: |
  * Software Delegated Exception Interface (SDEI)

  Firmware implementing the SDEI functions described in ARM document number
  ARM DEN 0054A ("Software Delegated Exception Interface") can be used by
  Linux to receive notification of events such as those generated by
  firmware-first error handling, or from an IRQ that has been promoted to
  a firmware-assisted NMI.

  The interface provides a number of API functions for registering callbacks
  and enabling/disabling events. Functions are invoked by trapping to the
  privilege level of the SDEI firmware (specified as part of the binding
  below) and passing arguments in a manner specified by the "SMC Calling
  Convention (ARM DEN 0028B):

      r0      => 32-bit Function ID / return value
    {r1 – r3}  => Parameters

  Note that the immediate field of the trapping instruction must be set
  to #0.

properties:
  compatible:
    description: The compatible string identifying the SDEI firmware version.
    items:
      - const: "arm,sdei-1.0"

  method:
    description: Method used to invoke the SDEI firmware.
    enum:
      - smc
      - hvc

required:
  - compatible
  - method

additionalProperties: false

examples:
  - |
    firmware {
        sdei {
            compatible = "arm,sdei-1.0";
            method = "smc";
        };
    };
```

## Documentation/devicetree/bindings/arm/freescale/fsl,vf610-mscm-ir.yaml
```yaml
# SPDX-License-Identifier: (GPL-2.0-only OR BSD-2-Clause)
# Copyright 2025 Rob Herring
%YAML 1.2
---
$id: http://devicetree.org/schemas/arm/freescale/fsl,vf610-mscm-ir.yaml#
$schema: http://devicetree.org/meta-schemas/core.yaml#

title: Freescale Vybrid Miscellaneous System Control - Interrupt Router

maintainers:
  - Rob Herring <robh@kernel.org>
  - Stefan Agner <stefan@agner.ch>

description:
  The MSCM IP contains multiple sub modules, this binding describes the second
  block of registers which control the interrupt router. The interrupt router
  allows to configure the recipient of each peripheral interrupt. Furthermore
  it controls the directed processor interrupts. The module is available in all
  Vybrid SoC's but is only really useful in dual core configurations (VF6xx
  which comes with a Cortex-A5/Cortex-M4 combination).

properties:
  compatible:
    const: fsl,vf610-mscm-ir

  reg:
    maxItems: 1

  interrupt-controller: true

  "#interrupt-cells":
    description: "Two cells: interrupt number and flags as defined by the GIC bindings"
    const: 2

  fsl,cpucfg:
    description:
      Handle to the MSCM CPU configuration node, required to get the current CPU
      ID.
    $ref: /schemas/types.yaml#/definitions/phandle

required:
  - compatible
  - reg
  - fsl,cpucfg
  - interrupt-controller
  - "#interrupt-cells"

additionalProperties: false

examples:
  - |
    interrupt-controller@40001800 {
        compatible = "fsl,vf610-mscm-ir";
        reg = <0x40001800 0x400>;
        interrupt-controller;
        #interrupt-cells = <2>;
        interrupt-parent = <&intc>;
        fsl,cpucfg = <&mscm_cpucfg>;
    };
```

## Documentation/devicetree/bindings/arm/keystone/ti,keystone.yaml
```yaml
# SPDX-License-Identifier: (GPL-2.0-only OR BSD-2-Clause)
%YAML 1.2
---
$id: http://devicetree.org/schemas/ti,keystone.yaml#
$schema: http://devicetree.org/meta-schemas/core.yaml#

title: TI Keystone Platforms

maintainers:
  - Franklin S Cooper Jr <fcooper@ti.com>
  - Ivan Khoronzhuk <ivan.khoronzhuk@ti.com>
  - Murali Karicheri <m-karicheri2@ti.com>
  - Nishanth Menon <nm@ti.com>
  - Santosh Shilimkar <santosh.shilimkar@ti.com>

description: |
  TI Keystone Platforms Device Tree Bindings
  -----------------------------------------------

  Boards with Keystone2 based devices (TCI66xxK2H) SOC shall have the
  following properties.

  SoC families:

  - Keystone 2 generic SoC:
     compatible = "ti,keystone"

  SoCs:

  - Keystone 2 Hawking/Kepler
     compatible = "ti,k2hk", "ti,keystone"
  - Keystone 2 Lamarr
     compatible = "ti,k2l", "ti,keystone"
  - Keystone 2 Edison
     compatible = "ti,k2e", "ti,keystone"
  - K2G
     compatible = "ti,k2g", "ti,keystone"

  Boards:
  - Keystone 2 Hawking/Kepler EVM
     compatible = "ti,k2hk-evm", "ti,k2hk", "ti,keystone"

  - Keystone 2 Lamarr EVM
     compatible = "ti,k2l-evm", "ti,k2l", "ti,keystone"

  - Keystone 2 Edison EVM
     compatible = "ti,k2e-evm", "ti,k2e", "ti,keystone"

  - K2G EVM
     compatible = "ti,k2g-evm", "ti,k2g", "ti-keystone"

  - K2G Industrial Communication Engine EVM
     compatible = "ti,k2g-ice", "ti,k2g", "ti-keystone"

properties:
  compatible:
    description: Node compatible strings for Keystone2 devices.
    oneOf:
      - items:
          - const: ti,keystone
      - items:
          - enum:
              - ti,k2hk
              - ti,k2l
              - ti,k2e
              - ti,k2g
          - const: ti,keystone
      - items:
          - enum:
              - ti,k2hk-evm
              - ti,k2l-evm
              - ti,k2e-evm
              - ti,k2g-evm
              - ti,k2g-ice
          - enum:
              - "ti,k2hk"
              - "ti,k2l"
              - "ti,k2e"
              - "ti,k2g"
          - enum:
              - ti,keystone
              - ti-keystone

additionalProperties: false

required:
  - compatible
```

## Documentation/devicetree/bindings/arm/marvell,berlin.yaml
```yaml
# SPDX-License-Identifier: (GPL-2.0-only OR BSD-2-Clause)
%YAML 1.2
---
$id: http://devicetree.org/schemas/arm/marvell,berlin.yaml#
$schema: http://devicetree.org/meta-schemas/core.yaml#


title: Synaptics Marvell Berlin SoC

maintainers:
  - Jisheng Zhang <jszhang@kernel.org>
  - Krzysztof Kozlowski <krzko@linaro.org>
  - Mauro Carvalho Chehab <mchehab+huawei@kernel.org>

description: |
  Synaptics SoC Device Tree Bindings

  According to https://www.synaptics.com/company/news/conexant-marvell
  Synaptics has acquired the Multimedia Solutions Business of Marvell, so
  Berlin SoCs are now Synaptics' SoCs.

  ---------------------------------------------------------------

  CPU control register allows various operations on CPUs, like resetting them
  independently.

  Marvell Berlin SoCs have a chip control register set providing several
  individual registers dealing with pinmux, padmux, clock, reset, and
  secondary CPU boot address. Unfortunately, the individual registers are
  spread among the chip control registers, so there should be a single DT
  node only providing the different functions which are described below.

  Marvell Berlin SoCs have a system control register set providing several
  individual registers dealing with pinmux, padmux, and reset.

properties: {}
additionalProperties: false

oneOf:
  - type: object
    properties:
      compatible:
        description: Root-node compatible strings on Marvell Berlin boards
        items:
          - description: Board-specific model identifier
          - enum:
              - marvell,berlin2
              - marvell,berlin2cd
              - marvell,berlin2ct
              - marvell,berlin2q
              - marvell,berlin3
          - const: marvell,berlin
    required:
      - compatible
    additionalProperties: false

  - type: object
    properties:
      compatible:
        const: marvell,berlin-cpu-ctrl
      reg:
        description: Control register address and size
        items:
          - description: Register base address
          - description: Register size
    required:
      - compatible
      - reg
    additionalProperties: false

  - type: object
    properties:
      compatible:
        items:
          - const: simple-mfd
          - const: syscon
      reg:
        description: Chip control and optional CPU-PLL registers
        oneOf:
          - items:
              - description: Chip control register set
          - items:
              - description: Chip control register set
              - description: CPU-PLL registers
    required:
      - compatible
      - reg
    additionalProperties: false

  - type: object
    properties:
      compatible:
        items:
          - const: simple-mfd
          - const: syscon
      reg:
        description: System control register set address and size
        items:
          - description: Register base address
          - description: Register size
    required:
      - compatible
      - reg
    additionalProperties: false
```

## Documentation/devicetree/bindings/arm/marvell/ap80x-system-controller.yaml
```yaml
# SPDX-License-Identifier: (GPL-2.0-only OR BSD-2-Clause)
# Copyright 2025 Linaro Ltd.
%YAML 1.2
---
$id: http://devicetree.org/schemas/arm/marvell/ap80x-system-controller.yaml#
$schema: http://devicetree.org/meta-schemas/core.yaml#

title: Marvell Armada AP80x System Controller

maintainers:
  - Amit Kucheria <amit.kucheria@linaro.org>
  - Baruch Siach <baruch@tkos.co.il>
  - Ben Peled <bpeled@marvell.com>
  - Chris Packham <chris.packham@alliedtelesis.co.nz>

description: |
  Marvell Armada AP80x System Controller

  The AP806/AP807 is one of the two core HW blocks of the Marvell Armada
  7K/8K/931x SoCs. It contains system controllers, which provide several
  registers giving access to numerous features: clocks, pin-muxing and
  many other SoC configuration items. This DT binding allows to describe
  these system controllers.

properties:
  compatible:
    items:
      - const: syscon
      - const: simple-mfd

  reg:
    description: Register area of the AP80x system controller
    items:
      - description: base address
      - description: size

patternProperties:
  "^.*$":
    anyOf:
      - $ref: "#/definitions/clock"
      - $ref: "#/definitions/pinctrl"
      - $ref: "#/definitions/gpio"
      - $ref: "#/definitions/thermal"
      - $ref: "#/definitions/clock-cpu"

additionalProperties: false

definitions:

  clock:
    description: System-controller clock subnode
    properties:
      compatible:
        items:
          - const: "marvell,ap806-clock"
          - const: "marvell,ap807-clock"
      "#clock-cells":
        const: 1
    required:
      - compatible
      - "#clock-cells"
    additionalProperties: false

  pinctrl:
    description: System-controller pinctrl subnode
    properties:
      compatible:
        const: "marvell,ap806-pinctrl"
    required:
      - compatible
    additionalProperties: false

  gpio:
    description: System-controller GPIO subnode
    properties:
      compatible:
        const: "marvell,armada-8k-gpio"
      offset:
        description: Offset address inside the syscon block
        $ref: /schemas/types.yaml#/definitions/uint32
      ngpios:
        description: Number of GPIOs
        $ref: /schemas/types.yaml#/definitions/uint32
      gpio-controller:
        description: GPIO controller flag
        type: boolean
      "#gpio-cells":
        const: 2
      gpio-ranges:
        description: GPIO ranges mapping
        $ref: /schemas/types.yaml#/definitions/phandle-array
      "marvell,pwm-offset":
        description: Offset of PWM duration control registers inside the syscon block
        $ref: /schemas/types.yaml#/definitions/uint32
      "#pwm-cells":
        const: 2
      clocks:
        description: GPIO source clock phandles
        $ref: /schemas/types.yaml#/definitions/phandle-array
    required:
      - compatible
      - offset
      - ngpios
      - gpio-controller
      - "#gpio-cells"
      - "#pwm-cells"
      - clocks
    additionalProperties: false

  thermal:
    description: Thermal sensor subnode of system-controller 1
    properties:
      compatible:
        const: "marvell,armada-ap806-thermal"
      reg:
        description: Register range for thermal functions
        items:
          - description: offset
          - description: size
      interrupt-parent:
        description: Overheat interrupt parent
        $ref: /schemas/types.yaml#/definitions/phandle
      interrupts:
        description: Overheat interrupt line
        $ref: /schemas/types.yaml#/definitions/uint32-array
      "#thermal-sensor-cells":
        const: 1
    required:
      - compatible
      - reg
      - "#thermal-sensor-cells"
    additionalProperties: false

  clock-cpu:
    description: Cluster-clock subnode
    properties:
      compatible:
        items:
          - const: "marvell,ap806-cpu-clock"
          - const: "marvell,ap807-cpu-clock"
      clocks:
        description: Input parent clocks (one per CPU cluster)
        items:
          - description: cluster 0 parent clock phandle
          - description: cluster 1 parent clock phandle
      "#clock-cells":
        const: 1
      reg:
        description: Register range for cluster clocks
        items:
          - description: offset
          - description: size
    required:
      - compatible
      - "#clock-cells"
      - clocks
      - reg
    additionalProperties: false
```

## Documentation/devicetree/bindings/arm/marvell/marvell,98dx3336-resume-ctrl.yaml
```yaml
# SPDX-License-Identifier: (GPL-2.0-only OR BSD-2-Clause)
%YAML 1.2
---
$id: http://devicetree.org/schemas/marvell,98dx3336-resume-ctrl.yaml#
$schema: http://devicetree.org/meta-schemas/core.yaml#

title: Marvell 98DX3336 Resume Control

maintainers:
  - Chris Packham <chris.packham@alliedtelesis.co.nz>

description: |
  Resume Control
  --------------
  Available on Marvell SOCs: 98DX3336 and 98DX4251

properties:
  compatible:
    const: marvell,98dx3336-resume-ctrl
    description: Must be "marvell,98dx3336-resume-ctrl"

  reg:
    maxItems: 1

required:
  - compatible
  - reg

additionalProperties: false

examples:
  - |
    resume@20980 {
        compatible = "marvell,98dx3336-resume-ctrl";
        reg = <0x20980 0x10>;
    };
```

## Documentation/devicetree/bindings/arm/marvell/marvell,armada-370-cpu-config.yaml
```yaml
# SPDX-License-Identifier: (GPL-2.0-only OR BSD-2-Clause)
# Copyright 2025 Gregory CLEMENT <gregory.clement@bootlin.com>

%YAML 1.2
---
$id: http://devicetree.org/schemas/marvell,armada-370-cpu-config.yaml#
$schema: http://devicetree.org/meta-schemas/core.yaml#

title: Marvell Armada 370/XP CPU Config registers

maintainers:
  - Gregory CLEMENT <gregory.clement@bootlin.com>

properties:
  compatible:
    enum:
      - marvell,armada-370-cpu-config
      - marvell,armada-xp-cpu-config

  reg:
    maxItems: 1

required:
  - compatible
  - reg

additionalProperties: false

examples:
  - |
    cpu-config@21000 {
      compatible = "marvell,armada-xp-cpu-config";
      reg = <0x21000 0x8>;
    };
```
