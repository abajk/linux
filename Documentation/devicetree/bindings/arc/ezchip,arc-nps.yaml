## Documentation/devicetree/bindings/arm/omap/ti,am3-scm.yaml
```yaml
# SPDX-License-Identifier: (GPL-2.0-only OR BSD-2-Clause)
# Copyright 2025 Texas Instruments
%YAML 1.2
---
$id: http://devicetree.org/schemas/arm/omap/ti,am3-scm.yaml#
$schema: http://devicetree.org/meta-schemas/core.yaml#

title: TI Control Module

maintainers:
  - Tero Kristo <t-kristo@ti.com>
  - Tony Lindgren <tony@atomide.com>

description: |
  Control Module contains miscellaneous features under it based on SoC type.
  Pincontrol is one common feature, and it has a specialized support
  described in [1]. Typically some clock nodes are also under control module.
  Syscon is used to share register level access to drivers external to
  control module driver itself.

  See [2] for documentation about clock/clockdomain nodes.

  Required properties:
  - compatible: Must be one of:
      ti,am3-scm
      ti,am4-scm
      ti,dm814-scrm
      ti,dm816-scrm
      ti,omap2-scm
      ti,omap3-scm
      ti,omap4-scm-core
      ti,omap4-scm-padconf-core
      ti,omap4-scm-wkup
      ti,omap4-scm-padconf-wkup
      ti,omap5-scm-core
      ti,omap5-scm-padconf-core
      ti,omap5-scm-wkup-pad-conf
      ti,dra7-scm-core
  - reg: Contains Control Module register address range (base address and length)

  Optional properties:
  - clocks: Clocks for this module
  - clockdomains: Clockdomains for this module

properties:
  compatible:
    items:
      - enum:
          - ti,am3-scm
          - ti,am4-scm
          - ti,dm814-scrm
          - ti,dm816-scrm
          - ti,omap2-scm
          - ti,omap3-scm
          - ti,omap4-scm-core
          - ti,omap4-scm-padconf-core
          - ti,omap4-scm-wkup
          - ti,omap4-scm-padconf-wkup
          - ti,omap5-scm-core
          - ti,omap5-scm-padconf-core
          - ti,omap5-scm-wkup-pad-conf
          - ti,dra7-scm-core
#      - const: simple-bus
  reg:
    maxItems: 1

  clocks:
    description: Clocks for this module
    $ref: /schemas/types.yaml#/definitions/phandle-array
  clockdomains:
    description: Clockdomains for this module
    $ref: /schemas/types.yaml#/definitions/phandle-array

required:
  - compatible
  - reg

additionalProperties: false

examples:
  - |
    scm: scm@2000 {
      compatible = "ti,omap3-scm", "simple-bus";
      reg = <0x2000 0x2000>;
      #address-cells = <1>;
      #size-cells = <1>;
      ranges = <0 0x2000 0x2000>;
    };
```
