## Documentation/devicetree/bindings/arm/marvell/marvell,armada-370-pmsu.yaml
```yaml
# SPDX-License-Identifier: (GPL-2.0-only OR BSD-2-Clause)
%YAML 1.2
---
$id: http://devicetree.org/schemas/arm/marvell/marvell,armada-370-pmsu.yaml#
$schema: http://devicetree.org/meta-schemas/core.yaml#

title: Marvell Armada 370/XP PMSU

maintainers:
  - Gregory CLEMENT <gregory.clement@bootlin.com>

description: |
  Power Management Service Unit(PMSU)
  -----------------------------------
  Available on Marvell SOCs: Armada 370, Armada 38x and Armada XP

properties:
  compatible:
    description: Supported compatible strings
    items:
      - enum:
          - marvell,armada-370-pmsu
          - marvell,armada-380-pmsu
          - marvell,armada-370-xp-pmsu

  reg:
    maxItems: 1

required:
  - compatible
  - reg

additionalProperties: false

examples:
  - |
    armada-370-xp-pmsu@22000 {
      compatible = "marvell,armada-370-pmsu";
      reg = <0x22000 0x1000>;
    };
```

## Documentation/devicetree/bindings/arm/marvell/marvell,armada-370-xp-system-controller.yaml
```yaml
---
$id: http://devicetree.org/schemas/marvell,armada-370-xp-system-controller.yaml#
$schema: http://devicetree.org/meta-schemas/core.yaml#

title: MVEBU System Controller

maintainers:
  - Gregory CLEMENT <gregory.clement@bootlin.com>

description: |
  MVEBU System Controller
  MVEBU (Marvell SOCs: Armada 370/375/XP, Dove, mv78xx0, Kirkwood, Orion5x)

properties:
  compatible:
    items:
      - enum:
          - marvell,orion-system-controller
          - marvell,armada-370-xp-system-controller
          - marvell,armada-375-system-controller

  reg:
    items:
      - description: System controller registers location and length

required:
  - compatible
  - reg

additionalProperties: false

examples:
  - |
    system-controller@d0018200 {
        compatible = "marvell,armada-370-xp-system-controller";
        reg = <0xd0018200 0x500>;
    };
```

## Documentation/devicetree/bindings/arm/marvell/marvell,armada-380-mpcore-soc-ctrl.yaml
```yaml
# SPDX-License-Identifier: (GPL-2.0-only OR BSD-2-Clause)
%YAML 1.2
---
$id: http://devicetree.org/schemas/marvell,armada-380-mpcore-soc-ctrl.yaml#
$schema: http://devicetree.org/meta-schemas/core.yaml#

title: Marvell Armada 38x CA9 MPcore SoC Controller

maintainers:
  - Gregory CLEMENT <gregory.clement@bootlin.com>

description: |
  Marvell Armada 38x CA9 MPcore SoC Controller
  ============================================

properties:
  compatible:
    items:
      - const: marvell,armada-380-mpcore-soc-ctrl

  reg:
    items:
      - description: register base and size of the CA9 MPcore SoC control registers

required:
  - compatible
  - reg

additionalProperties: false

examples:
  - |
    mpcore-soc-ctrl@20d20 {
      compatible = "marvell,armada-380-mpcore-soc-ctrl";
      reg = <0x20d20 0x6c>;
    };
```

## Documentation/devicetree/bindings/arm/marvell/marvell,coherency-fabric.yaml
```yaml
# SPDX-License-Identifier: (GPL-2.0-only OR BSD-2-Clause)
# Copyright 2025 Bootlin
%YAML 1.2
---
$id: http://devicetree.org/schemas/arm/marvell/marvell,coherency-fabric.yaml#
$schema: http://devicetree.org/meta-schemas/core.yaml#

title: Marvell Coherency Fabric

maintainers:
  - Gregory CLEMENT <gregory.clement@bootlin.com>

description: |
  Coherency fabric
  ----------------
  Available on Marvell SOCs: Armada 370, Armada 375, Armada 38x and Armada XP

properties:
  compatible:
    items:
      - const: marvell,coherency-fabric
      - const: marvell,armada-375-coherency-fabric
      - const: marvell,armada-380-coherency-fabric

  reg:
    items:
      - description: coherency fabric registers
      - description: per-CPU fabric registers

  broken-idle:
    description: Set when Idle mode is not supported by the hardware.
    type: boolean

required:
  - compatible
  - reg

additionalProperties: false

allOf:
  - if:
      properties:
        compatible:
          contains:
            const: marvell,coherency-fabric
    then:
      properties:
        reg:
          items:
            - description: coherency fabric registers
            - description: per-CPU fabric registers
    else:
      properties:
        reg:
          items:
            - description: per-CPU fabric registers
```

## Documentation/devicetree/bindings/arm/marvell/marvell-armada-370-cpu-reset.yaml
```yaml
# SPDX-License-Identifier: (GPL-2.0-only OR BSD-2-Clause)
%YAML 1.2
---
$id: http://devicetree.org/schemas/arm/marvell/marvell-armada-370-cpu-reset.yaml#
$schema: http://devicetree.org/meta-schemas/core.yaml#

title: Marvell Armada CPU reset controller

maintainers:
  - Gregory CLEMENT <gregory.clement@bootlin.com>

description: |
  Marvell Armada CPU reset controller

properties:
  compatible:
    items:
      - const: marvell,armada-370-cpu-reset

  reg:
    maxItems: 1

required:
  - compatible
  - reg

additionalProperties: false

examples:
  - |
    cpurst: cpurst@20800 {
        compatible = "marvell,armada-370-cpu-reset";
        reg = <0x20800 0x20>;
    };
```

## Documentation/devicetree/bindings/arm/marvell/syscon-simple-mfd.yaml
```yaml
# SPDX-License-Identifier: (GPL-2.0-only OR BSD-2-Clause)
# Copyright 2018 Linaro Ltd.
%YAML 1.2
---
$id: http://devicetree.org/schemas/arm/marvell/syscon-simple-mfd.yaml#
$schema: http://devicetree.org/meta-schemas/core.yaml#

title: Marvell Armada CP110 System Controller

maintainers:
  - Amit Kucheria <amit.kucheria@linaro.org>
  - Bjorn Helgaas <bhelgaas@google.com>
  - Chris Packham <chris.packham@alliedtelesis.co.nz>
  - Grzegorz Jaszczyk <jaz@semihalf.com>
  - Konstantin Porotchkin <kostap@marvell.com>
  - Miquel Raynal <miquel.raynal@bootlin.com>

description: |
  Marvell Armada CP110 System Controller
  ======================================

  The CP110 is one of the two core HW blocks of the Marvell Armada 7K/8K
  SoCs. It contains system controllers, which provide several registers
  giving access to numerous features: clocks, pin-muxing and many other
  SoC configuration items. This DT binding allows to describe these
  system controllers.

  SYSTEM CONTROLLER 0
  ===================

  Clocks:
  -------

  The Device Tree node representing this System Controller 0 provides a
  number of clocks:

   - a set of core clocks
   - a set of gateable clocks

  Those clocks can be referenced by other Device Tree nodes using two
  cells:
   - The first cell must be 0 or 1. 0 for the core clocks and 1 for the
     gateable clocks.
   - The second cell identifies the particular core clock or gateable
     clocks.

  The following clocks are available:
   - Core clocks
     - 0 0 APLL
     - 0 1 PPv2 core
     - 0 2 EIP
     - 0 3 Core
     - 0 4 NAND core
     - 0 5 SDIO core
   - Gateable clocks
     - 1 0 Audio
     - 1 1 Comm Unit
     - 1 2 NAND
     - 1 3 PPv2
     - 1 4 SDIO
     - 1 5 MG Domain
     - 1 6 MG Core
     - 1 7 XOR1
     - 1 8 XOR0
     - 1 9 GOP DP
     - 1 11 PCIe x1 0
     - 1 12 PCIe x1 1
     - 1 13 PCIe x4
     - 1 14 PCIe / XOR
     - 1 15 SATA
     - 1 16 SATA USB
     - 1 17 Main
     - 1 18 SD/MMC/GOP
     - 1 21 Slow IO (SPI, NOR, BootROM, I2C, UART)
     - 1 22 USB3H0
     - 1 23 USB3H1
     - 1 24 USB3 Device
     - 1 25 EIP150
     - 1 26 EIP197

  Pinctrl:
  --------

  For common binding part and usage, refer to the file
  Documentation/devicetree/bindings/pinctrl/marvell,mvebu-pinctrl.txt.

  GPIO:
  -----

  For common binding part and usage, refer to
  Documentation/devicetree/bindings/gpio/gpio-mvebu.yaml.

  Thermal:
  --------

  For common binding part and usage, refer to
  Documentation/devicetree/bindings/thermal/thermal*.yaml

properties:
  compatible:
    items:
      - const: syscon
      - const: simple-mfd
    description: Compatibility strings for the CP110 System Controller.
  reg:
    description: Register window for the system controller.
    items:
      - description: Base address of register window.
      - description: Size of register window.

  clock:
    description: Clock provider subnode.
    type: object
    properties:
      compatible:
        const: "marvell,cp110-clock"
      "#clock-cells":
        const: 2
    required:
      - compatible
      - "#clock-cells"
    additionalProperties: false

  pinctrl:
    description: Pin controller subnode.
    type: object
    properties:
      compatible:
        items:
          - enum:
              - marvell,armada-7k-pinctrl
              - marvell,armada-8k-cpm-pinctrl
              - marvell,armada-8k-cps-pinctrl
              - marvell,cp115-standalone-pinctrl
    required:
      - compatible
    additionalProperties: false

patternProperties:
  "^gpio@.*":
    description: GPIO controller subnode.
    type: object
    properties:
      compatible:
        const: "marvell,armada-8k-gpio"
      offset:
        description: Offset address inside the system controller.
        $ref: /schemas/types.yaml#/definitions/uint32
      ngpios:
        description: Number of GPIOs.
        $ref: /schemas/types.yaml#/definitions/uint32
      gpio-controller:
        description: Must be set to indicate a GPIO controller.
        type: boolean
      "#gpio-cells":
        const: 2
      gpio-ranges:
        description: Mapping of GPIO controller ranges to pin controller.
        items:
          - description: Phandle to pinctrl provider.
          - description: GPIO controller base offset.
          - description: Pin controller base offset.
          - description: Number of GPIOs.
    required:
      - compatible
      - offset
      - ngpios
      - gpio-controller
      - "#gpio-cells"
      - gpio-ranges
    additionalProperties: false

  "^thermal-sensor@.*":
    description: Thermal sensor subnode.
    type: object
    properties:
      compatible:
        const: "marvell,armada-cp110-thermal"
      reg:
        description: Register range for thermal functions.
        items:
          - description: Offset of thermal registers.
          - description: Size of thermal register range.
      interrupts-extended:
        description: Overheat interrupt handle.
        items:
          - description: Phandle to ICU-SEI irqchip.
          - description: Interrupt number.
          - description: Interrupt type flags.
      "#thermal-sensor-cells":
        const: 1
    required:
      - compatible
      - reg
    additionalProperties: false

additionalProperties: false
```

## Documentation/devicetree/bindings/arm/mediatek/mediatek,g3dsys.yaml
```yaml
# SPDX-License-Identifier: (GPL-2.0-only OR BSD-2-Clause)
# Copyright 2025 MediaTek
%YAML 1.2
---
$id: http://devicetree.org/schemas/arm/mediatek/mediatek,g3dsys.yaml#
$schema: http://devicetree.org/meta-schemas/core.yaml#

title: MediaTek G3DSYS Controller

maintainers:
  - Sean Wang <sean.wang@mediatek.com>

description: |
  MediaTek g3dsys controller provides various clocks and reset controller to
  the GPU.

  The g3dsys controller uses the common clk binding from
  Documentation/devicetree/bindings/clock/clock-bindings.txt.
  The available clocks are defined in dt-bindings/clock/mt*-clk.h.

properties:
  compatible:
    oneOf:
      - items:
          - const: mediatek,mt2701-g3dsys
          - const: syscon
      - items:
          - const: mediatek,mt7623-g3dsys
          - const: mediatek,mt2701-g3dsys
          - const: syscon
  reg:
    description: Register base address and size for the controller.
  "#clock-cells":
    description: Number of clock specifier cells.
    const: 1
  "#reset-cells":
    description: Number of reset specifier cells.
    const: 1

additionalProperties: false
```

## Documentation/devicetree/bindings/arm/omap/prcm.yaml
```yaml
# SPDX-License-Identifier: (GPL-2.0-only OR BSD-2-Clause)
%YAML 1.2
---
$id: http://devicetree.org/schemas/arm/omap/prcm.yaml#
$schema: http://devicetree.org/meta-schemas/core.yaml#

title: TI Power Reset and Clock Manager (PRCM)

maintainers:
  - Tero Kristo <t-kristo@ti.com>
  - Tony Lindgren <tony@atomide.com>

description: |
  Power Reset and Clock Manager lists the device clocks and clockdomains under
  a DT hierarchy. Each TI SoC can have multiple PRCM entities listed for it,
  each describing one module and the clock hierarchy under it. see [1] for
  documentation about the individual clock/clockdomain nodes.

  [1] Documentation/devicetree/bindings/clock/ti/*

  Required properties:
  - compatible: Must be one of the listed PRCM-compatible strings.
  - reg: Contains PRCM module register address range (base address and length).
  - clocks: Clocks provided by this PRCM module.
  - clockdomains: Clock domains provided by this PRCM module.
  - #clock-cells: Number of clock specifier cells (always 0).
  - clock-output-names: Names assigned to clocks in this module.

properties:
  compatible:
    description: Accepted PRCM-compatible strings.
    items:
      - enum:
          - ti,am3-prcm
          - ti,am4-prcm
          - ti,omap2-prcm
          - ti,omap3-prm
          - ti,omap3-cm
          - ti,omap4-cm1
          - ti,omap4-prm
          - ti,omap4-cm2
          - ti,omap4-scrm
          - ti,omap5-prm
          - ti,omap5-cm-core-aon
          - ti,omap5-scrm
          - ti,omap5-cm-core
          - ti,dra7-prm
          - ti,dra7-cm-core-aon
          - ti,dra7-cm-core
          - ti,dm814-prcm
          - ti,dm816-prcm

  reg:
    maxItems: 1
    description: PRCM module register address range

  clocks:
    maxItems: 1
    description: PRCM module clocks

  clockdomains:
    description: PRCM module clockdomains

  '#clock-cells':
    const: 0
    description: Number of clock specifier cells (always 0)

  clock-output-names:
    description: Names for the PRCM clocks

required:
  - compatible
  - reg
  - clocks
  - clockdomains
  - clock-output-names

additionalProperties: false
```
