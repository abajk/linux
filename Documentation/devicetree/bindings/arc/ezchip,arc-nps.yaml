## Documentation/devicetree/bindings/arc/ezchip,arc-nps.yaml
```yaml
# SPDX-License-Identifier: (GPL-2.0-only OR BSD-2-Clause)

%YAML 1.2
---
$id: http://devicetree.org/schemas/ezchip,arc-nps.yaml#
$schema: http://devicetree.org/meta-schemas/core.yaml#
maintainers:
  - linux-dt@vger.kernel.org

title: EZchip NPS Network Processor Platforms

description: |
  EZchip NPS Network Processor Platforms Device Tree Bindings

  Appliance main board with NPS400 ASIC.

properties:
  compatible:
    description: Device compatible with EZchip NPS Network Processor Platforms.
    items:
      - const: ezchip,arc-nps

required:
  - compatible

additionalProperties: false
```

## Documentation/devicetree/bindings/arc/snps,arc-sdp.yaml
```yaml
---
# SPDX-License-Identifier: (GPL-2.0-only OR BSD-2-Clause)
$id: http://devicetree.org/schemas/snps,arc-sdp.yaml#
$schema: http://devicetree.org/meta-schemas/core.yaml#

title: Synopsys DesignWare ARC SDP Main Board

description:
  SDP Main Board with an AXC001 CPU Card hoisting ARC700 core in silicon or
  AXC003 FPGA Card.

maintainers:
  - Synopsys DesignWare ARC SoC Team <soc-team@synopsys.com>

properties:
  $nodename:
    const: '/'

  compatible:
    items:
      - enum:
          - snps,axs101
          - snps,axs103
      - const: snps,arc-sdp

required:
  - compatible

additionalProperties: true
```

## Documentation/devicetree/bindings/arc/snps,arc700-pct.yaml
```yaml
# SPDX-License-Identifier: (GPL-2.0-only OR BSD-2-Clause)
# Copyright 2025 Eric Engestrom
%YAML 1.2
---
$id: http://devicetree.org/schemas/snps,arc700-pct.yaml#
# $schema is the meta-schema this schema should be validated with.
$schema: http://devicetree.org/meta-schemas/core.yaml#

title: SNPS ARC700 Performance Counters

maintainers:
  - Eric Engestrom <eric@engestrom.ch>

description: |
  * ARC Performance Counters

  The ARC700 can be configured with a pipeline performance monitor for counting
  CPU and cache events like cache misses and hits. Like conventional PCT there
  are 100+ hardware conditions dynamically mapped to up to 32 counters

  Note that:
   * The ARC 700 PCT does not support interrupts; although HW events may be
     counted, the HW events themselves cannot serve as a trigger for a sample.

properties:
  compatible:
    description: Supported compatible string identifying this ARC700 performance counter
    items:
      - const: snps,arc700-pct

required:
  - compatible

additionalProperties: false

examples:
  - |
    pmu {
        compatible = "snps,arc700-pct";
    };
```

## Documentation/devicetree/bindings/arc/snps,hsdk.yaml
```yaml
%YAML 1.2
---
$id: http://devicetree.org/schemas/snps,hsdk.yaml#
$schema: http://devicetree.org/meta-schemas/core.yaml#

title: Synopsys DesignWare ARC HS Development Kit
maintainers:
  - Alexey Brodkin <abrodkin@synopsys.com>

description: |
  Synopsys DesignWare ARC HS Development Kit Device Tree Bindings
  ---------------------------------------------------------------------------
  ARC HSDK Board with quad-core ARC HS38x4 in silicon.

properties:
  compatible:
    items:
      - const: snps,hsdk

required:
  - compatible

additionalProperties: false
```

## Documentation/devicetree/bindings/arm/altera/socfpga-sdram-edac.yaml
```yaml
# SPDX-License-Identifier: (GPL-2.0-only OR BSD-2-Clause)
# Copyright 2025 Thor Thayer <tthayer@opensource.altera.com>
%YAML 1.2
---
$id: http://devicetree.org/schemas/arm/altera/socfpga-sdram-edac.yaml#
$schema: http://devicetree.org/meta-schemas/core.yaml#

title: Altera SOCFPGA SDRAM Error Detection & Correction [EDAC]
maintainers:
  - Thor Thayer <tthayer@opensource.altera.com>

description: |
  Altera SOCFPGA SDRAM Error Detection & Correction [EDAC]
  The EDAC accesses a range of registers in the SDRAM controller.

properties:
  compatible:
    description: Contains compatible string identifying the SDRAM EDAC controller.
    contains:
      enum:
        - altr,sdram-edac
        - altr,sdram-edac-a10

  altr,sdr-syscon:
    description: Phandle of the SDR module syscon.
    $ref: /schemas/types.yaml#/definitions/phandle

  interrupts:
    description: ECC interrupt request to the IRQ controller.
    items:
      - description: ECC IRQ specifier in the form <specifier irq flags>.

required:
  - compatible
  - altr,sdr-syscon
  - interrupts

additionalProperties: false

examples:
  - |
    sdramedac {
        compatible = "altr,sdram-edac";
        altr,sdr-syscon = <&sdr>;
        interrupts = <0 39 4>;
    };
```

## Documentation/devicetree/bindings/arm/axis,artpec6.yaml
```yaml
# SPDX-License-Identifier: (GPL-2.0-only OR BSD-2-Clause)
# Copyright 2025 Axis Communications AB
%YAML 1.2
---
$id: http://devicetree.org/schemas/arm/axis,artpec6.yaml#
$schema: http://devicetree.org/meta-schemas/core.yaml#

title: Axis ARTPEC-6 SoC

maintainers:
  - Lars Persson <lars.persson@axis.com>
  - Rob Herring (Arm) <robh@kernel.org>

description: |
  Axis Communications AB
  ARTPEC series SoC Device Tree Bindings

  ARTPEC-6 ARM SoC

  ARTPEC-6 Development board:

properties:
  compatible:
    oneOf:
      - items:
          - const: axis,artpec6-dev-board
          - const: axis,artpec6
      - items:
          - const: axis,artpec6

required:
  - compatible

additionalProperties: false
```

## Documentation/devicetree/bindings/arm/bcm/brcm,bcm63138.yaml
```yaml
# SPDX-License-Identifier: (GPL-2.0-only OR BSD-2-Clause)
%YAML 1.2
---
$id: http://devicetree.org/schemas/arm/bcm/brcm,bcm63138.yaml#
$schema: http://devicetree.org/meta-schemas/core.yaml#

title: BCM63138 DSL System-on-a-Chip

maintainers:
  - Florian Fainelli <f.fainelli@gmail.com>
  - Ken Kurematsu <k.kurematsu@nskint.co.jp>
  - Mauro Carvalho Chehab <mchehab+huawei@kernel.org>
  - Scott Branden <sbranden@broadcom.com>

description: |
  Broadcom BCM63138 DSL System-on-a-Chip device tree bindings

  Boards compatible with the BCM63138 DSL System-on-a-Chip should have the
  following properties.

  An optional Boot lookup table Device Tree node is required for secondary CPU
  initialization as well as a 'resets' phandle to the correct PMB controller as
  defined in reset/brcm,bcm63138-pmb.txt for this secondary CPU, and an
  'enable-method' property.

  Two nodes are required for software reboot: a timer node and a syscon-reboot
  node.

  See Documentation/devicetree/bindings/power/reset/syscon-reboot.yaml for the
  detailed list of properties, the two values defined below are specific to the
  BCM6328-style timer.

properties:
  compatible:
    const: brcm,bcm63138

  bootlut:
    description: Boot lookup table Device Tree node
    type: object
    additionalProperties: false
    properties:
      compatible:
        items:
          - const: brcm,bcm63138-bootlut
      reg:
        items:
          - description: register base address
          - description: length for the Boot Lookup table
      enable-method:
        description: Method to enable secondary CPU initialization
        enum:
          - brcm,bcm63138
      resets:
        maxItems: 1

    required:
      - compatible
      - reg
      - enable-method
      - resets

  timer:
    description: Timer node for software reboot
    type: object
    additionalProperties: false
    properties:
      compatible:
        items:
          - enum:
              - brcm,bcm6328-timer
              - syscon
      reg:
        items:
          - description: register base address
          - description: register length
    required:
      - compatible
      - reg

  reboot:
    description: Syscon reboot node for software reboot
    type: object
    additionalProperties: false
    properties:
      compatible:
        const: syscon-reboot
      regmap:
        description: phandle to timer node
        items:
          - description: phandle to timer node
      offset:
        description: Offset of the TIMER_WD_TIMER_RESET register from the beginning of the TIMER block
      mask:
        description: SoftRst bit mask
    required:
      - compatible
      - regmap
      - offset
      - mask

additionalProperties: false
```

## Documentation/devicetree/bindings/arm/bcm/brcm,brcmstb.yaml
```yaml
# SPDX-License-Identifier: (GPL-2.0-only OR BSD-2-Clause)
%YAML 1.2
---
$id: http://devicetree.org/schemas/brcm,brcmstb.yaml#
$schema: http://devicetree.org/meta-schemas/core.yaml#

title: Broadcom STB platforms
maintainers:
  - Brian Norris <computersforpeace@gmail.com>
  - Doug Berger <opendmb@gmail.com>
  - Florian Fainelli <f.fainelli@gmail.com>
  - Scott Branden <sbranden@broadcom.com>

description: |
  ARM Broadcom STB platforms Device Tree Bindings
  -----------------------------------------------
  Boards with Broadcom Brahma15 ARM-based BCMxxxx (generally BCM7xxx variants)
  SoC shall have the following DT organization:

  cpu-biu-ctrl node
  -------------------
  SoCs with Broadcom Brahma15 ARM-based and Brahma53 ARM64-based CPUs have a
  specific Bus Interface Unit (BIU) block which controls and interfaces the CPU
  complex to the different Memory Controller Ports (MCP), one per memory
  controller (MEMC). This BIU block offers a feature called Write Pairing which
  consists in collapsing two adjacent cache lines into a single (bursted) write
  transaction towards the memory controller (MEMC) to maximize write bandwidth.

  Nodes that allow for support of SMP initialization and reboot are required:

  Power management
  ----------------
  For power management (particularly, S2/S3/S5 system suspend), the following SoC
  components are needed:

  Always-On control block (AON CTRL)
  This hardware provides control registers for the "always-on" (even in low-power
  modes) hardware, such as the Power Management State Machine (PMSM).

  Memory controllers
  ------------------
  A Broadcom STB SoC typically has a number of independent memory controllers,
  each of which may have several associated hardware blocks, which are versioned
  independently (control registers, DDR PHYs, etc.). One might consider
  describing these controllers as a parent "memory controllers" block, which
  contains N sub-nodes (one for each controller in the system), each of which is
  associated with a number of hardware register resources (e.g., its PHY).

properties:
  compatible:
    description: SoC and platform compatible strings
    oneOf:
      - items:
          - pattern: '^brcm,bcm[0-9]+$'
          - const: 'brcm,brcmstb'
      - items:
          - const: 'brcm,brcmstb'

  smpboot:
    $ref: '#/definitions/smpboot'
  reboot:
    $ref: '#/definitions/reboot'
  memory_controllers:
    $ref: '#/definitions/memory-controllers'

patternProperties:
  '^.*-ctrl@.*':
    anyOf:
      - $ref: '#/definitions/syscon-sun-top-ctrl'
      - $ref: '#/definitions/syscon-cpu-biu-ctrl'
      - $ref: '#/definitions/syscon-hif-continuation'
  '^aon-ctrl@.*':
    $ref: '#/definitions/aon-ctrl'

required:
  - compatible

additionalProperties: false

definitions:
  syscon-sun-top-ctrl:
    description: System-on-chip SUN_TOP control registers
    type: object
    properties:
      compatible:
        description: Compatibility for SUN_TOP control
        items:
          - pattern: '^brcm,bcm[0-9]+-sun-top-ctrl$'
          - const: syscon
      reg:
        description: Register address and size for SUN_TOP control
        $ref: /schemas/types.yaml#/definitions/reg

  syscon-cpu-biu-ctrl:
    description: CPU BIU control registers
    type: object
    properties:
      compatible:
        description: Compatibility for CPU BIU control
        items:
          - pattern: '^brcm,bcm[0-9]+-cpu-biu-ctrl$'
          - const: 'brcm,brcmstb-cpu-biu-ctrl'
          - const: syscon
      reg:
        description: Register address and size for CPU BIU control
        $ref: /schemas/types.yaml#/definitions/reg
      brcm,write-pairing:
        description: Indicates support for write-pairing feature
        type: boolean

  syscon-hif-continuation:
    description: CPU boot continuation registers
    type: object
    properties:
      compatible:
        description: Compatibility for CPU boot continuation
        items:
          - pattern: '^brcm,bcm[0-9]+-hif-continuation$'
          - const: syscon
      reg:
        description: Register address and size for HIF continuation
        $ref: /schemas/types.yaml#/definitions/reg

  smpboot:
    description: SMP initialization and boot continuation
    type: object
    properties:
      compatible:
        description: smpboot compatible string
        const: brcm,brcmstb-smpboot
      syscon-cpu:
        description: CPU power-on and reset register phandle and offsets
        $ref: /schemas/types.yaml#/definitions/phandle-array
        items:
          - items:
              - description: phandle to ?
              - description: offset of ?
              - description: offset of ?
      syscon-cont:
        description: CPU boot continuation syscon phandle
        $ref: /schemas/types.yaml#/definitions/phandle

  reboot:
    description: System reboot control
    type: object
    properties:
      compatible:
        description: Reboot compatible string
        oneOf:
          - const: brcm,brcmstb-reboot
          - const: brcm,bcm7038-reboot
      syscon:
        description: System reset register phandle and offsets
        $ref: /schemas/types.yaml#/definitions/phandle-array
        items:
          - items:
              - description: phandle to ?
              - description: offset of ?
              - description: offset of ?

  aon-ctrl:
    description: Always-on control registers
    type: object
    properties:
      compatible:
        description: AON control compatible string
        const: brcm,brcmstb-aon-ctrl
      reg:
        description: Register address and size for AON control
        $ref: /schemas/types.yaml#/definitions/reg

  memory-controllers:
    description: Memory controller bus
    type: object
    properties:
      ranges:
        description: Address translation ranges
        $ref: /schemas/types.yaml#/definitions/ranges
      compatible:
        items:
          - const: simple-bus
    additionalProperties:
      $ref: '#/definitions/memc'

  memc:
    description: Single memory controller
    type: object
    properties:
      ranges:
        description: Sub-bus ranges
        $ref: /schemas/types.yaml#/definitions/ranges
      compatible:
        items:
          - const: brcm,brcmstb-memc
          - const: simple-bus
    additionalProperties:
      anyOf:
        - $ref: '#/definitions/ddr-phy'
        - $ref: '#/definitions/shimphy'
        - $ref: '#/definitions/memc-ddr'

  ddr-phy:
    description: DDR PHY control registers
    type: object
    properties:
      compatible:
        enum:
          - brcm,brcmstb-ddr-phy-v71.1
          - brcm,brcmstb-ddr-phy-v72.0
          - brcm,brcmstb-ddr-phy-v225.1
          - brcm,brcmstb-ddr-phy-v240.1
          - brcm,brcmstb-ddr-phy-v240.2
      reg:
        description: DDR PHY register address and size
        maxItems: 1

  shimphy:
    description: DDR SHIMPHY control registers
    type: object
    properties:
      compatible:
        const: brcm,brcmstb-ddr-shimphy-v1.0
      reg:
        description: DDR SHIMPHY register address and size
        maxItems: 1

  memc-ddr:
    description: Memory controller DDR sequencer registers
    type: object
    properties:
      compatible:
        const: brcm,brcmstb-memc-ddr
      reg:
        description: Memory controller DDR registers address and size
        maxItems: 1
```
