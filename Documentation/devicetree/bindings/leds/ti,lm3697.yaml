## Documentation/devicetree/bindings/media/hisilicon,hix5hd2-ir.yaml
```yaml
# SPDX-License-Identifier: (GPL-2.0-only OR BSD-2-Clause)
# Copyright 2018 Linaro Ltd.
%YAML 1.2
---
$id: http://devicetree.org/schemas/hisilicon,hix5hd2-ir.yaml#
$schema: http://devicetree.org/meta-schemas/core.yaml#

title: HiSilicon HIX5HD2 IR controller

maintainers:
  - Guoxiong Yan <yanguoxiong@huawei.com>
  - Ruqiang Ju <juruqiang@huawei.com>
  - Sean Wang <sean.wang@mediatek.com>
  - Shawn Guo <shawn.guo@linaro.org>

description: |
  Device-Tree bindings for HIX5HD2 infrared (IR) IP.

  Optional properties:
    * linux,rc-map-name: see rc.txt file in the same directory.
    * hisilicon,power-syscon: DEPRECATED. Don't use this in new DTS files.
      Provide correct clocks instead.

properties:
  compatible:
    items:
      - enum:
          - hisilicon,hix5hd2-ir
          - hisilicon,hi3796cv300-ir

  reg:
    items:
      - description: Base physical address of the controller and length of memory mapped region.

  interrupts:
    items:
      - description: Interrupt specifier for the sole interrupt generated by the device.

  clocks:
    items:
      - description: Clock phandle and specifier pair.

  linux,rc-map-name:
    $ref: /schemas/types.yaml#/definitions/string
    description: Remote controller map name; see rc.txt file in the same directory.

  hisilicon,power-syscon:
    description: DEPRECATED. Don't use this in new DTS files. Provide correct clocks instead.
    $ref: /schemas/types.yaml#/definitions/phandle

required:
  - compatible
  - reg
  - interrupts
  - clocks

additionalProperties: false

examples:
  - |
      ir: ir@f8001000 {
          compatible = "hisilicon,hix5hd2-ir";
          reg = <0xf8001000 0x1000>;
          interrupts = <0 47 4>;
          clocks = <&clock HIX5HD2_IR_CLOCK>;
          linux,rc-map-name = "rc-tivo";
      };
```

## Documentation/devicetree/bindings/media/i2c/melexis,mlx90640.yaml
```yaml
# SPDX-License-Identifier: (GPL-2.0-only OR BSD-2-Clause)
# Copyright 2025 Matt Ranostay
%YAML 1.2
---
$id: http://devicetree.org/schemas/media/i2c/melexis,mlx90640.yaml#
$schema: http://devicetree.org/meta-schemas/core.yaml#

title: Melexis MLX90640 FIR Sensor

maintainers:
  - Matt Ranostay <matt@ranostay.sg>

description: |
  * Melexis MLX90640 FIR Sensor

  Melexis MLX90640 FIR sensor support which allows recording of thermal data
  with 32x24 resolution excluding 2 lines of coefficient data that is used by
  userspace to render processed frames.

properties:
  compatible:
    items:
      - const: melexis,mlx90640

  reg:
    description: I2C address of the device
    items:
      - description: The I2C address

required:
  - compatible
  - reg

additionalProperties: false

examples:
  - |
    i2c0@1c22000 {
        ...
        mlx90640@33 {
            compatible = "melexis,mlx90640";
            reg = <0x33>;
        };
        ...
    };
```

## Documentation/devicetree/bindings/media/i2c/panasonic,amg88xx.yaml
```yaml
# SPDX-License-Identifier: (GPL-2.0-only OR BSD-2-Clause)
# Copyright 2025 Matt Ranostay
%YAML 1.2
---
$id: http://devicetree.org/schemas/media/i2c/panasonic,amg88xx.yaml#
# $schema is the meta-schema this schema should be validated with.
$schema: http://devicetree.org/meta-schemas/core.yaml#

title: Panasonic AMG88xx

maintainers:
  - Matt Ranostay <matt@ranostay.sg>

description: |
  The Panasonic family of AMG88xx Grid-Eye sensors allow recording
  8x8 10Hz video which consists of thermal datapoints.

properties:
  compatible:
    description: Must be "panasonic,amg88xx".
    items:
      - const: panasonic,amg88xx

  reg:
    description: I2C address of the device.
    items:
      - description: I2C address of the device.

required:
  - compatible
  - reg

additionalProperties: false

examples:
  - |
    i2c0@1c22000 {
        amg88xx@69 {
            compatible = "panasonic,amg88xx";
            reg = <0x69>;
        };
    };
```

## Documentation/devicetree/bindings/media/i2c/toshiba,et8ek8.yaml
```yaml
# SPDX-License-Identifier: (GPL-2.0-only OR BSD-2-Clause)
# Copyright 2025 Pavel Machek
%YAML 1.2
---
$id: http://devicetree.org/schemas/media/i2c/toshiba,et8ek8.yaml#
$schema: http://devicetree.org/meta-schemas/core.yaml#

title: Toshiba et8ek8 5MP sensor

maintainers:
  - Pavel Machek <pavel@ucw.cz>

description: |
  Toshiba et8ek8 5MP sensor

  Toshiba et8ek8 5MP sensor is an image sensor found in Nokia N900 device

  More detailed documentation can be found in
  Documentation/devicetree/bindings/media/video-interfaces.txt .

properties:
  compatible:
    items:
      - const: toshiba,et8ek8

  reg:
    items:
      - description: I2C address of the sensor

  vana-supply: true

  clocks:
    maxItems: 1
    description: External clock to the sensor

  clock-frequency:
    description: Pre-determined frequency for the external clock to the sensor

  reset-gpios:
    maxItems: 1
    description: XSHUTDOWN GPIO; active low, hardware standby when low

  flash-leds:
    description: See ../video-interfaces.txt

  lens-focus:
    description: See ../video-interfaces.txt

  remote-endpoint:
    description: A phandle to the bus receiver's endpoint node
    $ref: /schemas/types.yaml#/definitions/phandle

additionalProperties: false

examples:
  - |
    &i2c3 {
        clock-frequency = <400000>;

        cam1: camera@3e {
            compatible = "toshiba,et8ek8";
            reg = <0x3e>;
            vana-supply = <&vaux4>;
            clocks = <&isp 0>;
            clock-frequency = <9600000>;
            reset-gpio = <&gpio4 6 GPIO_ACTIVE_HIGH>; /* 102 */
            port {
                csi_cam1: endpoint {
                    remote-endpoint = <&csi_out1>;
                };
            };
        };
    };
```

## Documentation/devicetree/bindings/media/img-ir-rev1.yaml
```yaml
# SPDX-License-Identifier: (GPL-2.0-only OR BSD-2-Clause)
# Copyright 2025 James Hogan <jhogan@kernel.org>, Marco Franchi <marco.franchi@nxp.com>
%YAML 1.2
---
$id: http://devicetree.org/schemas/media/img-ir-rev1.yaml#
$schema: http://devicetree.org/meta-schemas/core.yaml#

title: ImgTec Infrared (IR) decoder version 1

maintainers:
  - James Hogan <jhogan@kernel.org>
  - Marco Franchi <marco.franchi@nxp.com>

description: |
  * ImgTec Infrared (IR) decoder version 1

  This binding is for Imagination Technologies' Infrared decoder block,
  specifically major revision 1.

properties:
  compatible:
    items:
      - const: img,ir-rev1

  reg:
    description: Physical base address of the controller and length of memory mapped region.
    items:
      - description: Base address of the controller.
      - description: Size of the memory mapped region.

  interrupts:
    description: The interrupt specifier to the CPU.
    items:
      - description: Interrupt number.
      - description: Interrupt flags.

  clocks:
    description: List of controller clocks. Up to 3 clocks may be specified.
    items:
      - description: Core clock (defaults to 32.768 KHz if omitted).
      - description: System side (fast) clock.
      - description: Power modulation clock.

  clock-names:
    description: List of clock names corresponding to the clocks property.
    items:
      - const: core
      - const: sys
      - const: mod

required:
  - compatible
  - reg
  - interrupts

additionalProperties: false

examples:
  - |
    ir@2006200 {
        compatible = "img,ir-rev1";
        reg = <0x02006200 0x100>;
        interrupts = <29 4>;
        clocks = <&clk_32khz>;
        clock-names = "core";
    };
```

## Documentation/devicetree/bindings/media/marvell,pxa270-qci.yaml
```yaml
# SPDX-License-Identifier: (GPL-2.0-only OR BSD-2-Clause)
# Copyright 2025 Robert Jarzmik <robert.jarzmik@free.fr>
# Copyright 2025 Rob Herring <robh@kernel.org>
%YAML 1.2
---
$id: http://devicetree.org/schemas/media/marvell,pxa270-qci.yaml#
$schema: http://devicetree.org/meta-schemas/core.yaml#

title: Marvell PXA camera host interface

maintainers:
  - Robert Jarzmik <robert.jarzmik@free.fr>
  - Rob Herring <robh@kernel.org>

description: |
  Marvell PXA camera host interface

properties:
  compatible:
    items:
      - const: marvell,pxa270-qci
    description: Must be "marvell,pxa270-qci".
  reg:
    items:
      - description: Register base address.
      - description: Register range size.
  interrupts:
    items:
      - description: Interrupt number for camera host interface.
  clocks:
    maxItems: 1
    description: Input clock for the host interface.
  clock-frequency:
    description: Frequency of the master clock (MCLK) output driven by the host interface, in Hz.
  "#clock-cells":
    const: 1
  clock-output-names:
    $ref: /schemas/types.yaml#/definitions/string-array
    description: Name of the clock output driving the sensor master clock.
    items:
      - description: Name of the MCLK output.
  port:
    description: Parallel bus port for connecting to sensor endpoint.
    type: object
    additionalProperties: true
    properties:
      "#address-cells":
        const: 1
      "#size-cells":
        const: 0
    required:
      - "#address-cells"
      - "#size-cells"

required:
  - compatible
  - reg
  - interrupts

additionalProperties: false

examples:
  - |
    pxa_camera: pxa_camera@50000000 {
        compatible = "marvell,pxa270-qci";
        reg = <0x50000000 0x1000>;
        interrupts = <33>;

        clocks = <&pxa2xx_clks 24>;
        clock-names = "ciclk";
        clock-frequency = <50000000>;
        clock-output-names = "qci_mclk";

        port {
            #address-cells = <1>;
            #size-cells = <0>;

            /* Parallel bus endpoint */
            qci: endpoint@0 {
                reg = <0>;       /* Local endpoint # */
                remote-endpoint = <&mt9m111_1>;
                bus-width = <8>; /* Used data lines */
                hsync-active = <0>; /* Active low */
                vsync-active = <0>; /* Active low */
                pclk-sample = <1>; /* Rising */
            };
        };
    };
```

## Documentation/devicetree/bindings/media/mediatek,mt8173-mdp.yaml
```yaml
# SPDX-License-Identifier: (GPL-2.0-only OR BSD-2-Clause)
%YAML 1.2
---
$id: http://devicetree.org/schemas/media/mediatek,mt8173-mdp.yaml#
$schema: http://devicetree.org/meta-schemas/core.yaml#

title: Mediatek Media Data Path

maintainers:
  - Mauro Carvalho Chehab <mchehab+huawei@kernel.org>
  - Minghsiu Tsai <minghsiu.tsai@mediatek.com>
  - Yong Wu <yong.wu@mediatek.com>

description: |
  Mediatek Media Data Path is used for scaling and color space conversion.

properties:
  compatible:
    description: Bindings provide the Mediatek media data path controller.
    items:
      - const: mediatek,mt8173-mdp
  mediatek,vpu:
    description: The node of the video processor unit.
    $ref: /schemas/types.yaml#/definitions/phandle

patternProperties:
  '^rdma@.*$':
    $ref: '#/definitions/rdma'
  '^rsz@.*$':
    $ref: '#/definitions/rsz'
  '^wdma@.*$':
    $ref: '#/definitions/wdma'
  '^wrot@.*$':
    $ref: '#/definitions/wrot'

required:
  - compatible
  - mediatek,vpu

additionalProperties: false

definitions:
  rdma:
    description: Read DMA (RDMA) function block.
    type: object
    additionalProperties: false
    properties:
      compatible:
        items:
          - const: mediatek,mt8173-mdp-rdma
      reg:
        maxItems: 1
      clocks:
        maxItems: 2
      power-domains:
        maxItems: 1
      iommus:
        maxItems: 1
    required:
      - compatible
      - reg
      - clocks
      - power-domains
      - iommus

  rsz:
    description: Resizer (RSZ) function block.
    type: object
    additionalProperties: false
    properties:
      compatible:
        items:
          - const: mediatek,mt8173-mdp-rsz
      reg:
        maxItems: 1
      clocks:
        maxItems: 1
      power-domains:
        maxItems: 1
    required:
      - compatible
      - reg
      - clocks
      - power-domains

  wdma:
    description: Write DMA (WDMA) function block.
    type: object
    additionalProperties: false
    properties:
      compatible:
        items:
          - const: mediatek,mt8173-mdp-wdma
      reg:
        description: Physical base address and length of the WDMA registers.
        $ref: /schemas/types.yaml#/definitions/reg
      clocks:
        description: Device clocks.
        $ref: /schemas/types.yaml#/definitions/clocks
      power-domains:
        description: Power domain for WDMA.
        $ref: /schemas/types.yaml#/definitions/power-domains
      iommus:
        description: IOMMU mapping for WDMA.
        $ref: /schemas/types.yaml#/definitions/phandles
    required:
      - compatible
      - reg
      - clocks
      - power-domains
      - iommus

  wrot:
    description: Write DMA with rotation (WROT) function block.
    type: object
    additionalProperties: false
    properties:
      compatible:
        items:
          - const: mediatek,mt8173-mdp-wrot
      reg:
        maxItems: 1
      clocks:
        maxItems: 1
      power-domains:
        maxItems: 1
      iommus:
        maxItems: 1
    required:
      - compatible
      - reg
      - clocks
      - power-domains
      - iommus

examples:
  - |
    mdp: mdp@14000000 {
        compatible = "mediatek,mt8173-mdp";
        mediatek,vpu = <&vpu>;
        reg = <0x14000000 0x1000>;
        clocks = <&mmsys CLK_MM_MDP>;
        power-domains = <&scpsys MT8173_POWER_DOMAIN_MM>;
        mdp_rdma0: rdma@14001000 {
            compatible = "mediatek,mt8173-mdp-rdma";
            reg = <0x14001000 0x1000>;
            clocks = <&mmsys CLK_MM_MDP_RDMA0>, <&mmsys CLK_MM_MUTEX_32K>;
            power-domains = <&scpsys MT8173_POWER_DOMAIN_MM>;
            iommus = <&iommu M4U_PORT_MDP_RDMA0>;
        };
        mdp_rsz0: rsz@14003000 {
            compatible = "mediatek,mt8173-mdp-rsz";
            reg = <0x14003000 0x1000>;
            clocks = <&mmsys CLK_MM_MDP_RSZ0>;
            power-domains = <&scpsys MT8173_POWER_DOMAIN_MM>;
        };
        mdp_wdma0: wdma@14006000 {
            compatible = "mediatek,mt8173-mdp-wdma";
            reg = <0x14006000 0x1000>;
            clocks = <&mmsys CLK_MM_MDP_WDMA>;
            power-domains = <&scpsys MT8173_POWER_DOMAIN_MM>;
            iommus = <&iommu M4U_PORT_MDP_WDMA>;
        };
        mdp_wrot0: wrot@14007000 {
            compatible = "mediatek,mt8173-mdp-wrot";
            reg = <0x14007000 0x1000>;
            clocks = <&mmsys CLK_MM_MDP_WROT0>;
            power-domains = <&scpsys MT8173_POWER_DOMAIN_MM>;
            iommus = <&iommu M4U_PORT_MDP_WROT0>;
        };
    };
```
