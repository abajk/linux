## Documentation/devicetree/bindings/media/mediatek,mt8173-vpu.yaml
```yaml
# SPDX-License-Identifier: (GPL-2.0-only OR BSD-2-Clause)
# Copyright 2025 Andrew-CT Chen <andrew-ct.chen@mediatek.com>
%YAML 1.2
---
$id: http://devicetree.org/schemas/mediatek,mt8173-vpu.yaml#
$schema: http://devicetree.org/meta-schemas/core.yaml#

title: Mediatek Video Processor Unit

maintainers:
  - Andrew-CT Chen <andrew-ct.chen@mediatek.com>

description: |
  * Mediatek Video Processor Unit
  Video Processor Unit is a HW video controller. It controls HW Codec including
  H.264/VP8/VP9 Decode, H.264/VP8 Encode and Image Processor (scale/rotate/color convert).

properties:
  compatible:
    items:
      - const: mediatek,mt8173-vpu

  reg:
    items:
      - description: tcm base
      - description: Main configuration registers base

  reg-names:
    items:
      - const: tcm
      - const: cfg_reg

  interrupts:
    items:
      - description: Interrupt number to the CPU

  clocks:
    maxItems: 1
    description: Clock name from clock manager

  clock-names:
    items:
      - const: main

  memory-region:
    description: Phandle to a reserved-memory region to be used for VPU extended memory
    $ref: /schemas/types.yaml#/definitions/phandle

required:
  - compatible
  - reg
  - reg-names
  - interrupts
  - clocks
  - clock-names

additionalProperties: false

examples:
  - |
    vpu: vpu@10020000 {
        compatible = "mediatek,mt8173-vpu";
        reg = <0 0x10020000 0 0x30000>,
              <0 0x10050000 0 0x100>;
        reg-names = "tcm", "cfg_reg";
        interrupts = <GIC_SPI 166 IRQ_TYPE_LEVEL_HIGH>;
        clocks = <&topckgen TOP_SCP_SEL>;
        clock-names = "main";
    };
```

## Documentation/devicetree/bindings/media/silabs,si4713.yaml
```yaml
# SPDX-License-Identifier: (GPL-2.0-only OR BSD-2-Clause)
%YAML 1.2
---
$id: http://devicetree.org/schemas/media/silabs,si4713.yaml#
$schema: http://devicetree.org/meta-schemas/core.yaml#

title: Silicon Labs Si4713 FM Radio Transmitter

maintainers:
  - Sebastian Reichel <sre@kernel.org>

description: |
  * Silicon Labs FM Radio transmitter
  The Silicon Labs Si4713 is an FM radio transmitter with receive power scan
  supporting 76-108 MHz. It includes an RDS encoder and has both, a stereo-analog
  and a digital interface, which supports I2S, left-justified and a custom
  DSP-mode format. It is programmable through an I2C interface.

properties:
  compatible:
    contains:
      const: silabs,si4713
    description: Node must have compatible "silabs,si4713"

  reg:
    description: I2C address of the Si4713 device
    items:
      - description: I2C address

  interrupts-extended:
    description: Interrupt specifier for the chip's interrupt
    items:
      - description: Interrupt specifier

  reset-gpios:
    description: GPIO specifier for the chip's reset line
    maxItems: 1

  vdd-supply:
    description: Phandle for Vdd regulator

  vio-supply:
    description: Phandle for Vio regulator

required:
  - compatible
  - reg

additionalProperties: false

examples:
  - |
    &i2c2 {
        fmtx: si4713@63 {
            compatible = "silabs,si4713";
            reg = <0x63>;
            interrupts-extended = <&gpio2 21 IRQ_TYPE_EDGE_FALLING>;
            reset-gpios = <&gpio6 3 GPIO_ACTIVE_HIGH>;
            vio-supply = <&vio>;
            vdd-supply = <&vaux1>;
        };
    };
```

## Documentation/devicetree/bindings/media/spi/sony,cxd2880.yaml
```yaml
# SPDX-License-Identifier: (GPL-2.0-only OR BSD-2-Clause)
# Copyright 2025 Neil Armstrong <neil.armstrong@linaro.org>
# Copyright 2025 Yasunari Takiguchi <Yasunari.Takiguchi@sony.com>
%YAML 1.2
---
$id: http://devicetree.org/schemas/media/spi/sony,cxd2880.yaml#
$schema: http://devicetree.org/meta-schemas/core.yaml#

title: Sony CXD2880 DVB-T2/T tuner + demodulator driver SPI adapter

maintainers:
  - Neil Armstrong <neil.armstrong@linaro.org>
  - Yasunari Takiguchi <Yasunari.Takiguchi@sony.com>

description: |
  Sony CXD2880 DVB-T2/T tuner + demodulator driver SPI adapter

properties:
  compatible:
    const: sony,cxd2880

  reg:
    description: SPI chip select number for the device.
    items:
      - description: Chip select index

  spi-max-frequency:
    description: Maximum SPI bus speed in Hz.

  vcc-supply:
    description: Optional phandle to the vcc regulator to power the adapter.

required:
  - compatible
  - reg
  - spi-max-frequency

additionalProperties: false

examples:
  - |
    cxd2880@0 {
        compatible = "sony,cxd2880";
        reg = <0>; /* CE0 */
        spi-max-frequency = <55000000>; /* 55MHz */
    };
```

## Documentation/devicetree/bindings/media/st,comms-irb.yaml
```yaml
# SPDX-License-Identifier: (GPL-2.0-only OR BSD-2-Clause)
# Copyright 2025 STMicroelectronics
%YAML 1.2
---
$id: http://devicetree.org/schemas/st,comms-irb.yaml#
$schema: http://devicetree.org/meta-schemas/core.yaml#

title: ST Comms IRB controller

maintainers:
  - Srinivas Kandagatla <srinivas.kandagatla@st.com>

description: |
  Device-Tree bindings for ST IRB IP

properties:
  compatible:
    description: Driver compatible string; must contain st,comms-irb
    items:
      - enum: [st, comms-irb]

  reg:
    description: Base physical address of the controller and length of memory mapped region
    items:
      - description: Base physical address of the controller
      - description: Length of memory mapped region

  interrupts:
    description: Interrupt specifier for the sole interrupt generated by the device
    items:
      - description: Interrupt specifier; format depends on the interrupt controller parent

  rx-mode:
    description: >
      Specifies the L1 protocol used for receiving remote control signals;
      required if rx pins are wired up
    enum:
      - infrared
      - uhf

  tx-mode:
    description: >
      Specifies the L1 protocol used for transmitting remote control signals;
      required if tx pins are wired up
    enum:
      - infrared

  pinctrl-names:
    description: Pin control names for multiplexing IRB pins

  pinctrl-0:
    description: Phandle and specifier for pinctrl configuration 0

  clocks:
    description: Phandle with clock specifier for IRB
    maxItems: 1

required:
  - compatible
  - reg
  - interrupts

additionalProperties: false

examples:
  - |
    rc@fe518000 {
        compatible = "st,comms-irb";
        reg = <0xfe518000 0x234>;
        interrupts = <0 203 0>;
        rx-mode = "infrared";
    };
```

## Documentation/devicetree/bindings/media/st,st-delta.yaml
```yaml
# SPDX-License-Identifier: (GPL-2.0-only OR BSD-2-Clause)
# Copyright 2025 STMicroelectronics
%YAML 1.2
---
$id: http://devicetree.org/schemas/media/st,st-delta.yaml#
$schema: http://devicetree.org/meta-schemas/core.yaml#

title: STMicroelectronics DELTA multi-format video decoder

maintainers:
  - Hugues Fruchet <hugues.fruchet@st.com>

description: |
  STMicroelectronics DELTA multi-format video decoder

properties:
  compatible:
    items:
      - const: st,st-delta

  clocks:
    description: Clocks for the DELTA decoder; the number and type depend on the SoC.
    items:
      - description: delta master clock
      - description: ST231 DMU clock
      - description: flash PROMIP clock

  clock-names:
    description: Names of the clocks in the same order as clocks.
    items:
      - const: delta
      - const: delta-st231
      - const: delta-flash-promip

required:
  - compatible
  - clocks
  - clock-names

additionalProperties: false

examples:
  - |
    delta0 {
        compatible = "st,st-delta";
        clock-names = "delta", "delta-st231", "delta-flash-promip";
        clocks = <&clk_s_c0_flexgen CLK_VID_DMU>,
                <&clk_s_c0_flexgen CLK_ST231_DMU>,
                <&clk_s_c0_flexgen CLK_FLASH_PROMIP>;
    };
```
