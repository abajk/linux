## Documentation/devicetree/bindings/mailbox/hisilicon,hi6220-mbox.yaml
```yaml
# SPDX-License-Identifier: (GPL-2.0-only OR BSD-2-Clause)
%YAML 1.2
---
$id: http://devicetree.org/schemas/hisilicon,hi6220-mbox.yaml#
$schema: http://devicetree.org/meta-schemas/core.yaml#

title: Hisilicon Hi6220 Mailbox

maintainers:
  - Leo Yan <leo.yan@linux.dev>

description: |
  Hisilicon Hi6220 mailbox supports up to 32 channels. Each channel
  is unidirectional with a maximum message size of 8 words. I/O is
  performed using register access (there is no DMA) and the cell
  raises an interrupt when messages are received.

  Mailbox Device Node:

  Mailbox client

properties:
  compatible:
    const: "hisilicon,hi6220-mbox"
    description: Vendor and SoC specific compatible identifier for Hi6220 mailbox

  reg:
    description: |
      Mailbox register address ranges. First entry is IPC registers; second entry is shared buffer for slots.
    items:
      - description: IPC registers
      - description: Shared buffer for mailbox slots

  interrupts:
    description: |
      Contains the interrupt information for the mailbox device.
      The format is dependent on the interrupt controller used by the SoC.
    items:
      - description: Interrupt controller specifier (e.g. GIC_SPI)
      - description: IRQ number
      - description: Trigger type (e.g. IRQ_TYPE_LEVEL_HIGH)

  "#mbox-cells":
    const: 3
    description: |
      Number of cells in a mailbox specifier: <phandle slot_id dst_irq ack_irq>

  hi6220,mbox-tx-noirq:
    description: Flag to request MCU to enable automatic idle flag mode instead of IRQ for TX completion.
    type: boolean

required:
  - compatible
  - reg
  - interrupts
  - "#mbox-cells"

additionalProperties: false

examples:
  - |
    mailbox: mailbox@f7510000 {
      compatible = "hisilicon,hi6220-mbox";
      reg = <0x0 0xf7510000 0x0 0x1000>,
            <0x0 0x06dff800 0x0 0x0800>;
      interrupts = <GIC_SPI 94 IRQ_TYPE_LEVEL_HIGH>;
      #mbox-cells = <3>;
    };
```

## Documentation/devicetree/bindings/mailbox/marvell,armada-3700-rwtm-mailbox.yaml
```yaml
# SPDX-License-Identifier: (GPL-2.0-only OR BSD-2-Clause)
# Copyright 2025 Marek Behún <kabel@kernel.org>
%YAML 1.2
---
$id: http://devicetree.org/schemas/mailbox/marvell,armada-3700-rwtm-mailbox.yaml#
$schema: http://devicetree.org/meta-schemas/core.yaml#

title: Marvell Armada 3700 rWTM Mailbox

maintainers:
  - Marek Behún <kabel@kernel.org>

description: |
  rWTM BIU Mailbox driver for Armada 37xx

properties:
  compatible:
    items:
      - const: marvell,armada-3700-rwtm-mailbox

  reg:
    description: Physical base address of the mailbox and length of memory mapped region
    items:
      - description: physical base address of the mailbox
      - description: length of memory mapped region

  interrupts:
    description: IRQ line for the mailbox
    items:
      - description: interrupt controller specifier
      - description: interrupt number
      - description: IRQ type

  '#mbox-cells':
    description: Number of mailbox cells
    const: 1

required:
  - compatible
  - reg
  - interrupts
  - '#mbox-cells'

additionalProperties: false

examples:
  - |
    rwtm: mailbox@b0000 {
        compatible = "marvell,armada-3700-rwtm-mailbox";
        reg = <0xb0000 0x100>;
        interrupts = <GIC_SPI 18 IRQ_TYPE_LEVEL_HIGH>;
        #mbox-cells = <1>;
    };
```

## Documentation/devicetree/bindings/mailbox/rockchip,rk3368-mailbox.yaml
```yaml
# SPDX-License-Identifier: (GPL-2.0-only OR BSD-2-Clause)
# Copyright 2018 Linaro Ltd.
%YAML 1.2
---
$id: http://devicetree.org/schemas/mailbox/rockchip,rk3368-mailbox.yaml#
$schema: http://devicetree.org/meta-schemas/core.yaml#

title: Rockchip RK3368 Mailbox Controller
maintainers:
  - Caesar Wang <wxt@rock-chips.com>

description: |
  Rockchip mailbox

  The Rockchip mailbox is used by the Rockchip CPU cores to communicate
  requests to MCU processor.

  Refer to ./mailbox.txt for generic information about mailbox device-tree
  bindings.

properties:
  compatible:
    items:
      - enum:
          - rockchip,rk3368-mailbox
    description: |
      The compatible string for the Rockchip RK3368 mailbox controller.

  reg:
    maxItems: 1
    description: |
      Physical base address and length of the controller's memory-mapped region.

  interrupts:
    minItems: 1
    items:
      description: Interrupt specifier; format depends on interrupt controller.
    description: |
      Interrupt specifiers to CPU.

  '#mbox-cells':
    const: 1
    description: |
      Number of cells required for mailbox specifier; should be 1.

required:
  - compatible
  - reg
  - interrupts
  - '#mbox-cells'

additionalProperties: false

examples:
  - |
    mbox: mbox@ff6b0000 {
        compatible = "rockchip,rk3368-mailbox";
        reg = <0x0 0xff6b0000 0x0 0x1000>;
        interrupts = <GIC_SPI 146 IRQ_TYPE_LEVEL_HIGH>,
                     <GIC_SPI 147 IRQ_TYPE_LEVEL_HIGH>,
                     <GIC_SPI 148 IRQ_TYPE_LEVEL_HIGH>,
                     <GIC_SPI 149 IRQ_TYPE_LEVEL_HIGH>;
        #mbox-cells = <1>;
    };
```

## Documentation/devicetree/bindings/mailbox/ti,k2g-message-manager.yaml
```yaml
# SPDX-License-Identifier: (GPL-2.0-only OR BSD-2-Clause)
%YAML 1.2
---
$id: http://devicetree.org/schemas/ti,k2g-message-manager.yaml#
$schema: http://devicetree.org/meta-schemas/core.yaml#

title: Texas Instruments Message Manager Driver
maintainers:
  - Marco Franchi <marco.franchi@nxp.com>
  - Nishanth Menon <nm@ti.com>

description: |
  Texas Instruments' Message Manager is a mailbox controller that has configurable
  queues selectable at SoC (System on Chip) integration. The Message Manager is broken
  up into queues in different address regions that are called "proxies" - each instance
  is unidirectional and is instantiated at SoC integration level to indicate receive or
  transmit path.

properties:
  compatible:
    items:
      - const: ti,k2g-message-manager
    description: Device compatible string.

  reg-names:
    items:
      - const: queue_proxy_region
      - const: queue_state_debug_region
    description: Names of the queue proxy and queue state debug regions.

  reg:
    items:
      - description: queue proxy region register map
      - description: queue state debug region register map
    description: Register map for queue proxy and state debug regions.

  '#mbox-cells':
    const: 2
    description: "Number of mbox cells: queue ID and proxy ID in that order."

  interrupt-names:
    items:
      - const: rx_005
      - const: rx_057
    description: Interrupt names matching the receive transfer path.

  interrupts:
    items:
      - description: interrupt definition for rx_005
      - description: interrupt definition for rx_057
    description: Interrupt information corresponding to interrupt-names.

required:
  - compatible
  - reg-names
  - reg
  - '#mbox-cells'
  - interrupt-names
  - interrupts

additionalProperties: false

examples:
  - |
    msgmgr: msgmgr@2a00000 {
        compatible = "ti,k2g-message-manager";
        #mbox-cells = <2>;
        reg-names = "queue_proxy_region", "queue_state_debug_region";
        reg = <0x02a00000 0x400000>, <0x028c3400 0x400>;
        interrupt-names = "rx_005", "rx_057";
        interrupts = <GIC_SPI 324 IRQ_TYPE_LEVEL_HIGH>,
                     <GIC_SPI 327 IRQ_TYPE_LEVEL_HIGH>;
    };
```

## Documentation/devicetree/bindings/media/atmel-at91sam9g45-isi.yaml
```yaml
# SPDX-License-Identifier: (GPL-2.0-only OR BSD-2-Clause)
%YAML 1.2
---
$id: http://devicetree.org/schemas/media/atmel-at91sam9g45-isi.yaml#
$schema: http://devicetree.org/meta-schemas/core.yaml#

title: Atmel Image Sensor Interface

maintainers:
  - Claudiu Beznea <claudiu.beznea@tuxon.dev>
  - Fabio Estevam <fabio.estevam@freescale.com>
  - Hans Verkuil <hans.verkuil@cisco.com>
  - Josh Wu <josh.wu@atmel.com>

description: |
  Atmel Image Sensor Interface (ISI)

  Required properties for ISI:
  - compatible: must be "atmel,at91sam9g45-isi" or "microchip,sam9x60-isi".
  - reg: physical base address and length of the registers set for the device.
  - interrupts: should contain IRQ line for the ISI.
  - clocks: list of clock specifiers, corresponding to entries in the clock-names
    property; please refer to clock-bindings.txt.
  - clock-names: required elements: "isi_clk".
  - pinctrl-names, pinctrl-0: please refer to pinctrl-bindings.txt.

  ISI supports a single port node with parallel bus. It shall contain one 'port'
  child node with child 'endpoint' node. Please refer to the bindings defined in
  Documentation/devicetree/bindings/media/video-interfaces.txt.

  Endpoint node properties:

  - bus-width: <8> or <10> (mandatory)
  - hsync-active (default: active high)
  - vsync-active (default: active high)
  - pclk-sample (default: sample on falling edge)
  - remote-endpoint: A phandle to the bus receiver's endpoint node (mandatory).

properties:
  compatible:
    items:
      - const: atmel,at91sam9g45-isi
      - const: microchip,sam9x60-isi
    description: >
      Compatible strings for the ISI controller.

  reg:
    items:
      - description: Base address of the ISI registers
      - description: Size of the ISI register block
    description: >
      Register address and size for the ISI controller.

  interrupts:
    items:
      - description: IRQ line for the ISI controller
    description: >
      Interrupt specifier for the ISI controller.

  clocks:
    maxItems: 1
    description: >
      Main clock for the ISI controller.

  clock-names:
    items:
      - const: isi_clk
    description: >
      Name corresponding to the ISI clock.

  pinctrl-names:
    $ref: /schemas/types.yaml#/definitions/string-array
    items:
      - const: default
    description: >
      Pinctrl state name for default configuration.

  pinctrl-0:
    items:
      - $ref: /schemas/types.yaml#/definitions/phandle
    description: >
      Pinctrl settings for ISI signal pins.

  port:
    type: object
    description: >
      Port node describing the ISI parallel bus interface.
    properties:
      endpoint:
        type: object
        description: Endpoint configuration for the ISI port.
        properties:
          remote-endpoint:
            $ref: /schemas/types.yaml#/definitions/phandle
            description: Link to the sensor endpoint.
          bus-width:
            items:
              - const: 8
              - const: 10
            description: >
              Number of data lines on the parallel bus.
          vsync-active:
            type: boolean
            description: >
              Polarity of the VSYNC signal.
            default: true
          hsync-active:
            type: boolean
            description: >
              Polarity of the HSYNC signal.
            default: true
          pclk-sample:
            items:
              - const: rising-edge
              - const: falling-edge
            description: >
              Edge of pixel clock for data sampling.
            default: falling-edge
        required:
          - remote-endpoint
          - bus-width
        additionalProperties: false
    required:
      - endpoint
    additionalProperties: false

required:
  - compatible
  - reg
  - interrupts
  - clocks
  - clock-names
  - pinctrl-names
  - pinctrl-0
  - port

additionalProperties: false

examples:
  - |
    isi: isi@f0034000 {
      compatible = "atmel,at91sam9g45-isi";
      reg = <0xf0034000 0x4000>;
      interrupts = <37 IRQ_TYPE_LEVEL_HIGH 5>;
      pinctrl-names = "default";
      pinctrl-0 = <&pinctrl_isi_data_0_7>;
      clocks = <&isi_clk>;
      clock-names = "isi_clk";
      port {
        isi_0: endpoint {
          remote-endpoint = <&ov2640_0>;
          bus-width = <8>;
          vsync-active = <1>;
          hsync-active = <1>;
        };
      };
    };
```

## Documentation/devicetree/bindings/media/cdns,csi2tx.yaml
```yaml
# SPDX-License-Identifier: (GPL-2.0-only OR BSD-2-Clause)
# Copyright 2025 Cadence Design Systems
%YAML 1.2
---
$id: http://devicetree.org/schemas/media/cdns,csi2tx.yaml#
$schema: http://devicetree.org/meta-schemas/core.yaml#

title: Cadence MIPI-CSI2 TX controller

maintainers:
  - Jan Kotas <jank@cadence.com>
  - Maxime Ripard <mripard@kernel.org>

description: |
  Cadence MIPI-CSI2 TX controller
  ===============================

  The Cadence MIPI-CSI2 TX controller is a CSI-2 bridge supporting up to
  4 CSI lanes in output, and up to 4 different pixel streams in input.

properties:
  compatible:
    enum:
      - cdns,csi2tx
      - cdns,csi2tx-1.3
      - cdns,csi2tx-2.1

  reg:
    maxItems: 1

  clocks:
    maxItems: 6

  clock-names:
    items:
      - const: p_clk
      - const: esc_clk
      - const: pixel_if0_clk
      - const: pixel_if1_clk
      - const: pixel_if2_clk
      - const: pixel_if3_clk

  phys:
    maxItems: 1

  phy-names:
    items:
      - const: dphy

  ports:
    description: A ports node with one port child node per device input and output port
    type: object
    additionalProperties: false
    properties:
      "#address-cells":
        description: Number of address cells for port nodes
        const: 1
      "#size-cells":
        description: Number of size cells for port nodes
        const: 0
    patternProperties:
      "^port@[0-9]+$":  true

required:
  - compatible
  - reg
  - clocks
  - clock-names
  - ports

additionalProperties: false

examples:
  - |
    csi2tx: csi-bridge@0d0e1000 {
        compatible = "cdns,csi2tx";
        reg = <0x0d0e1000 0x1000>;
        clocks = <&byteclock>, <&byteclock>,
                <&coreclock>, <&coreclock>,
                <&coreclock>, <&coreclock>;
        clock-names = "p_clk", "esc_clk",
                      "pixel_if0_clk", "pixel_if1_clk",
                      "pixel_if2_clk", "pixel_if3_clk";

        ports {
            #address-cells = <1>;
            #size-cells = <0>;

            port@0 {
                reg = <0>;

                csi2tx_out: endpoint {
                    remote-endpoint = <&remote_in>;
                    clock-lanes = <0>;
                    data-lanes = <1 2>;
                };
            };

            port@1 {
                reg = <1>;

                csi2tx_in_stream0: endpoint {
                    remote-endpoint = <&stream0_out>;
                };
            };

            port@2 {
                reg = <2>;

                csi2tx_in_stream1: endpoint {
                    remote-endpoint = <&stream1_out>;
                };
            };

            port@3 {
                reg = <3>;

                csi2tx_in_stream2: endpoint {
                    remote-endpoint = <&stream2_out>;
                };
            };

            port@4 {
                reg = <4>;

                csi2tx_in_stream3: endpoint {
                    remote-endpoint = <&stream3_out>;
                };
            };
        };
    };
```
