## Documentation/devicetree/bindings/leds/ti,lm3697.yaml
```yaml
# SPDX-License-Identifier: (GPL-2.0-only OR BSD-2-Clause)
# Copyright 2025 Texas Instruments

%YAML 1.2
---
$id: http://devicetree.org/schemas/leds/ti,lm3697.yaml#
$schema: http://devicetree.org/meta-schemas/core.yaml#

title: TI LM3697 LED driver

maintainers:
  - Alexander A. Klimov <grandmaster@al2klimov.de>
  - Dan Murphy <dmurphy@ti.com>

description: |
  * Texas Instruments - LM3697 Highly Efficient White LED Driver

  The LM3697 11-bit LED driver provides high-
  performance backlight dimming for 1, 2, or 3 series
  LED strings while delivering up to 90% efficiency.

  This device is suitable for display and keypad lighting

properties:
  compatible:
    description: Device compatible with the TI LM3697 LED driver.
    $ref: /schemas/types.yaml#/definitions/string-array
    items:
      - enum: ["ti,lm3697"]

  reg:
    description: I2C slave address of the device.
    maxItems: 1

  "#address-cells":
    const: 1

  "#size-cells":
    const: 0

  enable-gpios:
    description: GPIO pin to enable or disable the device.
    maxItems: 1

  vled-supply:
    description: LED supply for the device.

patternProperties:
  "^led@\\d+$":
    description: LED control bank nodes.
    type: object
    additionalProperties: false
    properties:
      reg:
        description: Control bank selection (0 = bank A, 1 = bank B).
        maxItems: 1
      led-sources:
        description: HVLED strings associated with this control bank (zero-based indices).
        $ref: /schemas/types.yaml#/definitions/uint32-array
      ti,brightness-resolution:
        description: Brightness resolution for the LED string.
        $ref: /schemas/types.yaml#/definitions/uint32
      ramp-up-us:
        description: Ramp-up time in microseconds.
      ramp-down-us:
        description: Ramp-down time in microseconds.
      label:
        description: Label for the LED.
        $ref: /schemas/types.yaml#/definitions/string
      linux,default-trigger:
        description: Default trigger for the LED class device.
        $ref: /schemas/types.yaml#/definitions/string
    required:
      - reg
      - led-sources

required:
  - compatible
  - reg
  - "#address-cells"
  - "#size-cells"

additionalProperties: false

examples:
  - |
    led-controller@36 {
        compatible = "ti,lm3697";
        #address-cells = <1>;
        #size-cells = <0>;
        reg = <0x36>;

        enable-gpios = <&gpio1 28 GPIO_ACTIVE_HIGH>;
        vled-supply = <&vbatt>;

        led@0 {
            reg = <0>;
            led-sources = <0 2>;
            ti,brightness-resolution = <2047>;
            ramp-up-us = <5000>;
            ramp-down-us = <1000>;
            label = "white:first_backlight_cluster";
            linux,default-trigger = "backlight";
        };

        led@1 {
            reg = <1>;
            led-sources = <1>;
            ti,brightness-resolution = <255>;
            ramp-up-us = <500>;
            ramp-down-us = <1000>;
            label = "white:second_backlight_cluster";
            linux,default-trigger = "backlight";
        };
    };
```

## Documentation/devicetree/bindings/leds/ubnt,acb-spi-led.yaml
```yaml
# SPDX-License-Identifier: (GPL-2.0-only OR BSD-2-Clause)
%YAML 1.2
---
$id: http://devicetree.org/schemas/leds/ubnt,acb-spi-led.yaml#
$schema: http://devicetree.org/meta-schemas/core.yaml#

title: UBNT ACB SPI LED Controller

maintainers:
  - Christian Mauderer <oss@c-mauderer.de>

description: |
  * Single Byte SPI LED Device Driver.

  The driver can be used for controllers with a very simple SPI protocol:
  - one LED is controlled by a single byte on MOSI
  - the value of the byte gives the brightness between two values (lowest to
    highest)
  - no return value is necessary (no MISO signal)

  The value for lowest and highest brightness is dependent on the device and
  therefore on the compatible string.

  Depending on the compatible string some special functions (like hardware
  accelerated blinking) might can be supported too.

  The driver currently only supports one LED. The properties of the LED are
  configured in a sub-node in the device node.

  Property rules described in Documentation/devicetree/bindings/spi/spi-bus.txt
  apply.

properties:
  compatible:
    description: Compatible string for UBNT ACB SPI LED controller.
    items:
      - const: ubnt,acb-spi-led

  reg:
    description: SPI chip select line for the LED.
    items:
      - description: SPI chip select identifier

  spi-max-frequency:
    $ref: /schemas/types.yaml#/definitions/uint32
    description: Maximum SPI bus frequency in Hz.

  led:
    description: Single LED configuration sub-node.
    type: object
    additionalProperties: false
    properties:
      label:
        $ref: /schemas/types.yaml#/definitions/string
        description: Label for the LED.
      default-state:
        description: Initial default state of the LED.
        enum: [on, off]
    required:
      - label

required:
  - compatible
  - reg
  - spi-max-frequency
  - led

examples:
  - |
    led-controller@0 {
        compatible = "ubnt,acb-spi-led";
        reg = <0>;
        spi-max-frequency = <100000>;

        led {
            label = "white:status";
            default-state = "on";
        };
    };

additionalProperties: false
```

## Documentation/devicetree/bindings/mailbox/altr,mailbox-1.0.yaml
```yaml
# SPDX-License-Identifier: (GPL-2.0-only OR BSD-2-Clause)
# Copyright 2025 Ley Foon Tan
%YAML 1.2
---
$id: http://devicetree.org/schemas/altr,mailbox-1.0.yaml#
$schema: http://devicetree.org/meta-schemas/core.yaml#

title: Altera Mailbox Driver

maintainers:
  - Ley Foon Tan <lftan@altera.com>
  - Mathieu Malaterre <malat@debian.org>

description: |
  Altera Mailbox Driver

  Required properties:
  - compatible: "altr,mailbox-1.0".
  - reg: physical base address of the mailbox and length of memory mapped region.
  - #mbox-cells: common mailbox binding property to identify the number of cells required
    for the mailbox specifier; always 1.

  Optional properties:
  - interrupts: interrupt number for the mailbox.

properties:
  compatible:
    const: altr,mailbox-1.0

  reg:
    maxItems: 1

  interrupts:
    maxItems: 1

  '#mbox-cells':
    const: 1

additionalProperties: false

examples:
  - |
    mbox_tx: mailbox@100 {
      compatible = "altr,mailbox-1.0";
      reg = <0x100 0x8>;
      interrupts = <5>;
      #mbox-cells = <1>;
    };

    mbox_rx: mailbox@200 {
      compatible = "altr,mailbox-1.0";
      reg = <0x200 0x8>;
      interrupts = <6>;
      #mbox-cells = <1>;
    };
```

## Documentation/devicetree/bindings/mailbox/apm,xgene-slimpro-mbox.yaml
```yaml
# SPDX-License-Identifier: (GPL-2.0-only OR BSD-2-Clause)
%YAML 1.2
---
$id: http://devicetree.org/schemas/apm,xgene-slimpro-mbox.yaml#
$schema: http://devicetree.org/meta-schemas/core.yaml#

title: APM X-Gene SLIMpro mailbox

maintainers:
  - Duc Dang <dhdang@apm.com>

description: |
  The APM X-Gene SLIMpro mailbox is used to communicate messages between
  the ARM64 processors and the Cortex M3 (dubbed SLIMpro). It uses a simple
  interrupt based door bell mechanism and can exchange simple messages using the
  internal registers.

  There are total of 8 interrupts in this mailbox. Each used for an individual
  door bell (or mailbox channel).

properties:
  compatible:
    description: Should be "apm,xgene-slimpro-mbox".
    items:
      - const: apm,xgene-slimpro-mbox

  reg:
    description: Mailbox register address range.
    items:
      - description: mailbox registers

  interrupts:
    description: List of interrupts, one for each mailbox channel.
    items:
      - description: interrupt for mailbox channel 0
      - description: interrupt for mailbox channel 1
      - description: interrupt for mailbox channel 2
      - description: interrupt for mailbox channel 3
      - description: interrupt for mailbox channel 4
      - description: interrupt for mailbox channel 5
      - description: interrupt for mailbox channel 6
      - description: interrupt for mailbox channel 7

  '#mbox-cells':
    description: Number of mailbox channel.
    const: 1

required:
  - compatible
  - reg
  - interrupts
  - '#mbox-cells'

additionalProperties: false

examples:
  - |
    mailbox@10540000 {
        compatible = "apm,xgene-slimpro-mbox";
        reg = <0x0 0x10540000 0x0 0xa000>;
        #mbox-cells = <1>;
        interrupts = <0x0 0x0 0x4>,
                     <0x0 0x1 0x4>,
                     <0x0 0x2 0x4>,
                     <0x0 0x3 0x4>,
                     <0x0 0x4 0x4>,
                     <0x0 0x5 0x4>,
                     <0x0 0x6 0x4>,
                     <0x0 0x7 0x4>;
    };
```

## Documentation/devicetree/bindings/mailbox/brcm,iproc-flexrm-mbox.yaml
```yaml
# SPDX-License-Identifier: (GPL-2.0-only OR BSD-2-Clause)
# Copyright 2025 Broadcom Ltd.
%YAML 1.2
---
$id: http://devicetree.org/schemas/brcm,iproc-flexrm-mbox.yaml#
$schema: http://devicetree.org/meta-schemas/core.yaml#

title: Broadcom FlexRM Ring Manager
maintainers:
  - Anup Patel <anup.patel@broadcom.com>
  - Bjorn Helgaas <bhelgaas@google.com>
  - Yu-Chun Lin <eleanor15x@gmail.com>

description: |
  Broadcom FlexRM Ring Manager

  The Broadcom FlexRM ring manager provides a set of rings which can be
  used to submit work to offload engines. An SoC may have multiple FlexRM
  hardware blocks. There is one device tree entry per FlexRM block. The
  FlexRM driver will create a mailbox-controller instance for given FlexRM
  hardware block where each mailbox channel is a separate FlexRM ring.

properties:
  compatible:
    description: Identifies the device as Broadcom FlexRM mailbox controller.
    $ref: /schemas/types.yaml#/definitions/string-array
    items:
      - const: brcm,iproc-flexrm-mbox

  reg:
    description: Base physical address and size of the FlexRM ring registers.
    items:
      - description: Base address of the FlexRM ring registers.
      - description: Size of the FlexRM ring register region.

  msi-parent:
    description: Phandles (and potential Device IDs) to MSI controllers.
      The FlexRM engine will send MSIs (instead of wired interrupts) to CPU.
      There is one MSI for each FlexRM ring.
      Refer devicetree/bindings/interrupt-controller/msi.txt.
    $ref: /schemas/types.yaml#/definitions/phandle-array

  '#mbox-cells':
    description: Specifies the number of cells needed to encode a mailbox channel.
    const: 3

  dma-coherent:
    description: Indicates that DMA operations made by the FlexRM engine (such as DMA descriptor access,
      access to buffers pointed by DMA descriptors and read/write pointer updates to DDR)
      are cache coherent with the CPU.
    type: boolean

required:
  - compatible
  - reg
  - msi-parent
  - '#mbox-cells'

additionalProperties: false

examples:
  - |
    mbox@67000000 {
        compatible = "brcm,iproc-flexrm-mbox";
        reg = <0x67000000 0x200000>;
        msi-parent = <&gic_its 0x7f00>;
        #mbox-cells = <3>;
        dma-coherent;
    };
```

## Documentation/devicetree/bindings/mailbox/brcm,iproc-pdc-mbox.yaml
```yaml
# SPDX-License-Identifier: (GPL-2.0-only OR BSD-2-Clause)
# Copyright 2025 Broadcom Corporation
%YAML 1.2
---
$id: http://devicetree.org/schemas/brcm,iproc-pdc-mbox.yaml#
$schema: http://devicetree.org/meta-schemas/core.yaml#

title: Broadcom iProc PDC mailbox

maintainers:
  - Mathieu Malaterre <malat@debian.org>
  - Rob Rice <rrice@broadcom.com>
  - Steve Lin <steven.lin1@broadcom.com>

description: |
  The PDC driver manages data transfer to and from various offload engines
  on some Broadcom SoCs. An SoC may have multiple PDC hardware blocks. There is
  one device tree entry per block. On some chips, the PDC functionality is
  handled by the FA2 (Northstar Plus).

properties:
  compatible:
    items:
      - enum:
          - brcm,iproc-pdc-mbox
          - brcm,iproc-fa2-mbox
    description: >
      Compatible string selecting PDC mailbox for Broadcom iProc SoCs.
  reg:
    maxItems: 1

  interrupts:
    items:
      - description: PDC interrupt line


  '#mbox-cells':
    const: 1

  brcm,rx-status-len:
    description: >
      Length of metadata preceding received frames, in bytes.
    $ref: /schemas/types.yaml#/definitions/uint32

  brcm,use-bcm-hdr:
    type: boolean
    description: >
      Present if a BCM header precedes each frame.

required:
  - compatible
  - reg
  - interrupts
  - '#mbox-cells'
  - brcm,rx-status-len

additionalProperties: false

examples:
  - |
    pdc0: iproc-pdc0@612c0000 {
        compatible = "brcm,iproc-pdc-mbox";
        reg = <0 0x612c0000 0 0x445>;
        interrupts = <GIC_SPI 187 IRQ_TYPE_LEVEL_HIGH>;
        #mbox-cells = <1>;
        brcm,rx-status-len = <32>;
        brcm,use-bcm-hdr;
    };
```

## Documentation/devicetree/bindings/mailbox/hisilicon,hi3660-mbox.yaml
```yaml
# SPDX-License-Identifier: (GPL-2.0-only OR BSD-2-Clause)
# Copyright 2025 Leo Yan
%YAML 1.2
---
$id: http://devicetree.org/schemas/hisilicon,hi3660-mbox.yaml#
$schema: http://devicetree.org/meta-schemas/core.yaml#

title: Hisilicon Hi3660 Mailbox Controller

maintainers:
  - Leo Yan <leo.yan@linux.dev>

description: |
  Hisilicon Hi3660 Mailbox Controller

  Hisilicon Hi3660 mailbox controller supports up to 32 channels.  Messages
  are passed between processors, including application & communication
  processors, MCU, HIFI, etc.  Each channel is unidirectional and accessed
  by using MMIO registers; it supports maximum to 8 words message.

  Controller

  Client

properties:
  compatible:
    items:
      - const: hisilicon,hi3660-mbox

  reg:
    description: MMIO register base and length for mailbox controller
    items:
      - description: Register base physical address
      - description: Register map size in bytes

  interrupts:
    description: Mailbox interrupt vectors for message processing
    items:
      - description: Remote interrupt (<type irqflags irq>)
      - description: Local interrupt (<type irqflags irq>)

  '#mbox-cells':
    description: Number of mailbox cells
    const: 3

required:
  - compatible
  - reg
  - interrupts
  - '#mbox-cells'

additionalProperties: false

examples:
  - |
      mailbox: mailbox@e896b000 {
          compatible = "hisilicon,hi3660-mbox";
          reg = <0x0 0xe896b000 0x0 0x1000>;
          interrupts = <0x0 0xc0 0x4>,
                       <0x0 0xc1 0x4>;
          #mbox-cells = <3>;
      };
```
