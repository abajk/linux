## Documentation/devicetree/bindings/watchdog/microchip,pic32mzda-wdt.yaml
```yaml
# SPDX-License-Identifier: (GPL-2.0-only OR BSD-2-Clause)
# Copyright 2025 Microchip
%YAML 1.2
---
$id: http://devicetree.org/schemas/microchip,pic32mzda-wdt.yaml#
$schema: http://devicetree.org/meta-schemas/core.yaml#

title: Microchip PIC32 Watchdog Timer

maintainers:
  - Joshua Henderson <joshua.henderson@microchip.com>
  - Purna Chandra Mandal <purna.mandal@microchip.com>

description: |
  * Microchip PIC32 Watchdog Timer

  When enabled, the watchdog peripheral can be used to reset the device if the
  WDT is not cleared periodically in software.

properties:
  compatible:
    description: Device tree compatible string.
    items:
      - const: microchip,pic32mzda-wdt

  reg:
    description: Physical base address and length of the memory mapped region.
    items:
      - description: Physical base address of the controller.
      - description: Length of the memory mapped region.

  clocks:
    description: Phandle of the source clock.
    maxItems: 1

required:
  - compatible
  - reg
  - clocks

additionalProperties: false

examples:
  - |
    watchdog@1f800800 {
        compatible = "microchip,pic32mzda-wdt";
        reg = <0x1f800800 0x200>;
        clocks = <&rootclk LPRCCLK>;
    };
```

## Documentation/devicetree/bindings/watchdog/moxa,moxart-watchdog.yaml
```yaml
# SPDX-License-Identifier: (GPL-2.0-only OR BSD-2-Clause)
%YAML 1.2
---
$id: http://devicetree.org/schemas/moxa,moxart-watchdog.yaml#
$schema: http://devicetree.org/meta-schemas/core.yaml#

title: MOXA ART Watchdog timer

maintainers:
  - Jonas Jensen <jonas.jensen@gmail.com>

description: >
  MOXA ART Watchdog timer

properties:
  compatible:
    items:
      - enum:
          - moxa,moxart-watchdog

  reg:
    description: Register base address and size for the watchdog timer.
    items:
      - description: Base address of the watchdog registers
      - description: Length of the watchdog register region

  clocks:
    maxItems: 1
    description: Clock that drives the watchdog counter.

additionalProperties: false

examples:
  - |
      watchdog: watchdog@98500000 {
          compatible = "moxa,moxart-watchdog";
          reg = <0x98500000 0x10>;
          clocks = <&coreclk>;
      };
```

## Documentation/devicetree/bindings/watchdog/mpc8xxx-wdt.yaml
```yaml
# SPDX-License-Identifier: (GPL-2.0-only OR BSD-2-Clause)
# Copyright 2025 Christophe Leroy <christophe.leroy@c-s.fr>
%YAML 1.2
---
$id: http://devicetree.org/schemas/watchdog/mpc8xxx-wdt.yaml#
$schema: http://devicetree.org/meta-schemas/core.yaml#

title: Freescale mpc8xxx watchdog driver

maintainers:
  - Christophe Leroy <christophe.leroy@c-s.fr>

description: |
  Freescale mpc8xxx watchdog driver (For 83xx, 86xx and 8xx)

properties:
  compatible:
    description: Hardware compatibility string for the mpc8xxx watchdog.
    items:
      - enum:
          - mpc83xx_wdt
          - fsl,mpc8610-wdt
          - fsl,mpc823-wdt

  reg:
    description: >
      Base physical address and length of the watchdog timer registers, and
      optional reset status register.
    oneOf:
      - items:
          - description: Watchdog timer registers (base and size)
      - items:
          - description: Watchdog timer registers (base and size)
          - description: Reset status register (base and size)

  reg-names:
    description: Names for the watchdog timer and reset status registers.
    items:
      - const: wdt
      - const: reset-status

additionalProperties: false

examples:
  - |
    watchdog@0 {
        compatible = "fsl,mpc823-wdt";
        reg = <0x0 0x10 0x288 0x4>;
    };
```

## Documentation/devicetree/bindings/watchdog/nuvoton,npcm-wdt.yaml
```yaml
# SPDX-License-Identifier: (GPL-2.0-only OR BSD-2-Clause)
%YAML 1.2
---
$id: http://devicetree.org/schemas/nuvoton,npcm-wdt.yaml#
$schema: http://devicetree.org/meta-schemas/core.yaml#

title: Nuvoton NPCM Watchdog

maintainers:
  - Joel Stanley <joel@jms.id.au>
  - Jonathan Neuschäfer <j.neuschaefer@gmx.net>
  - Tomer Maimon <tmaimon77@gmail.com>

description: |
  Nuvoton NPCM Watchdog

  Nuvoton NPCM timer module provides five 24-bit timer counters, and a watchdog.
  The watchdog supports a pre-timeout interrupt that fires 10ms before the
  expiry.

properties:
  compatible:
    items:
      - enum:
          - nuvoton,npcm750-wdt
          - nuvoton,wpcm450-wdt
          - nuvoton,npcm845-wdt

  reg:
    maxItems: 1

  interrupts:
    maxItems: 1

  clocks:
    maxItems: 1

  clock-frequency:
    description: Frequency in Hz of the clock that drives the NPCM timer.
    $ref: /schemas/types.yaml#/definitions/uint32

  timeout-sec:
    description: Watchdog timeout in seconds.

required:
  - compatible
  - reg
  - interrupts

additionalProperties: false

examples:
  - |
    timer@f000801c {
        compatible = "nuvoton,npcm750-wdt";
        interrupts = <GIC_SPI 47 IRQ_TYPE_LEVEL_HIGH>;
        reg = <0xf000801c 0x4>;
        clocks = <&clk NPCM7XX_CLK_TIMER>;
    };
```

## Documentation/devicetree/bindings/watchdog/st,stih407-lpc.yaml
```yaml
# SPDX-License-Identifier: (GPL-2.0-only OR BSD-2-Clause)
# Copyright 2025 Linaro Ltd.
%YAML 1.2
---
$id: http://devicetree.org/schemas/watchdog/st,stih407-lpc.yaml#
$schema: http://devicetree.org/meta-schemas/core.yaml#

title: STMicroelectronics Low Power Controller (LPC) - Watchdog

maintainers:
  - Lee Jones <lee@kernel.org>
  - Peter Griffin <peter.griffin@linaro.org>

description: |
  LPC currently supports Watchdog OR Real Time Clock OR Clocksource functionality.

  [See: ../rtc/rtc-st-lpc.txt for RTC options]

  [See: ../timer/st,stih407-lpc for Clocksource options]

properties:
  compatible:
    const: st,stih407-lpc

  reg:
    maxItems: 1

  interrupts:
    maxItems: 1

  clocks:
    maxItems: 1

  st,lpc-mode:
    description: |
      The LPC can run either one of three modes: ST_LPC_MODE_RTC [0],
      ST_LPC_MODE_WDT [1], ST_LPC_MODE_CLKSRC [2]. One (and only one) mode
      must be selected.
    $ref: /schemas/types.yaml#/definitions/uint32
    enum: [0, 1, 2]

  st,syscfg:
    description: Phandle to syscfg node used to enable watchdog and configure CPU reset type.
    $ref: /schemas/types.yaml#/definitions/phandle

  timeout-sec:
    description: Watchdog timeout in seconds

  st,warm-reset:
    description: If present reset type will be 'warm' - if not it will be cold
    type: boolean

required:
  - compatible
  - reg
  - interrupts
  - clocks
  - st,lpc-mode
  - st,syscfg
  - timeout-sec

additionalProperties: false

examples:
  - |
    lpc@fde05000 {
      compatible = "st,stih407-lpc";
      reg = <0xfde05000 0x1000>;
      clocks = <&clk_s_d3_flexgen CLK_LPC_0>;
      st,syscfg = <&syscfg_core>;
      timeout-sec = <120>;
      st,lpc-mode = <ST_LPC_MODE_WDT>;
      st,warm-reset;
    };
```

## Documentation/devicetree/bindings/watchdog/technologic,ts4800-wdt.yaml
```yaml
# SPDX-License-Identifier: (GPL-2.0-only OR BSD-2-Clause)
%YAML 1.2
---
$id: http://devicetree.org/schemas/technologic,ts4800-wdt.yaml#
$schema: http://devicetree.org/meta-schemas/core.yaml#

title: TS4800 Watchdog
maintainers:
  - Damien Riegel <damien.riegel@savoirfairelinux.com>

description: |
  Technologic Systems Watchdog

properties:
  compatible:
    description: Must be "technologic,ts4800-wdt".
    const: technologic,ts4800-wdt

  syscon:
    description: phandle / integer array that points to the syscon node which
      describes the FPGA's syscon registers.
    items:
      - description: phandle to FPGA's syscon
      - description: offset to the watchdog register

  timeout-sec:
    description: Watchdog timeout in seconds.

required:
  - compatible
  - syscon

additionalProperties: false

examples:
  - |
    syscon: syscon@b0010000 {
        compatible = "syscon", "simple-mfd";
        reg = <0xb0010000 0x3d>;
        reg-io-width = <2>;

        wdt@e {
            compatible = "technologic,ts4800-wdt";
            syscon = <&syscon 0xe>;
            timeout-sec = <10>;
        };
    };
```

## Documentation/devicetree/bindings/watchdog/ti,omap4-wdt.yaml
```yaml
# SPDX-License-Identifier: (GPL-2.0-only OR BSD-2-Clause)
# Copyright 2018 Linaro Ltd.
%YAML 1.2
---
$id: http://devicetree.org/schemas/watchdog/ti,omap4-wdt.yaml#
# $schema is the meta-schema this schema should be validated with.
$schema: http://devicetree.org/meta-schemas/core.yaml#

title: TI OMAP Watchdog Timer Controller

maintainers:
  - Uwe Kleine-König <u.kleine-koenig@pengutronix.de>
  - Xiao Jiang <jgq516@gmail.com>

description: >-
  TI Watchdog Timer (WDT) Controller for OMAP

properties:
  compatible:
    description: List of compatible strings for the TI OMAP Watchdog Timer controller.
    oneOf:
      - items:
          - enum: ["ti,omap4-wdt"]
      - items:
          - enum: ["ti,omap3-wdt"]

  ti,hwmods:
    description: Name of the hardware module associated with the watchdog.
    $ref: /schemas/types.yaml#/definitions/string

  timeout-sec:
    description: Default watchdog timeout in seconds.

required:
  - compatible
  - ti,hwmods

additionalProperties: false

examples:
  - |
    wdt2: wdt@4a314000 {
        compatible = "ti,omap4-wdt", "ti,omap3-wdt";
        ti,hwmods = "wd_timer2";
    };
```

## Documentation/devicetree/bindings/x86/intel,ce4100-hpet.yaml
```yaml
# SPDX-License-Identifier: (GPL-2.0-only OR BSD-2-Clause)
%YAML 1.2
---
$id: http://devicetree.org/schemas/x86/intel,ce4100-hpet.yaml#
$schema: http://devicetree.org/meta-schemas/core.yaml#

title: High Precision Event Timer (HPET)

maintainers:
  - Sebastian Andrzej Siewior <bigeasy@linutronix.de>

description: |
  Timers

  High Precision Event Timer (HPET)

properties:
  compatible:
    items:
      - const: intel,ce4100-hpet

required:
  - compatible

additionalProperties: false
```

## Documentation/devicetree/bindings/xillybus/xillybus,xillybus-1.00.a.yaml
```yaml
# SPDX-License-Identifier: (GPL-2.0-only OR BSD-2-Clause)
%YAML 1.2
---
$id: http://devicetree.org/schemas/xillybus,xillybus-1.00.a.yaml#
$schema: http://devicetree.org/meta-schemas/core.yaml#

title: Xillybus driver for generic FPGA interface

maintainers:
  - Eli Billauer <eli.billauer@gmail.com>
  - Rob Herring <robh@kernel.org>

description: |
  * Xillybus driver for generic FPGA interface

properties:
  compatible:
    # Exactly one compatible string supported
    items:
      - enum: ["xillybus,xillybus-1.00.a"]

  reg:
    items:
      - description: Base address of register set
      - description: Length of register set

  interrupts:
    items:
      - description: Interrupt controller phandle
      - description: Interrupt number
      - description: Interrupt flags
    description: Contains one interrupt specifier, typically consisting of three cells.

  dma-coherent:
    type: boolean
    description: DMA operations are coherent

required:
  - compatible
  - reg
  - interrupts

additionalProperties: false

examples:
  - |
    xillybus@ff200400 {
        compatible = "xillybus,xillybus-1.00.a";
        reg = <0xff200400 0x00000080>;
        interrupts = <0 40 1>;
        dma-coherent;
    };
```

## Documentation/devicetree/bindings/xlnx,ip-cores.yaml
```yaml
# SPDX-License-Identifier: (GPL-2.0-only OR BSD-2-Clause)
# Copyright 2025 Secret Lab Ltd.
%YAML 1.2
---
$id: http://devicetree.org/schemas/xlnx,ip-cores.yaml#
$schema: http://devicetree.org/meta-schemas/core.yaml#

title: Xilinx IP cores
maintainers:
  - Grant Likely <grant.likely@secretlab.ca>
  - Michal Simek <michal.simek@amd.com>
  - Nava kishore Manne <nava.manne@xilinx.com>
  - Rob Herring <robh@kernel.org>

description: |
  The Xilinx EDK toolchain ships with a set of IP cores (devices) for use
  in Xilinx Spartan and Virtex FPGAs. The devices cover the whole range
  of standard device types (network, serial, etc.) and miscellaneous
  devices (gpio, LCD, spi, etc). Also, since these devices are
  implemented within the FPGA fabric every instance of the device can be
  synthesised with different options that change the behaviour.

  Each IP-core has a set of parameters which the FPGA designer can use to
  control how the core is synthesized. Historically, the EDK tool would
  extract the device parameters relevant to device drivers and copy them
  into an 'xparameters.h' in the form of #define symbols. This tells the
  device drivers how the IP cores are configured, but it requires the kernel
  to be recompiled every time the FPGA bitstream is resynthesized.

  The new approach is to export the parameters into the device tree and
  generate a new device tree each time the FPGA bitstream changes. The
  parameters which used to be exported as #defines will now become
  properties of the device node.

  Typically, the compatible list will include the exact IP core version
  followed by an older IP core version which implements the same
  interface or any other device with the same interface.

  'reg' and 'interrupts' are all optional properties.

properties:
  device_type:
    $ref: /schemas/types.yaml#/definitions/string
    description: >-
      An open firmware–style device type describing the generic class of the
      IP core, such as 'serial' or 'ethernet'.

  reg:
    description: >-
      Register address space of the IP core.
    items:
      - description: Base address of the IP core.
      - description: Size of the IP core register range in bytes.
  interrupts:
    description: >-
      Interrupt specifier(s) for the IP core.
    items:
      - description: Interrupt number and flags as defined by the parent interrupt controller.
  current-speed:
    $ref: /schemas/types.yaml#/definitions/uint32
    description: >-
      Standard serial device property specifying the current baud rate.
  clock-frequency:
    $ref: /schemas/types.yaml#/definitions/uint32
    description: >-
      Standard device property specifying the clock frequency.
  xlnx,data-bits:
    description: >-
      Number of data bits for the UART core.
  xlnx,odd-parity:
    type: boolean
    description: >-
      Parity type for the UART core: true for odd parity.
  xlnx,use-parity:
    type: boolean
    description: >-
      Enables parity checking in the UART core when true.

required:
  - compatible

additionalProperties: true
```
