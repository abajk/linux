## Documentation/devicetree/bindings/hsi/nokia,n900-modem.yaml
```yaml
# SPDX-License-Identifier: (GPL-2.0-only OR BSD-2-Clause)
%YAML 1.2
---
$id: http://devicetree.org/schemas/hsi/nokia,n900-modem.yaml#
$schema: http://devicetree.org/meta-schemas/core.yaml#

title: nokia,n900-modem

maintainers:
  - Sebastian Reichel <sre@kernel.org>

description: |
  Each HSI port is supposed to have one child node, which
  symbols the remote device connected to the HSI port. The
  following properties are standardized for HSI clients:

properties:
  compatible:
    # Only the nokia,n900-modem compatible is allowed
    items:
      - const: nokia,n900-modem

  hsi-channel-ids:
    $ref: /schemas/types.yaml#/definitions/uint32-array
    description: List of channel IDs for the HSI client.

  hsi-channel-names:
    $ref: /schemas/types.yaml#/definitions/string-array
    description: List of channel names corresponding to hsi-channel-ids.

  hsi-rx-mode:
    enum:
      - stream
      - frame
    description: Receiver bit transmission mode.

  hsi-tx-mode:
    enum:
      - stream
      - frame
    description: Transmitter bit transmission mode.

  hsi-mode:
    enum:
      - stream
      - frame
    description: Transmission mode for both receiver and transmitter.

  hsi-speed-kbps:
    $ref: /schemas/types.yaml#/definitions/uint32
    description: Maximum bit transmission speed in kbit/s.

  hsi-flow:
    enum:
      - synchronized
      - pipeline
    description: Receiver flow type.

  hsi-arb-mode:
    enum:
      - round-robin
      - priority
    description: Arbitration mode for TX frame.

required:
  - compatible
  - hsi-channel-ids
  - hsi-speed-kbps
  - hsi-flow
  - hsi-arb-mode

oneOf:
  - required:
      - hsi-rx-mode
      - hsi-tx-mode
  - required:
      - hsi-mode

additionalProperties: false

examples:
  - |
    hsi-controller {
        hsi-port {
            modem: hsi-client {
                compatible = "nokia,n900-modem";
                hsi-channel-ids = <0>, <1>, <2>, <3>;
                hsi-channel-names = "mcsaab-control",
                                    "speech-control",
                                    "speech-data",
                                    "mcsaab-data";
                hsi-speed-kbps = <55000>;
                hsi-mode = "frame";
                hsi-flow = "synchronized";
                hsi-arb-mode = "round-robin";
            };
        };
    };
```

## Documentation/devicetree/bindings/hsi/ti,omap3-ssi.yaml
```yaml
# SPDX-License-Identifier: (GPL-2.0-only OR BSD-2-Clause)
# Copyright 2025 Linaro Ltd.
%YAML 1.2
---
$id: http://devicetree.org/schemas/ti,omap3-ssi.yaml#
$schema: http://devicetree.org/meta-schemas/core.yaml#

title: TI OMAP SSI Controller

maintainers:
  - Rob Herring <robh@kernel.org>
  - Sebastian Reichel <sre@kernel.org>
  - Tony Lindgren <tony@atomide.com>

description: |
  OMAP SSI controller bindings

  OMAP3's Synchronous Serial Interface (SSI) controller implements a
  legacy variant of MIPI's High Speed Synchronous Serial Interface (HSI),
  while the controller found inside OMAP4 is supposed to be fully compliant
  with the HSI standard.

properties:
  compatible:
    oneOf:
      - items:
          - enum: [ti, omap3-ssi]
      - items:
          - enum: [ti, omap4-hsi]
    description: Device compatible string.

  reg-names:
    items:
      - const: sys
      - const: gdd
    description: Order of register regions.

  reg:
    items:
      - description: System registers region
      - description: GDD registers region
    description: Register address and size for each region.

  interrupt-names:
    items:
      - const: gdd_mpu
    description: Name of the MPU interrupt.

  interrupts:
    items:
      - description: GDD MPU interrupt
    description: Interrupt specifier for gdd_mpu.

  ranges:
    items:
      - description: Child bus address.
      - description: Parent bus address.
      - description: Size of mapping.
    description: Bus address mapping to child nodes.

  clock-names:
    items:
      - const: ssi_ssr_fck
      - const: ssi_sst_fck
      - const: ssi_ick
    description: Names of required clocks.

  clocks:
    items:
      - description: SSI SSR functional clock
      - description: SSI SST functional clock
      - description: SSI interface clock
    description: Clock phandles corresponding to clock-names.

  '#address-cells':
    const: 1
    description: Node has single address cell.

  '#size-cells':
    const: 1
    description: Node has single size cell.

  ti,hwmods:
    $ref: /schemas/types.yaml#/definitions/string
    description: Optional TI interconnect module name.

patternProperties:
  "^ssi-port@[0-9A-Fa-f]+$":
    $ref: "#/definitions/port"

additionalProperties: false

definitions:
  port:
    type: object
    description: SSI port sub-node.
    properties:
      compatible:
        items:
          - enum: [ti, omap3-ssi-port]
          - enum: [ti, omap4-hsi-port]
        description: Port compatible string.
      reg-names:
        items:
          - const: tx
          - const: rx
        description: Order of port register regions.
      reg:
        items:
          - description: TX registers region
          - description: RX registers region
        description: Register specifiers for port windows.
      interrupts:
        items:
          - description: MPU interrupt 0
          - description: MPU interrupt 1
        description: Interrupt specifier list for port.
      ti,ssi-cawake-gpio:
        $ref: /schemas/types.yaml#/definitions/phandle-array
        description: GPIO pin for CAWAKE events.
    required:
      - compatible
      - reg-names
      - reg
      - interrupts
    additionalProperties: false

required:
  - compatible
  - reg-names
  - reg
  - interrupt-names
  - interrupts

examples:
  - |
    ssi-controller@48058000 {
      compatible = "ti,omap3-ssi";
      reg = <0x48058000 0x1000>,
            <0x48059000 0x1000>;
      reg-names = "sys", "gdd";
      interrupts = <55>;
      interrupt-names = "gdd_mpu";
      clocks = <&ssi_ssr_fck>, <&ssi_sst_fck>, <&ssi_ick>;
      clock-names = "ssi_ssr_fck", "ssi_sst_fck", "ssi_ick";
      #address-cells = <1>;
      #size-cells = <1>;
      ranges;

      ssi-port@4805a000 {
        compatible = "ti,omap3-ssi-port";
        reg = <0x4805a000 0x800>, <0x4805a800 0x800>;
        reg-names = "tx", "rx";
        interrupts = <67>, <68>;
        ti,ssi-cawake-gpio = <&gpio5 23 GPIO_ACTIVE_HIGH>;
      };

      ssi-port@4805b000 {
        compatible = "ti,omap3-ssi-port";
        reg = <0x4805b000 0x800>, <0x4805b800 0x800>;
        reg-names = "tx", "rx";
        interrupts = <69>, <70>;
      };
    };
```

## Documentation/devicetree/bindings/hwmon/apm-xgene-slimpro-hwmon.yaml
```yaml
# SPDX-License-Identifier: (GPL-2.0-only OR BSD-2-Clause)
%YAML 1.2
---
$id: http://devicetree.org/schemas/hwmon/apm-xgene-slimpro-hwmon.yaml#
$schema: http://devicetree.org/meta-schemas/core.yaml#

title: APM X-Gene SLIMpro hwmon driver

maintainers:
  - hotran <hotran@apm.com>

description: |
  APM X-Gene hwmon driver

  APM X-Gene SOC sensors are accessed over the "SLIMpro" mailbox.

properties:
  compatible:
    items:
      - const: apm,xgene-slimpro-hwmon

  mboxes:
    description: |
      Use the label reference for the mailbox as the first parameter.
      The second parameter is the channel number.
    $ref: /schemas/types.yaml#/definitions/phandle-array

required:
  - compatible
  - mboxes

additionalProperties: false

examples:
  - |
    hwmonslimpro {
        compatible = "apm,xgene-slimpro-hwmon";
        mboxes = <&mailbox 7>;
    };
```

## Documentation/devicetree/bindings/hwmon/aspeed,ast2400-pwm-tacho.yaml
```yaml
%YAML 1.2
---
$id: http://devicetree.org/schemas/aspeed,ast2400-pwm-tacho.yaml#
$schema: http://devicetree.org/meta-schemas/core.yaml#

title: ASPEED AST2400/AST2500 PWM and Fan Tacho controller
maintainers:
  - Bjorn Helgaas <bhelgaas@google.com>
  - Jaghathiswari Rankappagounder Natarajan <jaghu@google.com>
  - Joel <joel@jms.id.au>
  - Mykola Kostenok <c_mykolak@mellanox.com>

description: |
  ASPEED AST2400/AST2500 PWM and Fan Tacho controller device driver

  The ASPEED PWM controller can support upto 8 PWM outputs. The ASPEED Fan Tacho
  controller can support upto 16 Fan tachometer inputs.

  There can be upto 8 fans supported. Each fan can have one PWM output and
  one/two Fan tach inputs.

properties:
  compatible:
    oneOf:
      - items:
          - const: aspeed,ast2400-pwm-tacho
      - items:
          - const: aspeed,ast2500-pwm-tacho

  # Bus access
  reg:
    items:
      - description: Register block base address
      - description: Register block size

  # Cell counts
  '#address-cells':
    const: 1
  '#size-cells':
    const: 1
  '#cooling-cells':
    const: 2

  # Pin control
  pinctrl-names:
    items:
      - const: default
  pinctrl-0: true

  # Clocks
  clocks:
    description: Clock provider phandle and clock specifier
    items:
      - description: Clock provider phandle
      - description: Clock number

  # Resets
  resets:
    description: Reset controller phandle and reset specifier
    items:
      - description: Reset controller phandle
      - description: Reset number

patternProperties:
  '^fan@.*$':
    description: Fan subnode
    type: object
    additionalProperties: false
    properties:
      reg:
        description: PWM source port index (0 = PWM A, ..., 7 = PWM H)
        items:
          - minimum: 0
            maximum: 7
      cooling-levels:
        description: PWM duty cycle values for cooling states (0–255)
        $ref: /schemas/types.yaml#/definitions/uint32-array
        items:
          minimum: 0
          maximum: 255
      'aspeed,fan-tach-ch':
        description: Fan tachometer input channel numbers (0–15)
        $ref: /schemas/types.yaml#/definitions/uint32-array
        minItems: 1
        items:
          minimum: 0
          maximum: 15
    required:
      - reg
      - aspeed,fan-tach-ch

required:
  - compatible
  - reg
  - '#address-cells'
  - '#size-cells'
  - '#cooling-cells'
  - pinctrl-names
  - pinctrl-0
  - clocks
  - resets

additionalProperties: false

examples:
  - |
    pwm_tacho: pwmtachocontroller@1e786000 {
        #address-cells = <1>;
        #size-cells = <1>;
        #cooling-cells = <2>;
        reg = <0x1E786000 0x1000>;
        compatible = "aspeed,ast2500-pwm-tacho";
        clocks = <&syscon ASPEED_CLK_APB>;
        resets = <&syscon ASPEED_RESET_PWM>;
        pinctrl-names = "default";
        pinctrl-0 = <&pinctrl_pwm0_default &pinctrl_pwm1_default>;

        fan@0 {
            reg = <0x00>;
            cooling-levels = /bits/ 8 <125 151 177 203 229 255>;
            aspeed,fan-tach-ch = /bits/ 8 <0x00>;
        };

        fan@1 {
            reg = <0x01>;
            aspeed,fan-tach-ch = /bits/ 8 <0x01 0x02>;
        };
    };
```

## Documentation/devicetree/bindings/hwmon/lantiq,cputemp.yaml
```yaml
# SPDX-License-Identifier: (GPL-2.0-only OR BSD-2-Clause)
# Copyright 2025 Lantiq
%YAML 1.2
---
$id: http://devicetree.org/schemas/hwmon/lantiq,cputemp.yaml#
$schema: http://devicetree.org/meta-schemas/core.yaml#

title: Lantiq CPU temperature sensor

maintainers:
  - Bjorn Helgaas <bhelgaas@google.com>
  - Florian Eckert <fe@dev.tdt.de>

description: |
  Lantiq cpu temperature sensor

properties:
  compatible:
    description: CPU temperature sensor compatible string.
    items:
      - const: lantiq,cputemp

required:
  - compatible

additionalProperties: false

examples:
  - |
    cputemp@0 {
        compatible = "lantiq,cputemp";
    };
```

## Documentation/devicetree/bindings/hwmon/lltc,ltc2990.yaml
```yaml
# SPDX-License-Identifier: (GPL-2.0-only OR BSD-2-Clause)
# Copyright 2025 Tom Levens <tom.levens@cern.ch>
%YAML 1.2
---
$id: http://devicetree.org/schemas/lltc,ltc2990.yaml#
$schema: http://devicetree.org/meta-schemas/core.yaml#

title: LTC2990 power monitor
maintainers:
  - Tom Levens <tom.levens@cern.ch>

description: |
  Linear Technology LTC2990 power monitor

properties:
  compatible:
    const: lltc,ltc2990

  reg:
    description: I2C slave address.
    items:
      - description: I2C slave address.

  lltc,meas-mode:
    description: |
      An array of two integers for configuring the chip measurement mode.

      The first integer defines the bits 2..0 in the control register. In all
      cases the internal temperature and supply voltage are measured. In
      addition the following input measurements are enabled per mode:

        0: V1, V2, TR2
        1: V1-V2, TR2
        2: V1-V2, V3, V4
        3: TR1, V3, V4
        4: TR1, V3-V4
        5: TR1, TR2
        6: V1-V2, V3-V4
        7: V1, V2, V3, V4

      The second integer defines the bits 4..3 in the control register. This
      allows a subset of the measurements to be enabled:

        0: Internal temperature and supply voltage only
        1: TR1, V1 or V1-V2 only per mode
        2: TR2, V3 or V3-V4 only per mode
        3: All measurements per mode

    $ref: /schemas/types.yaml#/definitions/uint32-array
    items:
      - description: Mode bits 2..0 in control register.
      - description: Mode bits 4..3 in control register.

required:
  - compatible
  - reg
  - lltc,meas-mode

additionalProperties: false

examples:
  - |
    ltc2990@4c {
        compatible = "lltc,ltc2990";
        reg = <0x4c>;
        lltc,meas-mode = <7 3>;
    };
```

## Documentation/devicetree/bindings/hwmon/maxim,max31785.yaml
```yaml
# SPDX-License-Identifier: (GPL-2.0-only OR BSD-2-Clause)
# Copyright 2025 Andrew Jeffery

%YAML 1.2
---
$id: http://devicetree.org/schemas/hwmon/maxim,max31785.yaml#
$schema: http://devicetree.org/meta-schemas/core.yaml#

title: Maxim MAX31785 Intelligent Fan Controller

maintainers:
  - Andrew Jeffery <andrew@aj.id.au>

description: |
  Bindings for the Maxim MAX31785 Intelligent Fan Controller

  Reference:

  https://datasheets.maximintegrated.com/en/ds/MAX31785.pdf

  The Maxim MAX31785 is a PMBus device providing closed-loop, multi-channel fan
  management with temperature and remote voltage sensing. Various fan control
  features are provided, including PWM frequency control, temperature hysteresis,
  dual tachometer measurements, and fan health monitoring.

properties:
  compatible:
    $ref: /schemas/types.yaml#/definitions/string-array
    items:
      - enum:
          - maxim,max31785
          - maxim,max31785a

  reg:
    description: I2C register address of the device.
    items:
      - description: I2C register address

required:
  - compatible
  - reg

additionalProperties: false

examples:
  - |
    i2c-bus {
      #address-cells = <1>;
      #size-cells = <0>;

      fans@52 {
        compatible = "maxim,max31785";
        reg = <0x52>;
      };
    };
```
