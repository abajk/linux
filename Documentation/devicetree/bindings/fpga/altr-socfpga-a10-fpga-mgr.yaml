## Documentation/devicetree/bindings/goldfish/google,goldfish-events-keypad.yaml
```yaml
# SPDX-License-Identifier: (GPL-2.0-only OR BSD-2-Clause)
# Copyright 2025 Greg Hackmann
%YAML 1.2
---
$id: http://devicetree.org/schemas/google,goldfish-events-keypad.yaml#
# $schema is the meta-schema this schema should be validated with.
$schema: http://devicetree.org/meta-schemas/core.yaml#

title: google,goldfish-events-keypad

maintainers:
  - Greg Hackmann <ghackmann@google.com>

description: |
  Android Goldfish Events Keypad

  Android goldfish events keypad device generated by android emulator.

properties:
  compatible:
    items:
      - const: google,goldfish-events-keypad

  reg:
    items:
      - description: Device registers mapping

  interrupts:
    items:
      - description: Interrupt mapping

required:
  - compatible
  - reg
  - interrupts

additionalProperties: false

examples:
  - |
    goldfish-events@9040000 {
        compatible = "google,goldfish-events-keypad";
        reg = <0x9040000 0x1000>;
        interrupts = <0x5>;
    };
```

## Documentation/devicetree/bindings/goldfish/google,goldfish-tty.yaml
```yaml
# SPDX-License-Identifier: (GPL-2.0-only OR BSD-2-Clause)
# Copyright 2025 Miodrag Dinic <miodrag.dinic@mips.com>
%YAML 1.2
---
$id: http://devicetree.org/schemas/google,goldfish-tty.yaml#
$schema: http://devicetree.org/meta-schemas/core.yaml#

title: Android Goldfish TTY

maintainers:
  - Miodrag Dinic <miodrag.dinic@mips.com>

description: |
  Android Goldfish TTY

  Android goldfish tty device generated by android emulator.

properties:
  compatible:
    items:
      - const: google,goldfish-tty

  reg:
    description: Base address and size mapping of the goldfish tty registers.
    items:
      - description: TTY register region.

  interrupts:
    description: Interrupt mapping for the goldfish tty device.
    items:
      - description: Interrupt line.

required:
  - compatible
  - reg
  - interrupts

additionalProperties: false

examples:
  - |
      goldfish_tty@1f004000 {
          compatible = "google,goldfish-tty";
          reg = <0x1f004000 0x1000>;
          interrupts = <0xc>;
      };
```

## Documentation/devicetree/bindings/gpio/ad,gpio-adnp.yaml
```yaml
# SPDX-License-Identifier: (GPL-2.0-only OR BSD-2-Clause)
# Copyright 2025 Avionic Design
%YAML 1.2
---
$id: http://devicetree.org/schemas/gpio/ad,gpio-adnp.yaml#
$schema: http://devicetree.org/meta-schemas/core.yaml#

title: Avionic Design N-bit GPIO expander

maintainers:
  - Rob Herring <robh@kernel.org>
  - Thierry Reding <thierry.reding@avionic-design.de>

description: |
  Avionic Design N-bit GPIO expander bindings

  The GPIO expander can optionally be used as an interrupt controller, in
  which case it uses the default two cell specifier as described in
  Documentation/devicetree/bindings/interrupt-controller/interrupts.txt.

properties:
  compatible:
    description: GPIO expander compatible string.
    $ref: /schemas/types.yaml#/definitions/string-array
    items:
      - const: "ad,gpio-adnp"
  reg:
    description: I2C slave address for the GPIO expander.
    items:
      - description: I2C slave address.
  interrupts:
    description: Interrupt specifier for the GPIO expander.
    items:
      - description: Interrupt number.
      - description: Interrupt flags.
  gpio-controller: true
  "#gpio-cells":
    const: 2
  nr-gpios:
    description: Number of GPIO pins supported by the controller.
    $ref: /schemas/types.yaml#/definitions/uint32
  interrupt-controller: true
  "#interrupt-cells":
    const: 2

required:
  - compatible
  - reg
  - interrupts
  - gpio-controller
  - "#gpio-cells"
  - nr-gpios

additionalProperties: false

examples:
  - |
    gpioext: gpio-controller@41 {
        compatible = "ad,gpio-adnp";
        reg = <0x41>;
        interrupts = <160 1>;
        gpio-controller;
        #gpio-cells = <2>;
        interrupt-controller;
        #interrupt-cells = <2>;
        nr-gpios = <64>;
    };
```

## Documentation/devicetree/bindings/gpio/cdns,gpio-r1p02.yaml
```yaml
# SPDX-License-Identifier: (GPL-2.0-only OR BSD-2-Clause)
%YAML 1.2
---
$id: http://devicetree.org/schemas/cdns,gpio-r1p02.yaml#
$schema: http://devicetree.org/meta-schemas/core.yaml#

title: Cadence GPIO controller

maintainers:
  - Jan Kotas <jank@cadence.com>

description: |
  Cadence GPIO controller bindings

properties:
  compatible:
    items:
      - const: cdns,gpio-r1p02

  reg:
    items:
      - description: register base address and size

  gpio-controller: true

  '#gpio-cells':
    const: 2

  clocks:
    maxItems: 1
    description: peripheral clock driving the GPIO controller

  ngpios:
    description: number of GPIO lines supported by this controller, up to 32
    $ref: /schemas/types.yaml#/definitions/uint32
    maximum: 32

  interrupt-controller: true

  '#interrupt-cells':
    const: 2

  interrupts:
    items:
      - description: GPIO number to use as interrupt source
      - description: IRQ type, as defined in <dt-bindings/interrupt-controller/irq.h>

dependencies:
  interrupt-controller: [interrupts, '#interrupt-cells']

required:
  - compatible
  - reg
  - gpio-controller
  - '#gpio-cells'

additionalProperties: false

examples:
  - |
    gpio0: gpio-controller@fd060000 {
        compatible = "cdns,gpio-r1p02";
        reg = <0xfd060000 0x1000>;
        clocks = <&gpio_clk>;
        gpio-controller;
        #gpio-cells = <2>;
        interrupt-controller;
        interrupts = <0 5 IRQ_TYPE_LEVEL_HIGH>;
        #interrupt-cells = <2>;
    };
```

## Documentation/devicetree/bindings/gpio/pci8086,2e67.2.yaml
```yaml
# SPDX-License-Identifier: (GPL-2.0-only OR BSD-2-Clause)
# Copyright 2025 Sebastian Andrzej Siewior
%YAML 1.2
---
$id: http://devicetree.org/schemas/gpio/pci8086,2e67.2.yaml#
$schema: http://devicetree.org/meta-schemas/core.yaml#

title: GPIO controller on CE4100 / Sodaville SoCs

maintainers:
  - Sebastian Andrzej Siewior <bigeasy@linutronix.de>

description: |
  The bindings for CE4100's GPIO controller match the generic description
  which is covered by the gpio.txt file in this folder.

  The only additional property is the intel,muxctl property which holds the
  value which is written into the MUXCNTL register.

  There is no compatible property for now because the driver is probed via
  PCI id (vendor 0x8086 device 0x2e67).

  The interrupt specifier consists of two cells encoded as follows:
    - <1st cell>: The interrupt-number that identifies the interrupt source.
    - <2nd cell>: The level-sense information, encoded as follows:
        4 - active high level-sensitive
        8 - active low level-sensitive

properties:
  compatible:
    description: List of compatible strings for the CE4100/Sodaville GPIO controller.
    items:
      - enum:
          - pci8086,2e67.2
          - pci8086,2e67
          - pciclassff0000
          - pciclassff00

  reg:
    description: PCI resource specifier for the GPIO controller register block.
    items:
      - description: PCI BAR and device/function identifier.
      - description: Base address high 32 bits.
      - description: Base address low 32 bits.
      - description: Size high 32 bits.
      - description: Size low 32 bits.

  interrupts:
    description: Interrupt specifier for the GPIO controller.
    items:
      - description: Interrupt number that identifies the interrupt source.
      - description: Level-sense information, 4=active high, 8=active low.

  interrupt-controller: true

  '#interrupt-cells':
    const: 2

  gpio-controller: true

  '#gpio-cells':
    const: 2

  intel,muxctl:
    description: Value to be written into the MUXCNTL register.
    $ref: /schemas/types.yaml#/definitions/uint32

additionalProperties: false

examples:
  - |
    pcigpio: gpio@b,1 {
        #gpio-cells = <2>;
        #interrupt-cells = <2>;
        compatible = "pci8086,2e67.2", "pci8086,2e67", "pciclassff0000", "pciclassff00";
        reg = <0x15900 0x0 0x0 0x0 0x0>;
        interrupts = <15 1>;
        interrupt-controller;
        gpio-controller;
        intel,muxctl = <0>;
    };

    testuser@20 {
        compatible = "example,testuser";
        interrupts = <11 8>;
        gpios = <&pcigpio 11 0>;
    };
```

## Documentation/devicetree/bindings/gpu/aspeed,ast2500-gfx.yaml
```yaml
# SPDX-License-Identifier: (GPL-2.0-only OR BSD-2-Clause)
# Copyright 2025 Joel Stanley <joel@jms.id.au>
%YAML 1.2
---
$id: http://devicetree.org/schemas/gpu/aspeed,ast2500-gfx.yaml#
$schema: http://devicetree.org/meta-schemas/core.yaml#

title: ASPEED GFX Display Controller

maintainers:
  - Joel Stanley <joel@jms.id.au>

description: |
  Device tree configuration for the GFX display device on the ASPEED SoCs

properties:
  compatible:
    items:
      - enum:
          - aspeed,ast2500-gfx
          - aspeed,ast2400-gfx
      - const: syscon
    description: >
      Device compatible strings. First must be one of the AST SoC GFX
      compatible values. Second must be "syscon" as required by the ASPEED
      pinctrl bindings.

  reg:
    items:
      - description: Physical base address of the GFX registers
      - description: Length of the GFX register region
    description: >
      Physical base address and length of the GFX registers.

  reg-io-width:
    $ref: /schemas/types.yaml#/definitions/uint32
    description: >
      Bus width (in bytes) of register accesses.

  clocks:
    maxItems: 1
    description: >
      Clock used to generate the pixel clock.

  resets:
    maxItems: 1
    description: >
      Reset line that must be released to use the GFX device.

  interrupts:
    items:
      - description: Interrupt number for the GFX device
    description: >
      Interrupt line for the GFX device.

  memory-region:
    $ref: /schemas/types.yaml#/definitions/phandle
    description: >
      Phandle to a reserved-memory region to use for the framebuffer.

required:
  - compatible
  - reg
  - interrupts
  - clocks
  - resets
  - memory-region

additionalProperties: false

examples:
  - |
    gfx: display@1e6e6000 {
        compatible = "aspeed,ast2500-gfx", "syscon";
        reg = <0x1e6e6000 0x1000>;
        reg-io-width = <4>;
        clocks = <&syscon ASPEED_CLK_GATE_D1CLK>;
        resets = <&syscon ASPEED_RESET_CRT1>;
        interrupts = <0x19>;
        memory-region = <&gfx_memory>;
    };
    gfx_memory: framebuffer {
        size = <0x01000000>;
        alignment = <0x01000000>;
        compatible = "shared-dma-pool";
        reusable;
    };
```

## Documentation/devicetree/bindings/gpu/nvidia,gk20a.yaml
```yaml
# SPDX-License-Identifier: (GPL-2.0-only OR BSD-2-Clause)
# Copyright 2018 Linaro Ltd.
%YAML 1.2
---
$id: http://devicetree.org/schemas/nvidia,gk20a.yaml#
$schema: http://devicetree.org/meta-schemas/core.yaml#

title: NVIDIA Tegra Graphics Processing Units

maintainers:
  - Alexandre Courbot <acourbot@nvidia.com>
  - Jon Hunter <jonathanh@nvidia.com>
  - Rob Herring <robh@kernel.org>
  - Thierry Reding <treding@nvidia.com>

description: |
  NVIDIA Tegra Graphics Processing Units

properties:
  compatible:
    oneOf:
      - items:
          - const: nvidia,gk20a
          - const: nvidia,gm20b
          - const: nvidia,gp10b
          - const: nvidia,gv11b
    description: >
      Compatible string for Tegra GPU; must be one of the recognized variants.
  reg:
    items:
      - description: Bar0 register window
      - description: Bar1 register window
    description: >
      Physical base address and length of GPU controller registers.
  interrupts:
    items:
      - description: Stall interrupt
      - description: Nonstall interrupt
    description: >
      Interrupt number and type for each GPU interrupt.
  interrupt-names:
    items:
      - const: stall
      - const: nonstall
  vdd-supply:
    description: >
      Regulator for GPU supply voltage; required unless power-domains is used.
  clocks:
    items:
      - description: GPU clock
      - description: Power clock
    description: >
      Clocks required for GPU operation.
  clock-names:
    items:
      - const: gpu
      - const: pwr
  resets:
    items:
      - description: GPU reset
    description: >
      Reset control for the GPU.
  reset-names:
    items:
      - const: gpu
  power-domains:
    maxItems: 1
    description: >
      Power domain references for GPUs using power domains.
  iommus:
    maxItems: 1
    description: >
      References to the IOMMU.
  dma-coherent:
    type: boolean
    description: >
      Enable DMA coherent mode (gv11b only).

required:
  - compatible
  - reg
  - interrupts
  - interrupt-names
  - clocks
  - clock-names
  - resets
  - reset-names

allOf:
  - if:
      properties:
        compatible:
          contains:
            const: nvidia,gm20b
    then:
      properties:
        clock-names:
          contains:
            const: ref
  - if:
      properties:
        compatible:
          contains:
            const: nvidia,gv11b
    then:
      properties:
        clock-names:
          contains:
            const: fuse
        dma-coherent:
          type: boolean
  - if:
      properties:
        compatible:
          contains:
            const: nvidia,gp10b
    then:
      required:
        - power-domains
    else:
      required:
        - vdd-supply

additionalProperties: false

examples:
  - |
    gpu@57000000 {
        compatible = "nvidia,gk20a";
        reg = <0x0 0x57000000 0x0 0x01000000>,
              <0x0 0x58000000 0x0 0x01000000>;
        interrupts = <GIC_SPI 157 IRQ_TYPE_LEVEL_HIGH>,
                     <GIC_SPI 158 IRQ_TYPE_LEVEL_HIGH>;
        interrupt-names = "stall", "nonstall";
        vdd-supply = <&vdd_gpu>;
        clocks = <&tegra_car TEGRA124_CLK_GPU>,
                 <&tegra_car TEGRA124_CLK_PLL_P_OUT5>;
        clock-names = "gpu", "pwr";
        resets = <&tegra_car 184>;
        reset-names = "gpu";
        iommus = <&mc TEGRA_SWGROUP_GPU>;
    };
  - |
    gpu@57000000 {
        compatible = "nvidia,gm20b";
        reg = <0x0 0x57000000 0x0 0x01000000>,
              <0x0 0x58000000 0x0 0x01000000>;
        interrupts = <GIC_SPI 157 IRQ_TYPE_LEVEL_HIGH>,
                     <GIC_SPI 158 IRQ_TYPE_LEVEL_HIGH>;
        interrupt-names = "stall", "nonstall";
        clocks = <&tegra_car TEGRA210_CLK_GPU>,
                 <&tegra_car TEGRA210_CLK_PLL_P_OUT5>,
                 <&tegra_car TEGRA210_CLK_PLL_G_REF>;
        clock-names = "gpu", "pwr", "ref";
        resets = <&tegra_car 184>;
        reset-names = "gpu";
        iommus = <&mc TEGRA_SWGROUP_GPU>;
    };
  - |
    gpu@17000000 {
        compatible = "nvidia,gp10b";
        reg = <0x0 0x17000000 0x0 0x1000000>,
              <0x0 0x18000000 0x0 0x1000000>;
        interrupts = <GIC_SPI 70 IRQ_TYPE_LEVEL_HIGH>,
                     <GIC_SPI 71 IRQ_TYPE_LEVEL_HIGH>;
        interrupt-names = "stall", "nonstall";
        clocks = <&bpmp TEGRA186_CLK_GPCCLK>,
                 <&bpmp TEGRA186_CLK_GPU>;
        clock-names = "gpu", "pwr";
        resets = <&bpmp TEGRA186_RESET_GPU>;
        reset-names = "gpu";
        power-domains = <&bpmp TEGRA186_POWER_DOMAIN_GPU>;
        iommus = <&smmu TEGRA186_SID_GPU>;
    };
  - |
    gpu@17000000 {
        compatible = "nvidia,gv11b";
        reg = <0x17000000 0x1000000>,
              <0x18000000 0x1000000>;
        interrupts = <GIC_SPI 70 IRQ_TYPE_LEVEL_HIGH>,
                     <GIC_SPI 71 IRQ_TYPE_LEVEL_HIGH>;
        interrupt-names = "stall", "nonstall";
        clocks = <&bpmp TEGRA194_CLK_GPCCLK>,
                 <&bpmp TEGRA194_CLK_GPU_PWR>,
                 <&bpmp TEGRA194_CLK_FUSE>;
        clock-names = "gpu", "pwr", "fuse";
        resets = <&bpmp TEGRA194_RESET_GPU>;
        reset-names = "gpu";
        dma-coherent;
        power-domains = <&bpmp TEGRA194_POWER_DOMAIN_GPU>;
        iommus = <&smmu TEGRA194_SID_GPU>;
    };
```
