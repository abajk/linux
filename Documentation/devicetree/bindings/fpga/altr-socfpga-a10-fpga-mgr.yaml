## Documentation/devicetree/bindings/fpga/altr-socfpga-a10-fpga-mgr.yaml
```yaml
# SPDX-License-Identifier: (GPL-2.0-only OR BSD-2-Clause)
# Copyright 2025 Alan Tull <atull@opensource.altera.com>
%YAML 1.2
---
$id: http://devicetree.org/schemas/fpga/altr-socfpga-a10-fpga-mgr.yaml#
$schema: http://devicetree.org/meta-schemas/core.yaml#

title: Altera SOCFPGA Arria10 FPGA Manager

maintainers:
  - Alan Tull <atull@opensource.altera.com>

description: |
  Altera SOCFPGA Arria10 FPGA Manager

properties:
  compatible:
    # Must list the compatible string values
    items:
      - const: altr,socfpga-a10-fpga-mgr
  reg:
    # The first index is for FPGA manager register access.
    # The second index is for writing FPGA configuration data.
    items:
      - description: FPGA manager register access
      - description: FPGA configuration data register access
  clocks:
    description: Clocks used by the device.
    $ref: /schemas/types.yaml#/definitions/phandle-array
  resets:
    description: Reset specifiers for the device's reset.
    $ref: /schemas/types.yaml#/definitions/phandle-array

required:
  - compatible
  - reg
  - clocks
  - resets

additionalProperties: false

examples:
  - |
    fpga_mgr: fpga-mgr@ffd03000 {
        compatible = "altr,socfpga-a10-fpga-mgr";
        reg = <0xffd03000 0x100
               0xffcfe400 0x20>;
        clocks = <&l4_mp_clk>;
        resets = <&rst FPGAMGR_RESET>;
    };
```

## Documentation/devicetree/bindings/fpga/lattice,ice40-fpga-mgr.yaml
```yaml
# SPDX-License-Identifier: (GPL-2.0-only OR BSD-2-Clause)
# Copyright 2025 Joel Holdsworth
%YAML 1.2
---
$id: http://devicetree.org/schemas/lattice,ice40-fpga-mgr.yaml#
$schema: http://devicetree.org/meta-schemas/core.yaml#

title: Lattice iCE40 FPGA Manager

maintainers:
  - Joel Holdsworth <joel@airwebreathe.org.uk>

description: |
  Lattice iCE40 FPGA Manager

  Required properties:
  - compatible: Should contain "lattice,ice40-fpga-mgr"
  - reg: SPI chip select
  - spi-max-frequency: Maximum SPI frequency (>=1000000, <=25000000)
  - cdone-gpios: GPIO input connected to CDONE pin
  - reset-gpios: Active-low GPIO output connected to CRESET_B pin. Note
      that unless the GPIO is held low during startup, the FPGA will enter
      Master SPI mode and drive SCK with a clock signal potentially jamming
      other devices on the bus until the firmware is loaded.

properties:
  compatible:
    items:
      - const: lattice,ice40-fpga-mgr

  reg:
    items:
      - description: SPI chip select

  spi-max-frequency:
    description: Maximum SPI frequency for firmware loading in Hertz
    minimum: 1000000
    maximum: 25000000

  cdone-gpios:
    maxItems: 1
    description: GPIO input connected to CDONE pin

  reset-gpios:
    maxItems: 1
    description: Active-low GPIO output connected to CRESET_B pin; must be
      held low during startup or FPGA will drive SCK and may jam the bus

required:
  - compatible
  - reg
  - spi-max-frequency
  - cdone-gpios
  - reset-gpios

additionalProperties: false

examples:
  - |
    fpga@0 {
        compatible = "lattice,ice40-fpga-mgr";
        reg = <0>;
        spi-max-frequency = <1000000>;
        cdone-gpios = <&gpio 24 GPIO_ACTIVE_HIGH>;
        reset-gpios = <&gpio 22 GPIO_ACTIVE_LOW>;
    };
```

## Documentation/devicetree/bindings/fpga/lattice,machxo2-slave-spi.yaml
```yaml
# SPDX-License-Identifier: (GPL-2.0-only OR BSD-2-Clause)
%YAML 1.2
---
$id: http://devicetree.org/schemas/fpga/lattice,machxo2-slave-spi.yaml#
# $schema is the meta-schema this schema should be validated with.
$schema: http://devicetree.org/meta-schemas/core.yaml#

title: Lattice MachXO2 Slave SPI FPGA Manager

maintainers:
  - Paolo Pisati <p.pisati@gmail.com>

description: |
  Lattice MachXO2 Slave SPI FPGA Manager

  Lattice MachXO2 FPGAs support a method of loading the bitstream over
  'slave SPI' interface.

  See 'MachXO2ProgrammingandConfigurationUsageGuide.pdf' on www.latticesemi.com

properties:
  compatible:
    items:
      - const: lattice,machxo2-slave-spi

  reg:
    description: SPI chip select of the FPGA.
    items:
      - description: SPI chip select index.

  spi-max-frequency:
    description: Maximum SPI clock frequency for bitstream transfer.
    $ref: /schemas/types.yaml#/definitions/uint32

required:
  - compatible
  - reg

additionalProperties: false

examples:
  - |
    fpga-mgr@0 {
        compatible = "lattice,machxo2-slave-spi";
        reg = <0>;
        spi-max-frequency = <8000000>;
    };
```

## Documentation/devicetree/bindings/fsi/aspeed,ast2400-cf-fsi-master.yaml
```yaml
# SPDX-License-Identifier: (GPL-2.0-only OR BSD-2-Clause)
# Copyright 2025 Benjamin Herrenschmidt
%YAML 1.2
---
$id: http://devicetree.org/schemas/aspeed,ast2400-cf-fsi-master.yaml#
$schema: http://devicetree.org/meta-schemas/core.yaml#

title: ColdFire offloaded gpio-based FSI master

maintainers:
  - Benjamin Herrenschmidt <benh@kernel.crashing.org>

description: |
  Device-tree bindings for ColdFire offloaded gpio-based FSI master driver

properties:
  compatible:
    oneOf:
      - items:
          - const: aspeed,ast2400-cf-fsi-master
      - items:
          - const: aspeed,ast2500-cf-fsi-master
      - items:
          - const: aspeed,ast2500-cf-fsi-master
          - const: fsi-master

  clock-gpios:
    maxItems: 1
    description: GPIO for FSI clock

  data-gpios:
    maxItems: 1
    description: GPIO for FSI data signal

  enable-gpios:
    maxItems: 1
    description: GPIO for enable signal

  trans-gpios:
    maxItems: 1
    description: GPIO for voltage translator enable

  mux-gpios:
    maxItems: 1
    description: GPIO for pin multiplexing with other functions (eg, external FSI masters)

  memory-region:
    description: |
      Reference to the reserved memory for the ColdFire. Must be 2M aligned on AST2400
      and 1M aligned on AST2500.
    $ref: /schemas/types.yaml#/definitions/phandle

  aspeed,sram:
    description: Reference to the SRAM node.
    $ref: /schemas/types.yaml#/definitions/phandle

  aspeed,cvic:
    description: Reference to the CVIC node.
    $ref: /schemas/types.yaml#/definitions/phandle

required:
  - compatible
  - clock-gpios
  - data-gpios
  - enable-gpios
  - trans-gpios
  - mux-gpios
  - memory-region
  - aspeed,sram
  - aspeed,cvic

additionalProperties: false

examples:
  - |
    fsi-master {
      compatible = "aspeed,ast2500-cf-fsi-master", "fsi-master";
      clock-gpios = <&gpio 0>;
      data-gpios = <&gpio 1>;
      enable-gpios = <&gpio 2>;
      trans-gpios = <&gpio 3>;
      mux-gpios = <&gpio 4>;
      memory-region = <&coldfire_memory>;
      aspeed,sram = <&sram>;
      aspeed,cvic = <&cvic>;
    };
```

## Documentation/devicetree/bindings/fsi/fsi-master-gpio.yaml
```yaml
# SPDX-License-Identifier: (GPL-2.0-only OR BSD-2-Clause)
# Copyright 2025 Benjamin Herrenschmidt <benh@kernel.crashing.org>
# Copyright 2025 Christopher Bostic <cbostic@linux.vnet.ibm.com>
%YAML 1.2
---
$id: http://devicetree.org/schemas/fsi-master-gpio.yaml#
$schema: http://devicetree.org/meta-schemas/core.yaml#

title: fsi-master-gpio

maintainers:
  - Benjamin Herrenschmidt <benh@kernel.crashing.org>
  - Christopher Bostic <cbostic@linux.vnet.ibm.com>

description: |
  Device-tree bindings for gpio-based FSI master driver
  -----------------------------------------------------

properties:
  compatible:
    description: Device compatible string identifying the gpio-based FSI master driver.
    oneOf:
      - items:
          - const: fsi-master-gpio
          - const: fsi-master
      - items:
          - const: fsi-master-gpio

  clock-gpios:
    description: GPIO for FSI clock
    $ref: /schemas/types.yaml#/definitions/gpio-array

  data-gpios:
    description: GPIO for FSI data signal
    $ref: /schemas/types.yaml#/definitions/gpio-array

  enable-gpios:
    description: GPIO for enable signal
    $ref: /schemas/types.yaml#/definitions/gpio-array

  trans-gpios:
    description: GPIO for voltage translator enable
    $ref: /schemas/types.yaml#/definitions/gpio-array

  mux-gpios:
    description: GPIO for pin multiplexing with other functions (eg, external
      FSI masters)
    $ref: /schemas/types.yaml#/definitions/gpio-array

  no-gpio-delays:
    description: Don't add extra delays between GPIO accesses.
      This is useful when the HW GPIO block is running at a low enough frequency.
    type: boolean

required:
  - compatible
  - clock-gpios
  - data-gpios

additionalProperties: false

examples:
  - |
    fsi-master {
        compatible = "fsi-master-gpio", "fsi-master";
        clock-gpios = <&gpio 0>;
        data-gpios = <&gpio 1>;
        enable-gpios = <&gpio 2>;
        trans-gpios = <&gpio 3>;
        mux-gpios = <&gpio 4>;
    };
```

## Documentation/devicetree/bindings/fsi/fsi-master.yaml
```yaml
# SPDX-License-Identifier: (GPL-2.0-only OR BSD-2-Clause)
%YAML 1.2
---
$id: http://devicetree.org/schemas/fsi-master.yaml#
$schema: http://devicetree.org/meta-schemas/core.yaml#

title: Generic FSI bus and engine

maintainers:
  - Benjamin Herrenschmidt <benh@kernel.crashing.org>
  - Christopher Bostic <cbostic@linux.vnet.ibm.com>
  - Jeremy Kerr <jk@ozlabs.org>

description: |
  FSI bus & engine generic device tree bindings

  The FSI bus is probe-able, so the OS is able to enumerate FSI slaves, and
  engines within those slaves. However, we have a facility to match devicetree
  nodes to probed engines. This allows for fsi engines to expose non-probeable
  busses, which are then exposed by the device tree. For example, an FSI engine
  that is an I2C master – the I2C bus can be described by the device tree under
  the engine’s device tree node.

  Since the master nodes describe the top-level of the FSI topology, they also
  need to declare the FSI-standard addressing scheme. Under the masters’ nodes,
  we can describe the bus topology using nodes to represent the FSI slaves and
  their slave engines. As a basic outline:

    fsi-master {
        fsi-slave@<link,id> {
            fsi-slave-engine@<addr> { … };
        };
    };

  Note that since the bus is probe-able, some (or all) of the topology may
  not be described; this binding only provides an optional facility for
  adding subordinate device tree nodes as children of FSI engines.

properties:
  compatible:
    items:
      - const: fsi-master
    description: >
      Node compatible with the generic FSI bus master driver.

  "#address-cells":
    const: 2
    description: >
      Two cells are used to encode the FSI bus address: link index and slave ID.

  "#size-cells":
    const: 0
    description: >
      FSI bus nodes do not use size cells.

  no-scan-on-init:
    type: boolean
    description: >
      If true, the master driver will not scan for slaves at initialization.

additionalProperties: false

examples:
  - |
    /* The GPIO-based FSI master node, describing the top level of the
     * FSI bus
     */
    gpio-fsi {
        compatible = "fsi-master-gpio", "fsi-master";
        #address-cells = <2>;
        #size-cells = <0>;

        /* A FSI slave (aka. CFAM) at link 0, ID 0. */
        cfam@0,0 {
            reg = <0 0>;
            #address-cells = <1>;
            #size-cells = <1>;
            chip-id = <0>;

            /* FSI engine at 0xc00, using a single page. In this example,
             * it’s an I2C master controller, so subnodes describe the
             * I2C bus.
             */
            i2c-controller@c00 {
                reg = <0xc00 0x400>;

                /* Engine-specific data. In this case, we’re describing an
                 * I2C bus, so we’re conforming to the generic I2C binding
                 */
                compatible = "some-vendor,fsi-i2c-controller";
                #address-cells = <1>;
                #size-cells = <1>;

                /* I2C endpoint device: an Atmel EEPROM */
                eeprom@50 {
                    compatible = "atmel,24c256";
                    reg = <0x50>;
                    pagesize = <64>;
                };
            };
        };
    };
```

## Documentation/devicetree/bindings/goldfish/google,android-pipe.yaml
```yaml
# SPDX-License-Identifier: (GPL-2.0-only OR BSD-2-Clause)
# Copyright 2025 Google LLC
%YAML 1.2
---
$id: http://devicetree.org/schemas/google,android-pipe.yaml#
$schema: http://devicetree.org/meta-schemas/core.yaml#

title: Android Goldfish QEMU Pipe

maintainers:
  - Greg Hackmann <ghackmann@google.com>

description: |
  Android Goldfish QEMU Pipe

  Andorid pipe virtual device generated by android emulator.

properties:
  compatible:
    items:
      - const: google,android-pipe

  reg:
    items:
      - description: Base address of the pipe registers
      - description: Size of the pipe register region

  interrupts:
    items:
      - description: Interrupt mapping for the pipe device

required:
  - compatible
  - reg
  - interrupts

additionalProperties: false

examples:
  - |
    android_pipe@a010000 {
        compatible = "google,android-pipe";
        reg = <ff018000 0x2000>;
        interrupts = <0x12>;
    };
```

## Documentation/devicetree/bindings/goldfish/google,goldfish-audio.yaml
```yaml
# SPDX-License-Identifier: (GPL-2.0-only OR BSD-2-Clause)
# Copyright 2025 Greg Hackmann <ghackmann@google.com>
%YAML 1.2
---
$id: http://devicetree.org/schemas/google,goldfish-audio.yaml#
$schema: http://devicetree.org/meta-schemas/core.yaml#

title: Google Goldfish Audio
maintainers:
  - Greg Hackmann <ghackmann@google.com>

description: |
  Android Goldfish Audio

  Android goldfish audio device generated by android emulator.

properties:
  compatible:
    items:
      - const: google,goldfish-audio
    description: Emulator’s goldfish-audio compatible string.

  reg:
    description: Address and size of the audio registers.
    items:
      - description: Base register address and register block size.

  interrupts:
    description: Interrupt mapping for the audio device.
    items:
      - description: Interrupt number for audio events.

required:
  - compatible
  - reg
  - interrupts

additionalProperties: false

examples:
  - |
    goldfish_audio@9030000 {
        compatible = "google,goldfish-audio";
        reg = <0x9030000 0x100>;
        interrupts = <0x4>;
    };
```

## Documentation/devicetree/bindings/goldfish/google,goldfish-battery.yaml
```yaml
# SPDX-License-Identifier: (GPL-2.0-only OR BSD-2-Clause)
# Copyright 2025 Google
%YAML 1.2
---
$id: http://devicetree.org/schemas/google,goldfish-battery.yaml#
$schema: http://devicetree.org/meta-schemas/core.yaml#

title: Google Goldfish Battery
maintainers:
  - Greg Hackmann <ghackmann@google.com>

description: |
  Android Goldfish Battery

  Android goldfish battery device generated by android emulator.

properties:
  compatible:
    items:
      - const: google,goldfish-battery

  reg:
    items:
      - description: Register address and size mapping

  interrupts:
    items:
      - description: Interrupt mapping

required:
  - compatible
  - reg
  - interrupts

additionalProperties: false

examples:
  - |
    goldfish_battery@9020000 {
        compatible = "google,goldfish-battery";
        reg = <0x9020000 0x1000>;
        interrupts = <0x3>;
    };
```
