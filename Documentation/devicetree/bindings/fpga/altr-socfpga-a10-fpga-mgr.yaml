## Documentation/devicetree/bindings/hwmon/maxim,max6697.yaml
```yaml
# SPDX-License-Identifier: (GPL-2.0-only OR BSD-2-Clause)
# Copyright 2025 Wolfram Sang <wsa@kernel.org>
%YAML 1.2
---
$id: http://devicetree.org/schemas/hwmon/maxim,max6697.yaml#
$schema: http://devicetree.org/meta-schemas/core.yaml#

title: MAX6697 temperature sensor

maintainers:
  - Wolfram Sang <wsa@kernel.org>

description: |
  max6697 properties

properties:
  compatible:
    items:
      - enum:
          - maxim,max6581
          - maxim,max6602
          - maxim,max6622
          - maxim,max6636
          - maxim,max6689
          - maxim,max6693
          - maxim,max6694
          - maxim,max6697
          - maxim,max6698
          - maxim,max6699
    description: Device compatible string for MAX6697 and related sensors.

  reg:
    items:
      - description: I2C address for the sensor.

  smbus-timeout-disable:
    type: boolean
    description: Disable SMBus timeout.

  extended-range-enable:
    type: boolean
    description: Enable extended temperature range. Only valid for MAX6581.

  beta-compensation-enable:
    type: boolean
    description: Enable beta compensation on remote temperature channel 1. Only valid for MAX6693 and MAX6694.

  alert-mask:
    $ref: /schemas/types.yaml#/definitions/uint32
    description: >
      Alert bit mask. Bits set will disable alert. Bit 0 for local temperature,
      bits 1..7 for remote channels.

  over-temperature-mask:
    $ref: /schemas/types.yaml#/definitions/uint32
    description: >
      Over-temperature bit mask. Bits set will disable over-temperature
      reporting. Bit 0 for local temperature, bits 1..7 for remote channels.

  resistance-cancellation:
    type: boolean
    description: >
      Enable resistance cancellation on remote temperature channel 1. For
      MAX6581, enables cancellation on all channels.

  transistor-ideality:
    $ref: /schemas/types.yaml#/definitions/uint32-array
    description: >
      For MAX6581 only. Two element array: first is bit mask for channels 1..7,
      second is ideality select value as per MAX6581 data sheet.
    items:
      - $ref: /schemas/types.yaml#/definitions/uint32
      - $ref: /schemas/types.yaml#/definitions/uint32

required:
  - compatible
  - reg

additionalProperties: false

examples:
  - |
    temp-sensor@1a {
        compatible = "maxim,max6697";
        reg = <0x1a>;
        smbus-timeout-disable;
        resistance-cancellation;
        alert-mask = <0x72>;
        over-temperature-mask = <0x7f>;
    };
```

## Documentation/devicetree/bindings/hwmon/nuvoton,npcm750-pwm-fan.yaml
```yaml
# SPDX-License-Identifier: (GPL-2.0-only OR BSD-2-Clause)
# Copyright 2025 Bjorn Helgaas <bhelgaas@google.com>
#          2025 Tomer Maimon <tmaimon77@gmail.com>
%YAML 1.2
---
$id: http://devicetree.org/schemas/nuvoton,npcm750-pwm-fan.yaml#
$schema: http://devicetree.org/meta-schemas/core.yaml#

title: Nuvoton NPCM PWM and Fan Tacho controller
maintainers:
  - Bjorn Helgaas <bhelgaas@google.com>
  - Tomer Maimon <tmaimon77@gmail.com>

description: |
  Nuvoton NPCM PWM and Fan Tacho controller device

  The Nuvoton BMC NPCM7XX supports 8 Pulse-width modulation (PWM)
  controller outputs and 16 Fan tachometer controller inputs.

  The Nuvoton BMC NPCM8XX supports 12 Pulse-width modulation (PWM)
  controller outputs and 16 Fan tachometer controller inputs.

properties:
  compatible:
    description: Device compatible string.
    items:
      - enum:
          - nuvoton,npcm750-pwm-fan
          - nuvoton,npcm845-pwm-fan

  '#address-cells':
    description: Must be 1.
    const: 1

  '#size-cells':
    description: Must be 0.
    const: 0

  reg:
    items:
      - description: PWM controller registers (address and size).
      - description: Fan controller registers (address and size).

  reg-names:
    description: Names for reg entries.
    items:
      - const: pwm
      - const: fan

  clocks:
    items:
      - description: PWM controller clock.
      - description: Fan controller clock.

  clock-names:
    items:
      - const: pwm
      - const: fan

  interrupts:
    description: Fan tachometer interrupts with falling-edge flags.
    minItems: 1

patternProperties:
  '^fan@[0-9]+$':
    type: object
    description: Fan subnode describing PWM channel and tachometer channel(s).
    properties:
      reg:
        description: PWM output channel number (0–7).
        minimum: 0
        maximum: 7

      fan-tach-ch:
        description: Fan tachometer channel number(s) (0–15).
        $ref: /schemas/types.yaml#/definitions/uint32-array
        minItems: 1
        items:
          minimum: 0
          maximum: 15

      cooling-levels:
        description: PWM duty cycle values for thermal cooling states (0–255).
        $ref: /schemas/types.yaml#/definitions/uint32-array
        items:
          minimum: 0
          maximum: 255

    required:
      - reg
      - fan-tach-ch
    additionalProperties: false

required:
  - compatible
  - '#address-cells'
  - '#size-cells'
  - reg
  - reg-names
  - clocks
  - clock-names
  - interrupts
  - pinctrl-names
  - pinctrl-0

additionalProperties: false

examples:
  - |
    pwm_fan:pwm-fan-controller@103000 {
      #address-cells = <1>;
      #size-cells = <0>;
      compatible = "nuvoton,npcm750-pwm-fan";
      reg = <0x103000 0x2000>,
            <0x180000 0x8000>;
      reg-names = "pwm", "fan";
      clocks = <&clk NPCM7XX_CLK_APB3>,
               <&clk NPCM7XX_CLK_APB4>;
      clock-names = "pwm", "fan";
      interrupts = <GIC_SPI 96 IRQ_TYPE_LEVEL_HIGH>,
                   <GIC_SPI 97 IRQ_TYPE_LEVEL_HIGH>,
                   <GIC_SPI 98 IRQ_TYPE_LEVEL_HIGH>,
                   <GIC_SPI 99 IRQ_TYPE_LEVEL_HIGH>,
                   <GIC_SPI 100 IRQ_TYPE_LEVEL_HIGH>,
                   <GIC_SPI 101 IRQ_TYPE_LEVEL_HIGH>,
                   <GIC_SPI 102 IRQ_TYPE_LEVEL_HIGH>,
                   <GIC_SPI 103 IRQ_TYPE_LEVEL_HIGH>;
      pinctrl-names = "default";
      pinctrl-0 = <&pwm0_pins &pwm1_pins &pwm2_pins
                   &fanin0_pins &fanin1_pins &fanin2_pins
                   &fanin3_pins &fanin4_pins>;
      fan@0 {
        reg = <0x00>;
        fan-tach-ch = /bits/ 8 <0x00 0x01>;
        cooling-levels = <127 255>;
      };
      fan@1 {
        reg = <0x01>;
        fan-tach-ch = /bits/ 8 <0x02 0x03>;
      };
      fan@2 {
        reg = <0x02>;
        fan-tach-ch = /bits/ 8 <0x04>;
      };
    };
```
