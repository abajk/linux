## Documentation/devicetree/bindings/mtd/renesas,shmobile-flctl-sh7372.yaml
```yaml
# SPDX-License-Identifier: (GPL-2.0-only OR BSD-2-Clause)
%YAML 1.2
---
$id: http://devicetree.org/schemas/renesas,shmobile-flctl-sh7372.yaml#
$schema: http://devicetree.org/meta-schemas/core.yaml#

title: FLCTL NAND controller

maintainers:
  - Bastian Hecht <hechtb@googlemail.com>
  - Nayab Sayed <nayabbasha.sayed@microchip.com>

description: |
  FLCTL NAND controller

  The DMA fields are not used yet in the driver but are listed here for
  completing the bindings.

  The device tree may optionally contain sub-nodes describing partitions of the
  address space. See mtd.yaml for more detail.

properties:
  compatible:
    items:
      - const: renesas,shmobile-flctl-sh7372

  reg:
    maxItems: 1

  interrupts:
    maxItems: 1

  nand-bus-width:
    description: Bus width to NAND chip.
    $ref: /schemas/types.yaml#/definitions/uint32

  dmas:
    description: DMA specifier(s) for data and ECC transfers.

  dma-names:
    description: Name for each DMA specifier.
    items:
      - enum: [data_tx, data_rx, ecc_tx, ecc_rx]

  '#address-cells':
    description: Number of address cells for partitions.
    const: 1

  '#size-cells':
    description: Number of size cells for partitions.
    const: 1

patternProperties:
  '^[a-z0-9,._-]+@[0-9A-Za-z]+$':
    description: Partition nodes of the NAND address space.
    type: object
    additionalProperties: false
    properties:
      label:
        description: Partition label.
        $ref: /schemas/types.yaml#/definitions/string
      reg:
        description: Partition address and size.
        maxItems: 1
    required:
      - reg

required:
  - compatible
  - reg
  - interrupts
  - nand-bus-width

additionalProperties: false

examples:
  - |
    flctl@e6a30000 {
      #address-cells = <1>;
      #size-cells = <1>;
      compatible = "renesas,shmobile-flctl-sh7372";
      reg = <0xe6a30000 0x100>;
      interrupts = <0x0d80>;
      nand-bus-width = <16>;
      dmas = <&dmac 1 /* data_tx */
         &dmac 2 /* data_rx */>;
      dma-names = "data_tx", "data_rx";

      system@0 {
        label = "system";
        reg = <0x0 0x8000000>;
      };

      userdata@8000000 {
        label = "userdata";
        reg = <0x8000000 0x10000000>;
      };

      cache@18000000 {
        label = "cache";
        reg = <0x18000000 0x8000000>;
      };
    };
```

## Documentation/devicetree/bindings/mtd/samsung-s3c2410-nand.yaml
```yaml
# SPDX-License-Identifier: (GPL-2.0-only OR BSD-2-Clause)
%YAML 1.2
---
$id: http://devicetree.org/schemas/mtd/samsung-s3c2410-nand.yaml#
$schema: http://devicetree.org/meta-schemas/core.yaml#

title: Samsung S3C2410 and compatible NAND flash controller

maintainers:
  - Kamal Dasu <kdasu.kdev@gmail.com>
  - Nayab Sayed <nayabbasha.sayed@microchip.com>
  - Sergio Prado <sergio.prado@e-labworks.com>

description: |
  Samsung S3C2410 and compatible NAND flash controller

properties:
  compatible:
    description: Compatibility strings for Samsung S3C NAND controller
    $ref: /schemas/types.yaml#/definitions/string-array
    items:
      - enum:
          - samsung,s3c2410-nand
          - samsung,s3c2412-nand
          - samsung,s3c2440-nand

  reg:
    description: Controller register base address and length
    items:
      - description: Controller register base address
      - description: Controller register length in bytes

  '#address-cells':
    description: Number of address cells for child nodes
    const: 1

  '#size-cells':
    description: Number of size cells for child nodes
    const: 0

  clocks:
    description: Phandle to the NAND controller clock
    maxItems: 1

  clock-names:
    description: Names for the controller clocks
    items:
      - const: nand

  nand-ecc-mode:
    description: NAND ECC mode for the flash chip
    enum:
      - soft
      - hw

  nand-on-flash-bbt:
    description: Enable on-flash bad block table
    type: boolean

additionalProperties: false

examples:
  - |
    nand-controller@4e000000 {
        compatible = "samsung,s3c2440-nand";
        reg = <0x4e000000 0x40>;

        #address-cells = <1>;
        #size-cells = <0>;

        clocks = <&clocks HCLK_NAND>;
        clock-names = "nand";

        nand {
            nand-ecc-mode = "soft";
            nand-on-flash-bbt;

            partitions {
                compatible = "fixed-partitions";
                #address-cells = <1>;
                #size-cells = <1>;

                partition@0 {
                    label = "u-boot";
                    reg = <0 0x040000>;
                };

                partition@40000 {
                    label = "kernel";
                    reg = <0x040000 0x500000>;
                };
            };
        };
    };
```

## Documentation/devicetree/bindings/mtd/st,spear600-fsmc-nand.yaml
```yaml
# SPDX-License-Identifier: (GPL-2.0-only OR BSD-2-Clause)
# Copyright 2018-2025 ST Microelectronics and contributors
%YAML 1.2
---
$id: http://devicetree.org/schemas/mtd/st,spear600-fsmc-nand.yaml#
$schema: http://devicetree.org/meta-schemas/core.yaml#

title: ST Microelectronics FSMC NAND Controller

maintainers:
  - Jean-Christophe PLAGNIOL-VILLARD <plagnioj@jcrosoft.com>
  - Kamal Dasu <kdasu.kdev@gmail.com>
  - Linus Walleij <linus.walleij@linaro.org>
  - Masanari Iida <standby24x7@gmail.com>
  - Mian Yousaf Kaukab <mian.yousaf.kaukab@stericsson.com>
  - Stefan Roese <sr@denx.de>

description: |
  ST Microelectronics Flexible Static Memory Controller (FSMC)
  NAND Interface

  Can support 1-bit HW ECC (default) or if stronger correction is required,
  software-based BCH.

allOf:
  - $ref: /schemas/mtd/nand-controller.yaml#

properties:
  compatible:
    description: Compatible strings for this controller.
    items:
      - enum:
          - st,spear600-fsmc-nand
          - stericsson,fsmc-nand

  reg:
    description: Address range of the NAND controller registers and NAND device.
    items:
      - description: FSMC register range.
      - description: NAND data range.
      - description: NAND address range.
      - description: NAND command range.

  reg-names:
    items:
      - const: fsmc_regs
      - const: nand_data
      - const: nand_addr
      - const: nand_cmd

  bank-width:
    description: Width (in bytes) of the device; defaults to 1.
    $ref: /schemas/types.yaml#/definitions/uint32
    default: 1

  nand-skip-bbtscan:
    description: Indicates that bad block table scanning should be skipped.
    type: boolean

  timings:
    description: >-
      NAND timing parameters in AHB clock cycles.
      Byte 0: TCLR (CLE to RE delay).
      Byte 1: TAR (ALE to RE delay).
      Byte 2: THIZ (bus tristate during write).
      Byte 3: THOLD (hold address and data after command deassertion).
      Byte 4: TWAIT (assert command duration).
      Byte 5: TSET (address setup before command).
    $ref: /schemas/types.yaml#/definitions/uint32-array
    items:
      - description: >-
          CLE to RE delay in number of AHB clock cycles; only 4 bits are valid
          (0=1 cycle, 15=16 cycles).
      - description: ALE to RE delay; only 4 bits valid; same format as TCLR.
      - description: >-
          Number of HCLK clock cycles during which the data bus is kept in Hi-Z
          after start of write access; 0=0 cycles, 255=255 cycles.
      - description: >-
          Number of HCLK clock cycles to hold address (and data when writing) after
          command deassertion; 0=1 cycle, 255=256 cycles.
      - description: >-
          Number of HCLK clock cycles to assert the command to the NAND flash in
          response to SMWAITn; 0=1 cycle, 255=256 cycles.
      - description: >-
          Number of HCLK clock cycles to assert the address before the command is
          asserted; 0=1 cycle, 255=256 cycles.

  bank:
    description: Default NAND bank to use.
    $ref: /schemas/types.yaml#/definitions/uint32
    enum:
      - 0
      - 1
      - 2
      - 3
    default: 0

additionalProperties: false

examples:
  - |
    fsmc: flash@d1800000 {
        compatible = "st,spear600-fsmc-nand";
        #address-cells = <1>;
        #size-cells = <1>;
        reg = <0xd1800000 0x1000   /* FSMC Register */
               0xd2000000 0x0010   /* NAND Base DATA */
               0xd2020000 0x0010   /* NAND Base ADDR */
               0xd2010000 0x0010>; /* NAND Base CMD */
        reg-names = "fsmc_regs", "nand_data", "nand_addr", "nand_cmd";
        bank-width = <1>;
        nand-skip-bbtscan;
        timings = /bits/ 8 <0 0 0 2 3 0>;
        bank = <1>;

        partition@0 {
            ...
        };
    };
```

## Documentation/devicetree/bindings/mtd/st,spear600-smi.yaml
```yaml
# SPDX-License-Identifier: (GPL-2.0-only OR BSD-2-Clause)
%YAML 1.2
---
$id: http://devicetree.org/schemas/mtd/st,spear600-smi.yaml#
$schema: http://devicetree.org/meta-schemas/core.yaml#

title: SPEAr SMI

maintainers:
  - Stefan Roese <sr@denx.de>

properties:
  compatible:
    items:
      - const: st,spear600-smi

  reg:
    maxItems: 1

  "#address-cells":
    const: 1
    description: Must be present if the device has sub-nodes representing partitions.

  "#size-cells":
    const: 1

  interrupts:
    maxItems: 1
    description: Should contain the STMMAC interrupts

  clock-rate:
    description: Functional clock rate of SMI in Hz
    $ref: /schemas/types.yaml#/definitions/uint32

  st,smi-fast-mode:
    description: Flash supports read in fast mode
    type: boolean

required:
  - compatible
  - reg
  - "#address-cells"
  - "#size-cells"
  - interrupts
  - clock-rate

additionalProperties: false

examples:
  - |
    smi: flash@fc000000 {
        compatible = "st,spear600-smi";
        #address-cells = <1>;
        #size-cells = <1>;
        reg = <0xfc000000 0x1000>;
        interrupts = <12>;
        clock-rate = <50000000>;    /* 50MHz */

        flash@f8000000 {
            st,smi-fast-mode;
        };
    };
```

## Documentation/devicetree/bindings/mtd/st,spi-fsm.yaml
```yaml
# SPDX-License-Identifier: (GPL-2.0-only OR BSD-2-Clause)
%YAML 1.2
---
$id: http://devicetree.org/schemas/mtd/st,spi-fsm.yaml#
$schema: http://devicetree.org/meta-schemas/core.yaml#

title: ST-Microelectronics SPI FSM Serial (NOR) Flash Controller

maintainers:
  - Lee Jones <lee@kernel.org>

properties:
  compatible:
    items:
      - const: st,spi-fsm

  reg:
    maxItems: 1
  reg-names:
    items:
      - const: spi-fsm

  interrupts:
    maxItems: 1

  st,syscfg:
    description: Phandle to boot-device system configuration registers.
    $ref: /schemas/types.yaml#/definitions/phandle

  st,boot-device-reg:
    description: Address of the boot-device register(s).
    $ref: /schemas/types.yaml#/definitions/uint32

  st,boot-device-spi:
    description: Expected boot-device value if booted via this device.
    $ref: /schemas/types.yaml#/definitions/uint32

required:
  - compatible
  - reg
  - reg-names
  - interrupts

additionalProperties: false

examples:
  - |
    spifsm: spifsm@fe902000 {
      compatible = "st,spi-fsm";
      reg = <0xfe902000 0x1000>;
      reg-names = "spi-fsm";
      interrupts = <5>;
      st,syscfg = <&syscfg_rear>;
      st,boot-device-reg = <0x958>;
      st,boot-device-spi = <0x1a>;
    };
```

## Documentation/devicetree/bindings/mux/adi,adg792a.yaml
```yaml
# SPDX-License-Identifier: (GPL-2.0-only OR BSD-2-Clause)
# Copyright 2025 Axentia Ltd.
%YAML 1.2
---
$id: http://devicetree.org/schemas/mux/adi,adg792a.yaml#
$schema: http://devicetree.org/meta-schemas/core.yaml#

title: Analog Devices ADG792A/G Triple 4:1 Multiplexers

maintainers:
  - Peter Rosin <peda@axentia.se>
  - Rob Herring <robh@kernel.org>

description: |
  Bindings for Analog Devices ADG792A/G Triple 4:1 Multiplexers

  States 0 through 3 correspond to signals A through D in the datasheet.

properties:
  compatible:
    description: Device compatible string.
    oneOf:
      - items:
          - enum: [adi, adg792a]
      - items:
          - enum: [adi, adg792g]

  reg:
    description: |
      I2C bus address of the device.
    items:
      - description: I2C slave address (7-bit).

  '#mux-control-cells':
    description: |
      Number of control cells: 0 if parallel (single mux controller for all three muxes),
      or 1 if independent (one mux controller per mux).
    enum: [0, 1]

  gpio-controller: true
  # GPIO controller, required for ADG792G.

  '#gpio-cells':
    description: >
      Number of GPIO cells (should be 2). First cell is the GPO line number (0 or 1);
      second cell specifies active high (0) or active low (1).
    const: 2

  idle-state:
    description: |
      Array of idle states for the multiplexers.
      The default state is MUX_IDLE_AS_IS, and MUX_IDLE_DISCONNECT will disconnect the channel.
      Numeric values 0–3 correspond to signals A–D in the datasheet.
    items:
      oneOf:
        - enum: [MUX_IDLE_DISCONNECT, MUX_IDLE_AS_IS]
        - enum: [0, 1, 2, 3]

dependencies:
  gpio-controller: ['#gpio-cells']

required:
  - compatible
  - reg
  - '#mux-control-cells'

additionalProperties: false

examples:
  - |
    /* Three independent mux controllers (of which one is used).
     * Mux 0 is disconnected when idle, mux 1 idles in the previously
     * selected state and mux 2 idles with signal B.
     */
    &i2c0 {
      mux: mux-controller@50 {
        compatible = "adi,adg792a";
        reg = <0x50>;
        #mux-control-cells = <1>;
        idle-state = <MUX_IDLE_DISCONNECT MUX_IDLE_AS_IS 1>;
      };
    };

    /* Three parallel muxes with one mux controller, useful e.g. if
     * the adc is differential, thus needing two signals to be muxed
     * simultaneously for correct operation.
     */
    &i2c0 {
      pmux: mux-controller@50 {
        compatible = "adi,adg792a";
        reg = <0x50>;
        #mux-control-cells = <0>;
        idle-state = <1>;
      };
    };
```
