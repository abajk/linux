## Documentation/devicetree/bindings/mtd/fsl,upm-nand.yaml
```yaml
# SPDX-License-Identifier: (GPL-2.0-only OR BSD-2-Clause)
%YAML 1.2
---
$id: http://devicetree.org/schemas/mtd/fsl,upm-nand.yaml#
$schema: http://devicetree.org/meta-schemas/core.yaml#

title: Freescale Localbus UPM NAND flash

maintainers:
  - Boris Brezillon <boris.brezillon@collabora.com>
  - Grant Likely <grant.likely@secretlab.ca>
  - Jamie Lentin <jm@lentin.co.uk>
  - Lucas De Marchi <lucas.demarchi@profusion.mobi>
  - Nayab Sayed <nayabbasha.sayed@microchip.com>

description: |
  Freescale Localbus UPM programmed to work with NAND flash

properties:
  compatible:
    description: List of compatible strings for the Freescale Localbus UPM NAND flash controller
    oneOf:
      - items:
          - const: fsl,upm-nand
      - items:
          - const: tqc,tqm8548-upm-nand
          - const: fsl,upm-nand

  reg:
    description: Register specifier for the UPM chip select and size used for the NAND chip
    items:
      - description: UPM localbus chip select number
      - description: Size of the NAND chip in bytes

  fsl,upm-addr-offset:
    description: UPM pattern offset for the address latch
    $ref: /schemas/types.yaml#/definitions/uint32

  fsl,upm-cmd-offset:
    description: UPM pattern offset for the command latch
    $ref: /schemas/types.yaml#/definitions/uint32

  fsl,upm-addr-line-cs-offsets:
    description: Address offsets for multi-chip support; selects chips via address line offsets
    $ref: /schemas/types.yaml#/definitions/uint32-array

  gpios:
    description: GPIO phandle-array for Ready-Not-Busy pins; one entry per chip
    $ref: /schemas/types.yaml#/definitions/phandle-array

  fsl,upm-wait-flags:
    description: Deprecated. Chip-dependent short delays after UPM operations
    $ref: /schemas/types.yaml#/definitions/uint32

  chip-delay:
    description: Deprecated. Chip-dependent delay for transferring data from array to read registers (tR)
    $ref: /schemas/types.yaml#/definitions/uint32

additionalProperties: false

examples:
  - |
    upm@1,0 {
        compatible = "fsl,upm-nand";
        reg = <1 0 1>;
        fsl,upm-addr-offset = <16>;
        fsl,upm-cmd-offset = <8>;
        gpios = <&qe_pio_e 18 0>;

        flash {
            #address-cells = <1>;
            #size-cells = <1>;
            compatible = "...";

            partition@0 {
                ...
            };
        };
    };
  - |
    upm@3,0 {
        #address-cells = <0>;
        #size-cells = <0>;
        compatible = "tqc,tqm8548-upm-nand", "fsl,upm-nand";
        reg = <3 0x0 0x800>;
        fsl,upm-addr-offset = <0x10>;
        fsl,upm-cmd-offset = <0x08>;
        /* Multi-chip NAND device */
        fsl,upm-addr-line-cs-offsets = <0x0 0x200>;

        nand@0 {
            #address-cells = <1>;
            #size-cells = <1>;

            partition@0 {
                label = "fs";
                reg = <0x00000000 0x10000000>;
            };
        };
    };
```

## Documentation/devicetree/bindings/mtd/gpio-control-nand.yaml
```yaml
# SPDX-License-Identifier: (GPL-2.0-only OR BSD-2-Clause)
%YAML 1.2
---
$id: http://devicetree.org/schemas/mtd/gpio-control-nand.yaml#
$schema: http://devicetree.org/meta-schemas/core.yaml#

title: GPIO Assisted NAND flash

maintainers:
  - Christophe Leroy <christophe.leroy@c-s.fr>
  - Gerhard Sittig <gsi@denx.de>
  - Jamie Iles <jamie@jamieiles.com>
  - Jamie Lentin <jm@lentin.co.uk>
  - Nayab Sayed <nayabbasha.sayed@microchip.com>

description: |
  GPIO assisted NAND flash

  The GPIO assisted NAND flash uses a memory mapped interface to
  read/write the NAND commands and data and GPIO pins for the control
  signals.

  The device tree may optionally contain sub-nodes describing partitions of the
  address space. See mtd.yaml for more detail.

properties:
  compatible:
    const: gpio-control-nand

  "#address-cells":
    description: Number of address cells for partition sub-nodes.
    $ref: /schemas/types.yaml#/definitions/uint32

  "#size-cells":
    description: Number of size cells for partition sub-nodes.
    $ref: /schemas/types.yaml#/definitions/uint32

  reg:
    description: Localbus chip select and size used for the chip.
    items:
      - description: localbus chip select
      - description: size

  gpios:
    description: |
      GPIO pins to control the NAND device. Order: RDY, nCE (optional), ALE, CLE, nWP (optional).
    minItems: 3
    maxItems: 5

  bank-width:
    description: Width (in bytes) of the device.
    $ref: /schemas/types.yaml#/definitions/uint32
    default: 1

  chip-delay:
    description: Chip dependent delay for transferring data from array to read registers (tR).
    $ref: /schemas/types.yaml#/definitions/uint32
    default: 20

  gpio-control-nand,io-sync-reg:
    description: 64-bit physical address for I/O sync register to guard against bus reordering.
    $ref: /schemas/types.yaml#/definitions/uint64


required:
  - compatible
  - reg
  - gpios

additionalProperties: false

examples:
  - |
    gpio-nand@1,0 {
      compatible = "gpio-control-nand";
      #address-cells = <1>;
      #size-cells = <1>;
      reg = <1 0x0000 0x2>;
      gpios = <&banka 1 0>,   /* RDY */
          <0>,        /* nCE */
          <&banka 3 0>,   /* ALE */
          <&banka 4 0>,   /* CLE */
          <0>;        /* nWP */

      partition@0 {
      };
    };
```

## Documentation/devicetree/bindings/mtd/hisilicon,504-nfc.yaml
```yaml
# SPDX-License-Identifier: (GPL-2.0-only OR BSD-2-Clause)
# Copyright 2025 Hisilicon Ltd.
%YAML 1.2
---
$id: http://devicetree.org/schemas/mtd/hisilicon,504-nfc.yaml#
$schema: http://devicetree.org/meta-schemas/core.yaml#

title: Hisilicon Hip04 Soc NAND controller

maintainers:
  - Kamal Dasu <kdasu.kdev@gmail.com>
  - Nayab Sayed <nayabbasha.sayed@microchip.com>
  - Zhou Wang <wangzhou1@hisilicon.com>

description: |
  Hisilicon Hip04 Soc NAND controller DT binding

  Flash chip may optionally contain additional sub-nodes describing partitions of
  the address space. See mtd.yaml for more detail.

properties:
  compatible:
    items:
      - const: hisilicon,504-nfc

  reg:
    items:
      - description: NAND controller registers
      - description: NAND controller buffer

  interrupts:
    maxItems: 1

  nand-bus-width:
    description: NAND bus width in bits
    $ref: /schemas/types.yaml#/definitions/uint32

  nand-ecc-mode:
    description: NAND ECC mode
    $ref: /schemas/types.yaml#/definitions/string
    enum:
      - none
      - hw

  nand-ecc-strength:
    description: Number of bits to correct per ECC step
    $ref: /schemas/types.yaml#/definitions/uint32

  nand-ecc-step-size:
    description: Number of data bytes covered by a single ECC step
    $ref: /schemas/types.yaml#/definitions/uint32

  '#address-cells':
    description: Partition address cell count
    const: 1

  '#size-cells':
    description: Partition size cell count
    const: 1

required:
  - compatible
  - reg
  - interrupts
  - nand-bus-width
  - nand-ecc-mode
  - '#address-cells'
  - '#size-cells'

additionalProperties: false

examples:
  - |
    nand: nand@4020000 {
        compatible = "hisilicon,504-nfc";
        reg = <0x4020000 0x10000>, <0x5000000 0x1000>;
        interrupts = <0 379 4>;
        nand-bus-width = <8>;
        nand-ecc-mode = "hw";
        nand-ecc-strength = <16>;
        nand-ecc-step-size = <1024>;
        #address-cells = <1>;
        #size-cells = <1>;

        partition@0 {
            label = "nand_text";
            reg = <0x00000000 0x00400000>;
        };

        ...
    };
```

## Documentation/devicetree/bindings/mtd/hisilicon,fmc-spi-nor.yaml
```yaml
# SPDX-License-Identifier: (GPL-2.0-only OR BSD-2-Clause)
%YAML 1.2
---
$id: http://devicetree.org/schemas/mtd/hisilicon,fmc-spi-nor.yaml#
$schema: http://devicetree.org/meta-schemas/core.yaml#

title: HiSilicon SPI-NOR Flash Controller

maintainers:
  - Jiancheng Xue <xuejiancheng@hisilicon.com>
  - Krzysztof Kozlowski <krzysztof.kozlowski@linaro.org>

description: |
  HiSilicon SPI-NOR Flash Controller

properties:
  compatible:
    items:
      - const: hisilicon,hi3519-spi-nor
      - const: hisilicon,fmc-spi-nor
    description: HiSilicon SPI-NOR controller compatible strings.

  "#address-cells":
    const: 1
    description: Number of address cells expected by the controller.

  "#size-cells":
    const: 0
    description: Number of size cells expected by the controller.

  reg:
    items:
      - description: Offset of the register set.
      - description: Length of the register set.
    description: Register offset and size for the controller.

  reg-names:
    items:
      - const: control
      - const: memory
    description: Names of each register entry.

  clocks:
    maxItems: 1
    description: Handle to the SPI-NOR flash controller clock.

required:
  - compatible
  - "#address-cells"
  - "#size-cells"
  - reg

additionalProperties: false

examples:
  - |
    spi-nor-controller@10000000 {
      compatible = "hisilicon,hi3519-spi-nor", "hisilicon,fmc-spi-nor";
      #address-cells = <1>;
      #size-cells = <0>;
      reg = <0x10000000 0x1000>, <0x14000000 0x1000000>;
      reg-names = "control", "memory";
      clocks = <&clock HI3519_FMC_CLK>;
      flash@0 {
        compatible = "jedec,spi-nor";
        reg = <0>;
      };
    };
```

## Documentation/devicetree/bindings/mtd/ibm,ndfc.yaml
```yaml
# SPDX-License-Identifier: (GPL-2.0-only OR BSD-2-Clause)
# Copyright 2018 Linaro Ltd.
%YAML 1.2
---
$id: http://devicetree.org/schemas/ibm,ndfc.yaml#
$schema: http://devicetree.org/meta-schemas/core.yaml#

title: AMCC NDFC (NanD Flash Controller)

maintainers:
  - Rob Herring <robh@kernel.org>

description: |
  AMCC NDFC (NanD Flash Controller)

  Notes:
  - partition(s) - follows the OF MTD standard for partitions

properties:
  compatible:
    const: ibm,ndfc

  reg:
    description: specify chip select and size used for the chip
    items:
      - description: chip select
      - description: size of the chip

  ccr:
    description: NDFC config and control register value
    $ref: /schemas/types.yaml#/definitions/uint32
    default: 0

  bank-settings:
    description: NDFC bank configuration register value
    $ref: /schemas/types.yaml#/definitions/uint32
    default: 0

  "#address-cells":
    description: number of address cells for child nodes
    const: 1

  "#size-cells":
    description: number of size cells for child nodes
    const: 1

  nand:
    description: NAND flash subnode
    type: object
    additionalProperties: false
    properties:
      "#address-cells":
        description: number of address cells for partitions
        const: 1
      "#size-cells":
        description: number of size cells for partitions
        const: 1
    patternProperties:
      "^partition@.*":
        description: MTD partition child nodes
        type: object
        additionalProperties: false
        properties:
          label:
            description: partition label
            $ref: /schemas/types.yaml#/definitions/string
          reg:
            description: partition offset and size
            items:
              - description: offset address
              - description: size of partition
        required:
          - label
          - reg

required:
  - compatible
  - reg

additionalProperties: false

examples:
  - |
    ndfc@1,0 {
        compatible = "ibm,ndfc";
        reg = <0x00000001 0x00000000 0x00002000>;
        ccr = <0x00001000>;
        bank-settings = <0x80002222>;
        #address-cells = <1>;
        #size-cells = <1>;
        nand {
            #address-cells = <1>;
            #size-cells = <1>;
            partition@0 {
                label = "kernel";
                reg = <0x00000000 0x00200000>;
            };
            partition@200000 {
                label = "root";
                reg = <0x00200000 0x03E00000>;
            };
        };
    };
```

## Documentation/devicetree/bindings/mtd/m-systems,diskonchip-g3.yaml
```yaml
# SPDX-License-Identifier: (GPL-2.0-only OR BSD-2-Clause)
%YAML 1.2
---
$id: http://devicetree.org/schemas/m-systems,diskonchip-g3.yaml#
$schema: http://devicetree.org/meta-schemas/core.yaml#

title: Sandisk/M-Systems DiskOnChip G3

maintainers:
  - Robert Jarzmik <robert.jarzmik@free.fr>

description: |
  M-Systems and Sandisk DiskOnChip devices

  The Sandisk (formerly M-Systems) docg3 is a nand device of 64M to 256MB.

properties:
  compatible:
    items:
      - enum:
          - m-systems,diskonchip-g3

  reg:
    items:
      - description: register base address
      - description: register size

required:
  - compatible
  - reg

additionalProperties: false

examples:
  - |
    docg3: flash@0 {
        compatible = "m-systems,diskonchip-g3";
        reg = <0x0 0x2000>;
    };
```

## Documentation/devicetree/bindings/mtd/marvell,orion-nand.yaml
```yaml
# SPDX-License-Identifier: (GPL-2.0-only OR BSD-2-Clause)
%YAML 1.2
---
$id: http://devicetree.org/schemas/mtd/marvell,orion-nand.yaml#
$schema: http://devicetree.org/meta-schemas/core.yaml#

title: NAND support for Marvell Orion SoC platforms

maintainers:
  - Andrew Lunn <andrew@lunn.ch>
  - Jamie Lentin <jm@lentin.co.uk>
  - Nayab Sayed <nayabbasha.sayed@microchip.com>

description: |
  NAND support for Marvell Orion SoC platforms

  The device tree may optionally contain sub-nodes describing partitions of the
  address space. See mtd.yaml for more detail.

properties:
  compatible:
    items:
      - const: marvell,orion-nand

  reg:
    items:
      - description: Base physical address of the NAND
      - description: Length of memory mapped region

  cle:
    description: Address line number connected to CLE
    $ref: /schemas/types.yaml#/definitions/uint32
    default: 0

  ale:
    description: Address line number connected to ALE
    $ref: /schemas/types.yaml#/definitions/uint32
    default: 1

  bank-width:
    description: Width in bytes of the device
    $ref: /schemas/types.yaml#/definitions/uint32
    default: 1

  chip-delay:
    description: Chip dependent delay for transferring data from array to read registers in microseconds
    $ref: /schemas/types.yaml#/definitions/uint32

required:
  - compatible
  - reg

additionalProperties: false

examples:
  - |
    nand@f4000000 {
        #address-cells = <1>;
        #size-cells = <1>;
        cle = <0>;
        ale = <1>;
        bank-width = <1>;
        chip-delay = <25>;
        compatible = "marvell,orion-nand";
        reg = <0xf4000000 0x400>;

        partition@0 {
            label = "u-boot";
            reg = <0x0000000 0x100000>;
            read-only;
        };

        partition@100000 {
            label = "uImage";
            reg = <0x0100000 0x200000>;
        };

        partition@300000 {
            label = "dtb";
            reg = <0x0300000 0x100000>;
        };

        partition@400000 {
            label = "root";
            reg = <0x0400000 0x7d00000>;
        };
    };
```
