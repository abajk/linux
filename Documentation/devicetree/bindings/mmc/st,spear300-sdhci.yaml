## Documentation/devicetree/bindings/mtd/microchip,mchp23k256.yaml
```yaml
%YAML 1.2
---
$id: http://devicetree.org/schemas/mtd/microchip,mchp23k256.yaml#
$schema: http://devicetree.org/meta-schemas/core.yaml#

title: Microchip 23K256 serial SRAM

maintainers:
  - Chris Packham <chris.packham@alliedtelesis.co.nz>

description: |
  MTD SPI driver for Microchip 23K256 (and similar) serial SRAM

properties:
  compatible:
    description: Supported compatible strings for this device.
    items:
      - enum:
          - microchip,mchp23k256
          - microchip,mchp23lcv1024

  reg:
    description: Chip-select number
    items:
      - description: Chip-select number

  '#address-cells':
    description: Must be present if the device has sub-nodes representing partitions.

  '#size-cells':
    description: Must be present if the device has sub-nodes representing partitions.

  spi-max-frequency:
    description: Maximum frequency of the SPI bus the chip can operate at

required:
  - compatible
  - reg

additionalProperties: false

examples:
  - |
    spi-sram@0 {
        #address-cells = <1>;
        #size-cells = <1>;
        compatible = "microchip,mchp23k256";
        reg = <0>;
        spi-max-frequency = <20000000>;
    };
```

## Documentation/devicetree/bindings/mtd/mxic,multi-itfc-v009-nand-controller.yaml
```yaml
# SPDX-License-Identifier: (GPL-2.0-only OR BSD-2-Clause)
# Copyright 2025 Mason Yang <masonccyang@mxic.com.tw>

%YAML 1.2
---
$id: http://devicetree.org/schemas/mtd/mxic,multi-itfc-v009-nand-controller.yaml#
$schema: http://devicetree.org/meta-schemas/core.yaml#

title: Macronix Raw NAND Controller
maintainers:
  - Mason Yang <masonccyang@mxic.com.tw>

description: |
  Macronix Raw NAND Controller Device Tree Bindings
  -------------------------------------------------

  Children nodes represent the available NAND chips.

  See Documentation/devicetree/bindings/mtd/nand-controller.yaml for more
  details on generic bindings.

properties:
  compatible:
    items:
      - const: mxic,multi-itfc-v009-nand-controller

  reg:
    items:
      - description: Controller registers

  '#address-cells':
    const: 1

  '#size-cells':
    const: 0

  interrupts:
    items:
      - description: Interrupt line connected to this raw NAND controller

  clocks:
    items:
      - description: ps clock
      - description: send clock
      - description: send_dly clock

  clock-names:
    items:
      - const: ps
      - const: send
      - const: send_dly

patternProperties:
  '^nand@.*$':
    type: object
    description: NAND chip subnode
    properties:
      reg:
        items:
          - description: NAND chip select
      nand-ecc-mode:
        description: NAND error correction mode
        $ref: /schemas/types.yaml#/definitions/string
      nand-ecc-algo:
        description: NAND error correction algorithm
        $ref: /schemas/types.yaml#/definitions/string
    required:
      - reg
      - nand-ecc-mode
      - nand-ecc-algo
    additionalProperties: false

required:
  - compatible
  - reg
  - '#address-cells'
  - '#size-cells'
  - interrupts
  - clocks
  - clock-names

additionalProperties: false

examples:
  - |
    nand: nand-controller@43c30000 {
        compatible = "mxic,multi-itfc-v009-nand-controller";
        reg = <0x43c30000 0x10000>;
        #address-cells = <1>;
        #size-cells = <0>;
        interrupts = <GIC_SPI 0x1d IRQ_TYPE_EDGE_RISING>;
        clocks = <&clkwizard 0>, <&clkwizard 1>, <&clkc 15>;
        clock-names = "send", "send_dly", "ps";

        nand@0 {
            reg = <0>;
            nand-ecc-mode = "soft";
            nand-ecc-algo = "bch";
        };
    };
```

## Documentation/devicetree/bindings/mtd/nvidia-tegra20-nand.yaml
```yaml
# SPDX-License-Identifier: (GPL-2.0-only OR BSD-2-Clause)
%YAML 1.2
---
$id: http://devicetree.org/schemas/mtd/nvidia-tegra20-nand.yaml#
$schema: http://devicetree.org/meta-schemas/core.yaml#

title: NVIDIA Tegra NAND Flash controller

maintainers:
  - Kamal Dasu <kdasu.kdev@gmail.com>
  - Nayab Sayed <nayabbasha.sayed@microchip.com>
  - Stefan Agner <stefan@agner.ch>

description: |
  NVIDIA Tegra NAND Flash controller

  Optional children nodes:
  Individual NAND chips are children of the NAND controller node. Currently
  only one NAND chip supported.

  Optional child node of NAND chip nodes:
  Partitions: see mtd.yaml

properties:
  compatible:
    items:
      - const: nvidia,tegra20-nand

  reg:
    description: MMIO address range for the NAND controller
    items:
      - description: base address and size of controller registers

  interrupts:
    description: interrupt output of the NFC controller
    items:
      - description: interrupt specifier

  clocks:
    description: NFC controller clock
    maxItems: 1

  clock-names:
    items:
      - const: nand

  resets:
    description: NFC controller reset
    items:
      - description: reset specifier

  reset-names:
    items:
      - const: nand

additionalProperties: false

patternProperties:
  "^nand@\\d+$":
    type: object
    description: Individual NAND chip instance
    properties:
      reg:
        description: chip-select line index (0–5)
        items:
          - description: CS line number
      "#address-cells":
        const: 1
      "#size-cells":
        const: 1
      nand-bus-width:
        description: NAND data bus width in bits
        items:
          - enum: [8]
      nand-on-flash-bbt:
        description: enable on-flash bad block table
        type: boolean
      nand-ecc-mode:
        description: operation mode of the NAND ECC
        items:
          - enum: [hw]
      nand-ecc-algo:
        description: algorithm used by the NAND ECC
        items:
          - enum: [rs, bch]
      nand-ecc-strength:
        description: number of bits corrected per ECC step
        items:
          - enum: [4, 6, 8, 14, 16]
      nand-ecc-maximize:
        description: maximize ECC strength when possible
        type: boolean
      nand-is-boot-medium:
        description: restrict ECC strengths to boot-ROM-supported values
        type: boolean
      wp-gpios:
        description: GPIO specifier for the write-protect pin
        maxItems: 1
    required:
      - reg
    additionalProperties: true

examples:
  - |
    nand-controller@70008000 {
        compatible = "nvidia,tegra20-nand";
        reg = <0x70008000 0x100>;
        interrupts = <GIC_SPI 24 IRQ_TYPE_LEVEL_HIGH>;
        clocks = <&tegra_car TEGRA20_CLK_NDFLASH>;
        clock-names = "nand";
        resets = <&tegra_car 13>;
        reset-names = "nand";

        nand@0 {
            reg = <0>;
            #address-cells = <1>;
            #size-cells = <1>;
            nand-bus-width = <8>;
            nand-on-flash-bbt;
            nand-ecc-algo = "bch";
            nand-ecc-strength = <8>;
            wp-gpios = <&gpio TEGRA_GPIO(S, 0) GPIO_ACTIVE_LOW>;
        };
    };
```

## Documentation/devicetree/bindings/mtd/nxp,lpc3220-mlc.yaml
```yaml
# SPDX-License-Identifier: (GPL-2.0-only OR BSD-2-Clause)
# Copyright 2025 Bootlin
%YAML 1.2
---
$id: http://devicetree.org/schemas/mtd/nxp,lpc3220-mlc.yaml#
$schema: http://devicetree.org/meta-schemas/core.yaml#

title: NXP LPC32xx SoC NAND MLC controller

maintainers:
  - Miquel Raynal <miquel.raynal@bootlin.com>
  - Rob Herring <robh@kernel.org>
  - Roland Stigge <stigge@antcom.de>

description: |
  NXP LPC32xx SoC NAND MLC controller

  The following required properties are very controller specific. See the LPC32xx
  User Manual 7.5.14 MLC NAND Timing Register (the values here are specified in
  Hz, to make them independent of actual clock speed and to provide for good
  accuracy:)

properties:
  compatible:
    enum:
      - nxp,lpc3220-mlc

  reg:
    items:
      - description: Address and size of the controller

  interrupts:
    items:
      - description: NAND interrupt specification

  '#address-cells':
    description: Number of address cells for child partitions
    const: 1

  '#size-cells':
    description: Number of size cells for child partitions
    const: 1

  nxp,tcea-delay:
    description: TCEA_DELAY timing parameter in Hz
    $ref: /schemas/types.yaml#/definitions/uint32

  nxp,busy-delay:
    description: BUSY_DELAY timing parameter in Hz
    $ref: /schemas/types.yaml#/definitions/uint32

  nxp,nand-ta:
    description: NAND_TA timing parameter in Hz
    $ref: /schemas/types.yaml#/definitions/uint32

  nxp,rd-high:
    description: RD_HIGH timing parameter in Hz
    $ref: /schemas/types.yaml#/definitions/uint32

  nxp,rd-low:
    description: RD_LOW timing parameter in Hz
    $ref: /schemas/types.yaml#/definitions/uint32

  nxp,wr-high:
    description: WR_HIGH timing parameter in Hz
    $ref: /schemas/types.yaml#/definitions/uint32

  nxp,wr-low:
    description: WR_LOW timing parameter in Hz
    $ref: /schemas/types.yaml#/definitions/uint32

  gpios:
    description: GPIO specification for NAND write protect
    $ref: /schemas/types.yaml#/definitions/phandle-array

patternProperties:
  '^mtd[0-9]+@[^ ]+$':
    description: Partition subnode
    $ref: /schemas/mtd/mtd.yaml

additionalProperties: false

required:
  - compatible
  - reg
  - interrupts
  - gpios

examples:
  - |
    mlc: flash@200a8000 {
        compatible = "nxp,lpc3220-mlc";
        reg = <0x200A8000 0x11000>;
        interrupts = <11 0>;
        #address-cells = <1>;
        #size-cells = <1>;

        nxp,tcea-delay = <333333333>;
        nxp,busy-delay = <10000000>;
        nxp,nand-ta = <18181818>;
        nxp,rd-high = <31250000>;
        nxp,rd-low = <45454545>;
        nxp,wr-high = <40000000>;
        nxp,wr-low = <83333333>;
        gpios = <&gpio 5 19 1>; /* GPO_P3 19, active low */

        mtd0@00000000 {
            label = "boot";
            reg = <0x00000000 0x00064000>;
            read-only;
        };

        ...
    };
```

## Documentation/devicetree/bindings/mtd/nxp,lpc3220-slc.yaml
```yaml
# SPDX-License-Identifier: (GPL-2.0-only OR BSD-2-Clause)
%YAML 1.2
---
$id: http://devicetree.org/schemas/mtd/nxp,lpc3220-slc.yaml#
$schema: http://devicetree.org/meta-schemas/core.yaml#

title: NXP LPC32xx SoC NAND SLC controller

maintainers:
  - Miquel Raynal <miquel.raynal@bootlin.com>
  - Roland Stigge <stigge@antcom.de>

description: |
  NXP LPC32xx SoC NAND SLC controller

  The following required properties are very controller specific. See the LPC32xx
  User Manual:

  (The following values are specified in Hz, to make them independent of actual
  clock speed:)

  Optional subnodes: Partitions, see Documentation/devicetree/bindings/mtd/mtd.yaml

properties:
  compatible:
    const: "nxp,lpc3220-slc"

  reg:
    description: Controller base address and size.

  nand-on-flash-bbt:
    description: Use bad block table on flash.
    type: boolean

  gpios:
    description: GPIO specification for NAND write protect.
    $ref: /schemas/types.yaml#/definitions/phandle-array

  nxp,wdr-clks:
    description: Delay before Ready signal is tested on write (W_RDY).
    $ref: /schemas/types.yaml#/definitions/uint32

  nxp,rdr-clks:
    description: Delay before Ready signal is tested on read (R_RDY).
    $ref: /schemas/types.yaml#/definitions/uint32

  nxp,wwidth:
    description: Write pulse width (W_WIDTH) in Hz.
    $ref: /schemas/types.yaml#/definitions/uint32

  nxp,whold:
    description: Write hold time (W_HOLD) in Hz.
    $ref: /schemas/types.yaml#/definitions/uint32

  nxp,wsetup:
    description: Write setup time (W_SETUP) in Hz.
    $ref: /schemas/types.yaml#/definitions/uint32

  nxp,rwidth:
    description: Read pulse width (R_WIDTH) in Hz.
    $ref: /schemas/types.yaml#/definitions/uint32

  nxp,rhold:
    description: Read hold time (R_HOLD) in Hz.
    $ref: /schemas/types.yaml#/definitions/uint32

  nxp,rsetup:
    description: Read setup time (R_SETUP) in Hz.
    $ref: /schemas/types.yaml#/definitions/uint32

additionalProperties: false

examples:
  - |
    slc: flash@20020000 {
      compatible = "nxp,lpc3220-slc";
      reg = <0x20020000 0x1000>;
      #address-cells = <1>;
      #size-cells = <1>;

      nxp,wdr-clks = <14>;
      nxp,wwidth = <40000000>;
      nxp,whold = <100000000>;
      nxp,wsetup = <100000000>;
      nxp,rdr-clks = <14>;
      nxp,rwidth = <40000000>;
      nxp,rhold = <66666666>;
      nxp,rsetup = <100000000>;
      nand-on-flash-bbt;
      gpios = <&gpio 5 19 1>; /* GPO_P3 19, active low */

      mtd0@00000000 {
        label = "phy3250-boot";
        reg = <0x00000000 0x00064000>;
        read-only;
      };
    };
```

## Documentation/devicetree/bindings/mtd/partitions/brcm,bcm963xx-cfe-nor-partitions.yaml
```yaml
---
$id: http://devicetree.org/schemas/mtd/partitions/brcm,bcm963xx-cfe-nor-partitions.yaml#
$schema: http://devicetree.org/meta-schemas/core.yaml#

title: Broadcom BCM963XX CFE Loader NOR Flash Partitions

maintainers:
  - Jonas Gorski <jonas.gorski@gmail.com>

description: |
  Most Broadcom BCM63XX SoC based devices follow the Broadcom reference layout for
  NOR. The first erase block used for the CFE bootloader, the last for an
  NVRAM partition, and the remainder in-between for one to two firmware partitions
  at fixed offsets. A valid firmware partition is identified by the ImageTag
  header found at beginning of the second erase block, containing the rootfs and
  kernel offsets and sizes within the firmware partition.

properties:
  compatible:
    items:
      - const: brcm,bcm963xx-cfe-nor-partitions

required:
  - compatible

additionalProperties: false

examples:
  - |
    flash@1fc00000 {
        compatible = "cfi-flash";
        reg = <0x1fc00000 0x400000>;
        bank-width = <2>;

        partitions {
            compatible = "brcm,bcm963xx-cfe-nor-partitions";
        };
    };
```

## Documentation/devicetree/bindings/mtd/partitions/brcm,bcm963xx-imagetag.yaml
```yaml
# SPDX-License-Identifier: (GPL-2.0-only OR BSD-2-Clause)
# Copyright 2025 Jonas Gorski
%YAML 1.2
---
$id: http://devicetree.org/schemas/mtd/partitions/brcm,bcm963xx-imagetag.yaml#
$schema: http://devicetree.org/meta-schemas/core.yaml#

title: Broadcom BCM963XX ImageTag Partition Container

maintainers:
  - Jonas Gorski <jonas.gorski@gmail.com>

description: |
  Broadcom BCM963XX ImageTag Partition Container

  Some Broadcom BCM63XX SoC based devices contain additional, non
  discoverable partitions or non standard bootloader partition sizes. For
  these a mixed layout needs to be used with an explicit firmware partition.

  The BCM963XX ImageTag is a simple firmware header describing the offsets
  and sizes of the rootfs and kernel parts contained in the firmware.

properties:
  compatible:
    items:
      - const: brcm,bcm963xx-imagetag

  reg:
    description: Partition offset and size of the image tag header.
    items:
      - description: Offset of the image tag header relative to the parent.
      - description: Length of the image tag header.

required:
  - compatible
  - reg

additionalProperties: false

examples:
  - |
    flash@1e000000 {
        compatible = "cfi-flash";
        reg = <0x1e000000 0x2000000>;
        bank-width = <2>;

        partitions {
            compatible = "fixed-partitions";
            #address-cells = <1>;
            #size-cells = <1>;

            cfe@0 {
                reg = <0x0 0x10000>;
                read-only;
            };

            firmware@10000 {
                reg = <0x10000 0x7d0000>;
                compatible = "brcm,bcm963xx-imagetag";
            };

            caldata@7e0000 {
                reg = <0x7e0000 0x10000>;
                read-only;
            };

            nvram@7f0000 {
                reg = <0x7f0000 0x10000>;
            };
        };
    };
```
