## Documentation/devicetree/bindings/mmc/st,spear300-sdhci.yaml
```yaml
# SPDX-License-Identifier: (GPL-2.0-only OR BSD-2-Clause)
%YAML 1.2
---
$id: http://devicetree.org/schemas/mmc/st,spear300-sdhci.yaml#
$schema: http://devicetree.org/meta-schemas/core.yaml#

title: SPEAr SDHCI Controller

maintainers:
  - Viresh Kumar <viresh.kumar@linaro.org>

properties:
  compatible:
    items:
      - const: st,spear300-sdhci

  reg:
    items:
      - description: Register block for the SPEAr SDHCI controller

required:
  - compatible

additionalProperties: false

examples:
  - |
    sdhci@fc000000 {
        compatible = "st,spear300-sdhci";
        reg = <0xfc000000 0x1000>;
        cd-gpios = <&gpio0 6 0>;
    };
```

## Documentation/devicetree/bindings/mmc/ti,da830-mmc.yaml
```yaml
# SPDX-License-Identifier: (GPL-2.0-only OR BSD-2-Clause)
%YAML 1.2
---
$id: http://devicetree.org/schemas/mmc/ti,da830-mmc.yaml#
$schema: http://devicetree.org/meta-schemas/core.yaml#

title: TI DaVinci MMC Host Controller
maintainers:
  - Manjunathappa, Prakash <prakash.pm@ti.com>
  - Rob Herring <robh@kernel.org>

description: |
  * TI Highspeed MMC host controller for DaVinci

  The Highspeed MMC Host Controller on TI DaVinci family
  provides an interface for MMC, SD and SDIO types of memory cards.

  This file documents the properties used by the davinci_mmc driver.

properties:
  compatible:
    description: Hardware compatibility string.
    items:
      - enum:
          - ti,da830-mmc
          - ti,dm355-mmc

  reg:
    description: Register base address and size.
    items:
      - description: Base address
      - description: Size of register region

  interrupts:
    description: Interrupt line for the MMC host controller.
    items:
      - description: Interrupt

  bus-width:
    description: Number of data lines.
    items:
      - enum: [1, 4, 8]
    default: 1

  max-frequency:
    description: Maximum operating clock frequency.
    items:
      - description: Frequency in Hz
    default: 25000000

  dmas:
    description: >
      List of DMA specifiers with the controller specific format.
      A tx and rx specifier is required.
    items:
      $ref: /schemas/types.yaml#/definitions/phandle-array
    minItems: 2
    maxItems: 2

  dma-names:
    description: RX and TX DMA request names corresponding to specifiers in 'dmas'.
    $ref: /schemas/types.yaml#/definitions/string-array
    items:
      - const: rx
      - const: tx

required:
  - compatible
  - reg
  - interrupts

additionalProperties: false

examples:
  - |
    mmc0: mmc@1c40000 {
        compatible = "ti,da830-mmc";
        reg = <0x40000 0x1000>;
        interrupts = <16>;
        bus-width = <4>;
        max-frequency = <50000000>;
        dmas = <&edma 16
            &edma 17>;
        dma-names = "rx", "tx";
    };
```

## Documentation/devicetree/bindings/mmc/ti,omap2420-mmc.yaml
```yaml
# SPDX-License-Identifier: (GPL-2.0-only OR BSD-2-Clause)
# Copyright 2018 Linaro Ltd.
%YAML 1.2
---
$id: http://devicetree.org/schemas/mmc/ti,omap2420-mmc.yaml#
$schema: http://devicetree.org/meta-schemas/core.yaml#

title: TI OMAP2420 MMC Host Controller

maintainers:
  - Mike Maslenkin <mike.maslenkin@gmail.com>
  - Tony Lindgren <tony@atomide.com>

description: |
  * TI MMC host controller for OMAP1 and 2420

  The MMC Host Controller on TI OMAP1 and 2420 family provides
  an interface for MMC, SD, and SDIO types of memory cards.

  This file documents differences between the core properties described
  by mmc.txt and the properties used by the omap mmc driver.

  Note that this driver will not work with omap2430 or later omaps,
  please see the omap hsmmc driver for the current omaps.

properties:
  compatible:
    items:
      - const: ti,omap2420-mmc
  reg:
    description: Physical address and size of the MMC controller registers.
  interrupts:
    description: Interrupt line used by the MMC controller.
    items:
      - description: Interrupt number.
  dmas:
    description: DMA controller phandles and channel indexes.
    items:
      - description: TX DMA channel phandle and index
      - description: RX DMA channel phandle and index
  dma-names:
    description: Names corresponding to each DMA channel.
    items:
      - const: tx
      - const: rx
  ti,hwmods:
    description: TI specific hwmods identifier, must be "msdi<n>" where n is the controller instance starting from 1.
    $ref: /schemas/types.yaml#/definitions/string

required:
  - compatible
  - ti,hwmods
  - reg
  - interrupts

additionalProperties: false

examples:
  - |
    msdi1: mmc@4809c000 {
        compatible = "ti,omap2420-mmc";
        ti,hwmods = "msdi1";
        reg = <0x4809c000 0x80>;
        interrupts = <83>;
        dmas = <&sdma 61 &sdma 62>;
        dma-names = "tx", "rx";
    };
```

## Documentation/devicetree/bindings/mmc/ti-omap-hsmmc.yaml
```yaml
%YAML 1.2
---
$id: http://devicetree.org/schemas/mmc/ti-omap-hsmmc.yaml#
$schema: http://devicetree.org/meta-schemas/core.yaml#

title: TI Highspeed MMC host controller for OMAP and 66AK2G family

maintainers:
  - Andreas Fenkart <afenkart@gmail.com>
  - Arnd Bergmann <arnd@arndb.de>
  - Bjorn Helgaas <bhelgaas@google.com>
  - Chris Ball <cjb@laptop.org>
  - Hebbar, Gururaja <gururaja.hebbar@ti.com>
  - Kishon Vijay Abraham I <kishon@kernel.org>
  - Lokesh Vutla <lokeshvutla@ti.com>
  - Mathieu Malaterre <malat@debian.org>
  - Matt Porter <mporter@ti.com>
  - Mauro Carvalho Chehab <mchehab+huawei@kernel.org>
  - Nishanth Menon <nm@ti.com>
  - Rajendra Nayak <rnayak@ti.com>
  - Tomas Paukrt <tomaspaukrt@email.cz>
description: |
  * TI Highspeed MMC host controller for OMAP and 66AK2G family.

  The Highspeed MMC Host Controller on TI OMAP and 66AK2G family
  provides an interface for MMC, SD, and SDIO types of memory cards.

  This file documents differences between the core properties described
  by mmc.txt and the properties used by the omap_hsmmc driver.

  [workaround for missing swakeup on am33xx]

  This SOC is missing the swakeup line, it will not detect SDIO irq
  while in suspend.

                               ------
                               | PRCM |
                                ------
                                 ^ |
                         swakeup | | fclk
                                 | v
         ------                -------               -----
        | card | -- CIRQ -->  | hsmmc | -- IRQ -->  | CPU |
         ------                -------               -----

  In suspend the fclk is off and the module is dysfunctional. Even register reads
  will fail. A small logic in the host will request fclk restore, when an
  external event is detected. Once the clock is restored, the host detects the
  event normally. Since am33xx doesn't have this line it never wakes from
  suspend.

  The workaround is to reconfigure the dat1 line as a GPIO upon suspend. To make
  this work, we need to set the named pinctrl states "default" and "idle".
  Prepare idle to remux dat1 as a gpio, and default to remux it back as sdio
  dat1. The MMC driver will then toggle between idle and default state during
  runtime.

  In summary:
  1. select matching 'compatible' section, see example below.
  2. specify pinctrl states "default" and "idle", "sleep" is optional.
  3. specify the gpio irq used for detecting sdio irq in suspend

  If configuration is incomplete, a warning message is emitted "falling back to
  polling". Also check the "sdio irq mode" in /sys/kernel/debug/mmc0/regs. Mind
  not every application needs SDIO irq, e.g. MMC cards.

properties:
  compatible:
    enum:
      - ti,omap2-hsmmc
      - ti,omap3-hsmmc
      - ti,omap3-pre-es3-hsmmc
      - ti,omap4-hsmmc
      - ti,am33xx-hsmmc
      - ti,k2g-hsmmc

  ti,hwmods:
    description: Must be "mmc<n>", n is controller instance starting 1.
    pattern: '^mmc[0-9]+$'

  power-domains:
    description: |
      Should contain a phandle to a PM domain provider node and an args specifier
      containing the MMC device id value. This property is as per the binding
      Documentation/devicetree/bindings/soc/ti/sci-pm-domain.yaml
    $ref: /schemas/types.yaml#/definitions/phandle-array

  clocks:
    description: |
      Must contain an entry for each entry in clock-names. Should be defined as per
      the appropriate clock bindings consumer usage in
      Documentation/devicetree/bindings/clock/ti,sci-clk.yaml
    maxItems: 2

  clock-names:
    items:
      - const: fck
      - const: mmchsdb_fck

  ti,dual-volt:
    description: Supports dual voltage cards.
    type: boolean

  vmmc-supply:
    description: Phandle to the regulator device tree node.

  vmmc_aux-supply:
    description: Phandle to the regulator device tree node. Deprecated.
    deprecated: true

  vqmmc-supply:
    description: Phandle to the regulator device tree node.

  ti,non-removable:
    description: Non-removable slot (like eMMC).
    type: boolean

  ti,needs-special-reset:
    description: Requires a special softreset sequence.
    type: boolean

  ti,needs-special-hs-handling:
    description: HSMMC IP needs special setting for handling High Speed.
    type: boolean

  dmas:
    description: |
      List of DMA specifiers with the controller specific format as described in
      the generic DMA client binding. A tx and rx specifier is required.
    $ref: /schemas/types.yaml#/definitions/phandle-array

  dma-names:
    description: |
      List of DMA request names. These strings correspond 1:1 with the DMA specifiers
      listed in dmas. The string naming is to be "rx" and "tx" for RX and TX DMA
      requests, respectively.
    items:
      - const: rx
      - const: tx

  pinctrl-names:
    description: Pin controller state names.
    $ref: /schemas/types.yaml#/definitions/string-array
    items:
      - const: default
      - const: idle
      - const: sleep

  interrupts:
    description: GPIO IRQ used for detecting SDIO IRQ in suspend.
    maxItems: 1

required:
  - compatible

allOf:
  - if:
      properties:
        compatible:
          contains:
            const: ti,omap2-hsmmc
    then:
      required: [ti, hwmods]

  - if:
      properties:
        compatible:
          contains:
            const: ti,omap3-hsmmc
    then:
      required: [ti, hwmods]

  - if:
      properties:
        compatible:
          contains:
            const: ti,omap3-pre-es3-hsmmc
    then:
      required: [ti, hwmods]

  - if:
      properties:
        compatible:
          contains:
            const: ti,omap4-hsmmc
    then:
      required: [ti, hwmods]

  - if:
      properties:
        compatible:
          contains:
            const: ti,am33xx-hsmmc
    then:
      required: [ti, hwmods]

  - if:
      properties:
        compatible:
          contains:
            const: ti,k2g-hsmmc
    then:
      required: [power-domains, clocks, clock-names]

additionalProperties: false
```

## Documentation/devicetree/bindings/mtd/atmel,at91rm9200-nand-controller.yaml
```yaml
%YAML 1.2
---
$id: http://devicetree.org/schemas/mtd/atmel,at91rm9200-nand-controller.yaml#
$schema: http://devicetree.org/meta-schemas/core.yaml#

title: Atmel NAND flash controller

maintainers:
  - Boris Brezillon <bbrezillon@kernel.org>
  - Claudiu Beznea <claudiu.beznea@tuxon.dev>
  - Jean-Christophe PLAGNIOL-VILLARD <plagnioj@jcrosoft.com>
  - Josh Wu <josh.wu@atmel.com>
  - Josh Wu <Josh.wu@atmel.com>
  - Miquel Raynal <miquel.raynal@bootlin.com>
  - Nicolas Ferre <nicolas.ferre@microchip.com>
  - Rob Herring (Arm) <robh@kernel.org>
  - Romain Izard <romain.izard.pro@gmail.com>
  - Tudor Ambarus <tudor.ambarus@linaro.org>
  - Varshini Rajendran <varshini.rajendran@microchip.com>
  - Wenyou Yang <wenyou.yang@atmel.com>
  - Wu, Josh <Josh.wu@atmel.com>

description: |
  Atmel NAND flash controller bindings

  The NAND flash controller node should be defined under the EBI bus (see
  Documentation/devicetree/bindings/memory-controllers/atmel,ebi.yaml).
  One or several NAND devices can be defined under this NAND controller.
  The NAND controller might be connected to an ECC engine.

properties:
  compatible:
    description: Supported compatible strings for the NAND controller
    items:
      - enum:
          - atmel,at91rm9200-nand-controller
          - atmel,at91sam9260-nand-controller
          - atmel,at91sam9261-nand-controller
          - atmel,at91sam9g45-nand-controller
          - atmel,sama5d3-nand-controller
          - microchip,sam9x60-nand-controller

  ranges:
    description: Empty ranges property to forward EBI ranges definitions

  '#address-cells':
    description: Must be set to 2
    const: 2

  '#size-cells':
    description: Must be set to 1
    const: 1

  atmel,nfc-io:
    description: Phandle to the NFC IO block (only for sama5d3 controllers)
    $ref: /schemas/types.yaml#/definitions/phandle

  atmel,nfc-sram:
    description: Phandle to the NFC SRAM block (only for sama5d3 controllers)
    $ref: /schemas/types.yaml#/definitions/phandle

  ecc-engine:
    description: Phandle to the PMECC block (optional, for SoCs with a PMECC engine)
    $ref: /schemas/types.yaml#/definitions/phandle

required:
  - compatible
  - ranges
  - '#address-cells'
  - '#size-cells'

additionalProperties: false

examples:
  - |
    nand_controller: nand-controller@0 {
        compatible = "atmel,sama5d3-nand-controller";
        atmel,nfc-sram = <&nfc_sram>;
        atmel,nfc-io = <&nfc_io>;
        ecc-engine = <&pmecc>;
        #address-cells = <2>;
        #size-cells = <1>;
        ranges;
    };
```
